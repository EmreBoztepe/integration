ASAP2_VERSION 1 6
/begin PROJECT ECEMTAG_CR8 ""
/begin MODULE DIM ""
/begin MOD_COMMON "Mod Common Comment Here" DEPOSIT ABSOLUTE BYTE_ORDER MSB_FIRST /end MOD_COMMON
/begin RECORD_LAYOUT FLOAT32_IEEE FNC_VALUES 1 FLOAT32_IEEE ROW_DIR DIRECT /end RECORD_LAYOUT
/begin RECORD_LAYOUT ULONG FNC_VALUES 1 ULONG ROW_DIR DIRECT /end RECORD_LAYOUT
/begin RECORD_LAYOUT UBYTE FNC_VALUES 1 UBYTE ROW_DIR DIRECT /end RECORD_LAYOUT
/******************************* From MATLAB ***************************************/ /* MATLAB_SECTION_START_1 */
/begin RECORD_LAYOUT Scalar_BOOLEAN FNC_VALUES 1 UBYTE ROW_DIR DIRECT /end RECORD_LAYOUT
/begin RECORD_LAYOUT Scalar_ULONG FNC_VALUES 1 ULONG ROW_DIR DIRECT /end RECORD_LAYOUT
/begin RECORD_LAYOUT Scalar_FLOAT32_IEEE FNC_VALUES 1 FLOAT32_IEEE ROW_DIR DIRECT /end RECORD_LAYOUT
/begin RECORD_LAYOUT Lookup1D_SLONG FNC_VALUES 1 SLONG ROW_DIR DIRECT /end RECORD_LAYOUT
/begin RECORD_LAYOUT Lookup1D_X_LONG AXIS_PTS_X 1 SLONG INDEX_INCR DIRECT /end RECORD_LAYOUT
/begin RECORD_LAYOUT Lookup1D_FLOAT32_IEEE FNC_VALUES 1 FLOAT32_IEEE ROW_DIR DIRECT /end RECORD_LAYOUT
/begin RECORD_LAYOUT Lookup1D_X_FLOAT32_IEEE AXIS_PTS_X 1 FLOAT32_IEEE INDEX_INCR DIRECT /end RECORD_LAYOUT
/begin RECORD_LAYOUT Lookup1D_FLOAT64_IEEE FNC_VALUES 1 FLOAT64_IEEE ROW_DIR DIRECT /end RECORD_LAYOUT
/begin RECORD_LAYOUT Lookup1D_X_FLOAT64_IEEE AXIS_PTS_X 1 FLOAT64_IEEE INDEX_INCR DIRECT /end RECORD_LAYOUT
/begin RECORD_LAYOUT Lookup2D_BOOLEAN FNC_VALUES 1 UBYTE ROW_DIR DIRECT /end RECORD_LAYOUT
/begin RECORD_LAYOUT Lookup2D_X_BOOLEAN AXIS_PTS_X 1 UBYTE INDEX_INCR DIRECT /end RECORD_LAYOUT
/begin RECORD_LAYOUT Lookup2D_UBYTE FNC_VALUES 1 UBYTE ROW_DIR DIRECT /end RECORD_LAYOUT
/begin RECORD_LAYOUT Lookup2D_FLOAT32_IEEE FNC_VALUES 1 FLOAT32_IEEE ROW_DIR DIRECT /end RECORD_LAYOUT
/begin RECORD_LAYOUT Lookup2D_X_FLOAT32_IEEE AXIS_PTS_X 1 FLOAT32_IEEE INDEX_INCR DIRECT /end RECORD_LAYOUT
/begin CHARACTERISTIC IC_InjChartc1_M "Injector 1 Characteristic Map" MAP 0x400450E0 /* @ECU_Address@IC_InjChartc1_M@ */ Lookup2D_FLOAT32_IEEE 0 EcuIntgdSwGend_CM_single_us 0.0 10000.0
 /begin AXIS_DESCR COM_AXIS EIP_PRail EcuIntgdSwGend_CM_single_bar 10 0.0 5000.0 AXIS_PTS_REF IC_PRailForDurInj_A /end AXIS_DESCR
 /begin AXIS_DESCR COM_AXIS IC_MMaiFuQntyCorrdCyl1 EcuIntgdSwGend_CM_single_mm_3_stk 15 0.0 5000.0 AXIS_PTS_REF IC_MFuQntyLimdForDurInj_A /end AXIS_DESCR
/end CHARACTERISTIC
/begin AXIS_PTS IC_PRailForDurInj_A "Rail Pressure Map Axis for Injector Characteristic Maps" 0x40045F7C /* @ECU_Address@IC_PRailForDurInj_A@ */ EIP_PRail Lookup2D_X_FLOAT32_IEEE 0 EcuIntgdSwGend_CM_single_bar 10 0.0 5000.0 /end AXIS_PTS
/begin AXIS_PTS IC_MFuQntyLimdForDurInj_A "Limited Fuel Quantity Mass For Injection Duration" 0x40045CFC /* @ECU_Address@IC_MFuQntyLimdForDurInj_A@ */ IC_MMaiFuQntyCorrdCyl1 Lookup2D_X_FLOAT32_IEEE 0 EcuIntgdSwGend_CM_single_mm_3_stk 15 0.0 5000.0 /end AXIS_PTS
/begin CHARACTERISTIC IC_InjChartc2_M "Injector 2 Characteristic Map" MAP 0x40045338 /* @ECU_Address@IC_InjChartc2_M@ */ Lookup2D_FLOAT32_IEEE 0 EcuIntgdSwGend_CM_single_us 0.0 10000.0
 /begin AXIS_DESCR COM_AXIS EIP_PRail EcuIntgdSwGend_CM_single_bar 10 0.0 5000.0 AXIS_PTS_REF IC_PRailForDurInj_A /end AXIS_DESCR
 /begin AXIS_DESCR COM_AXIS IC_MMaiFuQntyCorrdCyl1 EcuIntgdSwGend_CM_single_mm_3_stk 15 0.0 5000.0 AXIS_PTS_REF IC_MFuQntyLimdForDurInj_A /end AXIS_DESCR
/end CHARACTERISTIC
/begin CHARACTERISTIC IC_InjChartc3_M "Injector 3 Characteristic Map" MAP 0x40045590 /* @ECU_Address@IC_InjChartc3_M@ */ Lookup2D_FLOAT32_IEEE 0 EcuIntgdSwGend_CM_single_us 0.0 10000.0
 /begin AXIS_DESCR COM_AXIS EIP_PRail EcuIntgdSwGend_CM_single_bar 10 0.0 5000.0 AXIS_PTS_REF IC_PRailForDurInj_A /end AXIS_DESCR
 /begin AXIS_DESCR COM_AXIS IC_MMaiFuQntyCorrdCyl1 EcuIntgdSwGend_CM_single_mm_3_stk 15 0.0 5000.0 AXIS_PTS_REF IC_MFuQntyLimdForDurInj_A /end AXIS_DESCR
/end CHARACTERISTIC
/begin CHARACTERISTIC IC_InjChartc4_M "Injector 4 Characteristic Map" MAP 0x400457E8 /* @ECU_Address@IC_InjChartc4_M@ */ Lookup2D_FLOAT32_IEEE 0 EcuIntgdSwGend_CM_single_us 0.0 10000.0
 /begin AXIS_DESCR COM_AXIS EIP_PRail EcuIntgdSwGend_CM_single_bar 10 0.0 5000.0 AXIS_PTS_REF IC_PRailForDurInj_A /end AXIS_DESCR
 /begin AXIS_DESCR COM_AXIS IC_MMaiFuQntyCorrdCyl1 EcuIntgdSwGend_CM_single_mm_3_stk 15 0.0 5000.0 AXIS_PTS_REF IC_MFuQntyLimdForDurInj_A /end AXIS_DESCR
/end CHARACTERISTIC
/begin CHARACTERISTIC IC_InjChartc5_M "Injector 5 Characteristic Map" MAP 0x40045A40 /* @ECU_Address@IC_InjChartc5_M@ */ Lookup2D_FLOAT32_IEEE 0 EcuIntgdSwGend_CM_single_us 0.0 10000.0
 /begin AXIS_DESCR COM_AXIS EIP_PRail EcuIntgdSwGend_CM_single_bar 10 0.0 5000.0 AXIS_PTS_REF IC_PRailForDurInj_A /end AXIS_DESCR
 /begin AXIS_DESCR COM_AXIS IC_MMaiFuQntyCorrdCyl1 EcuIntgdSwGend_CM_single_mm_3_stk 15 0.0 5000.0 AXIS_PTS_REF IC_MFuQntyLimdForDurInj_A /end AXIS_DESCR
/end CHARACTERISTIC
/begin CHARACTERISTIC IC_SoiMainInjSetPoint1_M "Start of Main Injection Set Point Calculation Map 1" MAP 0x4004605C /* @ECU_Address@IC_SoiMainInjSetPoint1_M@ */ Lookup2D_FLOAT32_IEEE 0 EcuIntgdSwGend_CM_single_deg -100.0 500.0
 /begin AXIS_DESCR COM_AXIS IC_MMaiFuQntyCorrd EcuIntgdSwGend_CM_single_mm_3_stk 25 0.0 5000.0 AXIS_PTS_REF IC_MMaiFuQntyCorrdForSoiMainInj_A /end AXIS_DESCR
 /begin AXIS_DESCR COM_AXIS EIP_NEng EcuIntgdSwGend_CM_single_rpm 25 0.0 5000.0 AXIS_PTS_REF IC_NEngForSoiMainInj_A /end AXIS_DESCR
/end CHARACTERISTIC
/begin AXIS_PTS IC_MMaiFuQntyCorrdForSoiMainInj_A "Total Fuel Quantity Map Axis for Start of Pilot Injection Set Point Calcluation for Main Injection Map" 0x40045D38 /* @ECU_Address@IC_MMaiFuQntyCorrdForSoiMainInj_A@ */ IC_MMaiFuQntyCorrd Lookup2D_X_FLOAT32_IEEE 0 EcuIntgdSwGend_CM_single_mm_3_stk 25 0.0 5000.0 /end AXIS_PTS
/begin AXIS_PTS IC_NEngForSoiMainInj_A "Engine Speed Map Axis for Main Start of Injection Set Point Calculation Maps" 0x40045E00 /* @ECU_Address@IC_NEngForSoiMainInj_A@ */ EIP_NEng Lookup2D_X_FLOAT32_IEEE 0 EcuIntgdSwGend_CM_single_rpm 25 0.0 5000.0 /end AXIS_PTS
/begin CHARACTERISTIC IC_SoiMainInjSetPoint2_M "Start of Main Injection Set Point Calculation Map 2" MAP 0x40046A20 /* @ECU_Address@IC_SoiMainInjSetPoint2_M@ */ Lookup2D_FLOAT32_IEEE 0 EcuIntgdSwGend_CM_single_deg -100.0 500.0
 /begin AXIS_DESCR COM_AXIS IC_MMaiFuQntyCorrd EcuIntgdSwGend_CM_single_mm_3_stk 25 0.0 5000.0 AXIS_PTS_REF IC_MMaiFuQntyCorrdForSoiMainInj_A /end AXIS_DESCR
 /begin AXIS_DESCR COM_AXIS EIP_NEng EcuIntgdSwGend_CM_single_rpm 25 0.0 5000.0 AXIS_PTS_REF IC_NEngForSoiMainInj_A /end AXIS_DESCR
/end CHARACTERISTIC
/begin CHARACTERISTIC IC_SoiMainInjSetPoint3_M "Start of Main Injection Set Point Calculation Map 3" MAP 0x400473E4 /* @ECU_Address@IC_SoiMainInjSetPoint3_M@ */ Lookup2D_FLOAT32_IEEE 0 EcuIntgdSwGend_CM_single_deg -100.0 500.0
 /begin AXIS_DESCR COM_AXIS IC_MMaiFuQntyCorrd EcuIntgdSwGend_CM_single_mm_3_stk 25 0.0 5000.0 AXIS_PTS_REF IC_MMaiFuQntyCorrdForSoiMainInj_A /end AXIS_DESCR
 /begin AXIS_DESCR COM_AXIS EIP_NEng EcuIntgdSwGend_CM_single_rpm 25 0.0 5000.0 AXIS_PTS_REF IC_NEngForSoiMainInj_A /end AXIS_DESCR
/end CHARACTERISTIC
/begin CHARACTERISTIC IC_SoiPltInjSetPoint1_M "Start of Pilot Injection Set Point Calculation Map 1" MAP 0x40047DB4 /* @ECU_Address@IC_SoiPltInjSetPoint1_M@ */ Lookup2D_FLOAT32_IEEE 0 EcuIntgdSwGend_CM_single_deg -100.0 500.0
 /begin AXIS_DESCR COM_AXIS IC_MMaiFuQntyCorrd EcuIntgdSwGend_CM_single_mm_3_stk 10 0.0 5000.0 AXIS_PTS_REF IC_MMaiFuQntyCorrdForSoiPltInj_A /end AXIS_DESCR
 /begin AXIS_DESCR COM_AXIS EIP_NEng EcuIntgdSwGend_CM_single_rpm 15 0.0 5000.0 AXIS_PTS_REF IC_NEngForSoiPltInj_A /end AXIS_DESCR
/end CHARACTERISTIC
/begin AXIS_PTS IC_MMaiFuQntyCorrdForSoiPltInj_A "Total Fuel Quantity Map Axis for Start of Pilot Injection Set Point Calcluation for Pilot Injection Map" 0x40045D9C /* @ECU_Address@IC_MMaiFuQntyCorrdForSoiPltInj_A@ */ IC_MMaiFuQntyCorrd Lookup2D_X_FLOAT32_IEEE 0 EcuIntgdSwGend_CM_single_mm_3_stk 10 0.0 5000.0 /end AXIS_PTS
/begin AXIS_PTS IC_NEngForSoiPltInj_A "Engine Speed Map Axis for Pilot Start of Injection Set Point Calculation Maps" 0x40045E64 /* @ECU_Address@IC_NEngForSoiPltInj_A@ */ EIP_NEng Lookup2D_X_FLOAT32_IEEE 0 EcuIntgdSwGend_CM_single_rpm 15 0.0 5000.0 /end AXIS_PTS
/begin CHARACTERISTIC IC_SoiPltInjSetPoint2_M "Start of Pilot Injection Set Point Calculation Map 2" MAP 0x4004800C /* @ECU_Address@IC_SoiPltInjSetPoint2_M@ */ Lookup2D_FLOAT32_IEEE 0 EcuIntgdSwGend_CM_single_deg -100.0 500.0
 /begin AXIS_DESCR COM_AXIS IC_MMaiFuQntyCorrd EcuIntgdSwGend_CM_single_mm_3_stk 10 0.0 5000.0 AXIS_PTS_REF IC_MMaiFuQntyCorrdForSoiPltInj_A /end AXIS_DESCR
 /begin AXIS_DESCR COM_AXIS EIP_NEng EcuIntgdSwGend_CM_single_rpm 15 0.0 5000.0 AXIS_PTS_REF IC_NEngForSoiPltInj_A /end AXIS_DESCR
/end CHARACTERISTIC
/begin CHARACTERISTIC IC_SoiPltInjSetPoint3_M "Start of Pilot Injection Set Point Calculation Map 3" MAP 0x40048264 /* @ECU_Address@IC_SoiPltInjSetPoint3_M@ */ Lookup2D_FLOAT32_IEEE 0 EcuIntgdSwGend_CM_single_deg -100.0 500.0
 /begin AXIS_DESCR COM_AXIS IC_MMaiFuQntyCorrd EcuIntgdSwGend_CM_single_mm_3_stk 10 0.0 5000.0 AXIS_PTS_REF IC_MMaiFuQntyCorrdForSoiPltInj_A /end AXIS_DESCR
 /begin AXIS_DESCR COM_AXIS EIP_NEng EcuIntgdSwGend_CM_single_rpm 15 0.0 5000.0 AXIS_PTS_REF IC_NEngForSoiPltInj_A /end AXIS_DESCR
/end CHARACTERISTIC
/begin CHARACTERISTIC WM_UClmp30OvLvl1_M "Battery Voltage Over Level 1 Map" CURVE 0x400515F8 /* @ECU_Address@WM_UClmp30OvLvl1_M@ */ Lookup1D_FLOAT32_IEEE 0 EcuIntgdSwGend_CM_single_V 0.0 50.0
 /begin AXIS_DESCR COM_AXIS EIP_NEng EcuIntgdSwGend_CM_single_rpm 5 0.0 6000.0 AXIS_PTS_REF WM_NEng_A /end AXIS_DESCR
/end CHARACTERISTIC
/begin AXIS_PTS WM_NEng_A "Engine Speed Map Axis" 0x40050F48 /* @ECU_Address@WM_NEng_A@ */ EIP_NEng Lookup1D_X_FLOAT32_IEEE 0 EcuIntgdSwGend_CM_single_rpm 5 0.0 6000.0 /end AXIS_PTS
/begin CHARACTERISTIC WM_UClmp30OvLvl2_M "Battery Voltage Under Level 2 Map" CURVE 0x4005160C /* @ECU_Address@WM_UClmp30OvLvl2_M@ */ Lookup1D_FLOAT32_IEEE 0 EcuIntgdSwGend_CM_single_V 0.0 50.0
 /begin AXIS_DESCR COM_AXIS EIP_NEng EcuIntgdSwGend_CM_single_rpm 5 0.0 6000.0 AXIS_PTS_REF WM_NEng_A /end AXIS_DESCR
/end CHARACTERISTIC
/begin CHARACTERISTIC WM_UClmp30OvLvl3_M "Battery Voltage Under Level 3 Map" CURVE 0x40051620 /* @ECU_Address@WM_UClmp30OvLvl3_M@ */ Lookup1D_FLOAT32_IEEE 0 EcuIntgdSwGend_CM_single_V 0.0 50.0
 /begin AXIS_DESCR COM_AXIS EIP_NEng EcuIntgdSwGend_CM_single_rpm 5 0.0 6000.0 AXIS_PTS_REF WM_NEng_A /end AXIS_DESCR
/end CHARACTERISTIC
/begin CHARACTERISTIC WM_UClmp30UndLvl1_M "Battery Voltage Under Level 1 Map" CURVE 0x40051644 /* @ECU_Address@WM_UClmp30UndLvl1_M@ */ Lookup1D_FLOAT32_IEEE 0 EcuIntgdSwGend_CM_single_V 0.0 50.0
 /begin AXIS_DESCR COM_AXIS EIP_NEng EcuIntgdSwGend_CM_single_rpm 5 0.0 6000.0 AXIS_PTS_REF WM_NEng_A /end AXIS_DESCR
/end CHARACTERISTIC
/begin CHARACTERISTIC WM_UClmp30UndLvl2_M "Battery Voltage Under Level 2 Map" CURVE 0x40051658 /* @ECU_Address@WM_UClmp30UndLvl2_M@ */ Lookup1D_FLOAT32_IEEE 0 EcuIntgdSwGend_CM_single_V 0.0 50.0
 /begin AXIS_DESCR COM_AXIS EIP_NEng EcuIntgdSwGend_CM_single_rpm 5 0.0 6000.0 AXIS_PTS_REF WM_NEng_A /end AXIS_DESCR
/end CHARACTERISTIC
/begin CHARACTERISTIC WM_UClmp30UndLvl3_M "Battery Voltage Under Level 3 Map" CURVE 0x4005166C /* @ECU_Address@WM_UClmp30UndLvl3_M@ */ Lookup1D_FLOAT32_IEEE 0 EcuIntgdSwGend_CM_single_V 0.0 50.0
 /begin AXIS_DESCR COM_AXIS EIP_NEng EcuIntgdSwGend_CM_single_rpm 5 0.0 6000.0 AXIS_PTS_REF WM_NEng_A /end AXIS_DESCR
/end CHARACTERISTIC
/begin CHARACTERISTIC WM_LvlOilLvl1_M "Oil Level Under Level 1 Map" CURVE 0x40050BFC /* @ECU_Address@WM_LvlOilLvl1_M@ */ Lookup1D_FLOAT32_IEEE 0 EcuIntgdSwGend_CM_single__ 0.0 100.0
 /begin AXIS_DESCR COM_AXIS EIP_NEng EcuIntgdSwGend_CM_single_rpm 5 0.0 6000.0 AXIS_PTS_REF WM_NEng_A /end AXIS_DESCR
/end CHARACTERISTIC
/begin CHARACTERISTIC WM_LvlOilLvl2_M "Oil Level Under Level 2 Map" CURVE 0x40050C10 /* @ECU_Address@WM_LvlOilLvl2_M@ */ Lookup1D_FLOAT32_IEEE 0 EcuIntgdSwGend_CM_single__ 0.0 100.0
 /begin AXIS_DESCR COM_AXIS EIP_NEng EcuIntgdSwGend_CM_single_rpm 5 0.0 6000.0 AXIS_PTS_REF WM_NEng_A /end AXIS_DESCR
/end CHARACTERISTIC
/begin CHARACTERISTIC WM_LvlOilUndLvl3_M "Oil Level Under Level 3 Map" CURVE 0x40050C34 /* @ECU_Address@WM_LvlOilUndLvl3_M@ */ Lookup1D_FLOAT32_IEEE 0 EcuIntgdSwGend_CM_single__ 0.0 100.0
 /begin AXIS_DESCR COM_AXIS EIP_NEng EcuIntgdSwGend_CM_single_rpm 5 0.0 6000.0 AXIS_PTS_REF WM_NEng_A /end AXIS_DESCR
/end CHARACTERISTIC
/begin CHARACTERISTIC WM_PAirBoostOvLvl1_M "Air Boost Pressure Over Level 1 Map" CURVE 0x40050F6C /* @ECU_Address@WM_PAirBoostOvLvl1_M@ */ Lookup1D_FLOAT32_IEEE 0 EcuIntgdSwGend_CM_single_mbar 0.0 15000.0
 /begin AXIS_DESCR COM_AXIS EIP_NEng EcuIntgdSwGend_CM_single_rpm 5 0.0 6000.0 AXIS_PTS_REF WM_NEng_A /end AXIS_DESCR
/end CHARACTERISTIC
/begin CHARACTERISTIC WM_PAirBoostOvLvl2_M "Air Boost Pressure Over Level 2 Map" CURVE 0x40050F80 /* @ECU_Address@WM_PAirBoostOvLvl2_M@ */ Lookup1D_FLOAT32_IEEE 0 EcuIntgdSwGend_CM_single_mbar 0.0 15000.0
 /begin AXIS_DESCR COM_AXIS EIP_NEng EcuIntgdSwGend_CM_single_rpm 5 0.0 6000.0 AXIS_PTS_REF WM_NEng_A /end AXIS_DESCR
/end CHARACTERISTIC
/begin CHARACTERISTIC WM_PAirBoostOvLvl3_M "Air Boost Pressure Over Level 3 Map" CURVE 0x40050F94 /* @ECU_Address@WM_PAirBoostOvLvl3_M@ */ Lookup1D_FLOAT32_IEEE 0 EcuIntgdSwGend_CM_single_mbar 0.0 15000.0
 /begin AXIS_DESCR COM_AXIS EIP_NEng EcuIntgdSwGend_CM_single_rpm 5 0.0 6000.0 AXIS_PTS_REF WM_NEng_A /end AXIS_DESCR
/end CHARACTERISTIC
/begin CHARACTERISTIC WM_PAirBoostUndLvl1_M "Air Boost Pressure Under Level 1 Map" CURVE 0x40050FB8 /* @ECU_Address@WM_PAirBoostUndLvl1_M@ */ Lookup1D_FLOAT32_IEEE 0 EcuIntgdSwGend_CM_single_mbar 0.0 15000.0
 /begin AXIS_DESCR COM_AXIS EIP_NEng EcuIntgdSwGend_CM_single_rpm 5 0.0 6000.0 AXIS_PTS_REF WM_NEng_A /end AXIS_DESCR
/end CHARACTERISTIC
/begin CHARACTERISTIC WM_PAirBoostUndLvl2_M "Air Boost Pressure Under Level 2 Map" CURVE 0x40050FCC /* @ECU_Address@WM_PAirBoostUndLvl2_M@ */ Lookup1D_FLOAT32_IEEE 0 EcuIntgdSwGend_CM_single_mbar 0.0 15000.0
 /begin AXIS_DESCR COM_AXIS EIP_NEng EcuIntgdSwGend_CM_single_rpm 5 0.0 6000.0 AXIS_PTS_REF WM_NEng_A /end AXIS_DESCR
/end CHARACTERISTIC
/begin CHARACTERISTIC WM_PAirBoostUndLvl3_M "Air Boost Pressure Under Level 3 Map" CURVE 0x40050FE0 /* @ECU_Address@WM_PAirBoostUndLvl3_M@ */ Lookup1D_FLOAT32_IEEE 0 EcuIntgdSwGend_CM_single_mbar 0.0 15000.0
 /begin AXIS_DESCR COM_AXIS EIP_NEng EcuIntgdSwGend_CM_single_rpm 5 0.0 6000.0 AXIS_PTS_REF WM_NEng_A /end AXIS_DESCR
/end CHARACTERISTIC
/begin CHARACTERISTIC WM_PAmbAirOvLvl1_M "Ambient Air Pressure Over Level 1 Map" CURVE 0x40051004 /* @ECU_Address@WM_PAmbAirOvLvl1_M@ */ Lookup1D_FLOAT32_IEEE 0 EcuIntgdSwGend_CM_single_mbar 0.0 15000.0
 /begin AXIS_DESCR COM_AXIS EIP_NEng EcuIntgdSwGend_CM_single_rpm 5 0.0 6000.0 AXIS_PTS_REF WM_NEng_A /end AXIS_DESCR
/end CHARACTERISTIC
/begin CHARACTERISTIC WM_PAmbAirOvLvl2_M "Ambient Air Pressure Over Level 2 Map" CURVE 0x40051018 /* @ECU_Address@WM_PAmbAirOvLvl2_M@ */ Lookup1D_FLOAT32_IEEE 0 EcuIntgdSwGend_CM_single_mbar 0.0 15000.0
 /begin AXIS_DESCR COM_AXIS EIP_NEng EcuIntgdSwGend_CM_single_rpm 5 0.0 6000.0 AXIS_PTS_REF WM_NEng_A /end AXIS_DESCR
/end CHARACTERISTIC
/begin CHARACTERISTIC WM_PAmbAirOvLvl3_M "Ambient Air Pressure Over Level 3 Map" CURVE 0x4005102C /* @ECU_Address@WM_PAmbAirOvLvl3_M@ */ Lookup1D_FLOAT32_IEEE 0 EcuIntgdSwGend_CM_single_mbar 0.0 15000.0
 /begin AXIS_DESCR COM_AXIS EIP_NEng EcuIntgdSwGend_CM_single_rpm 5 0.0 6000.0 AXIS_PTS_REF WM_NEng_A /end AXIS_DESCR
/end CHARACTERISTIC
/begin CHARACTERISTIC WM_PAmbAirUndLvl1_M "Ambient Air Pressure Under Level 1 Map" CURVE 0x40051050 /* @ECU_Address@WM_PAmbAirUndLvl1_M@ */ Lookup1D_FLOAT32_IEEE 0 EcuIntgdSwGend_CM_single_mbar 0.0 15000.0
 /begin AXIS_DESCR COM_AXIS EIP_NEng EcuIntgdSwGend_CM_single_rpm 5 0.0 6000.0 AXIS_PTS_REF WM_NEng_A /end AXIS_DESCR
/end CHARACTERISTIC
/begin CHARACTERISTIC WM_PAmbAirUndLvl2_M "Ambient Air Pressure Under Level 2 Map" CURVE 0x40051064 /* @ECU_Address@WM_PAmbAirUndLvl2_M@ */ Lookup1D_FLOAT32_IEEE 0 EcuIntgdSwGend_CM_single_mbar 0.0 15000.0
 /begin AXIS_DESCR COM_AXIS EIP_NEng EcuIntgdSwGend_CM_single_rpm 5 0.0 6000.0 AXIS_PTS_REF WM_NEng_A /end AXIS_DESCR
/end CHARACTERISTIC
/begin CHARACTERISTIC WM_PAmbAirUndLvl3_M "Ambient Air Pressure Under Level 3 Map" CURVE 0x40051078 /* @ECU_Address@WM_PAmbAirUndLvl3_M@ */ Lookup1D_FLOAT32_IEEE 0 EcuIntgdSwGend_CM_single_mbar 0.0 15000.0
 /begin AXIS_DESCR COM_AXIS EIP_NEng EcuIntgdSwGend_CM_single_rpm 5 0.0 6000.0 AXIS_PTS_REF WM_NEng_A /end AXIS_DESCR
/end CHARACTERISTIC
/begin CHARACTERISTIC WM_PFuOvLvl1_M "Fuel Pressure Over Level 1 Map" CURVE 0x4005109C /* @ECU_Address@WM_PFuOvLvl1_M@ */ Lookup1D_FLOAT32_IEEE 0 EcuIntgdSwGend_CM_single_mbar 0.0 15000.0
 /begin AXIS_DESCR COM_AXIS EIP_NEng EcuIntgdSwGend_CM_single_rpm 5 0.0 6000.0 AXIS_PTS_REF WM_NEng_A /end AXIS_DESCR
/end CHARACTERISTIC
/begin CHARACTERISTIC WM_PFuOvLvl2_M "Fuel Pressure Over Level 2 Map" CURVE 0x400510B0 /* @ECU_Address@WM_PFuOvLvl2_M@ */ Lookup1D_FLOAT32_IEEE 0 EcuIntgdSwGend_CM_single_mbar 0.0 15000.0
 /begin AXIS_DESCR COM_AXIS EIP_NEng EcuIntgdSwGend_CM_single_rpm 5 0.0 6000.0 AXIS_PTS_REF WM_NEng_A /end AXIS_DESCR
/end CHARACTERISTIC
/begin CHARACTERISTIC WM_PFuOvLvl3_M "Fuel Pressure Over Level 3 Map" CURVE 0x400510C4 /* @ECU_Address@WM_PFuOvLvl3_M@ */ Lookup1D_FLOAT32_IEEE 0 EcuIntgdSwGend_CM_single_mbar 0.0 15000.0
 /begin AXIS_DESCR COM_AXIS EIP_NEng EcuIntgdSwGend_CM_single_rpm 5 0.0 6000.0 AXIS_PTS_REF WM_NEng_A /end AXIS_DESCR
/end CHARACTERISTIC
/begin CHARACTERISTIC WM_PFuUndLvl1_M "Fuel Pressure Under Level 1 Map" CURVE 0x400510E8 /* @ECU_Address@WM_PFuUndLvl1_M@ */ Lookup1D_FLOAT32_IEEE 0 EcuIntgdSwGend_CM_single_mbar 0.0 15000.0
 /begin AXIS_DESCR COM_AXIS EIP_NEng EcuIntgdSwGend_CM_single_rpm 5 0.0 6000.0 AXIS_PTS_REF WM_NEng_A /end AXIS_DESCR
/end CHARACTERISTIC
/begin CHARACTERISTIC WM_PFuUndLvl2_M "Fuel Pressure Under Level 2 Map" CURVE 0x400510FC /* @ECU_Address@WM_PFuUndLvl2_M@ */ Lookup1D_FLOAT32_IEEE 0 EcuIntgdSwGend_CM_single_mbar 0.0 15000.0
 /begin AXIS_DESCR COM_AXIS EIP_NEng EcuIntgdSwGend_CM_single_rpm 5 0.0 6000.0 AXIS_PTS_REF WM_NEng_A /end AXIS_DESCR
/end CHARACTERISTIC
/begin CHARACTERISTIC WM_PFuUndLvl3_M "Fuel Pressure Under Level 3 Map" CURVE 0x40051110 /* @ECU_Address@WM_PFuUndLvl3_M@ */ Lookup1D_FLOAT32_IEEE 0 EcuIntgdSwGend_CM_single_mbar 0.0 15000.0
 /begin AXIS_DESCR COM_AXIS EIP_NEng EcuIntgdSwGend_CM_single_rpm 5 0.0 6000.0 AXIS_PTS_REF WM_NEng_A /end AXIS_DESCR
/end CHARACTERISTIC
/begin CHARACTERISTIC WM_POilOvLvl1_M "Oil Pressure Over Level 1 Map" CURVE 0x40051134 /* @ECU_Address@WM_POilOvLvl1_M@ */ Lookup1D_FLOAT32_IEEE 0 EcuIntgdSwGend_CM_single_mbar 0.0 15000.0
 /begin AXIS_DESCR COM_AXIS EIP_NEng EcuIntgdSwGend_CM_single_rpm 5 0.0 6000.0 AXIS_PTS_REF WM_NEng_A /end AXIS_DESCR
/end CHARACTERISTIC
/begin CHARACTERISTIC WM_POilOvLvl2_M "Oil Pressure Over Level 2 Map" CURVE 0x40051148 /* @ECU_Address@WM_POilOvLvl2_M@ */ Lookup1D_FLOAT32_IEEE 0 EcuIntgdSwGend_CM_single_mbar 0.0 15000.0
 /begin AXIS_DESCR COM_AXIS EIP_NEng EcuIntgdSwGend_CM_single_rpm 5 0.0 6000.0 AXIS_PTS_REF WM_NEng_A /end AXIS_DESCR
/end CHARACTERISTIC
/begin CHARACTERISTIC WM_POilOvLvl3_M "Oil Pressure Over Level 3 Map" CURVE 0x4005115C /* @ECU_Address@WM_POilOvLvl3_M@ */ Lookup1D_FLOAT32_IEEE 0 EcuIntgdSwGend_CM_single_mbar 0.0 15000.0
 /begin AXIS_DESCR COM_AXIS EIP_NEng EcuIntgdSwGend_CM_single_rpm 5 0.0 6000.0 AXIS_PTS_REF WM_NEng_A /end AXIS_DESCR
/end CHARACTERISTIC
/begin CHARACTERISTIC WM_POilUndLvl1_M "Oil Pressure Under Level 1 Map" CURVE 0x40051180 /* @ECU_Address@WM_POilUndLvl1_M@ */ Lookup1D_FLOAT32_IEEE 0 EcuIntgdSwGend_CM_single_mbar 0.0 15000.0
 /begin AXIS_DESCR COM_AXIS EIP_NEng EcuIntgdSwGend_CM_single_rpm 5 0.0 6000.0 AXIS_PTS_REF WM_NEng_A /end AXIS_DESCR
/end CHARACTERISTIC
/begin CHARACTERISTIC WM_POilUndLvl2_M "Oil Pressure Under Level 2 Map" CURVE 0x40051194 /* @ECU_Address@WM_POilUndLvl2_M@ */ Lookup1D_FLOAT32_IEEE 0 EcuIntgdSwGend_CM_single_mbar 0.0 15000.0
 /begin AXIS_DESCR COM_AXIS EIP_NEng EcuIntgdSwGend_CM_single_rpm 5 0.0 6000.0 AXIS_PTS_REF WM_NEng_A /end AXIS_DESCR
/end CHARACTERISTIC
/begin CHARACTERISTIC WM_POilUndLvl3_M "Oil Pressure Under Level 3 Map" CURVE 0x400511A8 /* @ECU_Address@WM_POilUndLvl3_M@ */ Lookup1D_FLOAT32_IEEE 0 EcuIntgdSwGend_CM_single_mbar 0.0 15000.0
 /begin AXIS_DESCR COM_AXIS EIP_NEng EcuIntgdSwGend_CM_single_rpm 5 0.0 6000.0 AXIS_PTS_REF WM_NEng_A /end AXIS_DESCR
/end CHARACTERISTIC
/begin CHARACTERISTIC WM_PRailOvLvl1_M "Rail Pressure Over Level 1 Map" CURVE 0x400511D0 /* @ECU_Address@WM_PRailOvLvl1_M@ */ Lookup1D_FLOAT32_IEEE 0 EcuIntgdSwGend_CM_single_bar 0.0 2500.0
 /begin AXIS_DESCR COM_AXIS EIP_NEng EcuIntgdSwGend_CM_single_rpm 5 0.0 6000.0 AXIS_PTS_REF WM_NEng_A /end AXIS_DESCR
/end CHARACTERISTIC
/begin CHARACTERISTIC WM_PRailOvLvl2_M "Rail Pressure Over Level 2 Map" CURVE 0x400511E4 /* @ECU_Address@WM_PRailOvLvl2_M@ */ Lookup1D_FLOAT32_IEEE 0 EcuIntgdSwGend_CM_single_bar 0.0 2500.0
 /begin AXIS_DESCR COM_AXIS EIP_NEng EcuIntgdSwGend_CM_single_rpm 5 0.0 6000.0 AXIS_PTS_REF WM_NEng_A /end AXIS_DESCR
/end CHARACTERISTIC
/begin CHARACTERISTIC WM_PRailOvLvl3_M "Rail Pressure Over Level 3 Map" CURVE 0x400511F8 /* @ECU_Address@WM_PRailOvLvl3_M@ */ Lookup1D_FLOAT32_IEEE 0 EcuIntgdSwGend_CM_single_bar 0.0 2500.0
 /begin AXIS_DESCR COM_AXIS EIP_NEng EcuIntgdSwGend_CM_single_rpm 5 0.0 6000.0 AXIS_PTS_REF WM_NEng_A /end AXIS_DESCR
/end CHARACTERISTIC
/begin CHARACTERISTIC EIP_NCyl6MinThd_P "Cylinder 6 Speed Minimium Threshold Parameter" VALUE 0x400442BC /* @ECU_Address@EIP_NCyl6MinThd_P@ */ Scalar_FLOAT32_IEEE 0 EcuIntgdSwGend_CM_single_rpm 0.0 3200.0 /end CHARACTERISTIC
/begin CHARACTERISTIC IC_TCooltMap1Thd_P "Coolant High Temperature Map 1 Threshold Parameter" VALUE 0x40048614 /* @ECU_Address@IC_TCooltMap1Thd_P@ */ Scalar_FLOAT32_IEEE 0 EcuIntgdSwGend_CM_single_degC -50.0 150.0 /end CHARACTERISTIC
/begin CHARACTERISTIC IC_TCooltMap2Thd_P "Coolant High Temperature Map 2 Threshold Parameter" VALUE 0x40048618 /* @ECU_Address@IC_TCooltMap2Thd_P@ */ Scalar_FLOAT32_IEEE 0 EcuIntgdSwGend_CM_single_degC -50.0 150.0 /end CHARACTERISTIC
/begin CHARACTERISTIC IC_TCooltMap3Thd_P "Coolant High Temperature Map 3 Threshold Parameter" VALUE 0x4004861C /* @ECU_Address@IC_TCooltMap3Thd_P@ */ Scalar_FLOAT32_IEEE 0 EcuIntgdSwGend_CM_single_degC -50.0 150.0 /end CHARACTERISTIC
/begin CHARACTERISTIC RPG_IntglRstCoeffKiThd_P "Integral Reset Coefficient Integral Threshold Parameter" VALUE 0x4004981C /* @ECU_Address@RPG_IntglRstCoeffKiThd_P@ */ Scalar_FLOAT32_IEEE 0 EcuIntgdSwGend_CM_single -100.0 100.0 /end CHARACTERISTIC
/begin CHARACTERISTIC RPG_IntglRstPRailErrThd_P "Error Rail Pressure Threshold Parameter for Integral Reset" VALUE 0x40049820 /* @ECU_Address@RPG_IntglRstPRailErrThd_P@ */ Scalar_FLOAT32_IEEE 0 EcuIntgdSwGend_CM_single -1000.0 1000.0 /end CHARACTERISTIC
/begin CHARACTERISTIC RPG_IntglRstPercgVCVThd_P "Percentage VCV Threshold Parameter for Integral Reset" VALUE 0x40049824 /* @ECU_Address@RPG_IntglRstPercgVCVThd_P@ */ Scalar_FLOAT32_IEEE 0 EcuIntgdSwGend_CM_single__ 0.0 100.0 /end CHARACTERISTIC
/begin CHARACTERISTIC RPG_TiDebCoeffKiRst_P "Debounce Time Parameter of Coefficient Integral Reset" VALUE 0x4004B118 /* @ECU_Address@RPG_TiDebCoeffKiRst_P@ */ Scalar_FLOAT32_IEEE 0 EcuIntgdSwGend_CM_single 0.0 10000.0 /end CHARACTERISTIC
/begin CHARACTERISTIC WM_ErrCylMisfDesLvlQnty_P "Cylinder Misfire Desired Severity Level Quantity Parameter" VALUE 0x40050BF8 /* @ECU_Address@WM_ErrCylMisfDesLvlQnty_P@ */ Scalar_FLOAT32_IEEE 0 EcuIntgdSwGend_CM_single 0.0 3.0 /end CHARACTERISTIC
/begin CHARACTERISTIC WM_LvlOilUndDesLvlQnty_P "Level Oil Desired Severity Level Quantity Parameter" VALUE 0x40050C24 /* @ECU_Address@WM_LvlOilUndDesLvlQnty_P@ */ Scalar_FLOAT32_IEEE 0 EcuIntgdSwGend_CM_single 0.0 3.0 /end CHARACTERISTIC
/begin CHARACTERISTIC WM_LvlOilUndHysDeacLvl1_P "Oil Level Under Level 1 Hysteresis Deactivation Parameter" VALUE 0x40050C28 /* @ECU_Address@WM_LvlOilUndHysDeacLvl1_P@ */ Scalar_FLOAT32_IEEE 0 EcuIntgdSwGend_CM_single 0.0 100.0 /end CHARACTERISTIC
/begin CHARACTERISTIC WM_LvlOilUndHysDeacLvl2_P "Oil Level Under Level 2 Hysteresis Deactivation Parameter" VALUE 0x40050C2C /* @ECU_Address@WM_LvlOilUndHysDeacLvl2_P@ */ Scalar_FLOAT32_IEEE 0 EcuIntgdSwGend_CM_single 0.0 100.0 /end CHARACTERISTIC
/begin CHARACTERISTIC WM_LvlOilUndHysDeacLvl3_P "Oil Level Under Level 3 Hysteresis Deactivation Parameter" VALUE 0x40050C30 /* @ECU_Address@WM_LvlOilUndHysDeacLvl3_P@ */ Scalar_FLOAT32_IEEE 0 EcuIntgdSwGend_CM_single 0.0 100.0 /end CHARACTERISTIC
/begin CHARACTERISTIC WM_NEngLvl1ClrThd_P "Global Enable Engine Speed Level 1 Check Clear Hysteresis Threshold Parameter" VALUE 0x40050F0C /* @ECU_Address@WM_NEngLvl1ClrThd_P@ */ Scalar_FLOAT32_IEEE 0 EcuIntgdSwGend_CM_single_rpm 0.0 6000.0 /end CHARACTERISTIC
/begin CHARACTERISTIC WM_NEngLvl1DetdThd_P "Global Enable Engine Speed Level 1 Check Hysteresis Threshold Parameter" VALUE 0x40050F10 /* @ECU_Address@WM_NEngLvl1DetdThd_P@ */ Scalar_FLOAT32_IEEE 0 EcuIntgdSwGend_CM_single_rpm 0.0 6000.0 /end CHARACTERISTIC
/begin CHARACTERISTIC WM_NEngLvl2ClrThd_P "Global Enable Engine Speed Level 2 Check Clear Hysteresis Threshold Parameter" VALUE 0x40050F14 /* @ECU_Address@WM_NEngLvl2ClrThd_P@ */ Scalar_FLOAT32_IEEE 0 EcuIntgdSwGend_CM_single_rpm 0.0 6000.0 /end CHARACTERISTIC
/begin CHARACTERISTIC WM_NEngLvl2DetdThd_P "Global Enable Engine Speed Level 2 Check Hysteresis Threshold Parameter" VALUE 0x40050F18 /* @ECU_Address@WM_NEngLvl2DetdThd_P@ */ Scalar_FLOAT32_IEEE 0 EcuIntgdSwGend_CM_single_rpm 0.0 6000.0 /end CHARACTERISTIC
/begin CHARACTERISTIC WM_NEngLvl3ClrThd_P "Global Enable Engine Speed Level 3 Check Clear Hysteresis Threshold Parameter" VALUE 0x40050F1C /* @ECU_Address@WM_NEngLvl3ClrThd_P@ */ Scalar_FLOAT32_IEEE 0 EcuIntgdSwGend_CM_single_rpm 0.0 6000.0 /end CHARACTERISTIC
/begin CHARACTERISTIC WM_NEngLvl3DetdThd_P "Global Enable Engine Speed Level 3 Check Hysteresis Threshold Parameter" VALUE 0x40050F20 /* @ECU_Address@WM_NEngLvl3DetdThd_P@ */ Scalar_FLOAT32_IEEE 0 EcuIntgdSwGend_CM_single_rpm 0.0 6000.0 /end CHARACTERISTIC
/begin CHARACTERISTIC WM_NEngLvl4ClrThd_P "Global Enable Engine Speed Level 4 Check Clear Hysteresis Threshold Parameter" VALUE 0x40050F24 /* @ECU_Address@WM_NEngLvl4ClrThd_P@ */ Scalar_FLOAT32_IEEE 0 EcuIntgdSwGend_CM_single_rpm 0.0 6000.0 /end CHARACTERISTIC
/begin CHARACTERISTIC WM_NEngLvl4DetdThd_P "Global Enable Engine Speed Level 4 Check Hysteresis Threshold Parameter" VALUE 0x40050F28 /* @ECU_Address@WM_NEngLvl4DetdThd_P@ */ Scalar_FLOAT32_IEEE 0 EcuIntgdSwGend_CM_single_rpm 0.0 6000.0 /end CHARACTERISTIC
/begin CHARACTERISTIC WM_NEngLvl5ClrThd_P "Global Enable Engine Speed Level 5 Check Clear Hysteresis Threshold Parameter" VALUE 0x40050F2C /* @ECU_Address@WM_NEngLvl5ClrThd_P@ */ Scalar_FLOAT32_IEEE 0 EcuIntgdSwGend_CM_single_rpm 0.0 6000.0 /end CHARACTERISTIC
/begin CHARACTERISTIC WM_NEngLvl5DetdThd_P "Global Enable Engine Speed Level 5 Check Hysteresis Threshold Parameter" VALUE 0x40050F30 /* @ECU_Address@WM_NEngLvl5DetdThd_P@ */ Scalar_FLOAT32_IEEE 0 EcuIntgdSwGend_CM_single_rpm 0.0 6000.0 /end CHARACTERISTIC
/begin CHARACTERISTIC WM_NEngLvl6ClrThd_P "Global Enable Engine Speed Level 6 Check Clear Hysteresis Threshold Parameter" VALUE 0x40050F34 /* @ECU_Address@WM_NEngLvl6ClrThd_P@ */ Scalar_FLOAT32_IEEE 0 EcuIntgdSwGend_CM_single_rpm 0.0 6000.0 /end CHARACTERISTIC
/begin CHARACTERISTIC WM_NEngLvl6DetdThd_P "Global Enable Engine Speed Level 6 Check Hysteresis Threshold Parameter" VALUE 0x40050F38 /* @ECU_Address@WM_NEngLvl6DetdThd_P@ */ Scalar_FLOAT32_IEEE 0 EcuIntgdSwGend_CM_single_rpm 0.0 6000.0 /end CHARACTERISTIC
/begin CHARACTERISTIC WM_NEngLvl7ClrThd_P "Global Enable Engine Speed Level 7 Check Clear Hysteresis Threshold Parameter" VALUE 0x40050F3C /* @ECU_Address@WM_NEngLvl7ClrThd_P@ */ Scalar_FLOAT32_IEEE 0 EcuIntgdSwGend_CM_single_rpm 0.0 6000.0 /end CHARACTERISTIC
/begin CHARACTERISTIC WM_NEngLvl7DetdThd_P "Global Enable Engine Speed Level 7 Check Hysteresis Threshold Parameter" VALUE 0x40050F40 /* @ECU_Address@WM_NEngLvl7DetdThd_P@ */ Scalar_FLOAT32_IEEE 0 EcuIntgdSwGend_CM_single_rpm 0.0 6000.0 /end CHARACTERISTIC
/begin CHARACTERISTIC WM_PAirBoostOvDesLvlQnty_P "Air Boost Pressure Over Desired Severity Level Quantity Parameter" VALUE 0x40050F5C /* @ECU_Address@WM_PAirBoostOvDesLvlQnty_P@ */ Scalar_FLOAT32_IEEE 0 EcuIntgdSwGend_CM_single 0.0 3.0 /end CHARACTERISTIC
/begin CHARACTERISTIC WM_PAirBoostOvHysDeacLvl1_P "Air Boost Pressure Over Level 1 Hysteresis Deactivation Parameter" VALUE 0x40050F60 /* @ECU_Address@WM_PAirBoostOvHysDeacLvl1_P@ */ Scalar_FLOAT32_IEEE 0 EcuIntgdSwGend_CM_single_mbar 0.0 15000.0 /end CHARACTERISTIC
/begin CHARACTERISTIC WM_PAirBoostOvHysDeacLvl2_P "Air Boost Pressure Over Level 2 Hysteresis Deactivation Parameter" VALUE 0x40050F64 /* @ECU_Address@WM_PAirBoostOvHysDeacLvl2_P@ */ Scalar_FLOAT32_IEEE 0 EcuIntgdSwGend_CM_single_mbar 0.0 15000.0 /end CHARACTERISTIC
/begin CHARACTERISTIC WM_PAirBoostOvHysDeacLvl3_P "Air Boost Pressure Over Level 3 Hysteresis Deactivation Parameter" VALUE 0x40050F68 /* @ECU_Address@WM_PAirBoostOvHysDeacLvl3_P@ */ Scalar_FLOAT32_IEEE 0 EcuIntgdSwGend_CM_single_mbar 0.0 15000.0 /end CHARACTERISTIC
/begin CHARACTERISTIC WM_PAirBoostUndDesLvlQnty_P "Air Boost Pressure Under Desired Severity Level Quantity Parameter" VALUE 0x40050FA8 /* @ECU_Address@WM_PAirBoostUndDesLvlQnty_P@ */ Scalar_FLOAT32_IEEE 0 EcuIntgdSwGend_CM_single 0.0 3.0 /end CHARACTERISTIC
/begin CHARACTERISTIC WM_PAirBoostUndHysDeacLvl1_P "Air Boost Pressure Under Level 1 Hysteresis Deactivation Parameter" VALUE 0x40050FAC /* @ECU_Address@WM_PAirBoostUndHysDeacLvl1_P@ */ Scalar_FLOAT32_IEEE 0 EcuIntgdSwGend_CM_single_mbar 0.0 15000.0 /end CHARACTERISTIC
/begin CHARACTERISTIC WM_PAirBoostUndHysDeacLvl2_P "Air Boost Pressure Under Level 2 Hysteresis Deactivation Parameter" VALUE 0x40050FB0 /* @ECU_Address@WM_PAirBoostUndHysDeacLvl2_P@ */ Scalar_FLOAT32_IEEE 0 EcuIntgdSwGend_CM_single_mbar 0.0 15000.0 /end CHARACTERISTIC
/begin CHARACTERISTIC WM_PAirBoostUndHysDeacLvl3_P "Air Boost Pressure Under Level 3 Hysteresis Deactivation Parameter" VALUE 0x40050FB4 /* @ECU_Address@WM_PAirBoostUndHysDeacLvl3_P@ */ Scalar_FLOAT32_IEEE 0 EcuIntgdSwGend_CM_single_mbar 0.0 15000.0 /end CHARACTERISTIC
/begin CHARACTERISTIC WM_PAmbAirOvDesLvlQnty_P "Ambient Air Pressure Over Desired Severity Level Quantity Parameter" VALUE 0x40050FF4 /* @ECU_Address@WM_PAmbAirOvDesLvlQnty_P@ */ Scalar_FLOAT32_IEEE 0 EcuIntgdSwGend_CM_single 0.0 3.0 /end CHARACTERISTIC
/begin CHARACTERISTIC WM_PAmbAirOvHysDeacLvl1_P "Ambient Air Pressure Over Level 1 Hysteresis Deactivation Parameter" VALUE 0x40050FF8 /* @ECU_Address@WM_PAmbAirOvHysDeacLvl1_P@ */ Scalar_FLOAT32_IEEE 0 EcuIntgdSwGend_CM_single_mbar 0.0 15000.0 /end CHARACTERISTIC
/begin CHARACTERISTIC WM_PAmbAirOvHysDeacLvl2_P "Ambient Air Pressure Over Level 2 Hysteresis Deactivation Parameter" VALUE 0x40050FFC /* @ECU_Address@WM_PAmbAirOvHysDeacLvl2_P@ */ Scalar_FLOAT32_IEEE 0 EcuIntgdSwGend_CM_single_mbar 0.0 15000.0 /end CHARACTERISTIC
/begin CHARACTERISTIC WM_PAmbAirOvHysDeacLvl3_P "Ambient Air Pressure Over Level 3 Hysteresis Deactivation Parameter" VALUE 0x40051000 /* @ECU_Address@WM_PAmbAirOvHysDeacLvl3_P@ */ Scalar_FLOAT32_IEEE 0 EcuIntgdSwGend_CM_single_mbar 0.0 15000.0 /end CHARACTERISTIC
/begin CHARACTERISTIC WM_PAmbAirUndDesLvlQnty_P "Ambient Air Pressure Under Desired Severity Level Quantity Parameter" VALUE 0x40051040 /* @ECU_Address@WM_PAmbAirUndDesLvlQnty_P@ */ Scalar_FLOAT32_IEEE 0 EcuIntgdSwGend_CM_single 0.0 3.0 /end CHARACTERISTIC
/begin CHARACTERISTIC WM_PAmbAirUndHysDeacLvl1_P "Ambient Air Pressure Under Level 1 Hysteresis Deactivation Parameter" VALUE 0x40051044 /* @ECU_Address@WM_PAmbAirUndHysDeacLvl1_P@ */ Scalar_FLOAT32_IEEE 0 EcuIntgdSwGend_CM_single_mbar 0.0 15000.0 /end CHARACTERISTIC
/begin CHARACTERISTIC WM_PAmbAirUndHysDeacLvl2_P "Ambient Air Pressure Under Level 2 Hysteresis Deactivation Parameter" VALUE 0x40051048 /* @ECU_Address@WM_PAmbAirUndHysDeacLvl2_P@ */ Scalar_FLOAT32_IEEE 0 EcuIntgdSwGend_CM_single_mbar 0.0 15000.0 /end CHARACTERISTIC
/begin CHARACTERISTIC WM_PAmbAirUndHysDeacLvl3_P "Ambient Air Pressure Under Level 3 Hysteresis Deactivation Parameter" VALUE 0x4005104C /* @ECU_Address@WM_PAmbAirUndHysDeacLvl3_P@ */ Scalar_FLOAT32_IEEE 0 EcuIntgdSwGend_CM_single_mbar 0.0 15000.0 /end CHARACTERISTIC
/begin CHARACTERISTIC WM_PFuOvDesLvlQnty_P "Fuel Pressure Over Desired Severity Level Quantity Parameter" VALUE 0x4005108C /* @ECU_Address@WM_PFuOvDesLvlQnty_P@ */ Scalar_FLOAT32_IEEE 0 EcuIntgdSwGend_CM_single 0.0 3.0 /end CHARACTERISTIC
/begin CHARACTERISTIC WM_PFuOvHysDeacLvl1_P "Fuel Pressure Over Level 1 Hysteresis Deactivation Parameter" VALUE 0x40051090 /* @ECU_Address@WM_PFuOvHysDeacLvl1_P@ */ Scalar_FLOAT32_IEEE 0 EcuIntgdSwGend_CM_single_mbar 0.0 15000.0 /end CHARACTERISTIC
/begin CHARACTERISTIC WM_PFuOvHysDeacLvl2_P "Fuel Pressure Over Level 2 Hysteresis Deactivation Parameter" VALUE 0x40051094 /* @ECU_Address@WM_PFuOvHysDeacLvl2_P@ */ Scalar_FLOAT32_IEEE 0 EcuIntgdSwGend_CM_single_mbar 0.0 15000.0 /end CHARACTERISTIC
/begin CHARACTERISTIC WM_PFuOvHysDeacLvl3_P "Fuel Pressure Over Level 3 Hysteresis Deactivation Parameter" VALUE 0x40051098 /* @ECU_Address@WM_PFuOvHysDeacLvl3_P@ */ Scalar_FLOAT32_IEEE 0 EcuIntgdSwGend_CM_single_mbar 0.0 15000.0 /end CHARACTERISTIC
/begin CHARACTERISTIC WM_PFuUndDesLvlQnty_P "Fuel Pressure Under Desired Severity Level Quantity Parameter" VALUE 0x400510D8 /* @ECU_Address@WM_PFuUndDesLvlQnty_P@ */ Scalar_FLOAT32_IEEE 0 EcuIntgdSwGend_CM_single 0.0 3.0 /end CHARACTERISTIC
/begin CHARACTERISTIC WM_PFuUndHysDeacLvl1_P "Fuel Pressure Under Level 1 Hysteresis Deactivation Parameter" VALUE 0x400510DC /* @ECU_Address@WM_PFuUndHysDeacLvl1_P@ */ Scalar_FLOAT32_IEEE 0 EcuIntgdSwGend_CM_single_mbar 0.0 15000.0 /end CHARACTERISTIC
/begin CHARACTERISTIC WM_PFuUndHysDeacLvl2_P "Fuel Pressure Under Level 2 Hysteresis Deactivation Parameter" VALUE 0x400510E0 /* @ECU_Address@WM_PFuUndHysDeacLvl2_P@ */ Scalar_FLOAT32_IEEE 0 EcuIntgdSwGend_CM_single_mbar 0.0 15000.0 /end CHARACTERISTIC
/begin CHARACTERISTIC WM_PFuUndHysDeacLvl3_P "Fuel Pressure Under Level 3 Hysteresis Deactivation Parameter" VALUE 0x400510E4 /* @ECU_Address@WM_PFuUndHysDeacLvl3_P@ */ Scalar_FLOAT32_IEEE 0 EcuIntgdSwGend_CM_single_mbar 0.0 15000.0 /end CHARACTERISTIC
/begin CHARACTERISTIC WM_POilOvDesLvlQnty_P "Oil Pressure Over Desired Severity Level Quantity Parameter" VALUE 0x40051124 /* @ECU_Address@WM_POilOvDesLvlQnty_P@ */ Scalar_FLOAT32_IEEE 0 EcuIntgdSwGend_CM_single 0.0 3.0 /end CHARACTERISTIC
/begin CHARACTERISTIC WM_POilOvHysDeacLvl1_P "Oil Pressure Over Level 1 Hysteresis Deactivation Parameter" VALUE 0x40051128 /* @ECU_Address@WM_POilOvHysDeacLvl1_P@ */ Scalar_FLOAT32_IEEE 0 EcuIntgdSwGend_CM_single_mbar 0.0 15000.0 /end CHARACTERISTIC
/begin CHARACTERISTIC WM_POilOvHysDeacLvl2_P "Oil Pressure Over Level 2 Hysteresis Deactivation Parameter" VALUE 0x4005112C /* @ECU_Address@WM_POilOvHysDeacLvl2_P@ */ Scalar_FLOAT32_IEEE 0 EcuIntgdSwGend_CM_single_mbar 0.0 15000.0 /end CHARACTERISTIC
/begin CHARACTERISTIC WM_POilOvHysDeacLvl3_P "Oil Pressure Over Level 3 Hysteresis Deactivation Parameter" VALUE 0x40051130 /* @ECU_Address@WM_POilOvHysDeacLvl3_P@ */ Scalar_FLOAT32_IEEE 0 EcuIntgdSwGend_CM_single_mbar 0.0 15000.0 /end CHARACTERISTIC
/begin CHARACTERISTIC WM_POilUndDesLvlQnty_P "Oil Pressure Under Desired Severity Level Quantity Parameter" VALUE 0x40051170 /* @ECU_Address@WM_POilUndDesLvlQnty_P@ */ Scalar_FLOAT32_IEEE 0 EcuIntgdSwGend_CM_single 0.0 3.0 /end CHARACTERISTIC
/begin CHARACTERISTIC WM_POilUndHysDeacLvl1_P "Oil Pressure Under Level 1 Hysteresis Deactivation Parameter" VALUE 0x40051174 /* @ECU_Address@WM_POilUndHysDeacLvl1_P@ */ Scalar_FLOAT32_IEEE 0 EcuIntgdSwGend_CM_single_mbar 0.0 15000.0 /end CHARACTERISTIC
/begin CHARACTERISTIC WM_POilUndHysDeacLvl2_P "Oil Pressure Under Level 2 Hysteresis Deactivation Parameter" VALUE 0x40051178 /* @ECU_Address@WM_POilUndHysDeacLvl2_P@ */ Scalar_FLOAT32_IEEE 0 EcuIntgdSwGend_CM_single_mbar 0.0 15000.0 /end CHARACTERISTIC
/begin CHARACTERISTIC WM_POilUndHysDeacLvl3_P "Oil Pressure Under Level 3 Hysteresis Deactivation Parameter" VALUE 0x4005117C /* @ECU_Address@WM_POilUndHysDeacLvl3_P@ */ Scalar_FLOAT32_IEEE 0 EcuIntgdSwGend_CM_single_mbar 0.0 15000.0 /end CHARACTERISTIC
/begin CHARACTERISTIC WM_PRailOvDesLvlQnty_P "Rail Pressure Over Desired Severity Level Quantity Parameter" VALUE 0x400511C0 /* @ECU_Address@WM_PRailOvDesLvlQnty_P@ */ Scalar_FLOAT32_IEEE 0 EcuIntgdSwGend_CM_single 0.0 3.0 /end CHARACTERISTIC
/begin CHARACTERISTIC WM_PRailOvHysDeacLvl1_P "Rail Pressure Over Level 1 Hysteresis Deactivation Parameter" VALUE 0x400511C4 /* @ECU_Address@WM_PRailOvHysDeacLvl1_P@ */ Scalar_FLOAT32_IEEE 0 EcuIntgdSwGend_CM_single_bar 0.0 2500.0 /end CHARACTERISTIC
/begin CHARACTERISTIC WM_PRailOvHysDeacLvl2_P "Rail Pressure Over Level 2 Hysteresis Deactivation Parameter" VALUE 0x400511C8 /* @ECU_Address@WM_PRailOvHysDeacLvl2_P@ */ Scalar_FLOAT32_IEEE 0 EcuIntgdSwGend_CM_single_bar 0.0 2500.0 /end CHARACTERISTIC
/begin CHARACTERISTIC WM_PRailOvHysDeacLvl3_P "Rail Pressure Over Level 3 Hysteresis Deactivation Parameter" VALUE 0x400511CC /* @ECU_Address@WM_PRailOvHysDeacLvl3_P@ */ Scalar_FLOAT32_IEEE 0 EcuIntgdSwGend_CM_single_bar 0.0 2500.0 /end CHARACTERISTIC
/begin CHARACTERISTIC WM_TiErrCylMisfDeb_P "Cylinder Misfire Error Debouncer Time Parameter" VALUE 0x40051528 /* @ECU_Address@WM_TiErrCylMisfDeb_P@ */ Scalar_FLOAT32_IEEE 0 EcuIntgdSwGend_CM_single_ms 0.0 25000.0 /end CHARACTERISTIC
/begin CHARACTERISTIC WM_TiLvlOilUndDebHi_P "Level Oil Under Debouncer High Time Parameter" VALUE 0x4005152C /* @ECU_Address@WM_TiLvlOilUndDebHi_P@ */ Scalar_FLOAT32_IEEE 0 EcuIntgdSwGend_CM_single_ms 0.0 25000.0 /end CHARACTERISTIC
/begin CHARACTERISTIC WM_TiLvlOilUndDebLo_P "Level Oil Under Debouncer Low Time Parameter" VALUE 0x40051530 /* @ECU_Address@WM_TiLvlOilUndDebLo_P@ */ Scalar_FLOAT32_IEEE 0 EcuIntgdSwGend_CM_single_ms 0.0 25000.0 /end CHARACTERISTIC
/begin CHARACTERISTIC WM_TiPAirBoostOvDebHi_P "Air Boost Pressure Over Debouncer High Time Parameter" VALUE 0x40051538 /* @ECU_Address@WM_TiPAirBoostOvDebHi_P@ */ Scalar_FLOAT32_IEEE 0 EcuIntgdSwGend_CM_single_ms 0.0 25000.0 /end CHARACTERISTIC
/begin CHARACTERISTIC WM_TiPAirBoostOvDebLo_P "Air Boost Pressure Over Debouncer Low Time Parameter" VALUE 0x4005153C /* @ECU_Address@WM_TiPAirBoostOvDebLo_P@ */ Scalar_FLOAT32_IEEE 0 EcuIntgdSwGend_CM_single_ms 0.0 25000.0 /end CHARACTERISTIC
/begin CHARACTERISTIC WM_TiPAirBoostUndDebHi_P "Air Boost Pressure Under Debouncer High Time Parameter" VALUE 0x40051540 /* @ECU_Address@WM_TiPAirBoostUndDebHi_P@ */ Scalar_FLOAT32_IEEE 0 EcuIntgdSwGend_CM_single_ms 0.0 25000.0 /end CHARACTERISTIC
/begin CHARACTERISTIC WM_TiPAirBoostUndDebLo_P "Air Boost Pressure Under Debouncer Low Time Parameter" VALUE 0x40051544 /* @ECU_Address@WM_TiPAirBoostUndDebLo_P@ */ Scalar_FLOAT32_IEEE 0 EcuIntgdSwGend_CM_single_ms 0.0 25000.0 /end CHARACTERISTIC
/begin CHARACTERISTIC WM_TiPAmbAirOvDebHi_P "Ambient Air Pressure Over Debouncer High Time Parameter" VALUE 0x40051548 /* @ECU_Address@WM_TiPAmbAirOvDebHi_P@ */ Scalar_FLOAT32_IEEE 0 EcuIntgdSwGend_CM_single_ms 0.0 25000.0 /end CHARACTERISTIC
/begin CHARACTERISTIC WM_TiPAmbAirOvDebLo_P "Ambient Air Pressure Over Debouncer Low Time Parameter" VALUE 0x4005154C /* @ECU_Address@WM_TiPAmbAirOvDebLo_P@ */ Scalar_FLOAT32_IEEE 0 EcuIntgdSwGend_CM_single_ms 0.0 25000.0 /end CHARACTERISTIC
/begin CHARACTERISTIC WM_TiPAmbAirUndDebHi_P "Ambient Air Pressure Under Debouncer High Time Parameter" VALUE 0x40051550 /* @ECU_Address@WM_TiPAmbAirUndDebHi_P@ */ Scalar_FLOAT32_IEEE 0 EcuIntgdSwGend_CM_single_ms 0.0 25000.0 /end CHARACTERISTIC
/begin CHARACTERISTIC WM_TiPAmbAirUndDebLo_P "Ambient Air Pressure Under Debouncer Low Time Parameter" VALUE 0x40051554 /* @ECU_Address@WM_TiPAmbAirUndDebLo_P@ */ Scalar_FLOAT32_IEEE 0 EcuIntgdSwGend_CM_single_ms 0.0 25000.0 /end CHARACTERISTIC
/begin CHARACTERISTIC WM_TiPFuOvDebHi_P "Fuel Pressure Over Debouncer High Time Parameter" VALUE 0x40051558 /* @ECU_Address@WM_TiPFuOvDebHi_P@ */ Scalar_FLOAT32_IEEE 0 EcuIntgdSwGend_CM_single_ms 0.0 25000.0 /end CHARACTERISTIC
/begin CHARACTERISTIC WM_TiPFuOvDebLo_P "Fuel Pressure Over Debouncer Low Time Parameter" VALUE 0x4005155C /* @ECU_Address@WM_TiPFuOvDebLo_P@ */ Scalar_FLOAT32_IEEE 0 EcuIntgdSwGend_CM_single_ms 0.0 25000.0 /end CHARACTERISTIC
/begin CHARACTERISTIC WM_TiPFuUndDebHi_P "Fuel Pressure Under Debouncer High Time Parameter" VALUE 0x40051560 /* @ECU_Address@WM_TiPFuUndDebHi_P@ */ Scalar_FLOAT32_IEEE 0 EcuIntgdSwGend_CM_single_ms 0.0 25000.0 /end CHARACTERISTIC
/begin CHARACTERISTIC WM_TiPFuUndDebLo_P "Fuel Pressure Under Debouncer Low Time Parameter" VALUE 0x40051564 /* @ECU_Address@WM_TiPFuUndDebLo_P@ */ Scalar_FLOAT32_IEEE 0 EcuIntgdSwGend_CM_single_ms 0.0 25000.0 /end CHARACTERISTIC
/begin CHARACTERISTIC WM_TiPOilOvDebHi_P "Oil Pressure Over Debouncer High Time Parameter" VALUE 0x40051568 /* @ECU_Address@WM_TiPOilOvDebHi_P@ */ Scalar_FLOAT32_IEEE 0 EcuIntgdSwGend_CM_single_ms 0.0 25000.0 /end CHARACTERISTIC
/begin CHARACTERISTIC WM_TiPOilOvDebLo_P "Oil Pressure Over Debouncer Low Time Parameter" VALUE 0x4005156C /* @ECU_Address@WM_TiPOilOvDebLo_P@ */ Scalar_FLOAT32_IEEE 0 EcuIntgdSwGend_CM_single_ms 0.0 25000.0 /end CHARACTERISTIC
/begin CHARACTERISTIC WM_TiPOilUndDebHi_P "Oil Pressure Under Debouncer High Time Parameter" VALUE 0x40051570 /* @ECU_Address@WM_TiPOilUndDebHi_P@ */ Scalar_FLOAT32_IEEE 0 EcuIntgdSwGend_CM_single_ms 0.0 25000.0 /end CHARACTERISTIC
/begin CHARACTERISTIC WM_TiPOilUndDebLo_P "Oil Pressure Under Debouncer Low Time Parameter" VALUE 0x40051574 /* @ECU_Address@WM_TiPOilUndDebLo_P@ */ Scalar_FLOAT32_IEEE 0 EcuIntgdSwGend_CM_single_ms 0.0 25000.0 /end CHARACTERISTIC
/begin CHARACTERISTIC WM_TiPRailOvDebHi_P "Rail Pressure Over Debouncer High Time Parameter" VALUE 0x40051578 /* @ECU_Address@WM_TiPRailOvDebHi_P@ */ Scalar_FLOAT32_IEEE 0 EcuIntgdSwGend_CM_single_ms 0.0 25000.0 /end CHARACTERISTIC
/begin CHARACTERISTIC WM_TiPRailOvDebLo_P "Rail Pressure Over Debouncer Low Time Parameter" VALUE 0x4005157C /* @ECU_Address@WM_TiPRailOvDebLo_P@ */ Scalar_FLOAT32_IEEE 0 EcuIntgdSwGend_CM_single_ms 0.0 25000.0 /end CHARACTERISTIC
/begin CHARACTERISTIC WM_TiUClmp30OvDebHi_P "Battery Voltage Over Debouncer High Time Parameter" VALUE 0x400515D8 /* @ECU_Address@WM_TiUClmp30OvDebHi_P@ */ Scalar_FLOAT32_IEEE 0 EcuIntgdSwGend_CM_single_ms 0.0 25000.0 /end CHARACTERISTIC
/begin CHARACTERISTIC WM_TiUClmp30OvDebLo_P "Battery Voltage Over Debouncer Low Time Parameter" VALUE 0x400515DC /* @ECU_Address@WM_TiUClmp30OvDebLo_P@ */ Scalar_FLOAT32_IEEE 0 EcuIntgdSwGend_CM_single_ms 0.0 25000.0 /end CHARACTERISTIC
/begin CHARACTERISTIC WM_TiUClmp30UndDebHi_P "Battery Voltage Under Debouncer High Time Parameter" VALUE 0x400515E0 /* @ECU_Address@WM_TiUClmp30UndDebHi_P@ */ Scalar_FLOAT32_IEEE 0 EcuIntgdSwGend_CM_single_ms 0.0 25000.0 /end CHARACTERISTIC
/begin CHARACTERISTIC WM_TiUClmp30UndDebLo_P "Battery Voltage Under Debouncer Low Time Parameter" VALUE 0x400515E4 /* @ECU_Address@WM_TiUClmp30UndDebLo_P@ */ Scalar_FLOAT32_IEEE 0 EcuIntgdSwGend_CM_single_ms 0.0 25000.0 /end CHARACTERISTIC
/begin CHARACTERISTIC WM_UClmp30OvDesLvlQnty_P "Battery Voltage Over Desired Severity Level Quantity Parameter" VALUE 0x400515E8 /* @ECU_Address@WM_UClmp30OvDesLvlQnty_P@ */ Scalar_FLOAT32_IEEE 0 EcuIntgdSwGend_CM_single 0.0 3.0 /end CHARACTERISTIC
/begin CHARACTERISTIC WM_UClmp30OvHysDeacLvl1_P "Battery Voltage Over Level 1 Hysteresis Deactivation Parameter" VALUE 0x400515EC /* @ECU_Address@WM_UClmp30OvHysDeacLvl1_P@ */ Scalar_FLOAT32_IEEE 0 EcuIntgdSwGend_CM_single_V 0.0 50.0 /end CHARACTERISTIC
/begin CHARACTERISTIC WM_UClmp30OvHysDeacLvl2_P "Battery Voltage Over Level 2 Hysteresis Deactivation Parameter" VALUE 0x400515F0 /* @ECU_Address@WM_UClmp30OvHysDeacLvl2_P@ */ Scalar_FLOAT32_IEEE 0 EcuIntgdSwGend_CM_single_V 0.0 50.0 /end CHARACTERISTIC
/begin CHARACTERISTIC WM_UClmp30OvHysDeacLvl3_P "Battery Voltage Over Level 3 Hysteresis Deactivation Parameter" VALUE 0x400515F4 /* @ECU_Address@WM_UClmp30OvHysDeacLvl3_P@ */ Scalar_FLOAT32_IEEE 0 EcuIntgdSwGend_CM_single_V 0.0 50.0 /end CHARACTERISTIC
/begin CHARACTERISTIC WM_UClmp30UndDesLvlQnty_P "Battery Voltage Under Desired Severity Level Quantity Parameter" VALUE 0x40051634 /* @ECU_Address@WM_UClmp30UndDesLvlQnty_P@ */ Scalar_FLOAT32_IEEE 0 EcuIntgdSwGend_CM_single 0.0 3.0 /end CHARACTERISTIC
/begin CHARACTERISTIC WM_UClmp30UndHysDeacLvl1_P "Battery Voltage Under Level 1 Hysteresis Deactivation Parameter" VALUE 0x40051638 /* @ECU_Address@WM_UClmp30UndHysDeacLvl1_P@ */ Scalar_FLOAT32_IEEE 0 EcuIntgdSwGend_CM_single_V 0.0 50.0 /end CHARACTERISTIC
/begin CHARACTERISTIC WM_UClmp30UndHysDeacLvl2_P "Battery Voltage Under Level 2 Hysteresis Deactivation Parameter" VALUE 0x4005163C /* @ECU_Address@WM_UClmp30UndHysDeacLvl2_P@ */ Scalar_FLOAT32_IEEE 0 EcuIntgdSwGend_CM_single_V 0.0 50.0 /end CHARACTERISTIC
/begin CHARACTERISTIC WM_UClmp30UndHysDeacLvl3_P "Battery Voltage Under Level 3 Hysteresis Deactivation Parameter" VALUE 0x40051640 /* @ECU_Address@WM_UClmp30UndHysDeacLvl3_P@ */ Scalar_FLOAT32_IEEE 0 EcuIntgdSwGend_CM_single_V 0.0 50.0 /end CHARACTERISTIC
/begin CHARACTERISTIC WM_MaskErrCylMisfEnaCond_P "Cylinder Misfire Global Enable Condition Parameter" VALUE 0x40050C48 /* @ECU_Address@WM_MaskErrCylMisfEnaCond_P@ */ Scalar_ULONG 0 EcuIntgdSwGend_CM_uint32 0.0 4.294967295E+9 /end CHARACTERISTIC
/begin CHARACTERISTIC WM_MaskLvlOilUndEnaCond_P "Oil Level Under Global Enable Condition Parameter" VALUE 0x40050C54 /* @ECU_Address@WM_MaskLvlOilUndEnaCond_P@ */ Scalar_ULONG 0 EcuIntgdSwGend_CM_uint32 0.0 4.294967295E+9 /end CHARACTERISTIC
/begin CHARACTERISTIC WM_MaskPAirBoostOvEnaCond_P "Airboost Pressure Over Global Enable Condition Parameter" VALUE 0x40050C58 /* @ECU_Address@WM_MaskPAirBoostOvEnaCond_P@ */ Scalar_ULONG 0 EcuIntgdSwGend_CM_uint32 0.0 4.294967295E+9 /end CHARACTERISTIC
/begin CHARACTERISTIC WM_MaskPAirBoostUndEnaCond_P "Airboost Pressure Under Global Enable Condition Parameter" VALUE 0x40050C5C /* @ECU_Address@WM_MaskPAirBoostUndEnaCond_P@ */ Scalar_ULONG 0 EcuIntgdSwGend_CM_uint32 0.0 4.294967295E+9 /end CHARACTERISTIC
/begin CHARACTERISTIC WM_MaskPAmbAirOvEnaCond_P "Ambient Air Pressure Over Global Enable Condition Parameter" VALUE 0x40050C60 /* @ECU_Address@WM_MaskPAmbAirOvEnaCond_P@ */ Scalar_ULONG 0 EcuIntgdSwGend_CM_uint32 0.0 4.294967295E+9 /end CHARACTERISTIC
/begin CHARACTERISTIC WM_MaskPAmbAirUndEnaCond_P "Ambient Air Pressure Under Global Enable Condition Parameter" VALUE 0x40050C64 /* @ECU_Address@WM_MaskPAmbAirUndEnaCond_P@ */ Scalar_ULONG 0 EcuIntgdSwGend_CM_uint32 0.0 4.294967295E+9 /end CHARACTERISTIC
/begin CHARACTERISTIC WM_MaskPFuOvEnaCond_P "Fuel Pressure Over Global Enable Condition Parameter" VALUE 0x40050C68 /* @ECU_Address@WM_MaskPFuOvEnaCond_P@ */ Scalar_ULONG 0 EcuIntgdSwGend_CM_uint32 0.0 4.294967295E+9 /end CHARACTERISTIC
/begin CHARACTERISTIC WM_MaskPFuUndEnaCond_P "Fuel Pressure Under Global Enable Condition Parameter" VALUE 0x40050C6C /* @ECU_Address@WM_MaskPFuUndEnaCond_P@ */ Scalar_ULONG 0 EcuIntgdSwGend_CM_uint32 0.0 4.294967295E+9 /end CHARACTERISTIC
/begin CHARACTERISTIC WM_MaskPOilOvEnaCond_P "Oil Pressure Over Global Enable Condition Parameter" VALUE 0x40050C70 /* @ECU_Address@WM_MaskPOilOvEnaCond_P@ */ Scalar_ULONG 0 EcuIntgdSwGend_CM_uint32 0.0 4.294967295E+9 /end CHARACTERISTIC
/begin CHARACTERISTIC WM_MaskPOilUndEnaCond_P "Oil Pressure Under Global Enable Condition Parameter" VALUE 0x40050C74 /* @ECU_Address@WM_MaskPOilUndEnaCond_P@ */ Scalar_ULONG 0 EcuIntgdSwGend_CM_uint32 0.0 4.294967295E+9 /end CHARACTERISTIC
/begin CHARACTERISTIC WM_MaskPRailOvEnaCond_P "Rail Pressure Over Global Enable Condition Parameter" VALUE 0x40050C78 /* @ECU_Address@WM_MaskPRailOvEnaCond_P@ */ Scalar_ULONG 0 EcuIntgdSwGend_CM_uint32 0.0 4.294967295E+9 /end CHARACTERISTIC
/begin CHARACTERISTIC WM_MaskRTNForErrCylMisf_P "Return To Normal Mask for Cylinder Misfire Parameter" VALUE 0x40050CA0 /* @ECU_Address@WM_MaskRTNForErrCylMisf_P@ */ Scalar_ULONG 0 EcuIntgdSwGend_CM_uint32 0.0 4.294967295E+9 /end CHARACTERISTIC
/begin CHARACTERISTIC WM_MaskRTNForErrLvlOilUnd_P "Return To Normal Mask for Oil Level Under Parameter" VALUE 0x40050CA8 /* @ECU_Address@WM_MaskRTNForErrLvlOilUnd_P@ */ Scalar_ULONG 0 EcuIntgdSwGend_CM_uint32 0.0 4.294967295E+9 /end CHARACTERISTIC
/begin CHARACTERISTIC WM_MaskRTNForErrPAirBoostOv_P "Return To Normal Mask for Air Boost Pressure Over Parameter" VALUE 0x40050CAC /* @ECU_Address@WM_MaskRTNForErrPAirBoostOv_P@ */ Scalar_ULONG 0 EcuIntgdSwGend_CM_uint32 0.0 4.294967295E+9 /end CHARACTERISTIC
/begin CHARACTERISTIC WM_MaskRTNForErrPAirBoostUnd_P "Return To Normal Mask for Air Boost Pressure Under Parameter" VALUE 0x40050CB0 /* @ECU_Address@WM_MaskRTNForErrPAirBoostUnd_P@ */ Scalar_ULONG 0 EcuIntgdSwGend_CM_uint32 0.0 4.294967295E+9 /end CHARACTERISTIC
/begin CHARACTERISTIC WM_MaskRTNForErrPAmbAirOv_P "Return To Normal Mask for Ambient Air Pressure Over Parameter" VALUE 0x40050CB4 /* @ECU_Address@WM_MaskRTNForErrPAmbAirOv_P@ */ Scalar_ULONG 0 EcuIntgdSwGend_CM_uint32 0.0 4.294967295E+9 /end CHARACTERISTIC
/begin CHARACTERISTIC WM_MaskRTNForErrPAmbAirUnd_P "Return To Normal Mask for Ambient Air Pressure Under Parameter" VALUE 0x40050CB8 /* @ECU_Address@WM_MaskRTNForErrPAmbAirUnd_P@ */ Scalar_ULONG 0 EcuIntgdSwGend_CM_uint32 0.0 4.294967295E+9 /end CHARACTERISTIC
/begin CHARACTERISTIC WM_MaskRTNForErrPFuOv_P "Return To Normal Mask for Fuel Pressure Over Parameter" VALUE 0x40050CBC /* @ECU_Address@WM_MaskRTNForErrPFuOv_P@ */ Scalar_ULONG 0 EcuIntgdSwGend_CM_uint32 0.0 4.294967295E+9 /end CHARACTERISTIC
/begin CHARACTERISTIC WM_MaskRTNForErrPFuUnd_P "Return To Normal Mask for Fuel Pressure Under Parameter" VALUE 0x40050CC0 /* @ECU_Address@WM_MaskRTNForErrPFuUnd_P@ */ Scalar_ULONG 0 EcuIntgdSwGend_CM_uint32 0.0 4.294967295E+9 /end CHARACTERISTIC
/begin CHARACTERISTIC WM_MaskRTNForErrPOilOv_P "Return To Normal Mask for Oil Pressure Over Parameter" VALUE 0x40050CC4 /* @ECU_Address@WM_MaskRTNForErrPOilOv_P@ */ Scalar_ULONG 0 EcuIntgdSwGend_CM_uint32 0.0 4.294967295E+9 /end CHARACTERISTIC
/begin CHARACTERISTIC WM_MaskRTNForErrPOilUnd_P "Return To Normal Mask for Oil Pressure Under Parameter" VALUE 0x40050CC8 /* @ECU_Address@WM_MaskRTNForErrPOilUnd_P@ */ Scalar_ULONG 0 EcuIntgdSwGend_CM_uint32 0.0 4.294967295E+9 /end CHARACTERISTIC
/begin CHARACTERISTIC WM_MaskRTNForErrPRailOv_P "Return To Normal Mask for Rail Pressure Over Parameter" VALUE 0x40050CCC /* @ECU_Address@WM_MaskRTNForErrPRailOv_P@ */ Scalar_ULONG 0 EcuIntgdSwGend_CM_uint32 0.0 4.294967295E+9 /end CHARACTERISTIC
/begin CHARACTERISTIC WM_MaskRTNForErrUClmp30Ov_P "Return To Normal Mask for Battery Voltage Over Parameter" VALUE 0x40050CFC /* @ECU_Address@WM_MaskRTNForErrUClmp30Ov_P@ */ Scalar_ULONG 0 EcuIntgdSwGend_CM_uint32 0.0 4.294967295E+9 /end CHARACTERISTIC
/begin CHARACTERISTIC WM_MaskRTNForErrUClmp30Und_P "Return To Normal Mask for Battery Voltage Under Parameter" VALUE 0x40050D00 /* @ECU_Address@WM_MaskRTNForErrUClmp30Und_P@ */ Scalar_ULONG 0 EcuIntgdSwGend_CM_uint32 0.0 4.294967295E+9 /end CHARACTERISTIC
/begin CHARACTERISTIC WM_MaskRctnForErrCylMisfLvl1Err_P "Mask Reaction for Cylinder Misfire Level 1 Error Parameter" VALUE 0x40050D34 /* @ECU_Address@WM_MaskRctnForErrCylMisfLvl1Err_P@ */ Scalar_ULONG 0 EcuIntgdSwGend_CM_uint32 0.0 4.294967295E+9 /end CHARACTERISTIC
/begin CHARACTERISTIC WM_MaskRctnForErrCylMisfLvl2Err_P "Mask Reaction for Cylinder Misfire Level 2 Error Parameter" VALUE 0x40050D38 /* @ECU_Address@WM_MaskRctnForErrCylMisfLvl2Err_P@ */ Scalar_ULONG 0 EcuIntgdSwGend_CM_uint32 0.0 4.294967295E+9 /end CHARACTERISTIC
/begin CHARACTERISTIC WM_MaskRctnForErrCylMisfLvl3Err_P "Mask Reaction for Cylinder Misfire Level 3 Error Parameter" VALUE 0x40050D3C /* @ECU_Address@WM_MaskRctnForErrCylMisfLvl3Err_P@ */ Scalar_ULONG 0 EcuIntgdSwGend_CM_uint32 0.0 4.294967295E+9 /end CHARACTERISTIC
/begin CHARACTERISTIC WM_MaskRctnForLvlOilUndLvl1Err_P "Mask Reaction for Oil Level Under Level 1 Error Parameter" VALUE 0x40050D48 /* @ECU_Address@WM_MaskRctnForLvlOilUndLvl1Err_P@ */ Scalar_ULONG 0 EcuIntgdSwGend_CM_uint32 0.0 4.294967295E+9 /end CHARACTERISTIC
/begin CHARACTERISTIC WM_MaskRctnForLvlOilUndLvl2Err_P "Mask Reaction for Oil Level Under Level 2 Error Parameter" VALUE 0x40050D4C /* @ECU_Address@WM_MaskRctnForLvlOilUndLvl2Err_P@ */ Scalar_ULONG 0 EcuIntgdSwGend_CM_uint32 0.0 4.294967295E+9 /end CHARACTERISTIC
/begin CHARACTERISTIC WM_MaskRctnForLvlOilUndLvl3Err_P "Mask Reaction for Oil Level Under Level 3 Error Parameter" VALUE 0x40050D50 /* @ECU_Address@WM_MaskRctnForLvlOilUndLvl3Err_P@ */ Scalar_ULONG 0 EcuIntgdSwGend_CM_uint32 0.0 4.294967295E+9 /end CHARACTERISTIC
/begin CHARACTERISTIC WM_MaskRctnForPAirBoostOvLvl1Err_P "Mask Reaction for Air Boost Pressure Over Level 1 Error Parameter" VALUE 0x40050D54 /* @ECU_Address@WM_MaskRctnForPAirBoostOvLvl1Err_P@ */ Scalar_ULONG 0 EcuIntgdSwGend_CM_uint32 0.0 4.294967295E+9 /end CHARACTERISTIC
/begin CHARACTERISTIC WM_MaskRctnForPAirBoostOvLvl2Err_P "Mask Reaction for Air Boost Pressure Over Level 2 Error Parameter" VALUE 0x40050D58 /* @ECU_Address@WM_MaskRctnForPAirBoostOvLvl2Err_P@ */ Scalar_ULONG 0 EcuIntgdSwGend_CM_uint32 0.0 4.294967295E+9 /end CHARACTERISTIC
/begin CHARACTERISTIC WM_MaskRctnForPAirBoostOvLvl3Err_P "Mask Reaction for Air Boost Pressure Over Level 3 Error Parameter" VALUE 0x40050D5C /* @ECU_Address@WM_MaskRctnForPAirBoostOvLvl3Err_P@ */ Scalar_ULONG 0 EcuIntgdSwGend_CM_uint32 0.0 4.294967295E+9 /end CHARACTERISTIC
/begin CHARACTERISTIC WM_MaskRctnForPAirBoostUndLvl1Err_P "Mask Reaction for Air Boost Pressure Under Level 1 Error Parameter" VALUE 0x40050D60 /* @ECU_Address@WM_MaskRctnForPAirBoostUndLvl1Err_P@ */ Scalar_ULONG 0 EcuIntgdSwGend_CM_uint32 0.0 4.294967295E+9 /end CHARACTERISTIC
/begin CHARACTERISTIC WM_MaskRctnForPAirBoostUndLvl2Err_P "Mask Reaction for Air Boost Pressure Under Level 2 Error Parameter" VALUE 0x40050D64 /* @ECU_Address@WM_MaskRctnForPAirBoostUndLvl2Err_P@ */ Scalar_ULONG 0 EcuIntgdSwGend_CM_uint32 0.0 4.294967295E+9 /end CHARACTERISTIC
/begin CHARACTERISTIC WM_MaskRctnForPAirBoostUndLvl3Err_P "Mask Reaction for Air Boost Pressure Under Level 3 Error Parameter" VALUE 0x40050D68 /* @ECU_Address@WM_MaskRctnForPAirBoostUndLvl3Err_P@ */ Scalar_ULONG 0 EcuIntgdSwGend_CM_uint32 0.0 4.294967295E+9 /end CHARACTERISTIC
/begin CHARACTERISTIC WM_MaskRctnForPAmbAirOvLvl1Err_P "Mask Reaction for Ambient Air Pressure Over Level 1 Error Parameter" VALUE 0x40050D6C /* @ECU_Address@WM_MaskRctnForPAmbAirOvLvl1Err_P@ */ Scalar_ULONG 0 EcuIntgdSwGend_CM_uint32 0.0 4.294967295E+9 /end CHARACTERISTIC
/begin CHARACTERISTIC WM_MaskRctnForPAmbAirOvLvl2Err_P "Mask Reaction for Ambient Air Pressure Over Level 2 Error Parameter" VALUE 0x40050D70 /* @ECU_Address@WM_MaskRctnForPAmbAirOvLvl2Err_P@ */ Scalar_ULONG 0 EcuIntgdSwGend_CM_uint32 0.0 4.294967295E+9 /end CHARACTERISTIC
/begin CHARACTERISTIC WM_MaskRctnForPAmbAirOvLvl3Err_P "Mask Reaction for Ambient Air Pressure Over Level 3 Error Parameter" VALUE 0x40050D74 /* @ECU_Address@WM_MaskRctnForPAmbAirOvLvl3Err_P@ */ Scalar_ULONG 0 EcuIntgdSwGend_CM_uint32 0.0 4.294967295E+9 /end CHARACTERISTIC
/begin CHARACTERISTIC WM_MaskRctnForPAmbAirUndLvl1Err_P "Mask Reaction for Ambient Air Pressure Under Level 1 Error Parameter" VALUE 0x40050D78 /* @ECU_Address@WM_MaskRctnForPAmbAirUndLvl1Err_P@ */ Scalar_ULONG 0 EcuIntgdSwGend_CM_uint32 0.0 4.294967295E+9 /end CHARACTERISTIC
/begin CHARACTERISTIC WM_MaskRctnForPAmbAirUndLvl2Err_P "Mask Reaction for Ambient Air Pressure Under Level 2 Error Parameter" VALUE 0x40050D7C /* @ECU_Address@WM_MaskRctnForPAmbAirUndLvl2Err_P@ */ Scalar_ULONG 0 EcuIntgdSwGend_CM_uint32 0.0 4.294967295E+9 /end CHARACTERISTIC
/begin CHARACTERISTIC WM_MaskRctnForPAmbAirUndLvl3Err_P "Mask Reaction for Ambient Air Pressure Under Level 3 Error Parameter" VALUE 0x40050D80 /* @ECU_Address@WM_MaskRctnForPAmbAirUndLvl3Err_P@ */ Scalar_ULONG 0 EcuIntgdSwGend_CM_uint32 0.0 4.294967295E+9 /end CHARACTERISTIC
/begin CHARACTERISTIC WM_MaskRctnForPFuOvLvl1Err_P "Mask Reaction for Fuel Pressure Over Level 1 Error Parameter" VALUE 0x40050D84 /* @ECU_Address@WM_MaskRctnForPFuOvLvl1Err_P@ */ Scalar_ULONG 0 EcuIntgdSwGend_CM_uint32 0.0 4.294967295E+9 /end CHARACTERISTIC
/begin CHARACTERISTIC WM_MaskRctnForPFuOvLvl2Err_P "Mask Reaction for Fuel Pressure Over Level 2 Error Parameter" VALUE 0x40050D88 /* @ECU_Address@WM_MaskRctnForPFuOvLvl2Err_P@ */ Scalar_ULONG 0 EcuIntgdSwGend_CM_uint32 0.0 4.294967295E+9 /end CHARACTERISTIC
/begin CHARACTERISTIC WM_MaskRctnForPFuOvLvl3Err_P "Mask Reaction for Fuel Pressure Over Level 3 Error Parameter" VALUE 0x40050D8C /* @ECU_Address@WM_MaskRctnForPFuOvLvl3Err_P@ */ Scalar_ULONG 0 EcuIntgdSwGend_CM_uint32 0.0 4.294967295E+9 /end CHARACTERISTIC
/begin CHARACTERISTIC WM_MaskRctnForPFuUndLvl1Err_P "Mask Reaction for Fuel Pressure Under Level 1 Error Parameter" VALUE 0x40050D90 /* @ECU_Address@WM_MaskRctnForPFuUndLvl1Err_P@ */ Scalar_ULONG 0 EcuIntgdSwGend_CM_uint32 0.0 4.294967295E+9 /end CHARACTERISTIC
/begin CHARACTERISTIC WM_MaskRctnForPFuUndLvl2Err_P "Mask Reaction for Fuel Pressure Under Level 2 Error Parameter" VALUE 0x40050D94 /* @ECU_Address@WM_MaskRctnForPFuUndLvl2Err_P@ */ Scalar_ULONG 0 EcuIntgdSwGend_CM_uint32 0.0 4.294967295E+9 /end CHARACTERISTIC
/begin CHARACTERISTIC WM_MaskRctnForPFuUndLvl3Err_P "Mask Reaction for Fuel Pressure Under Level 3 Error Parameter" VALUE 0x40050D98 /* @ECU_Address@WM_MaskRctnForPFuUndLvl3Err_P@ */ Scalar_ULONG 0 EcuIntgdSwGend_CM_uint32 0.0 4.294967295E+9 /end CHARACTERISTIC
/begin CHARACTERISTIC WM_MaskRctnForPOilOvLvl1Err_P "Mask Reaction for Oil Pressure Over Level 1 Error Parameter" VALUE 0x40050D9C /* @ECU_Address@WM_MaskRctnForPOilOvLvl1Err_P@ */ Scalar_ULONG 0 EcuIntgdSwGend_CM_uint32 0.0 4.294967295E+9 /end CHARACTERISTIC
/begin CHARACTERISTIC WM_MaskRctnForPOilOvLvl2Err_P "Mask Reaction for Oil Pressure Over Level 2 Error Parameter" VALUE 0x40050DA0 /* @ECU_Address@WM_MaskRctnForPOilOvLvl2Err_P@ */ Scalar_ULONG 0 EcuIntgdSwGend_CM_uint32 0.0 4.294967295E+9 /end CHARACTERISTIC
/begin CHARACTERISTIC WM_MaskRctnForPOilOvLvl3Err_P "Mask Reaction for Oil Pressure Over Level 3 Error Parameter" VALUE 0x40050DA4 /* @ECU_Address@WM_MaskRctnForPOilOvLvl3Err_P@ */ Scalar_ULONG 0 EcuIntgdSwGend_CM_uint32 0.0 4.294967295E+9 /end CHARACTERISTIC
/begin CHARACTERISTIC WM_MaskRctnForPOilUndLvl1Err_P "Mask Reaction for Oil Pressure Under Level 1 Error Parameter" VALUE 0x40050DA8 /* @ECU_Address@WM_MaskRctnForPOilUndLvl1Err_P@ */ Scalar_ULONG 0 EcuIntgdSwGend_CM_uint32 0.0 4.294967295E+9 /end CHARACTERISTIC
/begin CHARACTERISTIC WM_MaskRctnForPOilUndLvl2Err_P "Mask Reaction for Oil Pressure Under Level 2 Error Parameter" VALUE 0x40050DAC /* @ECU_Address@WM_MaskRctnForPOilUndLvl2Err_P@ */ Scalar_ULONG 0 EcuIntgdSwGend_CM_uint32 0.0 4.294967295E+9 /end CHARACTERISTIC
/begin CHARACTERISTIC WM_MaskRctnForPOilUndLvl3Err_P "Mask Reaction for Oil Pressure Under Level 3 Error Parameter" VALUE 0x40050DB0 /* @ECU_Address@WM_MaskRctnForPOilUndLvl3Err_P@ */ Scalar_ULONG 0 EcuIntgdSwGend_CM_uint32 0.0 4.294967295E+9 /end CHARACTERISTIC
/begin CHARACTERISTIC WM_MaskRctnForPRailOvLvl1Err_P "Mask Reaction for Rail Pressure Over Level 1 Error Parameter" VALUE 0x40050DB8 /* @ECU_Address@WM_MaskRctnForPRailOvLvl1Err_P@ */ Scalar_ULONG 0 EcuIntgdSwGend_CM_uint32 0.0 4.294967295E+9 /end CHARACTERISTIC
/begin CHARACTERISTIC WM_MaskRctnForPRailOvLvl2Err_P "Mask Reaction for Rail Pressure Over Level 2 Error Parameter" VALUE 0x40050DBC /* @ECU_Address@WM_MaskRctnForPRailOvLvl2Err_P@ */ Scalar_ULONG 0 EcuIntgdSwGend_CM_uint32 0.0 4.294967295E+9 /end CHARACTERISTIC
/begin CHARACTERISTIC WM_MaskRctnForPRailOvLvl3Err_P "Mask Reaction for Rail Pressure Over Level 3 Error Parameter" VALUE 0x40050DC0 /* @ECU_Address@WM_MaskRctnForPRailOvLvl3Err_P@ */ Scalar_ULONG 0 EcuIntgdSwGend_CM_uint32 0.0 4.294967295E+9 /end CHARACTERISTIC
/begin CHARACTERISTIC WM_MaskRctnForUClmp30OvLvl1Err_P "Mask Reaction for Battery Voltage Over Level 1 Error Parameter" VALUE 0x40050E48 /* @ECU_Address@WM_MaskRctnForUClmp30OvLvl1Err_P@ */ Scalar_ULONG 0 EcuIntgdSwGend_CM_uint32 0.0 4.294967295E+9 /end CHARACTERISTIC
/begin CHARACTERISTIC WM_MaskRctnForUClmp30OvLvl2Err_P "Mask Reaction for Battery Voltage Over Level 2 Error Parameter" VALUE 0x40050E4C /* @ECU_Address@WM_MaskRctnForUClmp30OvLvl2Err_P@ */ Scalar_ULONG 0 EcuIntgdSwGend_CM_uint32 0.0 4.294967295E+9 /end CHARACTERISTIC
/begin CHARACTERISTIC WM_MaskRctnForUClmp30OvLvl3Err_P "Mask Reaction for Battery Voltage Over Level 3 Error Parameter" VALUE 0x40050E50 /* @ECU_Address@WM_MaskRctnForUClmp30OvLvl3Err_P@ */ Scalar_ULONG 0 EcuIntgdSwGend_CM_uint32 0.0 4.294967295E+9 /end CHARACTERISTIC
/begin CHARACTERISTIC WM_MaskRctnForUClmp30UndLvl1Err_P "Mask Reaction for Battery Voltage Under Level 1 Error Parameter" VALUE 0x40050E54 /* @ECU_Address@WM_MaskRctnForUClmp30UndLvl1Err_P@ */ Scalar_ULONG 0 EcuIntgdSwGend_CM_uint32 0.0 4.294967295E+9 /end CHARACTERISTIC
/begin CHARACTERISTIC WM_MaskRctnForUClmp30UndLvl2Err_P "Mask Reaction for Battery Voltage Under Level 2 Error Parameter" VALUE 0x40050E58 /* @ECU_Address@WM_MaskRctnForUClmp30UndLvl2Err_P@ */ Scalar_ULONG 0 EcuIntgdSwGend_CM_uint32 0.0 4.294967295E+9 /end CHARACTERISTIC
/begin CHARACTERISTIC WM_MaskRctnForUClmp30UndLvl3Err_P "Mask Reaction for Battery Voltage Under Level 3 Error Parameter" VALUE 0x40050E5C /* @ECU_Address@WM_MaskRctnForUClmp30UndLvl3Err_P@ */ Scalar_ULONG 0 EcuIntgdSwGend_CM_uint32 0.0 4.294967295E+9 /end CHARACTERISTIC
/begin CHARACTERISTIC WM_MaskUClmp30OvEnaCond_P "Battery Voltage Over Global Enable Condition Parameter" VALUE 0x40050F00 /* @ECU_Address@WM_MaskUClmp30OvEnaCond_P@ */ Scalar_ULONG 0 EcuIntgdSwGend_CM_uint32 0.0 4.294967295E+9 /end CHARACTERISTIC
/begin CHARACTERISTIC WM_MaskUClmp30UndEnaCond_P "Battery Voltage Under Global Enable Condition Parameter" VALUE 0x40050F04 /* @ECU_Address@WM_MaskUClmp30UndEnaCond_P@ */ Scalar_ULONG 0 EcuIntgdSwGend_CM_uint32 0.0 4.294967295E+9 /end CHARACTERISTIC
/begin CHARACTERISTIC RPG_bCoeffKiRstOvs_P "Coefficient Integral Reset Ovverride Switch Parameter" VALUE 0x4004B224 /* @ECU_Address@RPG_bCoeffKiRstOvs_P@ */ Scalar_BOOLEAN 0 EcuIntgdSwGend_CM_boolean 0.0 1.0 /end CHARACTERISTIC
/begin CHARACTERISTIC RPG_bCoeffKiRstOvv_P "Coefficient Integral Reset Ovverride Value Parameter" VALUE 0x4004B228 /* @ECU_Address@RPG_bCoeffKiRstOvv_P@ */ Scalar_BOOLEAN 0 EcuIntgdSwGend_CM_boolean 0.0 1.0 /end CHARACTERISTIC
/begin MEASUREMENT WM_MaskRctnForPAirBoostOvErr "Mask Reaction for Air Boost Pressure Over Error" ULONG EcuIntgdSwGend_CM_uint32 0 0 0.0 4.294967295E+9 ECU_ADDRESS 0x4000E444 /* @ECU_Address@WM_MaskRctnForPAirBoostOvErr@ */ /end MEASUREMENT
/begin MEASUREMENT WM_MaskRctnForPAirBoostUndErr "Mask Reaction for Air Boost Pressure Under Error" ULONG EcuIntgdSwGend_CM_uint32 0 0 0.0 4.294967295E+9 ECU_ADDRESS 0x4000D9BC /* @ECU_Address@WM_MaskRctnForPAirBoostUndErr@ */ /end MEASUREMENT
/begin MEASUREMENT WM_MaskRctnForPAmbAirOvErr "Mask Reaction for Ambient Air Pressure Over Error" ULONG EcuIntgdSwGend_CM_uint32 0 0 0.0 4.294967295E+9 ECU_ADDRESS 0x4000E348 /* @ECU_Address@WM_MaskRctnForPAmbAirOvErr@ */ /end MEASUREMENT
/begin MEASUREMENT WM_MaskRctnForPAmbAirUndErr "Mask Reaction for Ambient Air Pressure Under Error" ULONG EcuIntgdSwGend_CM_uint32 0 0 0.0 4.294967295E+9 ECU_ADDRESS 0x4000E864 /* @ECU_Address@WM_MaskRctnForPAmbAirUndErr@ */ /end MEASUREMENT
/begin MEASUREMENT WM_MaskRctnForPFuOvErr "Mask Reaction for Fuel Pressure Over Error" ULONG EcuIntgdSwGend_CM_uint32 0 0 0.0 4.294967295E+9 ECU_ADDRESS 0x4000E7E4 /* @ECU_Address@WM_MaskRctnForPFuOvErr@ */ /end MEASUREMENT
/begin MEASUREMENT WM_MaskRctnForPFuUndErr "Mask Reaction for Fuel Pressure Under Error" ULONG EcuIntgdSwGend_CM_uint32 0 0 0.0 4.294967295E+9 ECU_ADDRESS 0x4000DCF8 /* @ECU_Address@WM_MaskRctnForPFuUndErr@ */ /end MEASUREMENT
/begin MEASUREMENT WM_MaskRctnForPOilOvErr "Mask Reaction for Oil Pressure Over Error" ULONG EcuIntgdSwGend_CM_uint32 0 0 0.0 4.294967295E+9 ECU_ADDRESS 0x4000DAC4 /* @ECU_Address@WM_MaskRctnForPOilOvErr@ */ /end MEASUREMENT
/begin MEASUREMENT WM_MaskRctnForPOilUndErr "Mask Reaction for Oil Pressure Under Error" ULONG EcuIntgdSwGend_CM_uint32 0 0 0.0 4.294967295E+9 ECU_ADDRESS 0x4000DE30 /* @ECU_Address@WM_MaskRctnForPOilUndErr@ */ /end MEASUREMENT
/begin MEASUREMENT WM_MaskRctnForPRailOvErr "Mask Reaction for Rail Pressure Over Error" ULONG EcuIntgdSwGend_CM_uint32 0 0 0.0 4.294967295E+9 ECU_ADDRESS 0x4000DDB4 /* @ECU_Address@WM_MaskRctnForPRailOvErr@ */ /end MEASUREMENT
/begin MEASUREMENT WM_MaskRctnForUClmp30OvErr "Mask Reaction for Battery Voltage Over Error" ULONG EcuIntgdSwGend_CM_uint32 0 0 0.0 4.294967295E+9 ECU_ADDRESS 0x4000D980 /* @ECU_Address@WM_MaskRctnForUClmp30OvErr@ */ /end MEASUREMENT
/begin MEASUREMENT WM_MaskRctnForUClmp30UndErr "Mask Reaction for Battery Voltage Under Error " ULONG EcuIntgdSwGend_CM_uint32 0 0 0.0 4.294967295E+9 ECU_ADDRESS 0x4000D858 /* @ECU_Address@WM_MaskRctnForUClmp30UndErr@ */ /end MEASUREMENT
/begin MEASUREMENT WM_MaskRctnForErrCylMisfErr "Mask Reaction for Cylinder Misfire Error" ULONG EcuIntgdSwGend_CM_uint32 0 0 0.0 4.294967295E+9 ECU_ADDRESS 0x4000E8F0 /* @ECU_Address@WM_MaskRctnForErrCylMisfErr@ */ /end MEASUREMENT
/begin MEASUREMENT WM_MaskRctnForLvlOilUndErr "Mask Reaction for Level Oil Error" ULONG EcuIntgdSwGend_CM_uint32 0 0 0.0 4.294967295E+9 ECU_ADDRESS 0x4000E61C /* @ECU_Address@WM_MaskRctnForLvlOilUndErr@ */ /end MEASUREMENT
/begin MEASUREMENT TL_TiElpdNEngAcvForTOil "Elapsed Time of Engine Activation for Oil Temperature Limitation" FLOAT32_IEEE EcuIntgdSwGend_CM_single_ms 0 0 0.0 100000.0 ECU_ADDRESS 0x4000E7D4 /* @ECU_Address@TL_TiElpdNEngAcvForTOil@ */ /end MEASUREMENT
/begin MEASUREMENT TL_TiElpdNEngAcvForPAirAmb "Elapsed Time of Engine Activation for Ambient Air Pressure Limitation" FLOAT32_IEEE EcuIntgdSwGend_CM_single_ms 0 0 0.0 100000.0 ECU_ADDRESS 0x4000E490 /* @ECU_Address@TL_TiElpdNEngAcvForPAirAmb@ */ /end MEASUREMENT
/begin MEASUREMENT TL_TiElpdNEngAcvForTAir "Elapsed Time of Engine Activation for Air Boost Temperature Limitation" FLOAT32_IEEE EcuIntgdSwGend_CM_single_ms 0 0 0.0 100000.0 ECU_ADDRESS 0x4000D984 /* @ECU_Address@TL_TiElpdNEngAcvForTAir@ */ /end MEASUREMENT
/begin MEASUREMENT TL_TiElpdNEngAcvForPAirBoost "Elapsed Time of Engine Activation for Air Boost Pressure Limitation" FLOAT32_IEEE EcuIntgdSwGend_CM_single_ms 0 0 0.0 100000.0 ECU_ADDRESS 0x4000DB3C /* @ECU_Address@TL_TiElpdNEngAcvForPAirBoost@ */ /end MEASUREMENT
/begin MEASUREMENT TL_TiElpdNEngAcvForNExhTrbChrg "Elapsed Time of Engine Activation for Turbo Charger Speed Limitation" FLOAT32_IEEE EcuIntgdSwGend_CM_single_ms 0 0 0.0 100000.0 ECU_ADDRESS 0x4000E884 /* @ECU_Address@TL_TiElpdNEngAcvForNExhTrbChrg@ */ /end MEASUREMENT
/begin MEASUREMENT TL_TiElpdNEngAcvForTFu "Elapsed Time of Engine Activation for Fuel Temperature Limitation" FLOAT32_IEEE EcuIntgdSwGend_CM_single_ms 0 0 0.0 100000.0 ECU_ADDRESS 0x4000E6DC /* @ECU_Address@TL_TiElpdNEngAcvForTFu@ */ /end MEASUREMENT
/begin MEASUREMENT TL_TiElpdNEngAcvForTCoolt "Elapsed Time of Engine Activation for Coolant High Temperature Limitation" FLOAT32_IEEE EcuIntgdSwGend_CM_single_ms 0 0 0.0 100000.0 ECU_ADDRESS 0x4000DD14 /* @ECU_Address@TL_TiElpdNEngAcvForTCoolt@ */ /end MEASUREMENT
/begin MEASUREMENT SC_TiElpdEngNotTurn "Timer Elapsed Time Engine Not Turn" FLOAT32_IEEE EcuIntgdSwGend_CM_single_ms 0 0 0.0 100000.0 ECU_ADDRESS 0x4000E990 /* @ECU_Address@SC_TiElpdEngNotTurn@ */ /end MEASUREMENT
/begin MEASUREMENT SC_TiElpdStrtrProtn "Timer Elapsed Time of OverHeat Protection" FLOAT32_IEEE EcuIntgdSwGend_CM_single_ms 0 0 0.0 100000.0 ECU_ADDRESS 0x4000E3D4 /* @ECU_Address@SC_TiElpdStrtrProtn@ */ /end MEASUREMENT
/begin MEASUREMENT SC_TiElpdAcvnLvlOilDeb "Oil Level Debouncer Elapsed Time" FLOAT32_IEEE EcuIntgdSwGend_CM_single_ms 0 0 0.0 50000.0 ECU_ADDRESS 0x4000E554 /* @ECU_Address@SC_TiElpdAcvnLvlOilDeb@ */ /end MEASUREMENT
/begin MEASUREMENT SC_TiElpdAcvnLvlFuDeb "Fuel Level Debouncer Elapsed Time" FLOAT32_IEEE EcuIntgdSwGend_CM_single_ms 0 0 0.0 50000.0 ECU_ADDRESS 0x4000E7DC /* @ECU_Address@SC_TiElpdAcvnLvlFuDeb@ */ /end MEASUREMENT
/begin MEASUREMENT SC_TiElpdAcvnErrPCVDeb "PCV Error Debouncer Elapsed Time" FLOAT32_IEEE EcuIntgdSwGend_CM_single_ms 0 0 0.0 50000.0 ECU_ADDRESS 0x4000E74C /* @ECU_Address@SC_TiElpdAcvnErrPCVDeb@ */ /end MEASUREMENT
/begin MEASUREMENT SC_TiElpdAcvnErrVCVDeb "VCV Error Debouncer Elapsed Time" FLOAT32_IEEE EcuIntgdSwGend_CM_single_ms 0 0 0.0 50000.0 ECU_ADDRESS 0x4000E208 /* @ECU_Address@SC_TiElpdAcvnErrVCVDeb@ */ /end MEASUREMENT
/begin MEASUREMENT SpdLimr_PIDOutSpdLimrTq "PID Out Speed Limiter Torque" FLOAT32_IEEE EcuIntgdSwGend_CM_single_N_m 0 0 -5000.0 5000.0 ECU_ADDRESS 0x4000D948 /* @ECU_Address@SpdLimr_PIDOutSpdLimrTq@ */ /end MEASUREMENT
/begin MEASUREMENT SpdLimr_TiElpdEngBrkLvl2Actvn "Elapsed Time Engine Brake Level 2 Activation" FLOAT32_IEEE EcuIntgdSwGend_CM_single_ms 0 0 0.0 10000.0 ECU_ADDRESS 0x4000E4A0 /* @ECU_Address@SpdLimr_TiElpdEngBrkLvl2Actvn@ */ /end MEASUREMENT
/begin MEASUREMENT SpdLimr_TiElpdEngBrkLvl1Actvn "Elapsed Time Engine Brake Level 1 Activation" FLOAT32_IEEE EcuIntgdSwGend_CM_single_ms 0 0 0.0 10000.0 ECU_ADDRESS 0x4000DB74 /* @ECU_Address@SpdLimr_TiElpdEngBrkLvl1Actvn@ */ /end MEASUREMENT
/begin MEASUREMENT IC_SoiPltInjSetPointFromMap1 "Start of Pilot Injection Set Point Calculation from Map 1" FLOAT32_IEEE EcuIntgdSwGend_CM_single_deg 0 0 -100.0 100.0 ECU_ADDRESS 0x4000E904 /* @ECU_Address@IC_SoiPltInjSetPointFromMap1@ */ /end MEASUREMENT
/begin MEASUREMENT IC_SoiPltInjSetPointFromMap2 "Start of Pilot Injection Set Point Calculation from Map 2" FLOAT32_IEEE EcuIntgdSwGend_CM_single_deg 0 0 -100.0 100.0 ECU_ADDRESS 0x4000E7B8 /* @ECU_Address@IC_SoiPltInjSetPointFromMap2@ */ /end MEASUREMENT
/begin MEASUREMENT IC_SoiPltInjSetPoint1to2Intp "Start of Pilot Injection Set Point Calcluation Map 1 to Map 2 Interpolation" FLOAT32_IEEE EcuIntgdSwGend_CM_single_deg 0 0 -100.0 500.0 ECU_ADDRESS 0x4000E310 /* @ECU_Address@IC_SoiPltInjSetPoint1to2Intp@ */ /end MEASUREMENT
/begin MEASUREMENT IC_SoiPltInjSetPointFromMap3 "Start of Pilot Injection Set Point Calculation from Map 3" FLOAT32_IEEE EcuIntgdSwGend_CM_single_deg 0 0 -100.0 100.0 ECU_ADDRESS 0x4000E90C /* @ECU_Address@IC_SoiPltInjSetPointFromMap3@ */ /end MEASUREMENT
/begin MEASUREMENT IC_SoiPltInjSetPoint2to3Intp "Start of Pilot Injection Set Point Calcluation Map 2 to Map 3 Interpolation" FLOAT32_IEEE EcuIntgdSwGend_CM_single_deg 0 0 -100.0 500.0 ECU_ADDRESS 0x4000DA4C /* @ECU_Address@IC_SoiPltInjSetPoint2to3Intp@ */ /end MEASUREMENT
/begin MEASUREMENT IC_SoiPltInjSetPoint "Start of Pilot Injection Set Point" FLOAT32_IEEE EcuIntgdSwGend_CM_single_deg 0 0 -100.0 1000.0 ECU_ADDRESS 0x4000DF90 /* @ECU_Address@IC_SoiPltInjSetPoint@ */ /end MEASUREMENT
/begin MEASUREMENT IC_SoiMainInjSetPointFromMap1 "Start of Main Injection Set Point Calculation from Map 1" FLOAT32_IEEE EcuIntgdSwGend_CM_single_deg 0 0 -100.0 100.0 ECU_ADDRESS 0x4000DAB4 /* @ECU_Address@IC_SoiMainInjSetPointFromMap1@ */ /end MEASUREMENT
/begin MEASUREMENT IC_SoiMainInjSetPointFromMap2 "Start of Main Injection Set Point Calculation from Map 2" FLOAT32_IEEE EcuIntgdSwGend_CM_single_deg 0 0 -100.0 100.0 ECU_ADDRESS 0x4000E5F8 /* @ECU_Address@IC_SoiMainInjSetPointFromMap2@ */ /end MEASUREMENT
/begin MEASUREMENT IC_SoiMainInjSetPoint1to2Intp "Start of Main Injection Set Point Calcluation Map 1 to Map 2 Interpolation" FLOAT32_IEEE EcuIntgdSwGend_CM_single_deg 0 0 -100.0 500.0 ECU_ADDRESS 0x4000E68C /* @ECU_Address@IC_SoiMainInjSetPoint1to2Intp@ */ /end MEASUREMENT
/begin MEASUREMENT IC_SoiMainInjSetPointFromMap3 "Start of Main Injection Set Point Calculation from Map 3" FLOAT32_IEEE EcuIntgdSwGend_CM_single_deg 0 0 -100.0 100.0 ECU_ADDRESS 0x4000E6B0 /* @ECU_Address@IC_SoiMainInjSetPointFromMap3@ */ /end MEASUREMENT
/begin MEASUREMENT IC_SoiMainInjSetPoint2to3Intp "Start of Main Injection Set Point Calcluation Map 2 to Map 3 Interpolation" FLOAT32_IEEE EcuIntgdSwGend_CM_single_deg 0 0 -100.0 500.0 ECU_ADDRESS 0x4000DDF4 /* @ECU_Address@IC_SoiMainInjSetPoint2to3Intp@ */ /end MEASUREMENT
/begin MEASUREMENT IC_SoiMainInjSetPoint "Start of Main Injection Set Point" FLOAT32_IEEE EcuIntgdSwGend_CM_single_deg 0 0 -100.0 1000.0 ECU_ADDRESS 0x4000E608 /* @ECU_Address@IC_SoiMainInjSetPoint@ */ /end MEASUREMENT
/begin MEASUREMENT IC_CoeffKpOutCyl1 "Cylinder Balancing PID Controller Kp Coefficient Output for Cylinder 1" FLOAT32_IEEE EcuIntgdSwGend_CM_single 0 0 -1000.0 1000.0 ECU_ADDRESS 0x4000D97C /* @ECU_Address@IC_CoeffKpOutCyl1@ */ /end MEASUREMENT
/begin MEASUREMENT IC_CoeffKiOutCyl1 "Cylinder Balancing PID Controller Ki Coefficient Output for Cylinder 1" FLOAT32_IEEE EcuIntgdSwGend_CM_single 0 0 -1000.0 1000.0 ECU_ADDRESS 0x4000DB44 /* @ECU_Address@IC_CoeffKiOutCyl1@ */ /end MEASUREMENT
/begin MEASUREMENT IC_CoeffKdFbOutCyl1 "Cylinder Balancing PID Controller Kd Coefficient Feedback Output for Cylinder 1" FLOAT32_IEEE EcuIntgdSwGend_CM_single 0 0 -1000.0 1000.0 ECU_ADDRESS 0x4000DB28 /* @ECU_Address@IC_CoeffKdFbOutCyl1@ */ /end MEASUREMENT
/begin MEASUREMENT IC_CoeffKdOutCyl1 "Cylinder Balancing PID Controller Kd Coefficient Output for Cylinder 1" FLOAT32_IEEE EcuIntgdSwGend_CM_single 0 0 -1000.0 1000.0 ECU_ADDRESS 0x4000E378 /* @ECU_Address@IC_CoeffKdOutCyl1@ */ /end MEASUREMENT
/begin MEASUREMENT IC_CoeffKiClampPreSatOutCyl1 "Cylinder Balancing PID Controller Ki Coefficient Output before Saturation for Cylinder 1" FLOAT32_IEEE EcuIntgdSwGend_CM_single 0 0 -1000.0 1000.0 ECU_ADDRESS 0x4000DAD8 /* @ECU_Address@IC_CoeffKiClampPreSatOutCyl1@ */ /end MEASUREMENT
/begin MEASUREMENT IC_PIOutCyl1 "Cylinder Balancing PID Controller Output for Cylinder 1" FLOAT32_IEEE EcuIntgdSwGend_CM_single_mm_3_stk 0 0 -2000.0 2000.0 ECU_ADDRESS 0x4000DCA8 /* @ECU_Address@IC_PIOutCyl1@ */ /end MEASUREMENT
/begin MEASUREMENT IC_CoeffKiClampOutCyl1 "Cylinder Balancing PID Controller Ki Clmaping Coefficient for Cylinder 1" FLOAT32_IEEE EcuIntgdSwGend_CM_single 0 0 -1000.0 1000.0 ECU_ADDRESS 0x4000D9C8 /* @ECU_Address@IC_CoeffKiClampOutCyl1@ */ /end MEASUREMENT
/begin MEASUREMENT IC_CoeffKiClampSwtchOutCyl1 "Cylinder Balancing PID Controller Ki Coefficient after Clamping Switch Output for Cylinder 1" FLOAT32_IEEE EcuIntgdSwGend_CM_single 0 0 -1000.0 1000.0 ECU_ADDRESS 0x4000E694 /* @ECU_Address@IC_CoeffKiClampSwtchOutCyl1@ */ /end MEASUREMENT
/begin MEASUREMENT IC_CoeffKpOutCyl2 "Cylinder Balancing PID Controller Kp Coefficient Output for Cylinder 2" FLOAT32_IEEE EcuIntgdSwGend_CM_single 0 0 -1000.0 1000.0 ECU_ADDRESS 0x4000E8BC /* @ECU_Address@IC_CoeffKpOutCyl2@ */ /end MEASUREMENT
/begin MEASUREMENT IC_CoeffKiOutCyl2 "Cylinder Balancing PID Controller Ki Coefficient Output for Cylinder 2" FLOAT32_IEEE EcuIntgdSwGend_CM_single 0 0 -1000.0 1000.0 ECU_ADDRESS 0x4000DE18 /* @ECU_Address@IC_CoeffKiOutCyl2@ */ /end MEASUREMENT
/begin MEASUREMENT IC_CoeffKdFbOutCyl2 "Cylinder Balancing PID Controller Kd Coefficient Feedback Output for Cylinder 2" FLOAT32_IEEE EcuIntgdSwGend_CM_single 0 0 -1000.0 1000.0 ECU_ADDRESS 0x4000DB2C /* @ECU_Address@IC_CoeffKdFbOutCyl2@ */ /end MEASUREMENT
/begin MEASUREMENT IC_CoeffKdOutCyl2 "Cylinder Balancing PID Controller Kd Coefficient Output for Cylinder 2" FLOAT32_IEEE EcuIntgdSwGend_CM_single 0 0 -1000.0 1000.0 ECU_ADDRESS 0x4000D93C /* @ECU_Address@IC_CoeffKdOutCyl2@ */ /end MEASUREMENT
/begin MEASUREMENT IC_CoeffKiClampPreSatOutCyl2 "Cylinder Balancing PID Controller Ki Coefficient Output before Saturation for Cylinder 2" FLOAT32_IEEE EcuIntgdSwGend_CM_single 0 0 -1000.0 1000.0 ECU_ADDRESS 0x4000E340 /* @ECU_Address@IC_CoeffKiClampPreSatOutCyl2@ */ /end MEASUREMENT
/begin MEASUREMENT IC_PIOutCyl2 "Cylinder Balancing PID Controller Output for Cylinder 2" FLOAT32_IEEE EcuIntgdSwGend_CM_single_mm_3_stk 0 0 -2000.0 2000.0 ECU_ADDRESS 0x4000DCAC /* @ECU_Address@IC_PIOutCyl2@ */ /end MEASUREMENT
/begin MEASUREMENT IC_CoeffKiClampOutCyl2 "Cylinder Balancing PID Controller Ki Clmaping Coefficient for Cylinder 2" FLOAT32_IEEE EcuIntgdSwGend_CM_single 0 0 -1000.0 1000.0 ECU_ADDRESS 0x4000D9CC /* @ECU_Address@IC_CoeffKiClampOutCyl2@ */ /end MEASUREMENT
/begin MEASUREMENT IC_CoeffKiClampSwtchOutCyl2 "Cylinder Balancing PID Controller Ki Coefficient after Clamping Switch Output for Cylinder 2" FLOAT32_IEEE EcuIntgdSwGend_CM_single 0 0 -1000.0 1000.0 ECU_ADDRESS 0x4000E1F8 /* @ECU_Address@IC_CoeffKiClampSwtchOutCyl2@ */ /end MEASUREMENT
/begin MEASUREMENT IC_CoeffKpOutCyl3 "Cylinder Balancing PID Controller Kp Coefficient Output for Cylinder 3" FLOAT32_IEEE EcuIntgdSwGend_CM_single 0 0 -1000.0 1000.0 ECU_ADDRESS 0x4000E8C0 /* @ECU_Address@IC_CoeffKpOutCyl3@ */ /end MEASUREMENT
/begin MEASUREMENT IC_CoeffKiOutCyl3 "Cylinder Balancing PID Controller Ki Coefficient Output for Cylinder 3" FLOAT32_IEEE EcuIntgdSwGend_CM_single 0 0 -1000.0 1000.0 ECU_ADDRESS 0x4000DB4C /* @ECU_Address@IC_CoeffKiOutCyl3@ */ /end MEASUREMENT
/begin MEASUREMENT IC_CoeffKdFbOutCyl3 "Cylinder Balancing PID Controller Kd Coefficient Feedback Output for Cylinder 3" FLOAT32_IEEE EcuIntgdSwGend_CM_single 0 0 -1000.0 1000.0 ECU_ADDRESS 0x4000D834 /* @ECU_Address@IC_CoeffKdFbOutCyl3@ */ /end MEASUREMENT
/begin MEASUREMENT IC_CoeffKdOutCyl3 "Cylinder Balancing PID Controller Kd Coefficient Output for Cylinder 3" FLOAT32_IEEE EcuIntgdSwGend_CM_single 0 0 -1000.0 1000.0 ECU_ADDRESS 0x4000E380 /* @ECU_Address@IC_CoeffKdOutCyl3@ */ /end MEASUREMENT
/begin MEASUREMENT IC_CoeffKiClampPreSatOutCyl3 "Cylinder Balancing PID Controller Ki Coefficient Output before Saturation for Cylinder 3" FLOAT32_IEEE EcuIntgdSwGend_CM_single 0 0 -1000.0 1000.0 ECU_ADDRESS 0x4000DAE0 /* @ECU_Address@IC_CoeffKiClampPreSatOutCyl3@ */ /end MEASUREMENT
/begin MEASUREMENT IC_PIOutCyl3 "Cylinder Balancing PID Controller Output for Cylinder 3" FLOAT32_IEEE EcuIntgdSwGend_CM_single_mm_3_stk 0 0 -2000.0 2000.0 ECU_ADDRESS 0x4000DCB0 /* @ECU_Address@IC_PIOutCyl3@ */ /end MEASUREMENT
/begin MEASUREMENT IC_CoeffKiClampOutCyl3 "Cylinder Balancing PID Controller Ki Clmaping Coefficient for Cylinder 3" FLOAT32_IEEE EcuIntgdSwGend_CM_single 0 0 -1000.0 1000.0 ECU_ADDRESS 0x4000D9D0 /* @ECU_Address@IC_CoeffKiClampOutCyl3@ */ /end MEASUREMENT
/begin MEASUREMENT IC_CoeffKiClampSwtchOutCyl3 "Cylinder Balancing PID Controller Ki Coefficient after Clamping Switch Output for Cylinder 3" FLOAT32_IEEE EcuIntgdSwGend_CM_single 0 0 -1000.0 1000.0 ECU_ADDRESS 0x4000DDDC /* @ECU_Address@IC_CoeffKiClampSwtchOutCyl3@ */ /end MEASUREMENT
/begin MEASUREMENT IC_CoeffKpOutCyl4 "Cylinder Balancing PID Controller Kp Coefficient Output for Cylinder 4" FLOAT32_IEEE EcuIntgdSwGend_CM_single 0 0 -1000.0 1000.0 ECU_ADDRESS 0x4000E8C4 /* @ECU_Address@IC_CoeffKpOutCyl4@ */ /end MEASUREMENT
/begin MEASUREMENT IC_CoeffKiOutCyl4 "Cylinder Balancing PID Controller Ki Coefficient Output for Cylinder 4" FLOAT32_IEEE EcuIntgdSwGend_CM_single 0 0 -1000.0 1000.0 ECU_ADDRESS 0x4000DB50 /* @ECU_Address@IC_CoeffKiOutCyl4@ */ /end MEASUREMENT
/begin MEASUREMENT IC_CoeffKdFbOutCyl4 "Cylinder Balancing PID Controller Kd Coefficient Feedback Output for Cylinder 4" FLOAT32_IEEE EcuIntgdSwGend_CM_single 0 0 -1000.0 1000.0 ECU_ADDRESS 0x4000D838 /* @ECU_Address@IC_CoeffKdFbOutCyl4@ */ /end MEASUREMENT
/begin MEASUREMENT IC_CoeffKdOutCyl4 "Cylinder Balancing PID Controller Kd Coefficient Output for Cylinder 4" FLOAT32_IEEE EcuIntgdSwGend_CM_single 0 0 -1000.0 1000.0 ECU_ADDRESS 0x4000E384 /* @ECU_Address@IC_CoeffKdOutCyl4@ */ /end MEASUREMENT
/begin MEASUREMENT IC_CoeffKiClampPreSatOutCyl4 "Cylinder Balancing PID Controller Ki Coefficient Output before Saturation for Cylinder 4" FLOAT32_IEEE EcuIntgdSwGend_CM_single 0 0 -1000.0 1000.0 ECU_ADDRESS 0x4000DAE4 /* @ECU_Address@IC_CoeffKiClampPreSatOutCyl4@ */ /end MEASUREMENT
/begin MEASUREMENT IC_PIOutCyl4 "Cylinder Balancing PID Controller Output for Cylinder 4" FLOAT32_IEEE EcuIntgdSwGend_CM_single_mm_3_stk 0 0 -2000.0 2000.0 ECU_ADDRESS 0x4000DCB4 /* @ECU_Address@IC_PIOutCyl4@ */ /end MEASUREMENT
/begin MEASUREMENT IC_CoeffKiClampOutCyl4 "Cylinder Balancing PID Controller Ki Clmaping Coefficient for Cylinder 4" FLOAT32_IEEE EcuIntgdSwGend_CM_single 0 0 -1000.0 1000.0 ECU_ADDRESS 0x4000D9D4 /* @ECU_Address@IC_CoeffKiClampOutCyl4@ */ /end MEASUREMENT
/begin MEASUREMENT IC_CoeffKiClampSwtchOutCyl4 "Cylinder Balancing PID Controller Ki Coefficient after Clamping Switch Output for Cylinder 4" FLOAT32_IEEE EcuIntgdSwGend_CM_single 0 0 -1000.0 1000.0 ECU_ADDRESS 0x4000E6A8 /* @ECU_Address@IC_CoeffKiClampSwtchOutCyl4@ */ /end MEASUREMENT
/begin MEASUREMENT IC_CoeffKpOutCyl6 "Cylinder Balancing PID Controller Kp Coefficient Output for Cylinder 6" FLOAT32_IEEE EcuIntgdSwGend_CM_single 0 0 -1000.0 1000.0 ECU_ADDRESS 0x4000E94C /* @ECU_Address@IC_CoeffKpOutCyl6@ */ /end MEASUREMENT
/begin MEASUREMENT IC_CoeffKiOutCyl6 "Cylinder Balancing PID Controller Ki Coefficient Output for Cylinder 6" FLOAT32_IEEE EcuIntgdSwGend_CM_single 0 0 -1000.0 1000.0 ECU_ADDRESS 0x4000DCC4 /* @ECU_Address@IC_CoeffKiOutCyl6@ */ /end MEASUREMENT
/begin MEASUREMENT IC_CoeffKdFbOutCyl6 "Cylinder Balancing PID Controller Kd Coefficient Feedback Output for Cylinder 6" FLOAT32_IEEE EcuIntgdSwGend_CM_single 0 0 -1000.0 1000.0 ECU_ADDRESS 0x4000DB40 /* @ECU_Address@IC_CoeffKdFbOutCyl6@ */ /end MEASUREMENT
/begin MEASUREMENT IC_CoeffKdOutCyl6 "Cylinder Balancing PID Controller Kd Coefficient Output for Cylinder 6" FLOAT32_IEEE EcuIntgdSwGend_CM_single 0 0 -1000.0 1000.0 ECU_ADDRESS 0x4000E758 /* @ECU_Address@IC_CoeffKdOutCyl6@ */ /end MEASUREMENT
/begin MEASUREMENT IC_CoeffKiClampPreSatOutCyl6 "Cylinder Balancing PID Controller Ki Coefficient Output before Saturation for Cylinder 6" FLOAT32_IEEE EcuIntgdSwGend_CM_single 0 0 -1000.0 1000.0 ECU_ADDRESS 0x4000DB7C /* @ECU_Address@IC_CoeffKiClampPreSatOutCyl6@ */ /end MEASUREMENT
/begin MEASUREMENT IC_PIOutCyl6 "Cylinder Balancing PID Controller Output for Cylinder 6" FLOAT32_IEEE EcuIntgdSwGend_CM_single_mm_3_stk 0 0 -2000.0 2000.0 ECU_ADDRESS 0x4000E6BC /* @ECU_Address@IC_PIOutCyl6@ */ /end MEASUREMENT
/begin MEASUREMENT IC_CoeffKiClampOutCyl6 "Cylinder Balancing PID Controller Ki Clmaping Coefficient for Cylinder 6" FLOAT32_IEEE EcuIntgdSwGend_CM_single 0 0 -1000.0 1000.0 ECU_ADDRESS 0x4000E064 /* @ECU_Address@IC_CoeffKiClampOutCyl6@ */ /end MEASUREMENT
/begin MEASUREMENT IC_CoeffKiClampSwtchOutCyl6 "Cylinder Balancing PID Controller Ki Coefficient after Clamping Switch Output for Cylinder 6" FLOAT32_IEEE EcuIntgdSwGend_CM_single 0 0 -1000.0 1000.0 ECU_ADDRESS 0x4000E6B4 /* @ECU_Address@IC_CoeffKiClampSwtchOutCyl6@ */ /end MEASUREMENT
/begin MEASUREMENT IC_CoeffKpOutCyl5 "Cylinder Balancing PID Controller Kp Coefficient Output for Cylinder 5" FLOAT32_IEEE EcuIntgdSwGend_CM_single 0 0 -1000.0 1000.0 ECU_ADDRESS 0x4000E8C8 /* @ECU_Address@IC_CoeffKpOutCyl5@ */ /end MEASUREMENT
/begin MEASUREMENT IC_CoeffKiOutCyl5 "Cylinder Balancing PID Controller Ki Coefficient Output for Cylinder 5" FLOAT32_IEEE EcuIntgdSwGend_CM_single 0 0 -1000.0 1000.0 ECU_ADDRESS 0x4000DB54 /* @ECU_Address@IC_CoeffKiOutCyl5@ */ /end MEASUREMENT
/begin MEASUREMENT IC_CoeffKdFbOutCyl5 "Cylinder Balancing PID Controller Kd Coefficient Feedback Output for Cylinder 5" FLOAT32_IEEE EcuIntgdSwGend_CM_single 0 0 -1000.0 1000.0 ECU_ADDRESS 0x4000D83C /* @ECU_Address@IC_CoeffKdFbOutCyl5@ */ /end MEASUREMENT
/begin MEASUREMENT IC_CoeffKdOutCyl5 "Cylinder Balancing PID Controller Kd Coefficient Output for Cylinder 5" FLOAT32_IEEE EcuIntgdSwGend_CM_single 0 0 -1000.0 1000.0 ECU_ADDRESS 0x4000E754 /* @ECU_Address@IC_CoeffKdOutCyl5@ */ /end MEASUREMENT
/begin MEASUREMENT IC_CoeffKiClampPreSatOutCyl5 "Cylinder Balancing PID Controller Ki Coefficient Output before Saturation for Cylinder 5" FLOAT32_IEEE EcuIntgdSwGend_CM_single 0 0 -1000.0 1000.0 ECU_ADDRESS 0x4000DAE8 /* @ECU_Address@IC_CoeffKiClampPreSatOutCyl5@ */ /end MEASUREMENT
/begin MEASUREMENT IC_PIOutCyl5 "Cylinder Balancing PID Controller Output for Cylinder 5" FLOAT32_IEEE EcuIntgdSwGend_CM_single_mm_3_stk 0 0 -2000.0 2000.0 ECU_ADDRESS 0x4000DCB8 /* @ECU_Address@IC_PIOutCyl5@ */ /end MEASUREMENT
/begin MEASUREMENT IC_CoeffKiClampOutCyl5 "Cylinder Balancing PID Controller Ki Clmaping Coefficient for Cylinder 5" FLOAT32_IEEE EcuIntgdSwGend_CM_single 0 0 -1000.0 1000.0 ECU_ADDRESS 0x4000E060 /* @ECU_Address@IC_CoeffKiClampOutCyl5@ */ /end MEASUREMENT
/begin MEASUREMENT IC_CoeffKiClampSwtchOutCyl5 "Cylinder Balancing PID Controller Ki Coefficient after Clamping Switch Output for Cylinder 5" FLOAT32_IEEE EcuIntgdSwGend_CM_single 0 0 -1000.0 1000.0 ECU_ADDRESS 0x4000E20C /* @ECU_Address@IC_CoeffKiClampSwtchOutCyl5@ */ /end MEASUREMENT
/begin MEASUREMENT EIP_PAirBoostFild "Filtered Air Boost Pressure" FLOAT32_IEEE EcuIntgdSwGend_CM_single_mbar 0 0 0.0 15000.0 ECU_ADDRESS 0x4000E304 /* @ECU_Address@EIP_PAirBoostFild@ */ /end MEASUREMENT
/begin MEASUREMENT EIP_TiElpdErrPAirBoostSnsr "Elapsed Time for Error Air Boost Pressure Sensor" FLOAT32_IEEE EcuIntgdSwGend_CM_single_ms 0 0 0.0 250000.0 ECU_ADDRESS 0x4000D934 /* @ECU_Address@EIP_TiElpdErrPAirBoostSnsr@ */ /end MEASUREMENT
/begin MEASUREMENT EIP_PAmbAirFild "Filtered Ambient Air Pressure" FLOAT32_IEEE EcuIntgdSwGend_CM_single_mbar 0 0 0.0 15000.0 ECU_ADDRESS 0x4000DF28 /* @ECU_Address@EIP_PAmbAirFild@ */ /end MEASUREMENT
/begin MEASUREMENT EIP_TiElpdErrPAmbAirSnsr "Elapsed Time for Error Ambient Air Pressure Sensor" FLOAT32_IEEE EcuIntgdSwGend_CM_single_ms 0 0 0.0 250000.0 ECU_ADDRESS 0x4000DE38 /* @ECU_Address@EIP_TiElpdErrPAmbAirSnsr@ */ /end MEASUREMENT
/begin MEASUREMENT EIP_PRailFild "Filtered Rail Pressure" FLOAT32_IEEE EcuIntgdSwGend_CM_single_bar 0 0 0.0 15000.0 ECU_ADDRESS 0x4000DF68 /* @ECU_Address@EIP_PRailFild@ */ /end MEASUREMENT
/begin MEASUREMENT EIP_PFuFild "Filtered Fuel Pressure" FLOAT32_IEEE EcuIntgdSwGend_CM_single_mbar 0 0 0.0 15000.0 ECU_ADDRESS 0x4000DCE4 /* @ECU_Address@EIP_PFuFild@ */ /end MEASUREMENT
/begin MEASUREMENT EIP_POilFild "Filtered Oil Pressure" FLOAT32_IEEE EcuIntgdSwGend_CM_single_mbar 0 0 0.0 15000.0 ECU_ADDRESS 0x4000E95C /* @ECU_Address@EIP_POilFild@ */ /end MEASUREMENT
/begin MEASUREMENT EIP_TiElpdErrPOilSnsr "Elapsed Time for Error Oil Pressure Sensor" FLOAT32_IEEE EcuIntgdSwGend_CM_single_ms 0 0 0.0 250000.0 ECU_ADDRESS 0x4000D8B0 /* @ECU_Address@EIP_TiElpdErrPOilSnsr@ */ /end MEASUREMENT
/begin MEASUREMENT EIP_TiElpdErrPFuSnsr "Elapsed Time for Error Fuel Pressure Sensor" FLOAT32_IEEE EcuIntgdSwGend_CM_single_ms 0 0 0.0 250000.0 ECU_ADDRESS 0x4000D884 /* @ECU_Address@EIP_TiElpdErrPFuSnsr@ */ /end MEASUREMENT
/begin MEASUREMENT EIP_TiElpdErrPRailSnsr "Elapsed Time for Error Rail Pressure Sensor" FLOAT32_IEEE EcuIntgdSwGend_CM_single_ms 0 0 0.0 250000.0 ECU_ADDRESS 0x4000E1F4 /* @ECU_Address@EIP_TiElpdErrPRailSnsr@ */ /end MEASUREMENT
/begin MEASUREMENT EIP_TiElpdErrAccrDervDiffLo "Elapsed Time for Error Accelerator Derivation Difference Low" FLOAT32_IEEE EcuIntgdSwGend_CM_single_ms 0 0 0.0 250000.0 ECU_ADDRESS 0x4000DCF4 /* @ECU_Address@EIP_TiElpdErrAccrDervDiffLo@ */ /end MEASUREMENT
/begin MEASUREMENT EIP_TiElpdErrAccrDervDiffHi "Elapsed Time for Error Accelerator Derivation Difference High" FLOAT32_IEEE EcuIntgdSwGend_CM_single_ms 0 0 0.0 250000.0 ECU_ADDRESS 0x4000DA70 /* @ECU_Address@EIP_TiElpdErrAccrDervDiffHi@ */ /end MEASUREMENT
/begin MEASUREMENT EIP_TiElpdErrAccrDiff "Elapsed Time for Error Accelerator Difference" FLOAT32_IEEE EcuIntgdSwGend_CM_single_ms 0 0 0.0 250000.0 ECU_ADDRESS 0x4000E778 /* @ECU_Address@EIP_TiElpdErrAccrDiff@ */ /end MEASUREMENT
/begin MEASUREMENT EIP_TiElpdNEngAcvEmgcyShtdwnForOvspd "Elapsed Time for Engine Speed Actvie for Emergency Shutdown for Overspeed" FLOAT32_IEEE EcuIntgdSwGend_CM_single_ms 0 0 0.0 250000.0 ECU_ADDRESS 0x4000DC24 /* @ECU_Address@EIP_TiElpdNEngAcvEmgcyShtdwnForOvspd@ */ /end MEASUREMENT
/begin MEASUREMENT EIP_TAirBoostFild "Filtered Air Boost Temperature" FLOAT32_IEEE EcuIntgdSwGend_CM_single_degC 0 0 -50.0 250.0 ECU_ADDRESS 0x4000DBB8 /* @ECU_Address@EIP_TAirBoostFild@ */ /end MEASUREMENT
/begin MEASUREMENT EIP_TiElpdErrTAirBoostSnsr "Elapsed Time for Error Air Boost Temperature Sensor" FLOAT32_IEEE EcuIntgdSwGend_CM_single_ms 0 0 0.0 250000.0 ECU_ADDRESS 0x4000D91C /* @ECU_Address@EIP_TiElpdErrTAirBoostSnsr@ */ /end MEASUREMENT
/begin MEASUREMENT EIP_TOilFild "Filtered Oil Temperature" FLOAT32_IEEE EcuIntgdSwGend_CM_single_degC 0 0 -50.0 250.0 ECU_ADDRESS 0x4000DBA8 /* @ECU_Address@EIP_TOilFild@ */ /end MEASUREMENT
/begin MEASUREMENT EIP_TCooltFild "Filtered Coolant Temperature" FLOAT32_IEEE EcuIntgdSwGend_CM_single_degC 0 0 -50.0 250.0 ECU_ADDRESS 0x4000E57C /* @ECU_Address@EIP_TCooltFild@ */ /end MEASUREMENT
/begin MEASUREMENT EIP_TiElpdErrTOilSnsr "Elapsed Time for Error Oil Temperature Sensor" FLOAT32_IEEE EcuIntgdSwGend_CM_single_ms 0 0 0.0 250000.0 ECU_ADDRESS 0x4000E224 /* @ECU_Address@EIP_TiElpdErrTOilSnsr@ */ /end MEASUREMENT
/begin MEASUREMENT EIP_TiElpdErrTCooltSnsr "Elapsed Time for Error Coolant Temperature Sensor" FLOAT32_IEEE EcuIntgdSwGend_CM_single_ms 0 0 0.0 250000.0 ECU_ADDRESS 0x4000E0A8 /* @ECU_Address@EIP_TiElpdErrTCooltSnsr@ */ /end MEASUREMENT
/begin MEASUREMENT EIP_TFuFild "Filtered Fuel Temperature" FLOAT32_IEEE EcuIntgdSwGend_CM_single_degC 0 0 -50.0 250.0 ECU_ADDRESS 0x4000E388 /* @ECU_Address@EIP_TFuFild@ */ /end MEASUREMENT
/begin MEASUREMENT EIP_TEcuFild "Filtered Ecu Temperature" FLOAT32_IEEE EcuIntgdSwGend_CM_single_degC 0 0 -50.0 250.0 ECU_ADDRESS 0x4000E3AC /* @ECU_Address@EIP_TEcuFild@ */ /end MEASUREMENT
/begin MEASUREMENT EIP_TAmbAirFild "Filtered Ambient Air Temperature" FLOAT32_IEEE EcuIntgdSwGend_CM_single_degC 0 0 -50.0 250.0 ECU_ADDRESS 0x4000E2EC /* @ECU_Address@EIP_TAmbAirFild@ */ /end MEASUREMENT
/begin MEASUREMENT EIP_TiElpdErrTAmbAirSnsr "Elapsed Time for Error Ambient Air Temperature Sensor" FLOAT32_IEEE EcuIntgdSwGend_CM_single_ms 0 0 0.0 250000.0 ECU_ADDRESS 0x4000E1FC /* @ECU_Address@EIP_TiElpdErrTAmbAirSnsr@ */ /end MEASUREMENT
/begin MEASUREMENT EIP_TiElpdErrTEcuSnsr "Elapsed Time for Error ECU Temperature Sensor" FLOAT32_IEEE EcuIntgdSwGend_CM_single_ms 0 0 0.0 250000.0 ECU_ADDRESS 0x4000DE84 /* @ECU_Address@EIP_TiElpdErrTEcuSnsr@ */ /end MEASUREMENT
/begin MEASUREMENT EIP_TiEpldErrTFuSnsr "Elapsed Time for Error Fuel Temperature Sensor" FLOAT32_IEEE EcuIntgdSwGend_CM_single_ms 0 0 0.0 250000.0 ECU_ADDRESS 0x4000DAA4 /* @ECU_Address@EIP_TiEpldErrTFuSnsr@ */ /end MEASUREMENT
/begin MEASUREMENT EIP_LvlOilFild "Filtered Oil Level" FLOAT32_IEEE EcuIntgdSwGend_CM_single__ 0 0 0.0 100.0 ECU_ADDRESS 0x4000DF80 /* @ECU_Address@EIP_LvlOilFild@ */ /end MEASUREMENT
/begin MEASUREMENT EIP_TiElpdErrLvlOilSnsr "Elapsed Time for Error Level Oil Sensor" FLOAT32_IEEE EcuIntgdSwGend_CM_single_ms 0 0 0.0 250000.0 ECU_ADDRESS 0x4000DA5C /* @ECU_Address@EIP_TiElpdErrLvlOilSnsr@ */ /end MEASUREMENT
/begin MEASUREMENT EIP_TiElpdErrCylMisfWarn "Elapsed Time for Error Cylinder Misfire Warning" FLOAT32_IEEE EcuIntgdSwGend_CM_single_ms 0 0 0.0 250000.0 ECU_ADDRESS 0x4000DE98 /* @ECU_Address@EIP_TiElpdErrCylMisfWarn@ */ /end MEASUREMENT
/begin MEASUREMENT EIP_TiElpdErrCylMisfRedn "Elapsed Time for Error Cylinder Misfire Reduction" FLOAT32_IEEE EcuIntgdSwGend_CM_single_ms 0 0 0.0 250000.0 ECU_ADDRESS 0x4000DB58 /* @ECU_Address@EIP_TiElpdErrCylMisfRedn@ */ /end MEASUREMENT
/begin MEASUREMENT EIP_TiElpdErrCylMisfShtdwn "Elapsed Time for Error Cylinder Misfire Shutdown" FLOAT32_IEEE EcuIntgdSwGend_CM_single_ms 0 0 0.0 250000.0 ECU_ADDRESS 0x4000E7F4 /* @ECU_Address@EIP_TiElpdErrCylMisfShtdwn@ */ /end MEASUREMENT
/begin MEASUREMENT WM_bErrPRailOv "Rail Pressure Over Error" UBYTE EcuIntgdSwGend_CM_boolean 0 0 0.0 1.0 ECU_ADDRESS 0x4000DD96 /* @ECU_Address@WM_bErrPRailOv@ */ /end MEASUREMENT
/begin MEASUREMENT WM_bPRailOvEna "Rail Pressure Over Error Enable" UBYTE EcuIntgdSwGend_CM_boolean 0 0 0.0 1.0 ECU_ADDRESS 0x4000E818 /* @ECU_Address@WM_bPRailOvEna@ */ /end MEASUREMENT
/begin MEASUREMENT WM_bErrPRailOvLvl1 "Rail Pressure Over Error Level 1" UBYTE EcuIntgdSwGend_CM_boolean 0 0 0.0 1.0 ECU_ADDRESS 0x4000E7C7 /* @ECU_Address@WM_bErrPRailOvLvl1@ */ /end MEASUREMENT
/begin MEASUREMENT WM_bErrPRailOvLvl2 "Rail Pressure Over Error Level 2" UBYTE EcuIntgdSwGend_CM_boolean 0 0 0.0 1.0 ECU_ADDRESS 0x4000E7C8 /* @ECU_Address@WM_bErrPRailOvLvl2@ */ /end MEASUREMENT
/begin MEASUREMENT WM_bErrPRailOvLvl3 "Rail Pressure Over Error Level 3" UBYTE EcuIntgdSwGend_CM_boolean 0 0 0.0 1.0 ECU_ADDRESS 0x4000E404 /* @ECU_Address@WM_bErrPRailOvLvl3@ */ /end MEASUREMENT
/begin MEASUREMENT WM_bPOilUndEna "Oil Pressure Under Error Enable" UBYTE EcuIntgdSwGend_CM_boolean 0 0 0.0 1.0 ECU_ADDRESS 0x4000E774 /* @ECU_Address@WM_bPOilUndEna@ */ /end MEASUREMENT
/begin MEASUREMENT WM_bErrPOilUndLvl1 "Oil Pressure Under Error Level 1" UBYTE EcuIntgdSwGend_CM_boolean 0 0 0.0 1.0 ECU_ADDRESS 0x4000E594 /* @ECU_Address@WM_bErrPOilUndLvl1@ */ /end MEASUREMENT
/begin MEASUREMENT WM_bErrPOilUndLvl2 "Oil Pressure Under Error Level 2" UBYTE EcuIntgdSwGend_CM_boolean 0 0 0.0 1.0 ECU_ADDRESS 0x4000E53A /* @ECU_Address@WM_bErrPOilUndLvl2@ */ /end MEASUREMENT
/begin MEASUREMENT WM_bErrPOilUndLvl3 "Oil Pressure Under Error Level 3" UBYTE EcuIntgdSwGend_CM_boolean 0 0 0.0 1.0 ECU_ADDRESS 0x4000E53B /* @ECU_Address@WM_bErrPOilUndLvl3@ */ /end MEASUREMENT
/begin MEASUREMENT WM_bErrPOilUnd "Oil Pressure Under Error" UBYTE EcuIntgdSwGend_CM_boolean 0 0 0.0 1.0 ECU_ADDRESS 0x4000E115 /* @ECU_Address@WM_bErrPOilUnd@ */ /end MEASUREMENT
/begin MEASUREMENT WM_bPOilOvEna "Oil Pressure Over Error Enable" UBYTE EcuIntgdSwGend_CM_boolean 0 0 0.0 1.0 ECU_ADDRESS 0x4000E984 /* @ECU_Address@WM_bPOilOvEna@ */ /end MEASUREMENT
/begin MEASUREMENT WM_bErrPOilOvLvl1 "Oil Pressure Over Error Level 1" UBYTE EcuIntgdSwGend_CM_boolean 0 0 0.0 1.0 ECU_ADDRESS 0x4000DCD0 /* @ECU_Address@WM_bErrPOilOvLvl1@ */ /end MEASUREMENT
/begin MEASUREMENT WM_bErrPOilOvLvl2 "Oil Pressure Over Error Level 2" UBYTE EcuIntgdSwGend_CM_boolean 0 0 0.0 1.0 ECU_ADDRESS 0x4000DCD1 /* @ECU_Address@WM_bErrPOilOvLvl2@ */ /end MEASUREMENT
/begin MEASUREMENT WM_bErrPOilOvLvl3 "Oil Pressure Over Error Level 3" UBYTE EcuIntgdSwGend_CM_boolean 0 0 0.0 1.0 ECU_ADDRESS 0x4000DCD2 /* @ECU_Address@WM_bErrPOilOvLvl3@ */ /end MEASUREMENT
/begin MEASUREMENT WM_bErrPOilOv "Oil Pressure Over Error" UBYTE EcuIntgdSwGend_CM_boolean 0 0 0.0 1.0 ECU_ADDRESS 0x4000D8A5 /* @ECU_Address@WM_bErrPOilOv@ */ /end MEASUREMENT
/begin MEASUREMENT WM_bPFuUndEna "Fuel Pressure Under Error Enable" UBYTE EcuIntgdSwGend_CM_boolean 0 0 0.0 1.0 ECU_ADDRESS 0x4000E17A /* @ECU_Address@WM_bPFuUndEna@ */ /end MEASUREMENT
/begin MEASUREMENT WM_bErrPFuUndLvl1 "Fuel Pressure Under Error Level 1" UBYTE EcuIntgdSwGend_CM_boolean 0 0 0.0 1.0 ECU_ADDRESS 0x4000E181 /* @ECU_Address@WM_bErrPFuUndLvl1@ */ /end MEASUREMENT
/begin MEASUREMENT WM_bErrPFuUndLvl2 "Fuel Pressure Under Error Level 2" UBYTE EcuIntgdSwGend_CM_boolean 0 0 0.0 1.0 ECU_ADDRESS 0x4000D910 /* @ECU_Address@WM_bErrPFuUndLvl2@ */ /end MEASUREMENT
/begin MEASUREMENT WM_bErrPFuUndLvl3 "Fuel Pressure Under Error Level 3" UBYTE EcuIntgdSwGend_CM_boolean 0 0 0.0 1.0 ECU_ADDRESS 0x4000DDBC /* @ECU_Address@WM_bErrPFuUndLvl3@ */ /end MEASUREMENT
/begin MEASUREMENT WM_bErrPFuUnd "Fuel Pressure Under Error" UBYTE EcuIntgdSwGend_CM_boolean 0 0 0.0 1.0 ECU_ADDRESS 0x4000E760 /* @ECU_Address@WM_bErrPFuUnd@ */ /end MEASUREMENT
/begin MEASUREMENT WM_bPFuOvEna "Fuel Pressure Over Error Enable" UBYTE EcuIntgdSwGend_CM_boolean 0 0 0.0 1.0 ECU_ADDRESS 0x4000DFA5 /* @ECU_Address@WM_bPFuOvEna@ */ /end MEASUREMENT
/begin MEASUREMENT WM_bErrPFuOvLvl1 "Fuel Pressure Over Error Level 1" UBYTE EcuIntgdSwGend_CM_boolean 0 0 0.0 1.0 ECU_ADDRESS 0x4000E5DE /* @ECU_Address@WM_bErrPFuOvLvl1@ */ /end MEASUREMENT
/begin MEASUREMENT WM_bErrPFuOvLvl2 "Fuel Pressure Over Error Level 2" UBYTE EcuIntgdSwGend_CM_boolean 0 0 0.0 1.0 ECU_ADDRESS 0x4000E5DF /* @ECU_Address@WM_bErrPFuOvLvl2@ */ /end MEASUREMENT
/begin MEASUREMENT WM_bErrPFuOvLvl3 "Fuel Pressure Over Error Level 3" UBYTE EcuIntgdSwGend_CM_boolean 0 0 0.0 1.0 ECU_ADDRESS 0x4000E5E0 /* @ECU_Address@WM_bErrPFuOvLvl3@ */ /end MEASUREMENT
/begin MEASUREMENT WM_bErrPFuOv "Fuel Pressure Over Error" UBYTE EcuIntgdSwGend_CM_boolean 0 0 0.0 1.0 ECU_ADDRESS 0x4000DA48 /* @ECU_Address@WM_bErrPFuOv@ */ /end MEASUREMENT
/begin MEASUREMENT WM_bPAmbAirUndEna "Ambient Air Pressure Under Error Enable" UBYTE EcuIntgdSwGend_CM_boolean 0 0 0.0 1.0 ECU_ADDRESS 0x4000DC21 /* @ECU_Address@WM_bPAmbAirUndEna@ */ /end MEASUREMENT
/begin MEASUREMENT WM_bErrPAmbAirUndLvl1 "Ambient Air Pressure Under Error Level 1" UBYTE EcuIntgdSwGend_CM_boolean 0 0 0.0 1.0 ECU_ADDRESS 0x4000D918 /* @ECU_Address@WM_bErrPAmbAirUndLvl1@ */ /end MEASUREMENT
/begin MEASUREMENT WM_bErrPAmbAirUndLvl2 "Ambient Air Pressure Under Error Level 2" UBYTE EcuIntgdSwGend_CM_boolean 0 0 0.0 1.0 ECU_ADDRESS 0x4000D919 /* @ECU_Address@WM_bErrPAmbAirUndLvl2@ */ /end MEASUREMENT
/begin MEASUREMENT WM_bErrPAmbAirUndLvl3 "Ambient Air Pressure Under Error Level 3" UBYTE EcuIntgdSwGend_CM_boolean 0 0 0.0 1.0 ECU_ADDRESS 0x4000D91A /* @ECU_Address@WM_bErrPAmbAirUndLvl3@ */ /end MEASUREMENT
/begin MEASUREMENT WM_bErrPAmbAirUnd "Ambient Air Pressure Under Error" UBYTE EcuIntgdSwGend_CM_boolean 0 0 0.0 1.0 ECU_ADDRESS 0x4000E2B1 /* @ECU_Address@WM_bErrPAmbAirUnd@ */ /end MEASUREMENT
/begin MEASUREMENT WM_bPAmbAirOvEna "Ambient Air Pressure Over Error Enable" UBYTE EcuIntgdSwGend_CM_boolean 0 0 0.0 1.0 ECU_ADDRESS 0x4000E339 /* @ECU_Address@WM_bPAmbAirOvEna@ */ /end MEASUREMENT
/begin MEASUREMENT WM_bErrPAmbAirOvLvl1 "Ambient Air Pressure Over Error Level 1" UBYTE EcuIntgdSwGend_CM_boolean 0 0 0.0 1.0 ECU_ADDRESS 0x4000DE9F /* @ECU_Address@WM_bErrPAmbAirOvLvl1@ */ /end MEASUREMENT
/begin MEASUREMENT WM_bErrPAmbAirOvLvl2 "Ambient Air Pressure Over Error Level 2" UBYTE EcuIntgdSwGend_CM_boolean 0 0 0.0 1.0 ECU_ADDRESS 0x4000DEA0 /* @ECU_Address@WM_bErrPAmbAirOvLvl2@ */ /end MEASUREMENT
/begin MEASUREMENT WM_bErrPAmbAirOvLvl3 "Ambient Air Pressure Over Error Level 3" UBYTE EcuIntgdSwGend_CM_boolean 0 0 0.0 1.0 ECU_ADDRESS 0x4000DEA1 /* @ECU_Address@WM_bErrPAmbAirOvLvl3@ */ /end MEASUREMENT
/begin MEASUREMENT WM_bErrPAmbAirOv "Ambient Air Pressure Over Error" UBYTE EcuIntgdSwGend_CM_boolean 0 0 0.0 1.0 ECU_ADDRESS 0x4000E37C /* @ECU_Address@WM_bErrPAmbAirOv@ */ /end MEASUREMENT
/begin MEASUREMENT WM_bPAirBoostUndEna "Air Boost Pressure Under Error Enable" UBYTE EcuIntgdSwGend_CM_boolean 0 0 0.0 1.0 ECU_ADDRESS 0x4000D84D /* @ECU_Address@WM_bPAirBoostUndEna@ */ /end MEASUREMENT
/begin MEASUREMENT WM_bErrPAirBoostUndLvl1 "Air Boost Pressure Under Level 1" UBYTE EcuIntgdSwGend_CM_boolean 0 0 0.0 1.0 ECU_ADDRESS 0x4000E425 /* @ECU_Address@WM_bErrPAirBoostUndLvl1@ */ /end MEASUREMENT
/begin MEASUREMENT WM_bErrPAirBoostUndLvl2 "Air Boost Pressure Under Level 2" UBYTE EcuIntgdSwGend_CM_boolean 0 0 0.0 1.0 ECU_ADDRESS 0x4000E30C /* @ECU_Address@WM_bErrPAirBoostUndLvl2@ */ /end MEASUREMENT
/begin MEASUREMENT WM_bErrPAirBoostUndLvl3 "Air Boost Pressure Under Level 3" UBYTE EcuIntgdSwGend_CM_boolean 0 0 0.0 1.0 ECU_ADDRESS 0x4000E30D /* @ECU_Address@WM_bErrPAirBoostUndLvl3@ */ /end MEASUREMENT
/begin MEASUREMENT WM_bErrPAirBoostUnd "Air Boost Pressure Under Error" UBYTE EcuIntgdSwGend_CM_boolean 0 0 0.0 1.0 ECU_ADDRESS 0x4000DFF4 /* @ECU_Address@WM_bErrPAirBoostUnd@ */ /end MEASUREMENT
/begin MEASUREMENT WM_bPAirBoostOvEna "Air Boost Pressure Over Error Enable" UBYTE EcuIntgdSwGend_CM_boolean 0 0 0.0 1.0 ECU_ADDRESS 0x4000E974 /* @ECU_Address@WM_bPAirBoostOvEna@ */ /end MEASUREMENT
/begin MEASUREMENT WM_bErrPAirBoostOvLvl1 "Air Boost Pressure Over Error Level 1" UBYTE EcuIntgdSwGend_CM_boolean 0 0 0.0 1.0 ECU_ADDRESS 0x4000DE13 /* @ECU_Address@WM_bErrPAirBoostOvLvl1@ */ /end MEASUREMENT
/begin MEASUREMENT WM_bErrPAirBoostOvLvl2 "Air Boost Pressure Over Error Level 2" UBYTE EcuIntgdSwGend_CM_boolean 0 0 0.0 1.0 ECU_ADDRESS 0x4000E2DB /* @ECU_Address@WM_bErrPAirBoostOvLvl2@ */ /end MEASUREMENT
/begin MEASUREMENT WM_bErrPAirBoostOvLvl3 "Air Boost Pressure Over Error Level 3" UBYTE EcuIntgdSwGend_CM_boolean 0 0 0.0 1.0 ECU_ADDRESS 0x4000E929 /* @ECU_Address@WM_bErrPAirBoostOvLvl3@ */ /end MEASUREMENT
/begin MEASUREMENT WM_bErrPAirBoostOv "Air Boost Pressure Over Error" UBYTE EcuIntgdSwGend_CM_boolean 0 0 0.0 1.0 ECU_ADDRESS 0x4000E550 /* @ECU_Address@WM_bErrPAirBoostOv@ */ /end MEASUREMENT
/begin MEASUREMENT WM_bLvlOilUndEna "Oil Level Under Error Enable" UBYTE EcuIntgdSwGend_CM_boolean 0 0 0.0 1.0 ECU_ADDRESS 0x4000DEEC /* @ECU_Address@WM_bLvlOilUndEna@ */ /end MEASUREMENT
/begin MEASUREMENT WM_bErrLvlOilUndLvl1 "Oil Level Under Error Level 1" UBYTE EcuIntgdSwGend_CM_boolean 0 0 0.0 1.0 ECU_ADDRESS 0x4000DCA4 /* @ECU_Address@WM_bErrLvlOilUndLvl1@ */ /end MEASUREMENT
/begin MEASUREMENT WM_bErrLvlOilUndLvl2 "Oil Level Under Error Level 2" UBYTE EcuIntgdSwGend_CM_boolean 0 0 0.0 1.0 ECU_ADDRESS 0x4000DCA5 /* @ECU_Address@WM_bErrLvlOilUndLvl2@ */ /end MEASUREMENT
/begin MEASUREMENT WM_bErrLvlOilUndLvl3 "Oil Level Under Error Level 3" UBYTE EcuIntgdSwGend_CM_boolean 0 0 0.0 1.0 ECU_ADDRESS 0x4000DCA6 /* @ECU_Address@WM_bErrLvlOilUndLvl3@ */ /end MEASUREMENT
/begin MEASUREMENT WM_bErrLvlOilUnd "Oil Level Under Error" UBYTE EcuIntgdSwGend_CM_boolean 0 0 0.0 1.0 ECU_ADDRESS 0x4000DC75 /* @ECU_Address@WM_bErrLvlOilUnd@ */ /end MEASUREMENT
/begin MEASUREMENT WM_bErrCylMisfEna "Cylinder Misfire Error Enable" UBYTE EcuIntgdSwGend_CM_boolean 0 0 0.0 1.0 ECU_ADDRESS 0x4000E6DA /* @ECU_Address@WM_bErrCylMisfEna@ */ /end MEASUREMENT
/begin MEASUREMENT WM_bErrCylMisfLvl1 "Cylinder Misfire Error Level 1" UBYTE EcuIntgdSwGend_CM_boolean 0 0 0.0 1.0 ECU_ADDRESS 0x4000DC88 /* @ECU_Address@WM_bErrCylMisfLvl1@ */ /end MEASUREMENT
/begin MEASUREMENT WM_bErrCylMisfLvl2 "Cylinder Misfire Error Level 2" UBYTE EcuIntgdSwGend_CM_boolean 0 0 0.0 1.0 ECU_ADDRESS 0x4000DE66 /* @ECU_Address@WM_bErrCylMisfLvl2@ */ /end MEASUREMENT
/begin MEASUREMENT WM_bErrCylMisfLvl3 "Cylinder Misfire Error Level 3" UBYTE EcuIntgdSwGend_CM_boolean 0 0 0.0 1.0 ECU_ADDRESS 0x4000DC90 /* @ECU_Address@WM_bErrCylMisfLvl3@ */ /end MEASUREMENT
/begin MEASUREMENT WM_bErrCylMisf "Cylinder Misfire Error" UBYTE EcuIntgdSwGend_CM_boolean 0 0 0.0 1.0 ECU_ADDRESS 0x4000E88E /* @ECU_Address@WM_bErrCylMisf@ */ /end MEASUREMENT
/begin MEASUREMENT WM_bUClmp30UndEna "Battery Voltage Under Error Enable" UBYTE EcuIntgdSwGend_CM_boolean 0 0 0.0 1.0 ECU_ADDRESS 0x4000DF41 /* @ECU_Address@WM_bUClmp30UndEna@ */ /end MEASUREMENT
/begin MEASUREMENT WM_bErrUClmp30UndLvl1 "Batter Voltage Under Error Level 1" UBYTE EcuIntgdSwGend_CM_boolean 0 0 0.0 1.0 ECU_ADDRESS 0x4000D9D8 /* @ECU_Address@WM_bErrUClmp30UndLvl1@ */ /end MEASUREMENT
/begin MEASUREMENT WM_bErrUClmp30UndLvl2 "Batter Voltage Under Error Level 2" UBYTE EcuIntgdSwGend_CM_boolean 0 0 0.0 1.0 ECU_ADDRESS 0x4000D9D9 /* @ECU_Address@WM_bErrUClmp30UndLvl2@ */ /end MEASUREMENT
/begin MEASUREMENT WM_bErrUClmp30UndLvl3 "Batter Voltage Under Error Level 3" UBYTE EcuIntgdSwGend_CM_boolean 0 0 0.0 1.0 ECU_ADDRESS 0x4000D9DA /* @ECU_Address@WM_bErrUClmp30UndLvl3@ */ /end MEASUREMENT
/begin MEASUREMENT WM_bErrUClmp30Und "Batter Voltage Under Error" UBYTE EcuIntgdSwGend_CM_boolean 0 0 0.0 1.0 ECU_ADDRESS 0x4000E7BD /* @ECU_Address@WM_bErrUClmp30Und@ */ /end MEASUREMENT
/begin MEASUREMENT WM_bUClmp30OvEna "Battery Voltage Over Error Enable" UBYTE EcuIntgdSwGend_CM_boolean 0 0 0.0 1.0 ECU_ADDRESS 0x4000E1D8 /* @ECU_Address@WM_bUClmp30OvEna@ */ /end MEASUREMENT
/begin MEASUREMENT WM_bErrUClmp30OvLvl1 "Batter Voltage Over Error Level 1" UBYTE EcuIntgdSwGend_CM_boolean 0 0 0.0 1.0 ECU_ADDRESS 0x4000E164 /* @ECU_Address@WM_bErrUClmp30OvLvl1@ */ /end MEASUREMENT
/begin MEASUREMENT WM_bErrUClmp30OvLvl2 "Batter Voltage Over Error Level 2" UBYTE EcuIntgdSwGend_CM_boolean 0 0 0.0 1.0 ECU_ADDRESS 0x4000E165 /* @ECU_Address@WM_bErrUClmp30OvLvl2@ */ /end MEASUREMENT
/begin MEASUREMENT WM_bErrUClmp30OvLvl3 "Batter Voltage Over Error Level 3" UBYTE EcuIntgdSwGend_CM_boolean 0 0 0.0 1.0 ECU_ADDRESS 0x4000E768 /* @ECU_Address@WM_bErrUClmp30OvLvl3@ */ /end MEASUREMENT
/begin MEASUREMENT WM_bErrUClmp30Ov "Batter Voltage Over Error" UBYTE EcuIntgdSwGend_CM_boolean 0 0 0.0 1.0 ECU_ADDRESS 0x4000DBC0 /* @ECU_Address@WM_bErrUClmp30Ov@ */ /end MEASUREMENT
/begin MEASUREMENT TL_bComplDebNEngAcvForTCoolt "Engine Dependent Activation Timer Out for Exhaust Left Temperature" UBYTE EcuIntgdSwGend_CM_boolean 0 0 0.0 1.0 ECU_ADDRESS 0x4000E71A /* @ECU_Address@TL_bComplDebNEngAcvForTCoolt@ */ /end MEASUREMENT
/begin MEASUREMENT TL_bComplDebNEngAcvForTFu "Engine Dependent Activation Timer Out for Compressor Inlet Temperature" UBYTE EcuIntgdSwGend_CM_boolean 0 0 0.0 1.0 ECU_ADDRESS 0x4000E549 /* @ECU_Address@TL_bComplDebNEngAcvForTFu@ */ /end MEASUREMENT
/begin MEASUREMENT TL_bComplDebNEngAcvForNExhTrbChrg "Engine Dependent Activation Timer Out for Turbo Charger Speed" UBYTE EcuIntgdSwGend_CM_boolean 0 0 0.0 1.0 ECU_ADDRESS 0x4000E048 /* @ECU_Address@TL_bComplDebNEngAcvForNExhTrbChrg@ */ /end MEASUREMENT
/begin MEASUREMENT TL_bComplDebNEngAcvForPAirBoost "Engine Dependent Activation Timer Out for Air Boost Pressure" UBYTE EcuIntgdSwGend_CM_boolean 0 0 0.0 1.0 ECU_ADDRESS 0x4000E331 /* @ECU_Address@TL_bComplDebNEngAcvForPAirBoost@ */ /end MEASUREMENT
/begin MEASUREMENT TL_bComplDebNEngAcvForTAir "Engine Dependent Activation Timer Out for Air Boost Temperature" UBYTE EcuIntgdSwGend_CM_boolean 0 0 0.0 1.0 ECU_ADDRESS 0x4000E86D /* @ECU_Address@TL_bComplDebNEngAcvForTAir@ */ /end MEASUREMENT
/begin MEASUREMENT TL_bComplDebNEngAcvForPAirAmb "Engine Dependent Activation Timer Out for Ambient Air Pressure" UBYTE EcuIntgdSwGend_CM_boolean 0 0 0.0 1.0 ECU_ADDRESS 0x4000DB79 /* @ECU_Address@TL_bComplDebNEngAcvForPAirAmb@ */ /end MEASUREMENT
/begin MEASUREMENT TL_bComplDebNEngAcvForTOil "Engine Speed Dependent Activation Timer Out for Battery Voltage" UBYTE EcuIntgdSwGend_CM_boolean 0 0 0.0 1.0 ECU_ADDRESS 0x4000E508 /* @ECU_Address@TL_bComplDebNEngAcvForTOil@ */ /end MEASUREMENT
/begin MEASUREMENT SC_bEngNotTurnCompTi "" UBYTE EcuIntgdSwGend_CM_boolean 0 0 0.0 1.0 ECU_ADDRESS 0x4000E4B0 /* @ECU_Address@SC_bEngNotTurnCompTi@ */ /end MEASUREMENT
/begin MEASUREMENT SC_bTiAcvnErrVCVDebOutp "VCV Error Debouncer Activation" UBYTE EcuIntgdSwGend_CM_boolean 0 0 0.0 1.0 ECU_ADDRESS 0x4000E0F2 /* @ECU_Address@SC_bTiAcvnErrVCVDebOutp@ */ /end MEASUREMENT
/begin MEASUREMENT SC_bTiAcvnErrPCVDebOutp "PCV Error Debouncer Activation " UBYTE EcuIntgdSwGend_CM_boolean 0 0 0.0 1.0 ECU_ADDRESS 0x4000E7F8 /* @ECU_Address@SC_bTiAcvnErrPCVDebOutp@ */ /end MEASUREMENT
/begin MEASUREMENT SC_bTiAcvnLvlFuDebOutp "Fuel Level Debouncer Active Output" UBYTE EcuIntgdSwGend_CM_boolean 0 0 0.0 1.0 ECU_ADDRESS 0x4000DED2 /* @ECU_Address@SC_bTiAcvnLvlFuDebOutp@ */ /end MEASUREMENT
/begin MEASUREMENT SC_bTiAcvnLvlOilDebOutp "Oil Level Debouncer Active Output" UBYTE EcuIntgdSwGend_CM_boolean 0 0 0.0 1.0 ECU_ADDRESS 0x4000E821 /* @ECU_Address@SC_bTiAcvnLvlOilDebOutp@ */ /end MEASUREMENT
/begin MEASUREMENT SpdLimr_EngBrkLvl2Ena "Engine Brake Level 2 Enable" UBYTE EcuIntgdSwGend_CM_boolean 0 0 0.0 1.0 ECU_ADDRESS 0x4000E60C /* @ECU_Address@SpdLimr_EngBrkLvl2Ena@ */ /end MEASUREMENT
/begin MEASUREMENT SpdLimr_EngBrkLvl1Ena "Engine Brake Level 1 Enable" UBYTE EcuIntgdSwGend_CM_boolean 0 0 0.0 1.0 ECU_ADDRESS 0x4000E427 /* @ECU_Address@SpdLimr_EngBrkLvl1Ena@ */ /end MEASUREMENT
/begin MEASUREMENT RPG_bCoeffKiRst "Coefficient Integral Reset" UBYTE EcuIntgdSwGend_CM_boolean 0 0 0.0 1.0 ECU_ADDRESS 0x4000D890 /* @ECU_Address@RPG_bCoeffKiRst@ */ /end MEASUREMENT
/begin MEASUREMENT EIP_EngSteadyStFlg "Engine Steady State Flag" UBYTE EcuIntgdSwGend_CM_boolean 0 0 0.0 1.0 ECU_ADDRESS 0x4000E8D1 /* @ECU_Address@EIP_EngSteadyStFlg@ */ /end MEASUREMENT
/begin MEASUREMENT EIP_VehVDeToHi "Vehicle Speed Deviation To High" UBYTE EcuIntgdSwGend_CM_boolean 0 0 0.0 1.0 ECU_ADDRESS 0x4000DB68 /* @ECU_Address@EIP_VehVDeToHi@ */ /end MEASUREMENT
/begin MEASUREMENT EIP_bErrAccrDiff "Error Accelerator Actual Value Difference" UBYTE EcuIntgdSwGend_CM_boolean 0 0 0.0 1.0 ECU_ADDRESS 0x4000DB0D /* @ECU_Address@EIP_bErrAccrDiff@ */ /end MEASUREMENT
/begin MEASUREMENT EIP_bPercgAccrDervDiffHi "Acceleartor Percentage Derivative Difference High" UBYTE EcuIntgdSwGend_CM_boolean 0 0 0.0 1.0 ECU_ADDRESS 0x4000DFBC /* @ECU_Address@EIP_bPercgAccrDervDiffHi@ */ /end MEASUREMENT
/begin MEASUREMENT EIP_bPercgAccrDervDiffLo "Acceleartor Percentage Derivative Difference Low" UBYTE EcuIntgdSwGend_CM_boolean 0 0 0.0 1.0 ECU_ADDRESS 0x4000E1E0 /* @ECU_Address@EIP_bPercgAccrDervDiffLo@ */ /end MEASUREMENT
/begin COMPU_METHOD EcuIntgdSwGend_CM_single_N_m "Q = V" RAT_FUNC "%8.6" "N*m" COEFFS 0 1 0 0 0 1 /end COMPU_METHOD
/begin COMPU_METHOD EcuIntgdSwGend_CM_single_rpm "Q = V" RAT_FUNC "%8.6" "rpm" COEFFS 0 1 0 0 0 1 /end COMPU_METHOD
/begin COMPU_METHOD EcuIntgdSwGend_CM_single_degC "Q = V" RAT_FUNC "%8.6" "degC" COEFFS 0 1 0 0 0 1 /end COMPU_METHOD
/begin COMPU_METHOD EcuIntgdSwGend_CM_single__ "Q = V" RAT_FUNC "%8.6" "%" COEFFS 0 1 0 0 0 1 /end COMPU_METHOD
/begin COMPU_METHOD EcuIntgdSwGend_CM_single "Q = V" RAT_FUNC "%8.6" "" COEFFS 0 1 0 0 0 1 /end COMPU_METHOD
/begin COMPU_METHOD EcuIntgdSwGend_CM_single_deg "Q = V" RAT_FUNC "%8.6" "deg" COEFFS 0 1 0 0 0 1 /end COMPU_METHOD
/begin COMPU_METHOD EcuIntgdSwGend_CM_single_ms "Q = V" RAT_FUNC "%8.6" "ms" COEFFS 0 1 0 0 0 1 /end COMPU_METHOD
/begin COMPU_METHOD EcuIntgdSwGend_CM_single_mbar "Q = V" RAT_FUNC "%8.6" "mbar" COEFFS 0 1 0 0 0 1 /end COMPU_METHOD
/begin COMPU_METHOD EcuIntgdSwGend_CM_single_bar "Q = V" RAT_FUNC "%8.6" "bar" COEFFS 0 1 0 0 0 1 /end COMPU_METHOD
/begin COMPU_METHOD EcuIntgdSwGend_CM_single_mm_3_stk "Q = V" RAT_FUNC "%8.6" "mm^3/stk" COEFFS 0 1 0 0 0 1 /end COMPU_METHOD
/begin COMPU_METHOD EcuIntgdSwGend_CM_single_V "Q = V" RAT_FUNC "%8.6" "V" COEFFS 0 1 0 0 0 1 /end COMPU_METHOD
/begin COMPU_METHOD EcuIntgdSwGend_CM_single_us "Q = V" RAT_FUNC "%8.6" "us" COEFFS 0 1 0 0 0 1 /end COMPU_METHOD
/begin COMPU_METHOD EcuIntgdSwGend_CM_uint32 "Q = V" RAT_FUNC "%10.0" "" COEFFS 0 1 0 0 0 1 /end COMPU_METHOD
/begin COMPU_METHOD EcuIntgdSwGend_CM_boolean "Q = V" RAT_FUNC "%1.0" "" COEFFS 0 1 0 0 0 1 /end COMPU_METHOD
/begin GROUP S104_Injector_6_Misfire "EcuIntgdSwGend/ControlSoftware/EcuInpPrcsg/Additionals/Misfire Detection/Injector 6 Misfire" /begin REF_CHARACTERISTIC EIP_NCyl6MinThd_P /end REF_CHARACTERISTIC /end GROUP
/begin GROUP S105_Debouncer "EcuIntgdSwGend/ControlSoftware/EcuInpPrcsg/Additionals/Shutdown For Cylinder Misfire Error/Debouncer" /begin REF_MEASUREMENT EIP_TiElpdErrCylMisfWarn /end REF_MEASUREMENT /end GROUP
/begin GROUP S105_Debouncer1 "EcuIntgdSwGend/ControlSoftware/EcuInpPrcsg/Additionals/Shutdown For Cylinder Misfire Error/Debouncer1" /begin REF_MEASUREMENT EIP_TiElpdErrCylMisfRedn /end REF_MEASUREMENT /end GROUP
/begin GROUP S105_Debouncer2 "EcuIntgdSwGend/ControlSoftware/EcuInpPrcsg/Additionals/Shutdown For Cylinder Misfire Error/Debouncer2" /begin REF_MEASUREMENT EIP_TiElpdErrCylMisfShtdwn /end REF_MEASUREMENT /end GROUP
/begin GROUP S196_SetRstLtch "EcuIntgdSwGend/ControlSoftware/EcuInpPrcsg/Engine Steady State Detection/InRow_Debouncer/SetRstLtch" /begin REF_CHARACTERISTIC EG_bFlgFalse_C EG_bFlgTrue_C /end REF_CHARACTERISTIC /begin REF_MEASUREMENT EIP_EngSteadyStFlg /end REF_MEASUREMENT /end GROUP
/begin GROUP S200_Debouncer1 "EcuIntgdSwGend/ControlSoftware/EcuInpPrcsg/Level Sensor Signals/Level Sensor Errors/Debouncer1" /begin REF_MEASUREMENT EIP_TiElpdErrLvlOilSnsr /end REF_MEASUREMENT /end GROUP
/begin GROUP S200_Level_Sensor_Diagnostics_Info "EcuIntgdSwGend/ControlSoftware/EcuInpPrcsg/Level Sensor Signals/Level Sensor Errors/Level Sensor Diagnostics Info"
 /begin REF_CHARACTERISTIC EG_DiagcSnsrFltInfoNone_C EG_DiagcSnsrInfoLvlOil_C EG_Mask32Bit0_C EG_Mask32Bit256_C EG_Mask32Bit512_C /end REF_CHARACTERISTIC
/end GROUP
/begin GROUP S200_LowPassFilter2 "EcuIntgdSwGend/ControlSoftware/EcuInpPrcsg/Level Sensor Signals/Level Sensor Errors/LowPassFilter2" /begin REF_CHARACTERISTIC EG_NmrSng0_C EG_bFlgTrue_C /end REF_CHARACTERISTIC /begin REF_MEASUREMENT EIP_LvlOilFild /end REF_MEASUREMENT /end GROUP
/begin GROUP S206_Debouncer1 "EcuIntgdSwGend/ControlSoftware/EcuInpPrcsg/Position & Speed Sensor Signals/Accelerator Pedal Sensor Monitoring/Debouncer1" /begin REF_MEASUREMENT EIP_TiElpdErrAccrDervDiffHi EIP_bPercgAccrDervDiffHi /end REF_MEASUREMENT /end GROUP
/begin GROUP S206_Debouncer5 "EcuIntgdSwGend/ControlSoftware/EcuInpPrcsg/Position & Speed Sensor Signals/Accelerator Pedal Sensor Monitoring/Debouncer5" /begin REF_MEASUREMENT EIP_TiElpdErrAccrDiff EIP_bErrAccrDiff /end REF_MEASUREMENT /end GROUP
/begin GROUP S206_Debouncer6 "EcuIntgdSwGend/ControlSoftware/EcuInpPrcsg/Position & Speed Sensor Signals/Accelerator Pedal Sensor Monitoring/Debouncer6" /begin REF_MEASUREMENT EIP_TiElpdErrAccrDervDiffLo EIP_bPercgAccrDervDiffLo /end REF_MEASUREMENT /end GROUP
/begin GROUP S206_Derv "EcuIntgdSwGend/ControlSoftware/EcuInpPrcsg/Position & Speed Sensor Signals/Accelerator Pedal Sensor Monitoring/Derv" /begin REF_CHARACTERISTIC EG_NmrSng0_C EG_TsSw_C EG_bFlgTrue_C /end REF_CHARACTERISTIC /end GROUP
/begin GROUP S206_Derv1 "EcuIntgdSwGend/ControlSoftware/EcuInpPrcsg/Position & Speed Sensor Signals/Accelerator Pedal Sensor Monitoring/Derv1" /begin REF_CHARACTERISTIC EG_NmrSng0_C EG_TsSw_C EG_bFlgTrue_C /end REF_CHARACTERISTIC /end GROUP
/begin GROUP S206_Derv2 "EcuIntgdSwGend/ControlSoftware/EcuInpPrcsg/Position & Speed Sensor Signals/Accelerator Pedal Sensor Monitoring/Derv2" /begin REF_CHARACTERISTIC EG_NmrSng0_C EG_TsSw_C EG_bFlgTrue_C /end REF_CHARACTERISTIC /end GROUP
/begin GROUP S206_Derv3 "EcuIntgdSwGend/ControlSoftware/EcuInpPrcsg/Position & Speed Sensor Signals/Accelerator Pedal Sensor Monitoring/Derv3" /begin REF_CHARACTERISTIC EG_NmrSng0_C EG_TsSw_C EG_bFlgTrue_C /end REF_CHARACTERISTIC /end GROUP
/begin GROUP S206_Pressure_Sensor_Diagnostic_Info "EcuIntgdSwGend/ControlSoftware/EcuInpPrcsg/Position & Speed Sensor Signals/Accelerator Pedal Sensor Monitoring/Pressure Sensor Diagnostic Info"
 /begin REF_CHARACTERISTIC EG_DiagcSnsrFltInfoNone_C EG_DiagcSnsrInfoAccrPedl1_C EG_DiagcSnsrInfoAccrPedl2_C EG_Mask32Bit0_C EG_Mask32Bit256_C /end REF_CHARACTERISTIC
/end GROUP
/begin GROUP S207_SetRstLtch1 "EcuIntgdSwGend/ControlSoftware/EcuInpPrcsg/Position & Speed Sensor Signals/Accelerator Under Over Condition/SetRstLtch1" /begin REF_CHARACTERISTIC EG_bFlgFalse_C EG_bFlgTrue_C /end REF_CHARACTERISTIC /end GROUP
/begin GROUP S207_SetRstLtch2 "EcuIntgdSwGend/ControlSoftware/EcuInpPrcsg/Position & Speed Sensor Signals/Accelerator Under Over Condition/SetRstLtch2" /begin REF_CHARACTERISTIC EG_bFlgFalse_C EG_bFlgTrue_C /end REF_CHARACTERISTIC /end GROUP
/begin GROUP S208_Debouncer3 "EcuIntgdSwGend/ControlSoftware/EcuInpPrcsg/Position & Speed Sensor Signals/Engine Shutdown Overspeed/Debouncer3" /begin REF_MEASUREMENT EIP_TiElpdNEngAcvEmgcyShtdwnForOvspd /end REF_MEASUREMENT /end GROUP
/begin GROUP S228_Debouncer "EcuIntgdSwGend/ControlSoftware/EcuInpPrcsg/Pressure Sensor Signals/Pressure Sensor Errors/Debouncer" /begin REF_MEASUREMENT EIP_TiElpdErrPAmbAirSnsr /end REF_MEASUREMENT /end GROUP
/begin GROUP S228_Debouncer2 "EcuIntgdSwGend/ControlSoftware/EcuInpPrcsg/Pressure Sensor Signals/Pressure Sensor Errors/Debouncer2" /begin REF_MEASUREMENT EIP_TiElpdErrPFuSnsr /end REF_MEASUREMENT /end GROUP
/begin GROUP S228_Debouncer3 "EcuIntgdSwGend/ControlSoftware/EcuInpPrcsg/Pressure Sensor Signals/Pressure Sensor Errors/Debouncer3" /begin REF_MEASUREMENT EIP_TiElpdErrPOilSnsr /end REF_MEASUREMENT /end GROUP
/begin GROUP S228_Debouncer4 "EcuIntgdSwGend/ControlSoftware/EcuInpPrcsg/Pressure Sensor Signals/Pressure Sensor Errors/Debouncer4" /begin REF_MEASUREMENT EIP_TiElpdErrPAirBoostSnsr /end REF_MEASUREMENT /end GROUP
/begin GROUP S228_Debouncer5 "EcuIntgdSwGend/ControlSoftware/EcuInpPrcsg/Pressure Sensor Signals/Pressure Sensor Errors/Debouncer5" /begin REF_MEASUREMENT EIP_TiElpdErrPRailSnsr /end REF_MEASUREMENT /end GROUP
/begin GROUP S228_LowPassFilter1 "EcuIntgdSwGend/ControlSoftware/EcuInpPrcsg/Pressure Sensor Signals/Pressure Sensor Errors/LowPassFilter1" /begin REF_CHARACTERISTIC EG_NmrSng0_C EG_bFlgTrue_C /end REF_CHARACTERISTIC /begin REF_MEASUREMENT EIP_PAmbAirFild /end REF_MEASUREMENT /end GROUP
/begin GROUP S228_LowPassFilter4 "EcuIntgdSwGend/ControlSoftware/EcuInpPrcsg/Pressure Sensor Signals/Pressure Sensor Errors/LowPassFilter4" /begin REF_CHARACTERISTIC EG_NmrSng0_C EG_bFlgTrue_C /end REF_CHARACTERISTIC /begin REF_MEASUREMENT EIP_PFuFild /end REF_MEASUREMENT /end GROUP
/begin GROUP S228_LowPassFilter5 "EcuIntgdSwGend/ControlSoftware/EcuInpPrcsg/Pressure Sensor Signals/Pressure Sensor Errors/LowPassFilter5" /begin REF_CHARACTERISTIC EG_NmrSng0_C EG_bFlgTrue_C /end REF_CHARACTERISTIC /begin REF_MEASUREMENT EIP_POilFild /end REF_MEASUREMENT /end GROUP
/begin GROUP S228_LowPassFilter6 "EcuIntgdSwGend/ControlSoftware/EcuInpPrcsg/Pressure Sensor Signals/Pressure Sensor Errors/LowPassFilter6" /begin REF_CHARACTERISTIC EG_NmrSng0_C EG_bFlgTrue_C /end REF_CHARACTERISTIC /begin REF_MEASUREMENT EIP_PAirBoostFild /end REF_MEASUREMENT /end GROUP
/begin GROUP S228_LowPassFilter7 "EcuIntgdSwGend/ControlSoftware/EcuInpPrcsg/Pressure Sensor Signals/Pressure Sensor Errors/LowPassFilter7" /begin REF_CHARACTERISTIC EG_NmrSng0_C EG_bFlgTrue_C /end REF_CHARACTERISTIC /begin REF_MEASUREMENT EIP_PRailFild /end REF_MEASUREMENT /end GROUP
/begin GROUP S228_Pressure_Sensor_Diagnostic_Info "EcuIntgdSwGend/ControlSoftware/EcuInpPrcsg/Pressure Sensor Signals/Pressure Sensor Errors/Pressure Sensor Diagnostic Info"
 /begin REF_CHARACTERISTIC EG_DiagcSnsrFltInfoNone_C EG_DiagcSnsrInfoPAirBoost_C EG_DiagcSnsrInfoPAmbAir_C EG_DiagcSnsrInfoPFu_C EG_DiagcSnsrInfoPOil_C EG_DiagcSnsrInfoPRail_C EG_Mask32Bit0_C EG_Mask32Bit256_C EG_Mask32Bit512_C /end REF_CHARACTERISTIC
/end GROUP
/begin GROUP S250_Debouncer "EcuIntgdSwGend/ControlSoftware/EcuInpPrcsg/Temperature Sensor Signals/Temperature Sensor Errors/Debouncer" /begin REF_MEASUREMENT EIP_TiElpdErrTOilSnsr /end REF_MEASUREMENT /end GROUP
/begin GROUP S250_Debouncer1 "EcuIntgdSwGend/ControlSoftware/EcuInpPrcsg/Temperature Sensor Signals/Temperature Sensor Errors/Debouncer1" /begin REF_MEASUREMENT EIP_TiElpdErrTCooltSnsr /end REF_MEASUREMENT /end GROUP
/begin GROUP S250_Debouncer3 "EcuIntgdSwGend/ControlSoftware/EcuInpPrcsg/Temperature Sensor Signals/Temperature Sensor Errors/Debouncer3" /begin REF_MEASUREMENT EIP_TiElpdErrTAirBoostSnsr /end REF_MEASUREMENT /end GROUP
/begin GROUP S250_Debouncer4 "EcuIntgdSwGend/ControlSoftware/EcuInpPrcsg/Temperature Sensor Signals/Temperature Sensor Errors/Debouncer4" /begin REF_MEASUREMENT EIP_TiElpdErrTEcuSnsr /end REF_MEASUREMENT /end GROUP
/begin GROUP S250_Debouncer5 "EcuIntgdSwGend/ControlSoftware/EcuInpPrcsg/Temperature Sensor Signals/Temperature Sensor Errors/Debouncer5" /begin REF_MEASUREMENT EIP_TiEpldErrTFuSnsr /end REF_MEASUREMENT /end GROUP
/begin GROUP S250_Debouncer7 "EcuIntgdSwGend/ControlSoftware/EcuInpPrcsg/Temperature Sensor Signals/Temperature Sensor Errors/Debouncer7" /begin REF_MEASUREMENT EIP_TiElpdErrTAmbAirSnsr /end REF_MEASUREMENT /end GROUP
/begin GROUP S250_LowPassFilter1 "EcuIntgdSwGend/ControlSoftware/EcuInpPrcsg/Temperature Sensor Signals/Temperature Sensor Errors/LowPassFilter1" /begin REF_CHARACTERISTIC EG_NmrSng0_C EG_bFlgTrue_C /end REF_CHARACTERISTIC /begin REF_MEASUREMENT EIP_TCooltFild /end REF_MEASUREMENT /end GROUP
/begin GROUP S250_LowPassFilter2 "EcuIntgdSwGend/ControlSoftware/EcuInpPrcsg/Temperature Sensor Signals/Temperature Sensor Errors/LowPassFilter2" /begin REF_CHARACTERISTIC EG_NmrSng0_C EG_bFlgTrue_C /end REF_CHARACTERISTIC /begin REF_MEASUREMENT EIP_TOilFild /end REF_MEASUREMENT /end GROUP
/begin GROUP S250_LowPassFilter4 "EcuIntgdSwGend/ControlSoftware/EcuInpPrcsg/Temperature Sensor Signals/Temperature Sensor Errors/LowPassFilter4" /begin REF_CHARACTERISTIC EG_NmrSng0_C EG_bFlgTrue_C /end REF_CHARACTERISTIC /begin REF_MEASUREMENT EIP_TAirBoostFild /end REF_MEASUREMENT /end GROUP
/begin GROUP S250_LowPassFilter5 "EcuIntgdSwGend/ControlSoftware/EcuInpPrcsg/Temperature Sensor Signals/Temperature Sensor Errors/LowPassFilter5" /begin REF_CHARACTERISTIC EG_NmrSng0_C EG_bFlgTrue_C /end REF_CHARACTERISTIC /begin REF_MEASUREMENT EIP_TEcuFild /end REF_MEASUREMENT /end GROUP
/begin GROUP S250_LowPassFilter6 "EcuIntgdSwGend/ControlSoftware/EcuInpPrcsg/Temperature Sensor Signals/Temperature Sensor Errors/LowPassFilter6" /begin REF_CHARACTERISTIC EG_NmrSng0_C EG_bFlgTrue_C /end REF_CHARACTERISTIC /begin REF_MEASUREMENT EIP_TFuFild /end REF_MEASUREMENT /end GROUP
/begin GROUP S250_LowPassFilter8 "EcuIntgdSwGend/ControlSoftware/EcuInpPrcsg/Temperature Sensor Signals/Temperature Sensor Errors/LowPassFilter8" /begin REF_CHARACTERISTIC EG_NmrSng0_C EG_bFlgTrue_C /end REF_CHARACTERISTIC /begin REF_MEASUREMENT EIP_TAmbAirFild /end REF_MEASUREMENT /end GROUP
/begin GROUP S250_Temperature_Sensor_Diagnostic_Info "EcuIntgdSwGend/ControlSoftware/EcuInpPrcsg/Temperature Sensor Signals/Temperature Sensor Errors/Temperature Sensor Diagnostic Info"
 /begin REF_CHARACTERISTIC EG_DiagcSnsrFltInfoNone_C EG_DiagcSnsrInfoTAirBoost_C EG_DiagcSnsrInfoTAmbAir_C EG_DiagcSnsrInfoTCoolt_C EG_DiagcSnsrInfoTEcu_C EG_DiagcSnsrInfoTFu_C EG_DiagcSnsrInfoTOil_C EG_Mask32Bit0_C EG_Mask32Bit1024_C EG_Mask32Bit256_C EG_Mask32Bit512_C /end REF_CHARACTERISTIC
/end GROUP
/begin GROUP S279_Debouncer "EcuIntgdSwGend/ControlSoftware/EcuInpPrcsg/Vehicle Velocity Calculation/Vehicle Velocity Calculation/Debouncer" /begin REF_MEASUREMENT EIP_VehVDeToHi /end REF_MEASUREMENT /end GROUP
/begin GROUP S354_Cool_Down "EcuIntgdSwGend/ControlSoftware/EcuOutpPrcsg/CAN Signals/SPN 3543 - Engine Operating State/Cool Down" /begin REF_CHARACTERISTIC EG_SPN3543CoolDwn_C /end REF_CHARACTERISTIC /end GROUP
/begin GROUP S354_Engine_Running_Mode "EcuIntgdSwGend/ControlSoftware/EcuOutpPrcsg/CAN Signals/SPN 3543 - Engine Operating State/Engine Running Mode"
 /begin REF_CHARACTERISTIC EG_ModEngCtlIdleSpd_C EG_ModEngCtlOvspd_C EG_ModEngCtlPTO_C EG_ModEngCtlTSC1_C EG_ModEngCtlTq_C /end REF_CHARACTERISTIC
/end GROUP
/begin GROUP S354_Engine_Stopped___Ready "EcuIntgdSwGend/ControlSoftware/EcuOutpPrcsg/CAN Signals/SPN 3543 - Engine Operating State/Engine Stopped & Ready" /begin REF_CHARACTERISTIC EG_SPN3543EngStopped_C /end REF_CHARACTERISTIC /end GROUP
/begin GROUP S354_Not_Available "EcuIntgdSwGend/ControlSoftware/EcuOutpPrcsg/CAN Signals/SPN 3543 - Engine Operating State/Not Available" /begin REF_CHARACTERISTIC EG_SPN3543NotAvl_C /end REF_CHARACTERISTIC /end GROUP
/begin GROUP S354_Post_Run "EcuIntgdSwGend/ControlSoftware/EcuOutpPrcsg/CAN Signals/SPN 3543 - Engine Operating State/Post Run" /begin REF_CHARACTERISTIC EG_SPN3543PostRun_C /end REF_CHARACTERISTIC /end GROUP
/begin GROUP S354_Pre_Start "EcuIntgdSwGend/ControlSoftware/EcuOutpPrcsg/CAN Signals/SPN 3543 - Engine Operating State/Pre-Start" /begin REF_CHARACTERISTIC EG_SPN3543PreStrt_C /end REF_CHARACTERISTIC /end GROUP
/begin GROUP S354_Running "EcuIntgdSwGend/ControlSoftware/EcuOutpPrcsg/CAN Signals/SPN 3543 - Engine Operating State/Running" /begin REF_CHARACTERISTIC EG_SPN3543Runng_C /end REF_CHARACTERISTIC /end GROUP
/begin GROUP S354_Starting "EcuIntgdSwGend/ControlSoftware/EcuOutpPrcsg/CAN Signals/SPN 3543 - Engine Operating State/Starting" /begin REF_CHARACTERISTIC EG_SPN3543Strtg_C /end REF_CHARACTERISTIC /end GROUP
/begin GROUP S354_Stopping "EcuIntgdSwGend/ControlSoftware/EcuOutpPrcsg/CAN Signals/SPN 3543 - Engine Operating State/Stopping" /begin REF_CHARACTERISTIC EG_SPN3543Stopping_C /end REF_CHARACTERISTIC /end GROUP
/begin GROUP S354_Warm_Up "EcuIntgdSwGend/ControlSoftware/EcuOutpPrcsg/CAN Signals/SPN 3543 - Engine Operating State/Warm Up" /begin REF_CHARACTERISTIC EG_SPN3543WrmUp_C /end REF_CHARACTERISTIC /end GROUP
/begin GROUP S390_ABS_Control___Activated "EcuIntgdSwGend/ControlSoftware/EcuOutpPrcsg/CAN Signals/SPN 899 - Engine Torque Mode/ABS Control - Activated" /begin REF_CHARACTERISTIC EG_ABSActv_C EG_VldInpSt_C /end REF_CHARACTERISTIC /end GROUP
/begin GROUP S390_ABS_control "EcuIntgdSwGend/ControlSoftware/EcuOutpPrcsg/CAN Signals/SPN 899 - Engine Torque Mode/ABS control" /begin REF_CHARACTERISTIC EG_SPN899ABSCtrl_C /end REF_CHARACTERISTIC /end GROUP
/begin GROUP S390_ASR_Control___Activated "EcuIntgdSwGend/ControlSoftware/EcuOutpPrcsg/CAN Signals/SPN 899 - Engine Torque Mode/ASR Control - Activated" /begin REF_CHARACTERISTIC EG_ASRBrkCtrlActv_C EG_ASREngCtrlActv_C EG_VldInpSt_C /end REF_CHARACTERISTIC /end GROUP
/begin GROUP S390_ASR_control "EcuIntgdSwGend/ControlSoftware/EcuOutpPrcsg/CAN Signals/SPN 899 - Engine Torque Mode/ASR control" /begin REF_CHARACTERISTIC EG_SPN899ASRCtrl_C /end REF_CHARACTERISTIC /end GROUP
/begin GROUP S390_Accelerator_pedal__operator_selection "EcuIntgdSwGend/ControlSoftware/EcuOutpPrcsg/CAN Signals/SPN 899 - Engine Torque Mode/Accelerator pedal//operator selection" /begin REF_CHARACTERISTIC EG_SPN899AccrPedl_C /end REF_CHARACTERISTIC /end GROUP
/begin GROUP S390_Cruise_Control "EcuIntgdSwGend/ControlSoftware/EcuOutpPrcsg/CAN Signals/SPN 899 - Engine Torque Mode/Cruise Control" /begin REF_CHARACTERISTIC EG_SPN899CrsCtrl_C /end REF_CHARACTERISTIC /end GROUP
/begin GROUP S390_High_speed_governor "EcuIntgdSwGend/ControlSoftware/EcuOutpPrcsg/CAN Signals/SPN 899 - Engine Torque Mode/High speed governor" /begin REF_CHARACTERISTIC EG_SPN899HiSpdGovr_C /end REF_CHARACTERISTIC /end GROUP
/begin GROUP S390_Low_idle_governor__no_request__default_mode_ "EcuIntgdSwGend/ControlSoftware/EcuOutpPrcsg/CAN Signals/SPN 899 - Engine Torque Mode/Low idle governor//no request (default mode)" /begin REF_CHARACTERISTIC EG_SPN899LoIdleGovr_C /end REF_CHARACTERISTIC /end GROUP
/begin GROUP S390_Not_Defined "EcuIntgdSwGend/ControlSoftware/EcuOutpPrcsg/CAN Signals/SPN 899 - Engine Torque Mode/Not Defined" /begin REF_CHARACTERISTIC EG_SPN899NotDefd_C /end REF_CHARACTERISTIC /end GROUP
/begin GROUP S390_Road_speed_governor "EcuIntgdSwGend/ControlSoftware/EcuOutpPrcsg/CAN Signals/SPN 899 - Engine Torque Mode/Road speed governor" /begin REF_CHARACTERISTIC EG_SPN899RoadSpdGovr_C /end REF_CHARACTERISTIC /end GROUP
/begin GROUP S390_Torque_limiting "EcuIntgdSwGend/ControlSoftware/EcuOutpPrcsg/CAN Signals/SPN 899 - Engine Torque Mode/Torque limiting" /begin REF_CHARACTERISTIC EG_SPN899TqLimd_C /end REF_CHARACTERISTIC /end GROUP
/begin GROUP S390_Transmission_control "EcuIntgdSwGend/ControlSoftware/EcuOutpPrcsg/CAN Signals/SPN 899 - Engine Torque Mode/Transmission control" /begin REF_CHARACTERISTIC EG_SPN899TrsmCtrl_C /end REF_CHARACTERISTIC /end GROUP
/begin GROUP S392_avoidzerodivision_single "EcuIntgdSwGend/ControlSoftware/EcuOutpPrcsg/CAN Signals/SPN 92 - Engine Percent Load At Current Speed/avoidzerodivision_single" /begin REF_CHARACTERISTIC EG_NmrSng0_C EG_NmrSng1_C /end REF_CHARACTERISTIC /end GROUP
/begin GROUP S455_PID_Controller_for_Cylinder_1 "EcuIntgdSwGend/ControlSoftware/InjCtl/Cylinder Balancing/Cylinder Balancing PID Controllers /PID Controller for Cylinder 1" /begin SUB_GROUP S456_clamping_unit /end SUB_GROUP /begin REF_CHARACTERISTIC EG_NmrSng0_C /end REF_CHARACTERISTIC
 /begin REF_MEASUREMENT IC_CoeffKdFbOutCyl1 IC_CoeffKdOutCyl1 IC_CoeffKiClampOutCyl1 IC_CoeffKiClampPreSatOutCyl1 IC_CoeffKiClampSwtchOutCyl1 IC_CoeffKiOutCyl1 IC_CoeffKpOutCyl1 IC_PIOutCyl1 /end REF_MEASUREMENT
/end GROUP
/begin GROUP S455_PID_Controller_for_Cylinder_2 "EcuIntgdSwGend/ControlSoftware/InjCtl/Cylinder Balancing/Cylinder Balancing PID Controllers /PID Controller for Cylinder 2" /begin SUB_GROUP S457_clamping_unit /end SUB_GROUP /begin REF_CHARACTERISTIC EG_NmrSng0_C /end REF_CHARACTERISTIC
 /begin REF_MEASUREMENT IC_CoeffKdFbOutCyl2 IC_CoeffKdOutCyl2 IC_CoeffKiClampOutCyl2 IC_CoeffKiClampPreSatOutCyl2 IC_CoeffKiClampSwtchOutCyl2 IC_CoeffKiOutCyl2 IC_CoeffKpOutCyl2 IC_PIOutCyl2 /end REF_MEASUREMENT
/end GROUP
/begin GROUP S455_PID_Controller_for_Cylinder_3 "EcuIntgdSwGend/ControlSoftware/InjCtl/Cylinder Balancing/Cylinder Balancing PID Controllers /PID Controller for Cylinder 3" /begin SUB_GROUP S458_clamping_unit /end SUB_GROUP /begin REF_CHARACTERISTIC EG_NmrSng0_C /end REF_CHARACTERISTIC
 /begin REF_MEASUREMENT IC_CoeffKdFbOutCyl3 IC_CoeffKdOutCyl3 IC_CoeffKiClampOutCyl3 IC_CoeffKiClampPreSatOutCyl3 IC_CoeffKiClampSwtchOutCyl3 IC_CoeffKiOutCyl3 IC_CoeffKpOutCyl3 IC_PIOutCyl3 /end REF_MEASUREMENT
/end GROUP
/begin GROUP S455_PID_Controller_for_Cylinder_4 "EcuIntgdSwGend/ControlSoftware/InjCtl/Cylinder Balancing/Cylinder Balancing PID Controllers /PID Controller for Cylinder 4" /begin SUB_GROUP S459_clamping_unit /end SUB_GROUP /begin REF_CHARACTERISTIC EG_NmrSng0_C /end REF_CHARACTERISTIC
 /begin REF_MEASUREMENT IC_CoeffKdFbOutCyl4 IC_CoeffKdOutCyl4 IC_CoeffKiClampOutCyl4 IC_CoeffKiClampPreSatOutCyl4 IC_CoeffKiClampSwtchOutCyl4 IC_CoeffKiOutCyl4 IC_CoeffKpOutCyl4 IC_PIOutCyl4 /end REF_MEASUREMENT
/end GROUP
/begin GROUP S455_PID_Controller_for_Cylinder_5 "EcuIntgdSwGend/ControlSoftware/InjCtl/Cylinder Balancing/Cylinder Balancing PID Controllers /PID Controller for Cylinder 5" /begin SUB_GROUP S460_clamping_unit /end SUB_GROUP /begin REF_CHARACTERISTIC EG_NmrSng0_C /end REF_CHARACTERISTIC
 /begin REF_MEASUREMENT IC_CoeffKdFbOutCyl5 IC_CoeffKdOutCyl5 IC_CoeffKiClampOutCyl5 IC_CoeffKiClampPreSatOutCyl5 IC_CoeffKiClampSwtchOutCyl5 IC_CoeffKiOutCyl5 IC_CoeffKpOutCyl5 IC_PIOutCyl5 /end REF_MEASUREMENT
/end GROUP
/begin GROUP S455_PID_Controller_for_Cylinder_6 "EcuIntgdSwGend/ControlSoftware/InjCtl/Cylinder Balancing/Cylinder Balancing PID Controllers /PID Controller for Cylinder 6" /begin SUB_GROUP S461_clamping_unit /end SUB_GROUP /begin REF_CHARACTERISTIC EG_NmrSng0_C /end REF_CHARACTERISTIC
 /begin REF_MEASUREMENT IC_CoeffKdFbOutCyl6 IC_CoeffKdOutCyl6 IC_CoeffKiClampOutCyl6 IC_CoeffKiClampPreSatOutCyl6 IC_CoeffKiClampSwtchOutCyl6 IC_CoeffKiOutCyl6 IC_CoeffKpOutCyl6 IC_PIOutCyl6 /end REF_MEASUREMENT
/end GROUP
/begin GROUP S480_Injector_1_Characteristic_Map_1 "EcuIntgdSwGend/ControlSoftware/InjCtl/Main Injector Characteristic Maps/Injector 1 Characteristic/Injector 1 Characteristic Map 1" /begin REF_CHARACTERISTIC IC_InjChartc1_M /end REF_CHARACTERISTIC /end GROUP
/begin GROUP S480_Injector_1_Characteristic_Map_2 "EcuIntgdSwGend/ControlSoftware/InjCtl/Main Injector Characteristic Maps/Injector 1 Characteristic/Injector 1 Characteristic Map 2" /begin REF_CHARACTERISTIC IC_InjChartc2_M /end REF_CHARACTERISTIC /end GROUP
/begin GROUP S480_Injector_1_Characteristic_Map_3 "EcuIntgdSwGend/ControlSoftware/InjCtl/Main Injector Characteristic Maps/Injector 1 Characteristic/Injector 1 Characteristic Map 3" /begin REF_CHARACTERISTIC IC_InjChartc3_M /end REF_CHARACTERISTIC /end GROUP
/begin GROUP S480_Injector_1_Characteristic_Map_4 "EcuIntgdSwGend/ControlSoftware/InjCtl/Main Injector Characteristic Maps/Injector 1 Characteristic/Injector 1 Characteristic Map 4" /begin REF_CHARACTERISTIC IC_InjChartc4_M /end REF_CHARACTERISTIC /end GROUP
/begin GROUP S480_Injector_1_Characteristic_Map_5 "EcuIntgdSwGend/ControlSoftware/InjCtl/Main Injector Characteristic Maps/Injector 1 Characteristic/Injector 1 Characteristic Map 5" /begin REF_CHARACTERISTIC IC_InjChartc5_M /end REF_CHARACTERISTIC /end GROUP
/begin GROUP S482_Injector_2_Characteristic_Map_1 "EcuIntgdSwGend/ControlSoftware/InjCtl/Main Injector Characteristic Maps/Injector 2 Characteristic/Injector 2 Characteristic Map 1" /begin REF_CHARACTERISTIC IC_InjChartc1_M /end REF_CHARACTERISTIC /end GROUP
/begin GROUP S482_Injector_2_Characteristic_Map_2 "EcuIntgdSwGend/ControlSoftware/InjCtl/Main Injector Characteristic Maps/Injector 2 Characteristic/Injector 2 Characteristic Map 2" /begin REF_CHARACTERISTIC IC_InjChartc2_M /end REF_CHARACTERISTIC /end GROUP
/begin GROUP S482_Injector_2_Characteristic_Map_3 "EcuIntgdSwGend/ControlSoftware/InjCtl/Main Injector Characteristic Maps/Injector 2 Characteristic/Injector 2 Characteristic Map 3" /begin REF_CHARACTERISTIC IC_InjChartc3_M /end REF_CHARACTERISTIC /end GROUP
/begin GROUP S482_Injector_2_Characteristic_Map_4 "EcuIntgdSwGend/ControlSoftware/InjCtl/Main Injector Characteristic Maps/Injector 2 Characteristic/Injector 2 Characteristic Map 4" /begin REF_CHARACTERISTIC IC_InjChartc4_M /end REF_CHARACTERISTIC /end GROUP
/begin GROUP S482_Injector_2_Characteristic_Map_5 "EcuIntgdSwGend/ControlSoftware/InjCtl/Main Injector Characteristic Maps/Injector 2 Characteristic/Injector 2 Characteristic Map 5" /begin REF_CHARACTERISTIC IC_InjChartc5_M /end REF_CHARACTERISTIC /end GROUP
/begin GROUP S484_Injector_3_Characteristic_Map_1 "EcuIntgdSwGend/ControlSoftware/InjCtl/Main Injector Characteristic Maps/Injector 3 Characteristic/Injector 3 Characteristic Map 1" /begin REF_CHARACTERISTIC IC_InjChartc1_M /end REF_CHARACTERISTIC /end GROUP
/begin GROUP S484_Injector_3_Characteristic_Map_2 "EcuIntgdSwGend/ControlSoftware/InjCtl/Main Injector Characteristic Maps/Injector 3 Characteristic/Injector 3 Characteristic Map 2" /begin REF_CHARACTERISTIC IC_InjChartc2_M /end REF_CHARACTERISTIC /end GROUP
/begin GROUP S484_Injector_3_Characteristic_Map_3 "EcuIntgdSwGend/ControlSoftware/InjCtl/Main Injector Characteristic Maps/Injector 3 Characteristic/Injector 3 Characteristic Map 3" /begin REF_CHARACTERISTIC IC_InjChartc3_M /end REF_CHARACTERISTIC /end GROUP
/begin GROUP S484_Injector_3_Characteristic_Map_4 "EcuIntgdSwGend/ControlSoftware/InjCtl/Main Injector Characteristic Maps/Injector 3 Characteristic/Injector 3 Characteristic Map 4" /begin REF_CHARACTERISTIC IC_InjChartc4_M /end REF_CHARACTERISTIC /end GROUP
/begin GROUP S484_Injector_3_Characteristic_Map_5 "EcuIntgdSwGend/ControlSoftware/InjCtl/Main Injector Characteristic Maps/Injector 3 Characteristic/Injector 3 Characteristic Map 5" /begin REF_CHARACTERISTIC IC_InjChartc5_M /end REF_CHARACTERISTIC /end GROUP
/begin GROUP S486_Injector_4_Characteristic_Map_1 "EcuIntgdSwGend/ControlSoftware/InjCtl/Main Injector Characteristic Maps/Injector 4 Characteristic/Injector 4 Characteristic Map 1" /begin REF_CHARACTERISTIC IC_InjChartc1_M /end REF_CHARACTERISTIC /end GROUP
/begin GROUP S486_Injector_4_Characteristic_Map_2 "EcuIntgdSwGend/ControlSoftware/InjCtl/Main Injector Characteristic Maps/Injector 4 Characteristic/Injector 4 Characteristic Map 2" /begin REF_CHARACTERISTIC IC_InjChartc2_M /end REF_CHARACTERISTIC /end GROUP
/begin GROUP S486_Injector_4_Characteristic_Map_3 "EcuIntgdSwGend/ControlSoftware/InjCtl/Main Injector Characteristic Maps/Injector 4 Characteristic/Injector 4 Characteristic Map 3" /begin REF_CHARACTERISTIC IC_InjChartc3_M /end REF_CHARACTERISTIC /end GROUP
/begin GROUP S486_Injector_4_Characteristic_Map_4 "EcuIntgdSwGend/ControlSoftware/InjCtl/Main Injector Characteristic Maps/Injector 4 Characteristic/Injector 4 Characteristic Map 4" /begin REF_CHARACTERISTIC IC_InjChartc4_M /end REF_CHARACTERISTIC /end GROUP
/begin GROUP S486_Injector_4_Characteristic_Map_5 "EcuIntgdSwGend/ControlSoftware/InjCtl/Main Injector Characteristic Maps/Injector 4 Characteristic/Injector 4 Characteristic Map 5" /begin REF_CHARACTERISTIC IC_InjChartc5_M /end REF_CHARACTERISTIC /end GROUP
/begin GROUP S488_Injector_5_Characteristic_Map_1 "EcuIntgdSwGend/ControlSoftware/InjCtl/Main Injector Characteristic Maps/Injector 5 Characteristic/Injector 5 Characteristic Map 1" /begin REF_CHARACTERISTIC IC_InjChartc1_M /end REF_CHARACTERISTIC /end GROUP
/begin GROUP S488_Injector_5_Characteristic_Map_2 "EcuIntgdSwGend/ControlSoftware/InjCtl/Main Injector Characteristic Maps/Injector 5 Characteristic/Injector 5 Characteristic Map 2" /begin REF_CHARACTERISTIC IC_InjChartc2_M /end REF_CHARACTERISTIC /end GROUP
/begin GROUP S488_Injector_5_Characteristic_Map_3 "EcuIntgdSwGend/ControlSoftware/InjCtl/Main Injector Characteristic Maps/Injector 5 Characteristic/Injector 5 Characteristic Map 3" /begin REF_CHARACTERISTIC IC_InjChartc3_M /end REF_CHARACTERISTIC /end GROUP
/begin GROUP S488_Injector_5_Characteristic_Map_4 "EcuIntgdSwGend/ControlSoftware/InjCtl/Main Injector Characteristic Maps/Injector 5 Characteristic/Injector 5 Characteristic Map 4" /begin REF_CHARACTERISTIC IC_InjChartc4_M /end REF_CHARACTERISTIC /end GROUP
/begin GROUP S488_Injector_5_Characteristic_Map_5 "EcuIntgdSwGend/ControlSoftware/InjCtl/Main Injector Characteristic Maps/Injector 5 Characteristic/Injector 5 Characteristic Map 5" /begin REF_CHARACTERISTIC IC_InjChartc5_M /end REF_CHARACTERISTIC /end GROUP
/begin GROUP S490_Injector_6_Characteristic_Map_1 "EcuIntgdSwGend/ControlSoftware/InjCtl/Main Injector Characteristic Maps/Injector 6 Characteristic/Injector 6 Characteristic Map 1" /begin REF_CHARACTERISTIC IC_InjChartc1_M /end REF_CHARACTERISTIC /end GROUP
/begin GROUP S490_Injector_6_Characteristic_Map_2 "EcuIntgdSwGend/ControlSoftware/InjCtl/Main Injector Characteristic Maps/Injector 6 Characteristic/Injector 6 Characteristic Map 2" /begin REF_CHARACTERISTIC IC_InjChartc2_M /end REF_CHARACTERISTIC /end GROUP
/begin GROUP S490_Injector_6_Characteristic_Map_3 "EcuIntgdSwGend/ControlSoftware/InjCtl/Main Injector Characteristic Maps/Injector 6 Characteristic/Injector 6 Characteristic Map 3" /begin REF_CHARACTERISTIC IC_InjChartc3_M /end REF_CHARACTERISTIC /end GROUP
/begin GROUP S490_Injector_6_Characteristic_Map_4 "EcuIntgdSwGend/ControlSoftware/InjCtl/Main Injector Characteristic Maps/Injector 6 Characteristic/Injector 6 Characteristic Map 4" /begin REF_CHARACTERISTIC IC_InjChartc4_M /end REF_CHARACTERISTIC /end GROUP
/begin GROUP S490_Injector_6_Characteristic_Map_5 "EcuIntgdSwGend/ControlSoftware/InjCtl/Main Injector Characteristic Maps/Injector 6 Characteristic/Injector 6 Characteristic Map 5" /begin REF_CHARACTERISTIC IC_InjChartc5_M /end REF_CHARACTERISTIC /end GROUP
/begin GROUP S522_Injector_1_Characteristic_Map_1 "EcuIntgdSwGend/ControlSoftware/InjCtl/Pilot Injector Characteristic Maps/ Injector 1 Characteristic/Injector 1 Characteristic Map 1" /begin REF_CHARACTERISTIC IC_InjChartc1_M /end REF_CHARACTERISTIC /end GROUP
/begin GROUP S522_Injector_1_Characteristic_Map_2 "EcuIntgdSwGend/ControlSoftware/InjCtl/Pilot Injector Characteristic Maps/ Injector 1 Characteristic/Injector 1 Characteristic Map 2" /begin REF_CHARACTERISTIC IC_InjChartc2_M /end REF_CHARACTERISTIC /end GROUP
/begin GROUP S522_Injector_1_Characteristic_Map_3 "EcuIntgdSwGend/ControlSoftware/InjCtl/Pilot Injector Characteristic Maps/ Injector 1 Characteristic/Injector 1 Characteristic Map 3" /begin REF_CHARACTERISTIC IC_InjChartc3_M /end REF_CHARACTERISTIC /end GROUP
/begin GROUP S522_Injector_1_Characteristic_Map_4 "EcuIntgdSwGend/ControlSoftware/InjCtl/Pilot Injector Characteristic Maps/ Injector 1 Characteristic/Injector 1 Characteristic Map 4" /begin REF_CHARACTERISTIC IC_InjChartc4_M /end REF_CHARACTERISTIC /end GROUP
/begin GROUP S522_Injector_1_Characteristic_Map_5 "EcuIntgdSwGend/ControlSoftware/InjCtl/Pilot Injector Characteristic Maps/ Injector 1 Characteristic/Injector 1 Characteristic Map 5" /begin REF_CHARACTERISTIC IC_InjChartc5_M /end REF_CHARACTERISTIC /end GROUP
/begin GROUP S524_Injector_2_Characteristic_Map_1 "EcuIntgdSwGend/ControlSoftware/InjCtl/Pilot Injector Characteristic Maps/ Injector 2 Characteristic/Injector 2 Characteristic Map 1" /begin REF_CHARACTERISTIC IC_InjChartc1_M /end REF_CHARACTERISTIC /end GROUP
/begin GROUP S524_Injector_2_Characteristic_Map_2 "EcuIntgdSwGend/ControlSoftware/InjCtl/Pilot Injector Characteristic Maps/ Injector 2 Characteristic/Injector 2 Characteristic Map 2" /begin REF_CHARACTERISTIC IC_InjChartc2_M /end REF_CHARACTERISTIC /end GROUP
/begin GROUP S524_Injector_2_Characteristic_Map_3 "EcuIntgdSwGend/ControlSoftware/InjCtl/Pilot Injector Characteristic Maps/ Injector 2 Characteristic/Injector 2 Characteristic Map 3" /begin REF_CHARACTERISTIC IC_InjChartc3_M /end REF_CHARACTERISTIC /end GROUP
/begin GROUP S524_Injector_2_Characteristic_Map_4 "EcuIntgdSwGend/ControlSoftware/InjCtl/Pilot Injector Characteristic Maps/ Injector 2 Characteristic/Injector 2 Characteristic Map 4" /begin REF_CHARACTERISTIC IC_InjChartc4_M /end REF_CHARACTERISTIC /end GROUP
/begin GROUP S524_Injector_2_Characteristic_Map_5 "EcuIntgdSwGend/ControlSoftware/InjCtl/Pilot Injector Characteristic Maps/ Injector 2 Characteristic/Injector 2 Characteristic Map 5" /begin REF_CHARACTERISTIC IC_InjChartc5_M /end REF_CHARACTERISTIC /end GROUP
/begin GROUP S526_Injector_3_Characteristic_Map_1 "EcuIntgdSwGend/ControlSoftware/InjCtl/Pilot Injector Characteristic Maps/ Injector 3 Characteristic/Injector 3 Characteristic Map 1" /begin REF_CHARACTERISTIC IC_InjChartc1_M /end REF_CHARACTERISTIC /end GROUP
/begin GROUP S526_Injector_3_Characteristic_Map_2 "EcuIntgdSwGend/ControlSoftware/InjCtl/Pilot Injector Characteristic Maps/ Injector 3 Characteristic/Injector 3 Characteristic Map 2" /begin REF_CHARACTERISTIC IC_InjChartc2_M /end REF_CHARACTERISTIC /end GROUP
/begin GROUP S526_Injector_3_Characteristic_Map_3 "EcuIntgdSwGend/ControlSoftware/InjCtl/Pilot Injector Characteristic Maps/ Injector 3 Characteristic/Injector 3 Characteristic Map 3" /begin REF_CHARACTERISTIC IC_InjChartc3_M /end REF_CHARACTERISTIC /end GROUP
/begin GROUP S526_Injector_3_Characteristic_Map_4 "EcuIntgdSwGend/ControlSoftware/InjCtl/Pilot Injector Characteristic Maps/ Injector 3 Characteristic/Injector 3 Characteristic Map 4" /begin REF_CHARACTERISTIC IC_InjChartc4_M /end REF_CHARACTERISTIC /end GROUP
/begin GROUP S526_Injector_3_Characteristic_Map_5 "EcuIntgdSwGend/ControlSoftware/InjCtl/Pilot Injector Characteristic Maps/ Injector 3 Characteristic/Injector 3 Characteristic Map 5" /begin REF_CHARACTERISTIC IC_InjChartc5_M /end REF_CHARACTERISTIC /end GROUP
/begin GROUP S528_Injector_4_Characteristic_Map_1 "EcuIntgdSwGend/ControlSoftware/InjCtl/Pilot Injector Characteristic Maps/ Injector 4 Characteristic/Injector 4 Characteristic Map 1" /begin REF_CHARACTERISTIC IC_InjChartc1_M /end REF_CHARACTERISTIC /end GROUP
/begin GROUP S528_Injector_4_Characteristic_Map_2 "EcuIntgdSwGend/ControlSoftware/InjCtl/Pilot Injector Characteristic Maps/ Injector 4 Characteristic/Injector 4 Characteristic Map 2" /begin REF_CHARACTERISTIC IC_InjChartc2_M /end REF_CHARACTERISTIC /end GROUP
/begin GROUP S528_Injector_4_Characteristic_Map_3 "EcuIntgdSwGend/ControlSoftware/InjCtl/Pilot Injector Characteristic Maps/ Injector 4 Characteristic/Injector 4 Characteristic Map 3" /begin REF_CHARACTERISTIC IC_InjChartc3_M /end REF_CHARACTERISTIC /end GROUP
/begin GROUP S528_Injector_4_Characteristic_Map_4 "EcuIntgdSwGend/ControlSoftware/InjCtl/Pilot Injector Characteristic Maps/ Injector 4 Characteristic/Injector 4 Characteristic Map 4" /begin REF_CHARACTERISTIC IC_InjChartc4_M /end REF_CHARACTERISTIC /end GROUP
/begin GROUP S528_Injector_4_Characteristic_Map_5 "EcuIntgdSwGend/ControlSoftware/InjCtl/Pilot Injector Characteristic Maps/ Injector 4 Characteristic/Injector 4 Characteristic Map 5" /begin REF_CHARACTERISTIC IC_InjChartc5_M /end REF_CHARACTERISTIC /end GROUP
/begin GROUP S530_Injector_5_Characteristic_Map_1 "EcuIntgdSwGend/ControlSoftware/InjCtl/Pilot Injector Characteristic Maps/ Injector 5 Characteristic/Injector 5 Characteristic Map 1" /begin REF_CHARACTERISTIC IC_InjChartc1_M /end REF_CHARACTERISTIC /end GROUP
/begin GROUP S530_Injector_5_Characteristic_Map_2 "EcuIntgdSwGend/ControlSoftware/InjCtl/Pilot Injector Characteristic Maps/ Injector 5 Characteristic/Injector 5 Characteristic Map 2" /begin REF_CHARACTERISTIC IC_InjChartc2_M /end REF_CHARACTERISTIC /end GROUP
/begin GROUP S530_Injector_5_Characteristic_Map_3 "EcuIntgdSwGend/ControlSoftware/InjCtl/Pilot Injector Characteristic Maps/ Injector 5 Characteristic/Injector 5 Characteristic Map 3" /begin REF_CHARACTERISTIC IC_InjChartc3_M /end REF_CHARACTERISTIC /end GROUP
/begin GROUP S530_Injector_5_Characteristic_Map_4 "EcuIntgdSwGend/ControlSoftware/InjCtl/Pilot Injector Characteristic Maps/ Injector 5 Characteristic/Injector 5 Characteristic Map 4" /begin REF_CHARACTERISTIC IC_InjChartc4_M /end REF_CHARACTERISTIC /end GROUP
/begin GROUP S530_Injector_5_Characteristic_Map_5 "EcuIntgdSwGend/ControlSoftware/InjCtl/Pilot Injector Characteristic Maps/ Injector 5 Characteristic/Injector 5 Characteristic Map 5" /begin REF_CHARACTERISTIC IC_InjChartc5_M /end REF_CHARACTERISTIC /end GROUP
/begin GROUP S532_Injector_6_Characteristic_Map_1 "EcuIntgdSwGend/ControlSoftware/InjCtl/Pilot Injector Characteristic Maps/ Injector 6 Characteristic/Injector 6 Characteristic Map 1" /begin REF_CHARACTERISTIC IC_InjChartc1_M /end REF_CHARACTERISTIC /end GROUP
/begin GROUP S532_Injector_6_Characteristic_Map_2 "EcuIntgdSwGend/ControlSoftware/InjCtl/Pilot Injector Characteristic Maps/ Injector 6 Characteristic/Injector 6 Characteristic Map 2" /begin REF_CHARACTERISTIC IC_InjChartc2_M /end REF_CHARACTERISTIC /end GROUP
/begin GROUP S532_Injector_6_Characteristic_Map_3 "EcuIntgdSwGend/ControlSoftware/InjCtl/Pilot Injector Characteristic Maps/ Injector 6 Characteristic/Injector 6 Characteristic Map 3" /begin REF_CHARACTERISTIC IC_InjChartc3_M /end REF_CHARACTERISTIC /end GROUP
/begin GROUP S532_Injector_6_Characteristic_Map_4 "EcuIntgdSwGend/ControlSoftware/InjCtl/Pilot Injector Characteristic Maps/ Injector 6 Characteristic/Injector 6 Characteristic Map 4" /begin REF_CHARACTERISTIC IC_InjChartc4_M /end REF_CHARACTERISTIC /end GROUP
/begin GROUP S532_Injector_6_Characteristic_Map_5 "EcuIntgdSwGend/ControlSoftware/InjCtl/Pilot Injector Characteristic Maps/ Injector 6 Characteristic/Injector 6 Characteristic Map 5" /begin REF_CHARACTERISTIC IC_InjChartc5_M /end REF_CHARACTERISTIC /end GROUP
/begin GROUP S570_N_Map_Interpolation_for_Main_Start_of_Injection "EcuIntgdSwGend/ControlSoftware/InjCtl/Start of Injection Angle for Pilot and Main Injection/Main SOI Reference Calculation/N-Map Interpolation for Main Start of Injection"
 /begin SUB_GROUP S572_avoidzerodivision_single S572_avoidzerodivision_single1 /end SUB_GROUP
 /begin REF_CHARACTERISTIC IC_SoiMainInjSetPoint1_M IC_SoiMainInjSetPoint2_M IC_SoiMainInjSetPoint3_M IC_TCooltMap1Thd_P IC_TCooltMap2Thd_P IC_TCooltMap3Thd_P /end REF_CHARACTERISTIC
 /begin REF_MEASUREMENT IC_SoiMainInjSetPoint IC_SoiMainInjSetPoint1to2Intp IC_SoiMainInjSetPoint2to3Intp IC_SoiMainInjSetPointFromMap1 IC_SoiMainInjSetPointFromMap2 IC_SoiMainInjSetPointFromMap3 /end REF_MEASUREMENT
/end GROUP
/begin GROUP S571_N_Map_Interpolation_for_Pre_Start_of_Injection_ "EcuIntgdSwGend/ControlSoftware/InjCtl/Start of Injection Angle for Pilot and Main Injection/Pilot SOI Reference Calculation/N-Map Interpolation for Pre Start of Injection "
 /begin SUB_GROUP S575_avoidzerodivision_single S575_avoidzerodivision_single1 /end SUB_GROUP
 /begin REF_CHARACTERISTIC IC_SoiPltInjSetPoint1_M IC_SoiPltInjSetPoint2_M IC_SoiPltInjSetPoint3_M IC_TCooltMap1Thd_P IC_TCooltMap2Thd_P IC_TCooltMap3Thd_P /end REF_CHARACTERISTIC
 /begin REF_MEASUREMENT IC_SoiPltInjSetPoint IC_SoiPltInjSetPoint1to2Intp IC_SoiPltInjSetPoint2to3Intp IC_SoiPltInjSetPointFromMap1 IC_SoiPltInjSetPointFromMap2 IC_SoiPltInjSetPointFromMap3 /end REF_MEASUREMENT
/end GROUP
/begin GROUP S605_clamping_unit "EcuIntgdSwGend/ControlSoftware/PtoCtrl/PTO PID/PID_Controller/clamping_unit" /begin SUB_GROUP S606_deadzone /end SUB_GROUP /begin REF_CHARACTERISTIC EG_NmrSng0_C /end REF_CHARACTERISTIC /end GROUP
/begin GROUP S619_Integrator_Reset "EcuIntgdSwGend/ControlSoftware/RailPGovr/Rail Pressure PID Controller/VCV Opening Percentage PID Controller/Integrator Reset" /begin SUB_GROUP S620_Debouncer /end SUB_GROUP
 /begin REF_CHARACTERISTIC EG_TsSw_C RPG_IntglRstCoeffKiThd_P RPG_IntglRstPRailErrThd_P RPG_IntglRstPercgVCVThd_P RPG_TiDebCoeffKiRst_P RPG_bCoeffKiRstOvs_P RPG_bCoeffKiRstOvv_P /end REF_CHARACTERISTIC
 /begin REF_MEASUREMENT RPG_bCoeffKiRst /end REF_MEASUREMENT
/end GROUP
/begin GROUP S619_clamping_unit "EcuIntgdSwGend/ControlSoftware/RailPGovr/Rail Pressure PID Controller/VCV Opening Percentage PID Controller/clamping_unit" /begin SUB_GROUP S621_deadzone /end SUB_GROUP /begin REF_CHARACTERISTIC EG_NmrSng0_C /end REF_CHARACTERISTIC /end GROUP
/begin GROUP S625_avoidzerodivision_single "EcuIntgdSwGend/ControlSoftware/RailPGovr/Rail Pressure Reference Calculation/N-Map Interpolation for Rail Pressure Reference/avoidzerodivision_single" /begin REF_CHARACTERISTIC EG_NmrSng0_C EG_NmrSng1_C /end REF_CHARACTERISTIC /end GROUP
/begin GROUP S625_avoidzerodivision_single1 "EcuIntgdSwGend/ControlSoftware/RailPGovr/Rail Pressure Reference Calculation/N-Map Interpolation for Rail Pressure Reference/avoidzerodivision_single1" /begin REF_CHARACTERISTIC EG_NmrSng0_C EG_NmrSng1_C /end REF_CHARACTERISTIC /end GROUP
/begin GROUP S633_Debouncer "EcuIntgdSwGend/ControlSoftware/SpdLimr/Engine Brake Activation Via Speed Limiter/Engine Brake Level 1 Activation Condition/Debouncer" /begin REF_MEASUREMENT SpdLimr_TiElpdEngBrkLvl1Actvn /end REF_MEASUREMENT /end GROUP
/begin GROUP S633_SetRstLtch1 "EcuIntgdSwGend/ControlSoftware/SpdLimr/Engine Brake Activation Via Speed Limiter/Engine Brake Level 1 Activation Condition/SetRstLtch1" /begin REF_CHARACTERISTIC EG_bFlgFalse_C EG_bFlgTrue_C /end REF_CHARACTERISTIC /begin REF_MEASUREMENT SpdLimr_EngBrkLvl1Ena /end REF_MEASUREMENT /end GROUP
/begin GROUP S634_Debouncer1 "EcuIntgdSwGend/ControlSoftware/SpdLimr/Engine Brake Activation Via Speed Limiter/Engine Brake Level 2 Activation Condition/Debouncer1" /begin REF_MEASUREMENT SpdLimr_TiElpdEngBrkLvl2Actvn /end REF_MEASUREMENT /end GROUP
/begin GROUP S634_SetRstLtch2 "EcuIntgdSwGend/ControlSoftware/SpdLimr/Engine Brake Activation Via Speed Limiter/Engine Brake Level 2 Activation Condition/SetRstLtch2" /begin REF_CHARACTERISTIC EG_bFlgFalse_C EG_bFlgTrue_C /end REF_CHARACTERISTIC /begin REF_MEASUREMENT SpdLimr_EngBrkLvl2Ena /end REF_MEASUREMENT /end GROUP
/begin GROUP S641_PID_Controller "EcuIntgdSwGend/ControlSoftware/SpdLimr/Speed Limiter PID/SpeedLimiterPIDController/PID_Controller" /begin SUB_GROUP S642_clamping_unit /end SUB_GROUP /begin REF_CHARACTERISTIC EG_NmrSng0_C /end REF_CHARACTERISTIC /begin REF_MEASUREMENT SpdLimr_PIDOutSpdLimrTq /end REF_MEASUREMENT /end GROUP
/begin GROUP S656_CompRstTmr "EcuIntgdSwGend/ControlSoftware/StrtrCtl/Start Error Detect Algorithms /Engine Not Turn/CompRstTmr" /begin REF_CHARACTERISTIC EG_NmrInt0_C /end REF_CHARACTERISTIC /begin REF_MEASUREMENT SC_TiElpdEngNotTurn SC_bEngNotTurnCompTi /end REF_MEASUREMENT /end GROUP
/begin GROUP S656_Pos_Edge2 "EcuIntgdSwGend/ControlSoftware/StrtrCtl/Start Error Detect Algorithms /Engine Not Turn/Pos_Edge2" /begin REF_CHARACTERISTIC EG_NmrSng0_C /end REF_CHARACTERISTIC /end GROUP
/begin GROUP S656_SetRstLtch1 "EcuIntgdSwGend/ControlSoftware/StrtrCtl/Start Error Detect Algorithms /Engine Not Turn/SetRstLtch1" /begin REF_CHARACTERISTIC EG_bFlgFalse_C EG_bFlgTrue_C /end REF_CHARACTERISTIC /end GROUP
/begin GROUP S657_CompRstTmr1 "EcuIntgdSwGend/ControlSoftware/StrtrCtl/Start Error Detect Algorithms /Engine Over Heating Protection/CompRstTmr1" /begin REF_CHARACTERISTIC EG_NmrInt0_C /end REF_CHARACTERISTIC /begin REF_MEASUREMENT SC_TiElpdStrtrProtn /end REF_MEASUREMENT /end GROUP
/begin GROUP S657_Neg_Edge "EcuIntgdSwGend/ControlSoftware/StrtrCtl/Start Error Detect Algorithms /Engine Over Heating Protection/Neg_Edge" /begin REF_CHARACTERISTIC EG_NmrSng0_C /end REF_CHARACTERISTIC /end GROUP
/begin GROUP S657_SetRstLtch "EcuIntgdSwGend/ControlSoftware/StrtrCtl/Start Error Detect Algorithms /Engine Over Heating Protection/SetRstLtch" /begin REF_CHARACTERISTIC EG_bFlgFalse_C EG_bFlgTrue_C /end REF_CHARACTERISTIC /end GROUP
/begin GROUP S664_Debouncer "EcuIntgdSwGend/ControlSoftware/StrtrCtl/StartInhibitor/Electrical Failure Dependent Sensor Inhibitor/Debouncer" /begin REF_MEASUREMENT SC_TiElpdAcvnErrVCVDeb SC_bTiAcvnErrVCVDebOutp /end REF_MEASUREMENT /end GROUP
/begin GROUP S664_Debouncer1 "EcuIntgdSwGend/ControlSoftware/StrtrCtl/StartInhibitor/Electrical Failure Dependent Sensor Inhibitor/Debouncer1" /begin REF_MEASUREMENT SC_TiElpdAcvnErrPCVDeb SC_bTiAcvnErrPCVDebOutp /end REF_MEASUREMENT /end GROUP
/begin GROUP S665_Debouncer1 "EcuIntgdSwGend/ControlSoftware/StrtrCtl/StartInhibitor/Sensor Inhibitor/Debouncer1" /begin REF_MEASUREMENT SC_TiElpdAcvnLvlFuDeb SC_bTiAcvnLvlFuDebOutp /end REF_MEASUREMENT /end GROUP
/begin GROUP S665_Debouncer2 "EcuIntgdSwGend/ControlSoftware/StrtrCtl/StartInhibitor/Sensor Inhibitor/Debouncer2" /begin REF_MEASUREMENT SC_TiElpdAcvnLvlOilDeb SC_bTiAcvnLvlOilDebOutp /end REF_MEASUREMENT /end GROUP
/begin GROUP S689_avoidzerodivision_single "EcuIntgdSwGend/ControlSoftware/TqCnvn/Torque Conversion For SPN  2432 - Engine Demand Torque/N-Map Interpolation for Main Quantity/avoidzerodivision_single" /begin REF_CHARACTERISTIC EG_NmrSng0_C EG_NmrSng1_C /end REF_CHARACTERISTIC /end GROUP
/begin GROUP S689_avoidzerodivision_single1 "EcuIntgdSwGend/ControlSoftware/TqCnvn/Torque Conversion For SPN  2432 - Engine Demand Torque/N-Map Interpolation for Main Quantity/avoidzerodivision_single1" /begin REF_CHARACTERISTIC EG_NmrSng0_C EG_NmrSng1_C /end REF_CHARACTERISTIC /end GROUP
/begin GROUP S690_avoidzerodivision_single "EcuIntgdSwGend/ControlSoftware/TqCnvn/Torque Conversion For SPN  2432 - Engine Demand Torque/N-Map Interpolation for Pre Quantity/avoidzerodivision_single" /begin REF_CHARACTERISTIC EG_NmrSng0_C EG_NmrSng1_C /end REF_CHARACTERISTIC /end GROUP
/begin GROUP S690_avoidzerodivision_single1 "EcuIntgdSwGend/ControlSoftware/TqCnvn/Torque Conversion For SPN  2432 - Engine Demand Torque/N-Map Interpolation for Pre Quantity/avoidzerodivision_single1" /begin REF_CHARACTERISTIC EG_NmrSng0_C EG_NmrSng1_C /end REF_CHARACTERISTIC /end GROUP
/begin GROUP S692_avoidzerodivision_single "EcuIntgdSwGend/ControlSoftware/TqCnvn/Torque Conversion For SPN  2432 - Engine Demand Torque/Smoke Limitation/avoidzerodivision_single" /begin REF_CHARACTERISTIC EG_NmrSng0_C EG_NmrSng1_C /end REF_CHARACTERISTIC /end GROUP
/begin GROUP S692_avoidzerodivision_single1 "EcuIntgdSwGend/ControlSoftware/TqCnvn/Torque Conversion For SPN  2432 - Engine Demand Torque/Smoke Limitation/avoidzerodivision_single1" /begin REF_CHARACTERISTIC EG_NmrSng0_C EG_NmrSng1_C /end REF_CHARACTERISTIC /end GROUP
/begin GROUP S692_avoidzerodivision_single2 "EcuIntgdSwGend/ControlSoftware/TqCnvn/Torque Conversion For SPN  2432 - Engine Demand Torque/Smoke Limitation/avoidzerodivision_single2" /begin REF_CHARACTERISTIC EG_NmrSng0_C EG_NmrSng1_C /end REF_CHARACTERISTIC /end GROUP
/begin GROUP S713_Debouncer "EcuIntgdSwGend/ControlSoftware/TqLim/Engine Protection/Torque Limitation For Fuel Temperature/Debouncer" /begin REF_MEASUREMENT TL_TiElpdNEngAcvForTFu TL_bComplDebNEngAcvForTFu /end REF_MEASUREMENT /end GROUP
/begin GROUP S714_Debouncer "EcuIntgdSwGend/ControlSoftware/TqLim/Engine Protection/Torque Limitation for Air Temperature/Debouncer" /begin REF_MEASUREMENT TL_TiElpdNEngAcvForTAir TL_bComplDebNEngAcvForTAir /end REF_MEASUREMENT /end GROUP
/begin GROUP S715_Debouncer "EcuIntgdSwGend/ControlSoftware/TqLim/Engine Protection/Torque Limitation for Ambient Air Pressure/Debouncer" /begin REF_MEASUREMENT TL_TiElpdNEngAcvForPAirAmb TL_bComplDebNEngAcvForPAirAmb /end REF_MEASUREMENT /end GROUP
/begin GROUP S716_Debouncer "EcuIntgdSwGend/ControlSoftware/TqLim/Engine Protection/Torque Limitation for Coolant Temperature/Debouncer" /begin REF_MEASUREMENT TL_TiElpdNEngAcvForTCoolt TL_bComplDebNEngAcvForTCoolt /end REF_MEASUREMENT /end GROUP
/begin GROUP S717_Debouncer "EcuIntgdSwGend/ControlSoftware/TqLim/Engine Protection/Torque Limitation for Intake Air Pressure/Debouncer"
 /begin REF_MEASUREMENT TL_TiElpdNEngAcvForPAirBoost TL_bComplDebNEngAcvForPAirBoost /end REF_MEASUREMENT
/end GROUP
/begin GROUP S718_Debouncer1 "EcuIntgdSwGend/ControlSoftware/TqLim/Engine Protection/Torque Limitation for Oil Temperature/Debouncer1" /begin REF_MEASUREMENT TL_TiElpdNEngAcvForTOil TL_bComplDebNEngAcvForTOil /end REF_MEASUREMENT /end GROUP
/begin GROUP S720_Debouncer "EcuIntgdSwGend/ControlSoftware/TqLim/Engine Protection/Torque Limitation for Turbo Charge Speed/Debouncer"
 /begin REF_MEASUREMENT TL_TiElpdNEngAcvForNExhTrbChrg TL_bComplDebNEngAcvForNExhTrbChrg /end REF_MEASUREMENT
/end GROUP
/begin GROUP S732_Engine_Speed_Level_Check "EcuIntgdSwGend/ControlSoftware/WarnMong/Warning-Reduction-Shutdown Functions/Global Enable/Engine Speed Level Check"
 /begin SUB_GROUP S739_Hysteresis_Switch S739_Hysteresis_Switch1 S739_Hysteresis_Switch2 S739_Hysteresis_Switch3 S739_Hysteresis_Switch4 S739_Hysteresis_Switch5 S739_Hysteresis_Switch6 /end SUB_GROUP
 /begin REF_CHARACTERISTIC EG_bFlgTrue_C WM_NEngLvl1ClrThd_P WM_NEngLvl1DetdThd_P WM_NEngLvl2ClrThd_P WM_NEngLvl2DetdThd_P WM_NEngLvl3ClrThd_P WM_NEngLvl3DetdThd_P WM_NEngLvl4ClrThd_P WM_NEngLvl4DetdThd_P WM_NEngLvl5ClrThd_P WM_NEngLvl5DetdThd_P WM_NEngLvl6ClrThd_P WM_NEngLvl6DetdThd_P WM_NEngLvl7ClrThd_P WM_NEngLvl7DetdThd_P /end REF_CHARACTERISTIC
/end GROUP
/begin GROUP S733_Battery_Over_Voltage "EcuIntgdSwGend/ControlSoftware/WarnMong/Warning-Reduction-Shutdown Functions/Internal/Battery Over Voltage"
 /begin REF_CHARACTERISTIC EG_Mask32Bit0_C EG_NmrInt0_C EG_NmrInt1_C EG_NmrInt2_C EG_NmrInt3_C EG_TsSw20_C EG_bFlgFalse_C EG_bFlgTrue_C WM_MaskRTNForErrUClmp30Ov_P WM_MaskRctnForUClmp30OvLvl1Err_P WM_MaskRctnForUClmp30OvLvl2Err_P WM_MaskRctnForUClmp30OvLvl3Err_P WM_MaskUClmp30OvEnaCond_P WM_TiUClmp30OvDebHi_P WM_TiUClmp30OvDebLo_P WM_UClmp30OvDesLvlQnty_P WM_UClmp30OvHysDeacLvl1_P WM_UClmp30OvHysDeacLvl2_P WM_UClmp30OvHysDeacLvl3_P WM_UClmp30OvLvl1_M WM_UClmp30OvLvl2_M WM_UClmp30OvLvl3_M /end REF_CHARACTERISTIC
 /begin REF_MEASUREMENT WM_MaskRctnForUClmp30OvErr WM_bErrUClmp30Ov WM_bErrUClmp30OvLvl1 WM_bErrUClmp30OvLvl2 WM_bErrUClmp30OvLvl3 WM_bUClmp30OvEna /end REF_MEASUREMENT
/end GROUP
/begin GROUP S733_Battery_Under_Voltage "EcuIntgdSwGend/ControlSoftware/WarnMong/Warning-Reduction-Shutdown Functions/Internal/Battery Under Voltage"
 /begin REF_CHARACTERISTIC EG_Mask32Bit0_C EG_NmrInt0_C EG_NmrInt1_C EG_NmrInt2_C EG_NmrInt3_C EG_TsSw20_C EG_bFlgFalse_C EG_bFlgTrue_C WM_MaskRTNForErrUClmp30Und_P WM_MaskRctnForUClmp30UndLvl1Err_P WM_MaskRctnForUClmp30UndLvl2Err_P WM_MaskRctnForUClmp30UndLvl3Err_P WM_MaskUClmp30UndEnaCond_P WM_TiUClmp30UndDebHi_P WM_TiUClmp30UndDebLo_P WM_UClmp30UndDesLvlQnty_P WM_UClmp30UndHysDeacLvl1_P WM_UClmp30UndHysDeacLvl2_P WM_UClmp30UndHysDeacLvl3_P WM_UClmp30UndLvl1_M WM_UClmp30UndLvl2_M WM_UClmp30UndLvl3_M /end REF_CHARACTERISTIC
 /begin REF_MEASUREMENT WM_MaskRctnForUClmp30UndErr WM_bErrUClmp30Und WM_bErrUClmp30UndLvl1 WM_bErrUClmp30UndLvl2 WM_bErrUClmp30UndLvl3 WM_bUClmp30UndEna /end REF_MEASUREMENT
/end GROUP
/begin GROUP S733_Cylinder_Misfire "EcuIntgdSwGend/ControlSoftware/WarnMong/Warning-Reduction-Shutdown Functions/Internal/Cylinder Misfire"
 /begin REF_CHARACTERISTIC EG_Mask32Bit0_C EG_NmrInt0_C EG_NmrInt1_C EG_NmrInt2_C EG_NmrInt3_C EG_TsSw20_C EG_bFlgFalse_C EG_bFlgTrue_C WM_ErrCylMisfDesLvlQnty_P WM_MaskErrCylMisfEnaCond_P WM_MaskRTNForErrCylMisf_P WM_MaskRctnForErrCylMisfLvl1Err_P WM_MaskRctnForErrCylMisfLvl2Err_P WM_MaskRctnForErrCylMisfLvl3Err_P WM_TiErrCylMisfDeb_P /end REF_CHARACTERISTIC
 /begin REF_MEASUREMENT WM_MaskRctnForErrCylMisfErr WM_bErrCylMisf WM_bErrCylMisfEna WM_bErrCylMisfLvl1 WM_bErrCylMisfLvl2 WM_bErrCylMisfLvl3 /end REF_MEASUREMENT
/end GROUP
/begin GROUP S733_Oil_Under_Level "EcuIntgdSwGend/ControlSoftware/WarnMong/Warning-Reduction-Shutdown Functions/Internal/Oil Under Level"
 /begin REF_CHARACTERISTIC EG_Mask32Bit0_C EG_NmrInt0_C EG_NmrInt1_C EG_NmrInt2_C EG_NmrInt3_C EG_TsSw20_C EG_bFlgFalse_C EG_bFlgTrue_C WM_LvlOilLvl1_M WM_LvlOilLvl2_M WM_LvlOilUndDesLvlQnty_P WM_LvlOilUndHysDeacLvl1_P WM_LvlOilUndHysDeacLvl2_P WM_LvlOilUndHysDeacLvl3_P WM_LvlOilUndLvl3_M WM_MaskLvlOilUndEnaCond_P WM_MaskRTNForErrLvlOilUnd_P WM_MaskRctnForLvlOilUndLvl1Err_P WM_MaskRctnForLvlOilUndLvl2Err_P WM_MaskRctnForLvlOilUndLvl3Err_P WM_TiLvlOilUndDebHi_P WM_TiLvlOilUndDebLo_P /end REF_CHARACTERISTIC
 /begin REF_MEASUREMENT WM_MaskRctnForLvlOilUndErr WM_bErrLvlOilUnd WM_bErrLvlOilUndLvl1 WM_bErrLvlOilUndLvl2 WM_bErrLvlOilUndLvl3 WM_bLvlOilUndEna /end REF_MEASUREMENT
/end GROUP
/begin GROUP S735_Air_Boost_Over_Pressure "EcuIntgdSwGend/ControlSoftware/WarnMong/Warning-Reduction-Shutdown Functions/Pressure/Air Boost Over Pressure"
 /begin REF_CHARACTERISTIC EG_Mask32Bit0_C EG_NmrInt0_C EG_NmrInt1_C EG_NmrInt2_C EG_NmrInt3_C EG_TsSw20_C EG_bFlgFalse_C EG_bFlgTrue_C WM_MaskPAirBoostOvEnaCond_P WM_MaskRTNForErrPAirBoostOv_P WM_MaskRctnForPAirBoostOvLvl1Err_P WM_MaskRctnForPAirBoostOvLvl2Err_P WM_MaskRctnForPAirBoostOvLvl3Err_P WM_PAirBoostOvDesLvlQnty_P WM_PAirBoostOvHysDeacLvl1_P WM_PAirBoostOvHysDeacLvl2_P WM_PAirBoostOvHysDeacLvl3_P WM_PAirBoostOvLvl1_M WM_PAirBoostOvLvl2_M WM_PAirBoostOvLvl3_M WM_TiPAirBoostOvDebHi_P WM_TiPAirBoostOvDebLo_P /end REF_CHARACTERISTIC
 /begin REF_MEASUREMENT WM_MaskRctnForPAirBoostOvErr WM_bErrPAirBoostOv WM_bErrPAirBoostOvLvl1 WM_bErrPAirBoostOvLvl2 WM_bErrPAirBoostOvLvl3 WM_bPAirBoostOvEna /end REF_MEASUREMENT
/end GROUP
/begin GROUP S735_Air_Boost_Under_Pressure "EcuIntgdSwGend/ControlSoftware/WarnMong/Warning-Reduction-Shutdown Functions/Pressure/Air Boost Under Pressure"
 /begin REF_CHARACTERISTIC EG_Mask32Bit0_C EG_NmrInt0_C EG_NmrInt1_C EG_NmrInt2_C EG_NmrInt3_C EG_TsSw20_C EG_bFlgFalse_C EG_bFlgTrue_C WM_MaskPAirBoostUndEnaCond_P WM_MaskRTNForErrPAirBoostUnd_P WM_MaskRctnForPAirBoostUndLvl1Err_P WM_MaskRctnForPAirBoostUndLvl2Err_P WM_MaskRctnForPAirBoostUndLvl3Err_P WM_PAirBoostUndDesLvlQnty_P WM_PAirBoostUndHysDeacLvl1_P WM_PAirBoostUndHysDeacLvl2_P WM_PAirBoostUndHysDeacLvl3_P WM_PAirBoostUndLvl1_M WM_PAirBoostUndLvl2_M WM_PAirBoostUndLvl3_M WM_TiPAirBoostUndDebHi_P WM_TiPAirBoostUndDebLo_P /end REF_CHARACTERISTIC
 /begin REF_MEASUREMENT WM_MaskRctnForPAirBoostUndErr WM_bErrPAirBoostUnd WM_bErrPAirBoostUndLvl1 WM_bErrPAirBoostUndLvl2 WM_bErrPAirBoostUndLvl3 WM_bPAirBoostUndEna /end REF_MEASUREMENT
/end GROUP
/begin GROUP S735_Ambient_Air_Over_Pressure "EcuIntgdSwGend/ControlSoftware/WarnMong/Warning-Reduction-Shutdown Functions/Pressure/Ambient Air Over Pressure"
 /begin REF_CHARACTERISTIC EG_Mask32Bit0_C EG_NmrInt0_C EG_NmrInt1_C EG_NmrInt2_C EG_NmrInt3_C EG_TsSw20_C EG_bFlgFalse_C EG_bFlgTrue_C WM_MaskPAmbAirOvEnaCond_P WM_MaskRTNForErrPAmbAirOv_P WM_MaskRctnForPAmbAirOvLvl1Err_P WM_MaskRctnForPAmbAirOvLvl2Err_P WM_MaskRctnForPAmbAirOvLvl3Err_P WM_PAmbAirOvDesLvlQnty_P WM_PAmbAirOvHysDeacLvl1_P WM_PAmbAirOvHysDeacLvl2_P WM_PAmbAirOvHysDeacLvl3_P WM_PAmbAirOvLvl1_M WM_PAmbAirOvLvl2_M WM_PAmbAirOvLvl3_M WM_TiPAmbAirOvDebHi_P WM_TiPAmbAirOvDebLo_P /end REF_CHARACTERISTIC
 /begin REF_MEASUREMENT WM_MaskRctnForPAmbAirOvErr WM_bErrPAmbAirOv WM_bErrPAmbAirOvLvl1 WM_bErrPAmbAirOvLvl2 WM_bErrPAmbAirOvLvl3 WM_bPAmbAirOvEna /end REF_MEASUREMENT
/end GROUP
/begin GROUP S735_Ambient_Air_Under_Pressure "EcuIntgdSwGend/ControlSoftware/WarnMong/Warning-Reduction-Shutdown Functions/Pressure/Ambient Air Under Pressure"
 /begin REF_CHARACTERISTIC EG_Mask32Bit0_C EG_NmrInt0_C EG_NmrInt1_C EG_NmrInt2_C EG_NmrInt3_C EG_TsSw20_C EG_bFlgFalse_C EG_bFlgTrue_C WM_MaskPAmbAirUndEnaCond_P WM_MaskRTNForErrPAmbAirUnd_P WM_MaskRctnForPAmbAirUndLvl1Err_P WM_MaskRctnForPAmbAirUndLvl2Err_P WM_MaskRctnForPAmbAirUndLvl3Err_P WM_PAmbAirUndDesLvlQnty_P WM_PAmbAirUndHysDeacLvl1_P WM_PAmbAirUndHysDeacLvl2_P WM_PAmbAirUndHysDeacLvl3_P WM_PAmbAirUndLvl1_M WM_PAmbAirUndLvl2_M WM_PAmbAirUndLvl3_M WM_TiPAmbAirUndDebHi_P WM_TiPAmbAirUndDebLo_P /end REF_CHARACTERISTIC
 /begin REF_MEASUREMENT WM_MaskRctnForPAmbAirUndErr WM_bErrPAmbAirUnd WM_bErrPAmbAirUndLvl1 WM_bErrPAmbAirUndLvl2 WM_bErrPAmbAirUndLvl3 WM_bPAmbAirUndEna /end REF_MEASUREMENT
/end GROUP
/begin GROUP S735_Fuel_Over_Pressure "EcuIntgdSwGend/ControlSoftware/WarnMong/Warning-Reduction-Shutdown Functions/Pressure/Fuel Over Pressure"
 /begin REF_CHARACTERISTIC EG_Mask32Bit0_C EG_NmrInt0_C EG_NmrInt1_C EG_NmrInt2_C EG_NmrInt3_C EG_TsSw20_C EG_bFlgFalse_C EG_bFlgTrue_C WM_MaskPFuOvEnaCond_P WM_MaskRTNForErrPFuOv_P WM_MaskRctnForPFuOvLvl1Err_P WM_MaskRctnForPFuOvLvl2Err_P WM_MaskRctnForPFuOvLvl3Err_P WM_PFuOvDesLvlQnty_P WM_PFuOvHysDeacLvl1_P WM_PFuOvHysDeacLvl2_P WM_PFuOvHysDeacLvl3_P WM_PFuOvLvl1_M WM_PFuOvLvl2_M WM_PFuOvLvl3_M WM_TiPFuOvDebHi_P WM_TiPFuOvDebLo_P /end REF_CHARACTERISTIC
 /begin REF_MEASUREMENT WM_MaskRctnForPFuOvErr WM_bErrPFuOv WM_bErrPFuOvLvl1 WM_bErrPFuOvLvl2 WM_bErrPFuOvLvl3 WM_bPFuOvEna /end REF_MEASUREMENT
/end GROUP
/begin GROUP S735_Fuel_Under_Pressure "EcuIntgdSwGend/ControlSoftware/WarnMong/Warning-Reduction-Shutdown Functions/Pressure/Fuel Under Pressure"
 /begin REF_CHARACTERISTIC EG_Mask32Bit0_C EG_NmrInt0_C EG_NmrInt1_C EG_NmrInt2_C EG_NmrInt3_C EG_TsSw20_C EG_bFlgFalse_C EG_bFlgTrue_C WM_MaskPFuUndEnaCond_P WM_MaskRTNForErrPFuUnd_P WM_MaskRctnForPFuUndLvl1Err_P WM_MaskRctnForPFuUndLvl2Err_P WM_MaskRctnForPFuUndLvl3Err_P WM_PFuUndDesLvlQnty_P WM_PFuUndHysDeacLvl1_P WM_PFuUndHysDeacLvl2_P WM_PFuUndHysDeacLvl3_P WM_PFuUndLvl1_M WM_PFuUndLvl2_M WM_PFuUndLvl3_M WM_TiPFuUndDebHi_P WM_TiPFuUndDebLo_P /end REF_CHARACTERISTIC
 /begin REF_MEASUREMENT WM_MaskRctnForPFuUndErr WM_bErrPFuUnd WM_bErrPFuUndLvl1 WM_bErrPFuUndLvl2 WM_bErrPFuUndLvl3 WM_bPFuUndEna /end REF_MEASUREMENT
/end GROUP
/begin GROUP S735_Oil_Over_Pressure "EcuIntgdSwGend/ControlSoftware/WarnMong/Warning-Reduction-Shutdown Functions/Pressure/Oil Over Pressure"
 /begin REF_CHARACTERISTIC EG_Mask32Bit0_C EG_NmrInt0_C EG_NmrInt1_C EG_NmrInt2_C EG_NmrInt3_C EG_TsSw20_C EG_bFlgFalse_C EG_bFlgTrue_C WM_MaskPOilOvEnaCond_P WM_MaskRTNForErrPOilOv_P WM_MaskRctnForPOilOvLvl1Err_P WM_MaskRctnForPOilOvLvl2Err_P WM_MaskRctnForPOilOvLvl3Err_P WM_POilOvDesLvlQnty_P WM_POilOvHysDeacLvl1_P WM_POilOvHysDeacLvl2_P WM_POilOvHysDeacLvl3_P WM_POilOvLvl1_M WM_POilOvLvl2_M WM_POilOvLvl3_M WM_TiPOilOvDebHi_P WM_TiPOilOvDebLo_P /end REF_CHARACTERISTIC
 /begin REF_MEASUREMENT WM_MaskRctnForPOilOvErr WM_bErrPOilOv WM_bErrPOilOvLvl1 WM_bErrPOilOvLvl2 WM_bErrPOilOvLvl3 WM_bPOilOvEna /end REF_MEASUREMENT
/end GROUP
/begin GROUP S735_Oil_Under_Pressure "EcuIntgdSwGend/ControlSoftware/WarnMong/Warning-Reduction-Shutdown Functions/Pressure/Oil Under Pressure"
 /begin REF_CHARACTERISTIC EG_Mask32Bit0_C EG_NmrInt0_C EG_NmrInt1_C EG_NmrInt2_C EG_NmrInt3_C EG_TsSw20_C EG_bFlgFalse_C EG_bFlgTrue_C WM_MaskPOilUndEnaCond_P WM_MaskRTNForErrPOilUnd_P WM_MaskRctnForPOilUndLvl1Err_P WM_MaskRctnForPOilUndLvl2Err_P WM_MaskRctnForPOilUndLvl3Err_P WM_POilUndDesLvlQnty_P WM_POilUndHysDeacLvl1_P WM_POilUndHysDeacLvl2_P WM_POilUndHysDeacLvl3_P WM_POilUndLvl1_M WM_POilUndLvl2_M WM_POilUndLvl3_M WM_TiPOilUndDebHi_P WM_TiPOilUndDebLo_P /end REF_CHARACTERISTIC
 /begin REF_MEASUREMENT WM_MaskRctnForPOilUndErr WM_bErrPOilUnd WM_bErrPOilUndLvl1 WM_bErrPOilUndLvl2 WM_bErrPOilUndLvl3 WM_bPOilUndEna /end REF_MEASUREMENT
/end GROUP
/begin GROUP S735_Rail_Over_Pressure "EcuIntgdSwGend/ControlSoftware/WarnMong/Warning-Reduction-Shutdown Functions/Pressure/Rail Over Pressure"
 /begin REF_CHARACTERISTIC EG_Mask32Bit0_C EG_NmrInt0_C EG_NmrInt1_C EG_NmrInt2_C EG_NmrInt3_C EG_TsSw20_C EG_bFlgFalse_C EG_bFlgTrue_C WM_MaskPRailOvEnaCond_P WM_MaskRTNForErrPRailOv_P WM_MaskRctnForPRailOvLvl1Err_P WM_MaskRctnForPRailOvLvl2Err_P WM_MaskRctnForPRailOvLvl3Err_P WM_PRailOvDesLvlQnty_P WM_PRailOvHysDeacLvl1_P WM_PRailOvHysDeacLvl2_P WM_PRailOvHysDeacLvl3_P WM_PRailOvLvl1_M WM_PRailOvLvl2_M WM_PRailOvLvl3_M WM_TiPRailOvDebHi_P WM_TiPRailOvDebLo_P /end REF_CHARACTERISTIC
 /begin REF_MEASUREMENT WM_MaskRctnForPRailOvErr WM_bErrPRailOv WM_bErrPRailOvLvl1 WM_bErrPRailOvLvl2 WM_bErrPRailOvLvl3 WM_bPRailOvEna /end REF_MEASUREMENT
/end GROUP
/end MODULE
/end PROJECT
