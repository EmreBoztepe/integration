ASAP2_VERSION 1 6
/begin PROJECT ECEMTAG_CR8 ""
/begin MODULE DIM ""
/begin MOD_COMMON "Mod Common Comment Here" DEPOSIT ABSOLUTE BYTE_ORDER MSB_FIRST /end MOD_COMMON
/begin CHARACTERISTIC Save_Cal "calibration save start-trigger" VALUE 0x40010884 /* @ECU_Address@flash_save_eeprom_cal_flag@ */ UBYTE 1 NO_COMPU_METHOD 0 1 FORMAT "%20.0" /end CHARACTERISTIC
/begin CHARACTERISTIC Clr_Diag_List_Flg "Clear Diag Info List Flag " VALUE 0x400109E4 /* @ECU_Address@ClearFlagFaultLists@ */ ULONG 1 NO_COMPU_METHOD 0 1 FORMAT "%20.0" /end CHARACTERISTIC
/begin MEASUREMENT Flash_Sts "The status of the Flash" UBYTE NO_COMPU_METHOD 1 100 0 4 FORMAT "%20.0" ECU_ADDRESS 0x40010894 /* @ECU_Address@gucflash_status@ */ /end MEASUREMENT
/begin MEASUREMENT Cpu_Load "Cpu Load Percentage" FLOAT32_IEEE Percent_CM 1 100 0 100 FORMAT "%20.2" ECU_ADDRESS 0x4001C220 /* @ECU_Address@WatchdogFile.cpu_load@ */ /end MEASUREMENT
/begin MEASUREMENT sw_ident_start_addr "sw_ident_start_addr" UBYTE NO_COMPU_METHOD 1 100 0 255 FORMAT "%20.0" ECU_ADDRESS 0x9FFF00 /* @ECU_Address@gstSoftwareIdent@ */ /end MEASUREMENT
/begin MEASUREMENT SVNREVNUM "software version" ULONG NO_COMPU_METHOD 1 100 0 4000000000 FORMAT "%20.0" ECU_ADDRESS 0x9FFF1C /* @ECU_Address@gstSoftwareIdent.build_rev@ */ /* mta: undefined */ /end MEASUREMENT
/*****************************************RTC START*******************************************/
/begin CHARACTERISTIC RTC_Cfg_IniSec "RTC Config Initial Second" VALUE 0x85CE5C /* @ECU_Address@g_sRtcDefaultConfigTime.second@ */ UBYTE 1 NO_COMPU_METHOD 0 255 FORMAT "%20.0" /end CHARACTERISTIC
/begin CHARACTERISTIC RTC_Cfg_IniMins "RTC Config Initial Minute" VALUE 0x85CE5D /* @ECU_Address@g_sRtcDefaultConfigTime.minute@ */ UBYTE 1 NO_COMPU_METHOD 0 255 FORMAT "%20.0" /end CHARACTERISTIC
/begin CHARACTERISTIC RTC_Cfg_IniHr "RTC Config Initial Hour" VALUE 0x85CE5E /* @ECU_Address@g_sRtcDefaultConfigTime.hour@ */ UBYTE 1 NO_COMPU_METHOD 0 255 FORMAT "%20.0" /end CHARACTERISTIC
/begin CHARACTERISTIC RTC_Cfg_IniDay "RTC Config Initial Day" VALUE 0x85CE5F /* @ECU_Address@g_sRtcDefaultConfigTime.day@ */ UBYTE 1 NO_COMPU_METHOD 0 255 FORMAT "%20.0" /end CHARACTERISTIC
/begin CHARACTERISTIC RTC_Cfg_IniWeekDay "RTC Config Initial Weekday" VALUE 0x85CE60 /* @ECU_Address@g_sRtcDefaultConfigTime.weekday@ */ UBYTE 1 NO_COMPU_METHOD 0 255 FORMAT "%20.0" /end CHARACTERISTIC
/begin CHARACTERISTIC RTC_Cfg_IniMth "RTC Config Initial Month" VALUE 0x85CE61 /* @ECU_Address@g_sRtcDefaultConfigTime.month@ */ UBYTE 1 NO_COMPU_METHOD 0 255 FORMAT "%20.0" /end CHARACTERISTIC
/begin CHARACTERISTIC RTC_Cfg_IniYr "RTC Config Initial Year" VALUE 0x85CE62 /* @ECU_Address@g_sRtcDefaultConfigTime.year@ */ UBYTE 1 NO_COMPU_METHOD 0 255 FORMAT "%20.0" /end CHARACTERISTIC
/*****************************************RTC END*******************************************/ /***************************************** FF START *******************************************/
/begin CHARACTERISTIC FF_Nr "Requested freeze frame number" VALUE 0x4000B314 /* @ECU_Address@A2L_FF_DM4.freeze_frame_number@ */ UBYTE 80 NO_COMPU_METHOD 1 80 FORMAT "%20.0" /end CHARACTERISTIC
/begin MEASUREMENT FF_Idx_Nr "Index of next freeze frame" UBYTE NO_COMPU_METHOD 1 100 0 255 FORMAT "%20.2" ECU_ADDRESS 0x400109E3 /* @ECU_Address@a2l_freeze_frame_index_number@ */ /end MEASUREMENT
/begin MEASUREMENT FF_SPN "Suspect Parameter Number" ULONG CM_SPNList 1 100 0 4000000000 FORMAT "%20.2" ECU_ADDRESS 0x4000B318 /* @ECU_Address@A2L_FF_DM4.spn@ */ /end MEASUREMENT
/begin MEASUREMENT FF_FMI "Failure Mode Identifier" UBYTE CM_FMIList 1 100 0 255 FORMAT "%20.0" ECU_ADDRESS 0x4000B31C /* @ECU_Address@A2L_FF_DM4.fmi@ */ /end MEASUREMENT
/begin MEASUREMENT FF_OC "Occurrence Count" UBYTE NO_COMPU_METHOD 1 100 0 255 FORMAT "%20.0" ECU_ADDRESS 0x4000B31D /* @ECU_Address@A2L_FF_DM4.oc@ */ /end MEASUREMENT
/begin MEASUREMENT FF_EngTqMod "Engine Torque Mode" UBYTE NO_COMPU_METHOD 1 100 0 255 FORMAT "%20.0" ECU_ADDRESS 0x4000B31E /* @ECU_Address@A2L_FF_DM4.engine_torque_mode@ */ /end MEASUREMENT
/begin MEASUREMENT FF_PAirBoost "Air Boost Pressure" UBYTE kPa_CM 1 100 0 255 ECU_ADDRESS 0x4000B31F /* @ECU_Address@A2L_FF_DM4.boost@ */ /end MEASUREMENT
/begin MEASUREMENT FF_NEng "Engine Speed" UWORD SpeedSensor_CM 1 100 0 65535 ECU_ADDRESS 0x4000B320 /* @ECU_Address@A2L_FF_DM4.engine_speed_raw@ */ /end MEASUREMENT
/begin MEASUREMENT FF_EngPrcLoadAtCurrentSpd "Engine Percent Load At Current Speed" UBYTE percent_CM 1 100 0 255 ECU_ADDRESS 0x4000B322 /* @ECU_Address@A2L_FF_DM4.engine_percent_load@ */ /end MEASUREMENT
/begin MEASUREMENT FF_TCoolt "Coolant Temperature" SWORD degC_CM 1 100 0 255 FORMAT "%20.0" ECU_ADDRESS 0x4000B324 /* @ECU_Address@A2L_FF_DM4.coolant_temp@ */ /end MEASUREMENT
/begin MEASUREMENT FF_VehV "Wheel-Based Vehicle Speed" UWORD kmh_CM 1 100 0 65535 ECU_ADDRESS 0x4000B326 /* @ECU_Address@A2L_FF_DM4.vehicle_speed_raw@ */ /end MEASUREMENT
/begin MEASUREMENT FF_TOil "Oil Temperature" SWORD degC_CM 1 100 0 65535 FORMAT "%20.0" ECU_ADDRESS 0x4000B328 /* @ECU_Address@A2L_FF_DM4.engine_oil_temp@ */ /end MEASUREMENT
/begin MEASUREMENT FF_TrsmCurrentGear "Transmission Current Gear" UWORD NO_COMPU_METHOD 1 100 0 65535 FORMAT "%20.0" ECU_ADDRESS 0x4000B32A /* @ECU_Address@A2L_FF_DM4.trasnmission_current_gear@ */ /end MEASUREMENT
/begin MEASUREMENT FF_MTotFuQntyCorr "Total Fuel Quantity Correction" UWORD mm3_CM 1 100 0 65535 FORMAT "%20.0" ECU_ADDRESS 0x4000B32C /* @ECU_Address@A2L_FF_DM4.total_fuel_quantity_correction@ */ /end MEASUREMENT
/begin MEASUREMENT FF_EngHr "Engine Hour" FLOAT32_IEEE hour_CM 1 100 0 4000000000 FORMAT "%20.2" ECU_ADDRESS 0x4000B330 /* @ECU_Address@A2L_FF_DM4.engine_hour@ */ /end MEASUREMENT
/***************************************** FF END *******************************************/ /*****************************************raw_value START*******************************************/ /* PRESSURE RAW VALUE*/
/begin MEASUREMENT PAmbAir_RawValU "PAmbAir_RawValU" FLOAT32_IEEE Voltage_CM 1 100 0 5 FORMAT "%20.2" ECU_ADDRESS 0x0000 /* @ECU_Address@PAmbAir_RawValU@ */ /end MEASUREMENT
/begin MEASUREMENT PRail_RawValU "PRail_RawValU" FLOAT32_IEEE Voltage_CM 1 100 0 5 FORMAT "%20.2" ECU_ADDRESS 0x0000 /* @ECU_Address@PRail_RawValU@ */ /end MEASUREMENT
/begin MEASUREMENT POil_RawValU "POil_RawValU" FLOAT32_IEEE Voltage_CM 1 100 0 5 FORMAT "%20.2" ECU_ADDRESS 0x0000 /* @ECU_Address@POil_RawValU@ */ /end MEASUREMENT
/begin MEASUREMENT PFu_RawValU "PFu_RawValU" FLOAT32_IEEE Voltage_CM 1 100 0 5 FORMAT "%20.2" ECU_ADDRESS 0x0000 /* @ECU_Address@PFu_RawValU@ */ /end MEASUREMENT
/begin MEASUREMENT PAirBoost_RawValU "PAirBoost_RawValU" FLOAT32_IEEE Voltage_CM 1 100 0 5 FORMAT "%20.2" ECU_ADDRESS 0x0000 /* @ECU_Address@PAirBoost_RawValU@ */ /end MEASUREMENT
/begin MEASUREMENT LvlOil_RawValU "LvlOil_RawValU" FLOAT32_IEEE Voltage_CM 1 100 0 5 FORMAT "%20.2" ECU_ADDRESS 0x0000 /* @ECU_Address@LvlOil_RawValU@ */ /end MEASUREMENT
/begin MEASUREMENT AccrPedl1_RawValU "AccrPedl1_RawValU" FLOAT32_IEEE Voltage_CM 1 100 0 5 FORMAT "%20.2" ECU_ADDRESS 0x0000 /* @ECU_Address@AccrPedl1_RawValU@ */ /end MEASUREMENT
/begin MEASUREMENT AccrPedl2_RawValU "AccrPedl2_RawValU" FLOAT32_IEEE Voltage_CM 1 100 0 5 FORMAT "%20.2" ECU_ADDRESS 0x0000 /* @ECU_Address@AccrPedl2_RawValU@ */ /end MEASUREMENT
/* TEMPERATURE RAW VALUE*/
/begin MEASUREMENT TEcu_RawValU "TEcu_RawValU" FLOAT32_IEEE Voltage_CM 1 100 0 50000 FORMAT "%20.2" ECU_ADDRESS 0x0000 /* @ECU_Address@TEcu_RawValU@ */ /end MEASUREMENT
/begin MEASUREMENT TOil_RawValR "TOil_RawValR" FLOAT32_IEEE Resistor_CM 1 100 0 50000 FORMAT "%20.2" ECU_ADDRESS 0x0000 /* @ECU_Address@TOil_RawValR@ */ /end MEASUREMENT
/begin MEASUREMENT TCoolt_RawValR "TCoolt_RawValR" FLOAT32_IEEE Resistor_CM 1 100 0 50000 FORMAT "%20.2" ECU_ADDRESS 0x0000 /* @ECU_Address@TCoolt_RawValR@ */ /end MEASUREMENT
/begin MEASUREMENT TAirBoost_RawValR "TAirBoost_RawValR" FLOAT32_IEEE Resistor_CM 1 100 0 50000 FORMAT "%20.2" ECU_ADDRESS 0x0000 /* @ECU_Address@TAirBoost_RawValR@ */ /end MEASUREMENT
/begin MEASUREMENT TAmbAir_RawValR "TAmbAir_RawValR" FLOAT32_IEEE Resistor_CM 1 100 0 50000 FORMAT "%20.2" ECU_ADDRESS 0x0000 /* @ECU_Address@TAmbAir_RawValR@ */ /end MEASUREMENT
/begin MEASUREMENT TFu_RawValR "TFu_RawValR" FLOAT32_IEEE Resistor_CM 1 100 0 50000 FORMAT "%20.2" ECU_ADDRESS 0x0000 /* @ECU_Address@TFu_RawValR@ */ /end MEASUREMENT
/begin MEASUREMENT TOil_RawValU "TOil_RawValU" FLOAT32_IEEE Voltage_CM 1 100 0 50 FORMAT "%20.2" ECU_ADDRESS 0x0000 /* @ECU_Address@TOil_RawValU@ */ /end MEASUREMENT
/begin MEASUREMENT TCoolt_RawValU "TCoolt_RawValU" FLOAT32_IEEE Voltage_CM 1 100 0 50 FORMAT "%20.2" ECU_ADDRESS 0x0000 /* @ECU_Address@TCoolt_RawValU@ */ /end MEASUREMENT
/begin MEASUREMENT TAirBoost_RawValU "TAirBoost_RawValU" FLOAT32_IEEE Voltage_CM 1 100 0 50 FORMAT "%20.2" ECU_ADDRESS 0x0000 /* @ECU_Address@TAirBoost_RawValU@ */ /end MEASUREMENT
/begin MEASUREMENT TAmbAir_RawValU "TAmbAir_RawValU" FLOAT32_IEEE Voltage_CM 1 100 0 50 FORMAT "%20.2" ECU_ADDRESS 0x0000 /* @ECU_Address@TAmbAir_RawValU@ */ /end MEASUREMENT
/begin MEASUREMENT TFu_RawValU "TFu_RawValU" FLOAT32_IEEE Voltage_CM 1 100 0 50 FORMAT "%20.2" ECU_ADDRESS 0x0000 /* @ECU_Address@TFu_RawValU@ */ /end MEASUREMENT
/* BATTERY RAW VALUE */
/begin MEASUREMENT V48_Boost_RawValU "V48_Boost_RawValU" FLOAT32_IEEE Voltage_CM 1 100 0 50 FORMAT "%20.2" ECU_ADDRESS 0x0000 /* @ECU_Address@V48_Boost_RawValU@ */ /end MEASUREMENT
/begin MEASUREMENT Batt_RawValU "Batt_RawValU" FLOAT32_IEEE Voltage_CM 1 100 0 50 FORMAT "%20.2" ECU_ADDRESS 0x0000 /* @ECU_Address@Batt_RawValU@ */ /end MEASUREMENT
/begin MEASUREMENT V12_RawValU "V12_RawValU" FLOAT32_IEEE Voltage_CM 1 100 0 50 FORMAT "%20.2" ECU_ADDRESS 0x0000 /* @ECU_Address@V12_RawValU@ */ /end MEASUREMENT
/begin MEASUREMENT V5_Ref_RawValU "V5_Ref_RawValU" FLOAT32_IEEE Voltage_CM 1 100 0 50 FORMAT "%20.2" ECU_ADDRESS 0x0000 /* @ECU_Address@V5_Ref_RawValU@ */ /end MEASUREMENT
/begin MEASUREMENT V5_RawValU "V5_RawValU" FLOAT32_IEEE Voltage_CM 1 100 0 50 FORMAT "%20.2" ECU_ADDRESS 0x0000 /* @ECU_Address@V5_RawValU@ */ /end MEASUREMENT
/begin MEASUREMENT V3_3_RawValU "V3_3_RawValU" FLOAT32_IEEE Voltage_CM 1 100 0 50 FORMAT "%20.2" ECU_ADDRESS 0x0000 /* @ECU_Address@V3_3_RawValU@ */ /end MEASUREMENT
/begin MEASUREMENT V1_25_RawValU "V1_25_RawValU" FLOAT32_IEEE Voltage_CM 1 100 0 50 FORMAT "%20.2" ECU_ADDRESS 0x0000 /* @ECU_Address@V1_25_RawValU@ */ /end MEASUREMENT
/begin MEASUREMENT V12_Ref_Cam_RawValU "V12_Ref_Cam_RawValU" FLOAT32_IEEE Voltage_CM 1 100 0 50 FORMAT "%20.2" ECU_ADDRESS 0x0000 /* @ECU_Address@V12_Ref_Cam_RawValU@ */ /end MEASUREMENT
/begin MEASUREMENT V12_Ref_Crk_RawValU "V12_Ref_Crk_RawValU" FLOAT32_IEEE Voltage_CM 1 100 0 50 FORMAT "%20.2" ECU_ADDRESS 0x0000 /* @ECU_Address@V12_Ref_Crk_RawValU@ */ /end MEASUREMENT
/begin MEASUREMENT NTC_1_Diag_RawValU "NTC_1_Diag_RawValU" FLOAT32_IEEE Voltage_CM 1 100 0 50 FORMAT "%20.2" ECU_ADDRESS 0x0000 /* @ECU_Address@NTC_1_Diag_RawValU@ */ /end MEASUREMENT
/begin MEASUREMENT NTC_2_Diag_RawValU "NTC_2_Diag_RawValU" FLOAT32_IEEE Voltage_CM 1 100 0 50 FORMAT "%20.2" ECU_ADDRESS 0x0000 /* @ECU_Address@NTC_2_Diag_RawValU@ */ /end MEASUREMENT
/begin MEASUREMENT NTC_3_Diag_RawValU "NTC_3_Diag_RawValU" FLOAT32_IEEE Voltage_CM 1 100 0 50 FORMAT "%20.2" ECU_ADDRESS 0x0000 /* @ECU_Address@NTC_3_Diag_RawValU@ */ /end MEASUREMENT
/begin MEASUREMENT NTC_4_Diag_RawValU "NTC_4_Diag_RawValU" FLOAT32_IEEE Voltage_CM 1 100 0 50 FORMAT "%20.2" ECU_ADDRESS 0x0000 /* @ECU_Address@NTC_4_Diag_RawValU@ */ /end MEASUREMENT
/begin MEASUREMENT DO6_Diag_RawValU "DO6_Diag_RawValU" FLOAT32_IEEE Voltage_CM 1 100 0 50 FORMAT "%20.2" ECU_ADDRESS 0x0000 /* @ECU_Address@DO6_Diag_RawValU@ */ /end MEASUREMENT
/begin MEASUREMENT DO7_Diag_RawValU "DO7_Diag_RawValU" FLOAT32_IEEE Voltage_CM 1 100 0 50 FORMAT "%20.2" ECU_ADDRESS 0x0000 /* @ECU_Address@DO7_Diag_RawValU@ */ /end MEASUREMENT
/begin MEASUREMENT DO8_Diag_RawValU "DO8_Diag_RawValU" FLOAT32_IEEE Voltage_CM 1 100 0 50 FORMAT "%20.2" ECU_ADDRESS 0x0000 /* @ECU_Address@DO8_Diag_RawValU@ */ /end MEASUREMENT
/begin MEASUREMENT DO9_Diag_RawValU "DO9_Diag_RawValU" FLOAT32_IEEE Voltage_CM 1 100 0 50 FORMAT "%20.2" ECU_ADDRESS 0x0000 /* @ECU_Address@DO9_Diag_RawValU@ */ /end MEASUREMENT
/begin MEASUREMENT V12_Ref_Cam_Diag_RawValU "V12_Ref_Cam_Diag_RawValU" FLOAT32_IEEE Voltage_CM 1 100 0 50 FORMAT "%20.2" ECU_ADDRESS 0x0000 /* @ECU_Address@V12_Ref_Cam_Diag_RawValU@ */ /end MEASUREMENT
/begin MEASUREMENT V12_Ref_Crk_Diag_RawValU "V12_Ref_Crk_Diag_RawValU" FLOAT32_IEEE Voltage_CM 1 100 0 50 FORMAT "%20.2" ECU_ADDRESS 0x0000 /* @ECU_Address@V12_Ref_Crk_Diag_RawValU@ */ /end MEASUREMENT
/begin MEASUREMENT V5_Ref_MCU_Diag_RawValU "V5_Ref_MCU_Diag_RawValU" FLOAT32_IEEE Voltage_CM 1 100 0 50 FORMAT "%20.2" ECU_ADDRESS 0x0000 /* @ECU_Address@V5_Ref_MCU_Diag_RawValU@ */ /end MEASUREMENT
/begin MEASUREMENT V5_Ref_1_Diag_RawValU "V5_Ref_1_Diag_RawValU" FLOAT32_IEEE Voltage_CM 1 100 0 50 FORMAT "%20.2" ECU_ADDRESS 0x0000 /* @ECU_Address@V5_Ref_1_Diag_RawValU@ */ /end MEASUREMENT
/begin MEASUREMENT V5_Ref_2_Diag_RawValU "V5_Ref_2_Diag_RawValU" FLOAT32_IEEE Voltage_CM 1 100 0 50 FORMAT "%20.2" ECU_ADDRESS 0x0000 /* @ECU_Address@V5_Ref_2_Diag_RawValU@ */ /end MEASUREMENT
/* CURRENT RAW VALUE*/
/begin MEASUREMENT Fb_IRefVCV "Current Feedback VCV" FLOAT32_IEEE Current_A_CM 1 100 0 3000 FORMAT "%20.2" ECU_ADDRESS 0x0000 /* @ECU_Address@Fb_IRefVCV@ */ /end MEASUREMENT
/begin MEASUREMENT Fb_IRefPCV "Current Feedback PCV" FLOAT32_IEEE Current_A_CM 1 100 0 3000 FORMAT "%20.2" ECU_ADDRESS 0x0000 /* @ECU_Address@Fb_IRefPCV@ */ /end MEASUREMENT
/*****************************************raw_value END*********************************************/ /*****************************************CURVE START*********************************************/ /* MAPS CURVES */
/begin CHARACTERISTIC PRailSnsr_Curve "rail pressure curve" CURVE 0x40040114 /* @ECU_Address@crv_CRPressUy@ */ FLOAT32_IEEE 2850 PressSensor_CM 0 2850
 /begin AXIS_DESCR COM_AXIS PRail_RawValU Voltage_CM 4 0 5 FORMAT "%20.2" AXIS_PTS_REF PRailU /end AXIS_DESCR
 FORMAT "%20.2" /end CHARACTERISTIC
/begin AXIS_PTS PRailU "rail pressure voltage" 0x40040104 /* @ECU_Address@crv_CRPressUx@ */ PRail_RawValU RL_X_FLOAT32_IEEE 5 NO_COMPU_METHOD 4 0 5 DEPOSIT ABSOLUTE /end AXIS_PTS
/begin CHARACTERISTIC PAirBoostSnsr_Curve "air boost pressure curve" CURVE 0x40040134 /* @ECU_Address@crv_BoostPressUy@ */ FLOAT32_IEEE 10 PressSensor_CM 0 10
 /begin AXIS_DESCR COM_AXIS PAirBoost_RawValU Voltage_CM 4 0 5 FORMAT "%20.2" AXIS_PTS_REF PAirBoostU /end AXIS_DESCR
 FORMAT "%20.2" /end CHARACTERISTIC
/begin AXIS_PTS PAirBoostU "air boost pressure voltage" 0x40040124 /* @ECU_Address@crv_BoostPressUx@ */ PAirBoost_RawValU RL_X_FLOAT32_IEEE 5 NO_COMPU_METHOD 4 0 5 DEPOSIT ABSOLUTE /end AXIS_PTS
/begin CHARACTERISTIC AccrPedlSensr1_Curve "accelerator pedal curve" CURVE 0x400401AC /* @ECU_Address@crv_Pedal1PosY@ */ FLOAT32_IEEE 100 LevelSensor_CM 0 100
 /begin AXIS_DESCR COM_AXIS AccrPedl1_RawValU Voltage_CM 2 0 5 FORMAT "%20.2" AXIS_PTS_REF AccrPedl1U /end AXIS_DESCR
 FORMAT "%20.2" /end CHARACTERISTIC
/begin AXIS_PTS AccrPedl1U "accelerator pedal voltage" 0x400401A4 /* @ECU_Address@crv_Pedal1PosX@ */ AccrPedl1_RawValU RL_X_FLOAT32_IEEE 5 NO_COMPU_METHOD 2 0 5 DEPOSIT ABSOLUTE /end AXIS_PTS
/begin CHARACTERISTIC AccrPedlSensr2_Curve "accelerator pedal 2 curve" CURVE 0x400401BC /* @ECU_Address@crv_Pedal2PosY@ */ FLOAT32_IEEE 100 LevelSensor_CM 0 100
 /begin AXIS_DESCR COM_AXIS AccrPedl2_RawValU Voltage_CM 2 0 5 FORMAT "%20.2" AXIS_PTS_REF AccrPedl2U /end AXIS_DESCR
 FORMAT "%20.2" /end CHARACTERISTIC
/begin AXIS_PTS AccrPedl2U "accelerator pedal 2 voltage" 0x400401B4 /* @ECU_Address@crv_Pedal2PosX@ */ AccrPedl2_RawValU RL_X_FLOAT32_IEEE 5 NO_COMPU_METHOD 2 0 5 DEPOSIT ABSOLUTE /end AXIS_PTS
/begin CHARACTERISTIC PFuSnsr_Curve "fuel pressure curve" CURVE 0x40040174 /* @ECU_Address@crv_FuelPressY@ */ /* mta:3338 */ FLOAT32_IEEE 10 PressSensor_CM 0 10
 /begin AXIS_DESCR COM_AXIS PFu_RawValU Voltage_CM 4 0 5 FORMAT "%20.2" AXIS_PTS_REF PFuU /end AXIS_DESCR
 FORMAT "%20.2" /end CHARACTERISTIC
/begin AXIS_PTS PFuU "fuel pressure voltage" 0x40040164 /* @ECU_Address@crv_FuelPressX@ */ /* mta:3338 */ PFu_RawValU RL_X_FLOAT32_IEEE 5 NO_COMPU_METHOD 4 0 5 DEPOSIT ABSOLUTE /end AXIS_PTS
/begin CHARACTERISTIC LvlOilSnsr_Curve "oil level curve" CURVE 0x40040194 /* @ECU_Address@crv_OilLevelUy@ */ /* mta:3341 */ FLOAT32_IEEE 100 LevelSensor_CM 0 100
 /begin AXIS_DESCR COM_AXIS LvlOil_RawValU Voltage_CM 4 0 5 FORMAT "%20.2" AXIS_PTS_REF LvlOilU /end AXIS_DESCR
 FORMAT "%20.2" /end CHARACTERISTIC
/begin AXIS_PTS LvlOilU "oil level voltage" 0x40040184 /* @ECU_Address@crv_OilLevelUx@ */ /* mta:3341 */ LvlOil_RawValU RL_X_FLOAT32_IEEE 5 NO_COMPU_METHOD 4 0 5 DEPOSIT ABSOLUTE /end AXIS_PTS
/begin CHARACTERISTIC POilSnsr_Curve "oil pressure curve" CURVE 0x40040154 /* @ECU_Address@crv_OilPressUy@ */ /* mta:3334 */ FLOAT32_IEEE 10 PressSensor_CM 0 10
 /begin AXIS_DESCR COM_AXIS POil_RawValU Voltage_CM 4 0 5 FORMAT "%20.2" AXIS_PTS_REF POilU /end AXIS_DESCR
 FORMAT "%20.2" /end CHARACTERISTIC
/begin AXIS_PTS POilU "oil pressure voltage" 0x40040144 /* @ECU_Address@crv_OilPressUx@ */ /* mta:3334 */ POil_RawValU RL_X_FLOAT32_IEEE 5 NO_COMPU_METHOD 4 0 5 DEPOSIT ABSOLUTE /end AXIS_PTS
/begin CHARACTERISTIC TOilSnsr_Curve "oil temperature sensor curve" CURVE 0x400401F8 /* @ECU_Address@crv_PT1000y_TOil@ */ FLOAT32_IEEE 0 NO_COMPU_METHOD -50.0 150
 /begin AXIS_DESCR COM_AXIS TOil_RawValR NO_COMPU_METHOD 5 0 2000 AXIS_PTS_REF TOilR /end AXIS_DESCR
/end CHARACTERISTIC
/begin AXIS_PTS TOilR "oil temperature resistance" 0x400401E4 /* @ECU_Address@crv_PT1000x_TOil@ */ TOil_RawValR RL_X_FLOAT32_IEEE 0 NO_COMPU_METHOD 5 0 2000 /end AXIS_PTS
/begin CHARACTERISTIC TCooltSnsr_Curve "coolant temperature sensor curve" CURVE 0x4004025C /* @ECU_Address@crv_NTCy_TCoolt@ */ FLOAT32_IEEE 0 NO_COMPU_METHOD -50.0 150
 /begin AXIS_DESCR COM_AXIS TCoolt_RawValR NO_COMPU_METHOD 20 0 50000 AXIS_PTS_REF TCooltR /end AXIS_DESCR
/end CHARACTERISTIC
/begin AXIS_PTS TCooltR "coolant temperature resistance" 0x4004020C /* @ECU_Address@crv_NTCx_TCoolt@ */ TCoolt_RawValR RL_X_FLOAT32_IEEE 0 NO_COMPU_METHOD 20 0 50000 /end AXIS_PTS
/begin CHARACTERISTIC TAirBoostSnsr_Curve "air boost temperature sensor curve" CURVE 0x40040310 /* @ECU_Address@crv_NTCy_TAirBoost@ */ FLOAT32_IEEE 0 NO_COMPU_METHOD -50.0 150
 /begin AXIS_DESCR COM_AXIS TAirBoost_RawValR NO_COMPU_METHOD 20 0 50000 AXIS_PTS_REF TAirBoostR /end AXIS_DESCR
/end CHARACTERISTIC
/begin AXIS_PTS TAirBoostR "air boost temperature resistance" 0x400402C0 /* @ECU_Address@crv_NTCx_TAirBoost@ */ TAirBoost_RawValR RL_X_FLOAT32_IEEE 0 NO_COMPU_METHOD 20 0 50000 /end AXIS_PTS
/begin CHARACTERISTIC TAmbAirSnsr_Curve "ambient air temperature sensor curve" CURVE 0x40040374 /* @ECU_Address@crv_PT1000y_TAmbAir@ */ FLOAT32_IEEE 0 NO_COMPU_METHOD -50.0 150
 /begin AXIS_DESCR COM_AXIS TAmbAir_RawValR NO_COMPU_METHOD 5 0 2000 AXIS_PTS_REF TAmbAirR /end AXIS_DESCR
/end CHARACTERISTIC
/begin AXIS_PTS TAmbAirR "ambient air temperature resistance" 0x40040360 /* @ECU_Address@crv_PT1000x_TAmbAir@ */ TAmbAir_RawValR RL_X_FLOAT32_IEEE 0 NO_COMPU_METHOD 5 0 2000 /end AXIS_PTS
/begin CHARACTERISTIC TFuSnsr_Curve "fuel temperature sensor curve" CURVE 0x4004039C /* @ECU_Address@crv_PT1000y_TFu@ */ FLOAT32_IEEE 0 NO_COMPU_METHOD -50.0 150
 /begin AXIS_DESCR COM_AXIS TFu_RawValR NO_COMPU_METHOD 5 0 2000 AXIS_PTS_REF TFuR /end AXIS_DESCR
/end CHARACTERISTIC
/begin AXIS_PTS TFuR "fuel temperature resistance" 0x40040388 /* @ECU_Address@crv_PT1000x_TFu@ */ TFu_RawValR RL_X_FLOAT32_IEEE 0 NO_COMPU_METHOD 5 0 2000 /end AXIS_PTS
/*****************************************CURVE END*********************************************/ /* INJECTOR */
/begin CHARACTERISTIC boost_current "injector" VALUE 0x40040090 /* @ECU_Address@cnst_BoostCurrent@ */ /* mta: 4031 */ FLOAT32_IEEE 20 Current_CM 0 20 /end CHARACTERISTIC
/begin CHARACTERISTIC hold_current "injector" VALUE 0x4004008C /* @ECU_Address@cnst_HoldCurrent@ */ /* mta: 4030 */ FLOAT32_IEEE 20 Current_CM 0 20 /end CHARACTERISTIC
/begin CHARACTERISTIC boost_voltage "injector" VALUE 0x40040094 /* @ECU_Address@cnst_BoostVoltage@ */ /* mta: 4032 */ FLOAT32_IEEE 50 Voltage_CM 0 50 /end CHARACTERISTIC
/begin CHARACTERISTIC boost_voltage_duration "injector" VALUE 0x40040060 /* @ECU_Address@stDefaultInjBankTiming.UBoost@ */ /* mta: 4034 */ FLOAT32_IEEE 30000 Duration_ms_Scale1000000_CM 0 30000 FORMAT "%20.6" /end CHARACTERISTIC
/begin CHARACTERISTIC boost_current_duration "injector" VALUE 0x40040064 /* @ECU_Address@stDefaultInjBankTiming.IBoost@ */ /* mta: 4033 */ FLOAT32_IEEE 30000 Duration_ms_Scale1000000_CM 0 30000 FORMAT "%20.6" /end CHARACTERISTIC
/begin CHARACTERISTIC boost_current_max1_pulse_duration "injector" VALUE 0x40040068 /* @ECU_Address@stDefaultInjBankTiming.FirstPuls@ */ /* mta: 4036 */ FLOAT32_IEEE 30000 Duration_ms_Scale1000000_CM -1000 30000 FORMAT "%20.6" /end CHARACTERISTIC
/begin CHARACTERISTIC boost_current_min_pulse_duration "injector" VALUE 0x4004006C /* @ECU_Address@stDefaultInjBankTiming.BoostPuls@ */ /* mta: 4037 */ FLOAT32_IEEE 30000 Duration_ms_Scale1000000_CM 0 30000 /end CHARACTERISTIC
/begin CHARACTERISTIC boost_current_max_pulse_duration "injector" VALUE 0x40040070 /* @ECU_Address@stDefaultInjBankTiming.BoostLimit@ */ /* mta: 4041 */ FLOAT32_IEEE 30000 Duration_ms_Scale1000000_CM 0 30000 FORMAT "%20.6" /end CHARACTERISTIC
/begin CHARACTERISTIC boost_current_pause_duration "injector" VALUE 0x40040074 /* @ECU_Address@stDefaultInjBankTiming.BoostPause@ */ /* mta: 4038 */ FLOAT32_IEEE 30000 Duration_ms_Scale1000000_CM 0 30000 /end CHARACTERISTIC
/begin CHARACTERISTIC min_switch_time_boost_holdcur "injector" VALUE 0x40040078 /* @ECU_Address@stDefaultInjBankTiming.Unload@ */ /* mta: 4035 */ FLOAT32_IEEE 1000 Duration_ms_Scale1000000_CM 0 1000 /end CHARACTERISTIC
/begin CHARACTERISTIC max_switch_time_boost_holdcur "injector" VALUE 0x4004007C /* @ECU_Address@stDefaultInjBankTiming.UnloadLimit@ */ /* mta: 4043 */ FLOAT32_IEEE 1000 Duration_ms_Scale1000000_CM 0 1000 /end CHARACTERISTIC
/begin CHARACTERISTIC hold_current_min_pulse_duration "injector" VALUE 0x40040080 /* @ECU_Address@stDefaultInjBankTiming.HoldPuls@ */ /* mta: 4039 */ FLOAT32_IEEE 30000 Duration_ms_Scale1000000_CM 0 30000 /end CHARACTERISTIC
/begin CHARACTERISTIC hold_current_max_pulse_duration "injector" VALUE 0x40040084 /* @ECU_Address@stDefaultInjBankTiming.HoldLimit@ */ /* mta: 4042 */ FLOAT32_IEEE 30000 Duration_ms_Scale1000000_CM 0 30000 FORMAT "%20.6" /end CHARACTERISTIC
/begin CHARACTERISTIC hold_current_pause_duration "injector" VALUE 0x40040088 /* @ECU_Address@stDefaultInjBankTiming.HoldPause@ */ /* mta: 4040 */ FLOAT32_IEEE 30000 Duration_ms_Scale1000000_CM 0 30000 /end CHARACTERISTIC
/begin CHARACTERISTIC Crksft_Tooth_Nr "teeth on crankshaft gear" VALUE 0x40040024 /* @ECU_Address@gkSpeedconfig.ZaehnezahlKW@ */ UWORD 65535 NO_COMPU_METHOD 1 360 FORMAT "%20.0" /end CHARACTERISTIC
/begin CHARACTERISTIC Crksft_Gap_Nr "gap on crankshaft gear" VALUE 0x40040026 /* @ECU_Address@gkSpeedconfig.FehlZaehneKW@ */ UBYTE 65535 NO_COMPU_METHOD 0 2 FORMAT "%20.0" /end CHARACTERISTIC
/begin CHARACTERISTIC First_TDC_To_First_Crksft_Tooth_Fall_Edge_Aft_Gap "first firing TDC to first crankshaft tooth falling edge after gap" VALUE 0x4004002C /* @ECU_Address@gkSpeedconfig.WinkelKW@ */ FLOAT32_IEEE 65535 Angle_CM 0 720 FORMAT "%20.6" /end CHARACTERISTIC
/begin CHARACTERISTIC First_TDC_To_Camsft_Plus_Tooth_Fall_Edge "first firing TDC to first camshaft plus tooth falling edge as crankshaft degree" VALUE 0x40040030 /* @ECU_Address@gkSpeedconfig.WinkelNW@ */ FLOAT32_IEEE 65535 Angle_CM 0 720 FORMAT "%20.6" /end CHARACTERISTIC
/begin CHARACTERISTIC Min_Crnkshft_Angle_For_Camsft_Plus_Tooth_Search_Zone "min distance from tooth before camshaft plus tooth falling edge" VALUE 0x40040034 /* @ECU_Address@gkSpeedconfig.WinkelKW1@ */ FLOAT32_IEEE 65535 Angle_CM 0 100 /end CHARACTERISTIC
/begin CHARACTERISTIC Max_Crnkshft_Angle_For_Camsft_Plus_Tooth_Search_Zone "max distance from tooth before camshaft plus tooth falling edge" VALUE 0x40040038 /* @ECU_Address@gkSpeedconfig.WinkelNW1@ */ FLOAT32_IEEE 65535 Angle_CM 0 720 /end CHARACTERISTIC
/begin CHARACTERISTIC Eng_Cyl_Nr "engine cylinder number" VALUE 0x40040052 /* @ECU_Address@cnst_CylinderNumber@ */ UWORD 65535 NO_COMPU_METHOD 0 6 FORMAT "%20.0" /end CHARACTERISTIC
/begin CHARACTERISTIC Injr_Bnk_Nr "injector bank number" VALUE 0x40040054 /* @ECU_Address@cnst_BankNumber@ */ UWORD 65535 NO_COMPU_METHOD 0 3 FORMAT "%20.0" /end CHARACTERISTIC
/begin CHARACTERISTIC Ag_Cyl1_To_Cyl2 "angle between cylinder 1 to cylinder 2" VALUE 0x4004005C /* @ECU_Address@cnst_VAngle@ */ FLOAT32_IEEE 65535 NO_COMPU_METHOD 0 720 FORMAT "%20.0" /end CHARACTERISTIC
/begin MEASUREMENT Crksft_Sts "Implies Status of Crankshaft" UBYTE CM_Sft_Sts 1 100 0 255 FORMAT "%20.0" ECU_ADDRESS 0x40010969 /* @ECU_Address@gucCrankStatus@ */ /end MEASUREMENT
/begin MEASUREMENT Camsft_Sts "Implies Status of Camshaft" UBYTE CM_Sft_Sts 1 100 0 255 FORMAT "%20.0" ECU_ADDRESS 0x4001096A /* @ECU_Address@gucCamStatus@ */ /end MEASUREMENT
/begin COMPU_METHOD CM_Sft_Sts "" TAB_VERB "%0.0" "" COMPU_TAB_REF CT_Sft_Sts /end COMPU_METHOD
/begin COMPU_VTAB CT_Sft_Sts "" TAB_VERB /* Number Value Pairs */ 7 0 "STALL" 1 "WAITING GAP" 2 "HALF SYNCHRONIZATION" 3 "FULL SYNCHRONIZATION" 4 "ERROR" 5 "WRONG GAP" 6 "MISSING GAP" /end COMPU_VTAB
/begin CHARACTERISTIC N_stroke_engine "configuration 1 - engine type" VALUE 0x40040028 /* @ECU_Address@gkSpeedconfig.Typ@ */ UBYTE 4 NO_COMPU_METHOD 0 4 FORMAT "%20.0" /end CHARACTERISTIC
/begin CHARACTERISTIC Crksft_Gap_Miss_Tooth_Nr "Enables 2 teeth gap search: 1: 2 teeth in the gap, 0: 1 tooth in the gap" VALUE 0x40040027 /* @ECU_Address@gkSpeedconfig.Gap@ */ UBYTE 1 NO_COMPU_METHOD 0 1 FORMAT "%20.0" /end CHARACTERISTIC
/begin MEASUREMENT First_TDC_To_Camsft_Plus_Tooth_Fall_Edge_Measd "first firing TDC to camshaft plus tooth falling edge measured by ETPU as crankshaft degree" FLOAT32_IEEE Angle_CM 1 100 0 720 FORMAT "%20.2" ECU_ADDRESS 0x40010964 /* @ECU_Address@gfCamAngle@ */ /end MEASUREMENT
/begin MEASUREMENT First_TDC_To_First_Crksft_Tooth_Fall_Edge_Aft_Gap_Measd "first firing TDC to first crankshaft tooth falling edge after gap measured by ETPU" UWORD Angle_CM 1 100 0 1000 FORMAT "%20.2" ECU_ADDRESS 0x40010996 /* @ECU_Address@gusTPUFirstToothAngle@ */ /end MEASUREMENT
/begin CHARACTERISTIC Injection_Duration_Low_Limit "Injection_Duration_Low_Limit" VALUE 0x40040018 /* @ECU_Address@gfInjectionDurationLowLimit@ */ FLOAT32_IEEE 1000 Duration_us_Scale_CM 0 1000 /end CHARACTERISTIC
/begin CHARACTERISTIC Injection_Duration_Under_Low_Limit "Injection_Duration_Under_Low_Limit" VALUE 0x40040014 /* @ECU_Address@gfInjectionDurationUnderLowLimit@ */ FLOAT32_IEEE 1000 Duration_us_Scale_CM 0 1000 /end CHARACTERISTIC
/*****************************************J1939 PARAMS START*********************************************/
/begin CHARACTERISTIC CCVS1_J1939_Src_Adr "CCVS1 Source Address" VALUE 0x4000B060 /* @ECU_Address@j1939_handle_entry[0].sa@ */ UBYTE 255 NO_COMPU_METHOD 0 255 FORMAT "%20.0" /end CHARACTERISTIC
/begin CHARACTERISTIC CM1_J1939_Src_Adr "CM1 Source Address" VALUE 0x4000B07C /* @ECU_Address@j1939_handle_entry[1].sa@ */ UBYTE 255 NO_COMPU_METHOD 0 255 FORMAT "%20.0" /end CHARACTERISTIC
/begin CHARACTERISTIC CM3_J1939_Src_Adr "CM3 Source Address" VALUE 0x4000B098 /* @ECU_Address@j1939_handle_entry[2].sa@ */ UBYTE 255 NO_COMPU_METHOD 0 255 FORMAT "%20.0" /end CHARACTERISTIC
/begin CHARACTERISTIC CTL_J1939_Src_Adr "CTL Source Address" VALUE 0x4000B0B4 /* @ECU_Address@j1939_handle_entry[3].sa@ */ UBYTE 255 NO_COMPU_METHOD 0 255 FORMAT "%20.0" /end CHARACTERISTIC
/begin CHARACTERISTIC DLCC1COC_J1939_Src_Adr "DLCC1COC Source Address" VALUE 0x4000B0D0 /* @ECU_Address@j1939_handle_entry[4].sa@ */ UBYTE 255 NO_COMPU_METHOD 0 255 FORMAT "%20.0" /end CHARACTERISTIC
/begin CHARACTERISTIC EBC1_J1939_Src_Adr "EBC1 Source Address" VALUE 0x4000B0EC /* @ECU_Address@j1939_handle_entry[5].sa@ */ UBYTE 255 NO_COMPU_METHOD 0 255 FORMAT "%20.0" /end CHARACTERISTIC
/begin CHARACTERISTIC ETC7_J1939_Src_Adr "ETC7 Source Address" VALUE 0x4000B108 /* @ECU_Address@j1939_handle_entry[6].sa@ */ UBYTE 255 NO_COMPU_METHOD 0 255 FORMAT "%20.0" /end CHARACTERISTIC
/begin CHARACTERISTIC EEC3_RX_J1939_Src_Adr "EEC3_RX Source Address" VALUE 0x4000B124 /* @ECU_Address@j1939_handle_entry[7].sa@ */ UBYTE 255 NO_COMPU_METHOD 0 255 FORMAT "%20.0" /end CHARACTERISTIC
/begin CHARACTERISTIC ERC1_RX_J1939_Src_Adr "ERC1_RX Source Address" VALUE 0x4000B140 /* @ECU_Address@j1939_handle_entry[8].sa@ */ UBYTE 255 NO_COMPU_METHOD 0 255 FORMAT "%20.0" /end CHARACTERISTIC
/begin CHARACTERISTIC ETC1_J1939_Src_Adr "ETC1 Source Address" VALUE 0x4000B15C /* @ECU_Address@j1939_handle_entry[9].sa@ */ UBYTE 255 NO_COMPU_METHOD 0 255 FORMAT "%20.0" /end CHARACTERISTIC
/begin CHARACTERISTIC ETC2_J1939_Src_Adr "ETC2 Source Address" VALUE 0x4000B178 /* @ECU_Address@j1939_handle_entry[10].sa@ */ UBYTE 255 NO_COMPU_METHOD 0 255 FORMAT "%20.0" /end CHARACTERISTIC
/begin CHARACTERISTIC ETC8_J1939_Src_Adr "ETC8 Source Address" VALUE 0x4000B194 /* @ECU_Address@j1939_handle_entry[11].sa@ */ UBYTE 255 NO_COMPU_METHOD 0 255 FORMAT "%20.0" /end CHARACTERISTIC
/begin CHARACTERISTIC FD1_J1939_Src_Adr "FD1 Source Address" VALUE 0x4000B1B0 /* @ECU_Address@j1939_handle_entry[12].sa@ */ UBYTE 255 NO_COMPU_METHOD 0 255 FORMAT "%20.0" /end CHARACTERISTIC
/begin CHARACTERISTIC IDFF33_J1939_Src_Adr "IDFF33 Source Address" VALUE 0x4000B1CC /* @ECU_Address@j1939_handle_entry[13].sa@ */ UBYTE 255 NO_COMPU_METHOD 0 255 FORMAT "%20.0" /end CHARACTERISTIC
/begin CHARACTERISTIC M2E46_J1939_Src_Adr "M2E46 Source Address" VALUE 0x4000B1E8 /* @ECU_Address@j1939_handle_entry[14].sa@ */ UBYTE 255 NO_COMPU_METHOD 0 255 FORMAT "%20.0" /end CHARACTERISTIC
/begin CHARACTERISTIC M2E47_J1939_Src_Adr "M2E47 Source Address" VALUE 0x4000B204 /* @ECU_Address@j1939_handle_entry[15].sa@ */ UBYTE 255 NO_COMPU_METHOD 0 255 FORMAT "%20.0" /end CHARACTERISTIC
/begin CHARACTERISTIC M2E48_J1939_Src_Adr "M2E48 Source Address" VALUE 0x4000B220 /* @ECU_Address@j1939_handle_entry[16].sa@ */ UBYTE 255 NO_COMPU_METHOD 0 255 FORMAT "%20.0" /end CHARACTERISTIC
/begin CHARACTERISTIC M2E49_J1939_Src_Adr "M2E49 Source Address" VALUE 0x4000B23C /* @ECU_Address@j1939_handle_entry[17].sa@ */ UBYTE 255 NO_COMPU_METHOD 0 255 FORMAT "%20.0" /end CHARACTERISTIC
/begin CHARACTERISTIC PropVehT_J1939_Src_Adr "PropVehT Source Address" VALUE 0x4000B258 /* @ECU_Address@j1939_handle_entry[18].sa@ */ UBYTE 255 NO_COMPU_METHOD 0 255 FORMAT "%20.0" /end CHARACTERISTIC
/begin CHARACTERISTIC TCI_J1939_Src_Adr "TCI Source Address" VALUE 0x4000B274 /* @ECU_Address@j1939_handle_entry[19].sa@ */ UBYTE 255 NO_COMPU_METHOD 0 255 FORMAT "%20.0" /end CHARACTERISTIC
/begin CHARACTERISTIC TD_J1939_Src_Adr "TD Source Address" VALUE 0x4000B290 /* @ECU_Address@j1939_handle_entry[20].sa@ */ UBYTE 255 NO_COMPU_METHOD 0 255 FORMAT "%20.0" /end CHARACTERISTIC
/begin CHARACTERISTIC TSC1_J1939_Src_Adr "TSC1 Source Address" VALUE 0x4000B2AC /* @ECU_Address@j1939_handle_entry[21].sa@ */ UBYTE 255 NO_COMPU_METHOD 0 255 FORMAT "%20.0" /end CHARACTERISTIC
/*****************************************J1939 PARAMS END*********************************************/ /* HW_SPECIFIC_ALARM_LIST_START */ /* HW_SPECIFIC_ALARM_LIST_END */ /* HW_SPECIFIC_DATABASE_START */ /* HW_SPECIFIC_DATABASE_END */ /* DEBUG_SPECIFIC_DATABASE_START */ /* DEBUG_SPECIFIC_DATABASE_END */ /*COMPU METHODS*/
/begin COMPU_METHOD Resistor_CM "Scale 1" RAT_FUNC "%20.0" "Ohm" COEFFS 0 1 0 0 0 1 /end COMPU_METHOD
/begin COMPU_METHOD Percent_CM "Scale 1" RAT_FUNC "%20.1" "%" COEFFS 0 1 0 0 0 1 /end COMPU_METHOD
/begin COMPU_METHOD degC_CM "Scale 1" RAT_FUNC "%20.1" "degC" COEFFS 0 1 0 0 0 1 /end COMPU_METHOD
/begin COMPU_METHOD mm3_CM "Scale 1" RAT_FUNC "%20.1" "mm3/stk" COEFFS 0 1 0 0 0 1 /end COMPU_METHOD
/begin COMPU_METHOD hour_CM "Scale 1" RAT_FUNC "%20.1" "h" COEFFS 0 1 0 0 0 1 /end COMPU_METHOD
/begin COMPU_METHOD LevelSensor_CM "Scale 1" RAT_FUNC "%20.0" "%" COEFFS 0 1 0 0 0 1 /end COMPU_METHOD
/begin COMPU_METHOD PressSensor_CM "Scale 1" RAT_FUNC "%20.0" "bar" COEFFS 0 1 0 0 0 1 /end COMPU_METHOD
/begin COMPU_METHOD SpeedSensor_CM "Scale 1" RAT_FUNC "%20.0" "rpm" COEFFS 0 1 0 0 0 1 /end COMPU_METHOD
/begin COMPU_METHOD kmh_CM "Scale 1" RAT_FUNC "%20.0" "km/h" COEFFS 0 1 0 0 0 1 /end COMPU_METHOD
/begin COMPU_METHOD kPa_CM "Scale 1" RAT_FUNC "%20.0" "kPa" COEFFS 0 1 0 0 0 1 /end COMPU_METHOD
/begin COMPU_METHOD percent_CM "Scale 1" RAT_FUNC "%20.0" "%" COEFFS 0 1 0 0 0 1 /end COMPU_METHOD
/begin COMPU_METHOD Voltage_CM "Scale 1" RAT_FUNC "%20.0" "V" COEFFS 0 1 0 0 0 1 /end COMPU_METHOD
/begin COMPU_METHOD Current_CM "Scale 1" RAT_FUNC "%20.0" "A" COEFFS 0 1 0 0 0 1 /end COMPU_METHOD
/begin COMPU_METHOD Duration_ms_Scale1000000_CM "Scale 1000000" RAT_FUNC "%20.0" "us" COEFFS 0 1 0 0 0 1000000 /end COMPU_METHOD
/begin COMPU_METHOD Angle_CM "Scale 1" RAT_FUNC "%20.0" "crk" COEFFS 0 1 0 0 0 1 /end COMPU_METHOD
/begin COMPU_METHOD Duration_us_Scale_CM "Scale 1" RAT_FUNC "%20.0" "us" COEFFS 0 1 0 0 0 1 /end COMPU_METHOD
/begin COMPU_METHOD Current_A_CM "Scale 1" RAT_FUNC "%20.0" "A" COEFFS 0 1 0 0 0 1 /end COMPU_METHOD
/begin RECORD_LAYOUT FLOAT32_IEEE FNC_VALUES 1 FLOAT32_IEEE ROW_DIR DIRECT /end RECORD_LAYOUT
/begin RECORD_LAYOUT ULONG FNC_VALUES 1 ULONG ROW_DIR DIRECT /end RECORD_LAYOUT
/begin RECORD_LAYOUT UWORD FNC_VALUES 1 UWORD ROW_DIR DIRECT /end RECORD_LAYOUT
/begin RECORD_LAYOUT SWORD FNC_VALUES 1 SWORD ROW_DIR DIRECT /end RECORD_LAYOUT
/begin RECORD_LAYOUT UBYTE FNC_VALUES 1 UBYTE ROW_DIR DIRECT /end RECORD_LAYOUT
/begin RECORD_LAYOUT SBYTE FNC_VALUES 1 SBYTE ROW_DIR DIRECT /end RECORD_LAYOUT
/begin RECORD_LAYOUT RL_X_FLOAT32_IEEE AXIS_PTS_X 1 FLOAT32_IEEE INDEX_INCR DIRECT /end RECORD_LAYOUT
/******************************* From MATLAB ***************************************/ /* MATLAB_SECTION_START_1 */
/begin RECORD_LAYOUT Scalar_BOOLEAN FNC_VALUES 1 UBYTE ROW_DIR DIRECT /end RECORD_LAYOUT
/begin RECORD_LAYOUT Scalar_ULONG FNC_VALUES 1 ULONG ROW_DIR DIRECT /end RECORD_LAYOUT
/begin RECORD_LAYOUT Scalar_FLOAT32_IEEE FNC_VALUES 1 FLOAT32_IEEE ROW_DIR DIRECT /end RECORD_LAYOUT
/begin RECORD_LAYOUT Lookup1D_FLOAT32_IEEE FNC_VALUES 1 FLOAT32_IEEE ROW_DIR DIRECT /end RECORD_LAYOUT
/begin RECORD_LAYOUT Lookup1D_X_FLOAT32_IEEE AXIS_PTS_X 1 FLOAT32_IEEE INDEX_INCR DIRECT /end RECORD_LAYOUT
/begin RECORD_LAYOUT Lookup2D_X_UBYTE AXIS_PTS_X 1 UBYTE INDEX_INCR DIRECT /end RECORD_LAYOUT
/begin RECORD_LAYOUT Lookup2D_BYTE FNC_VALUES 1 SBYTE ROW_DIR DIRECT /end RECORD_LAYOUT
/begin RECORD_LAYOUT Lookup2D_X_BYTE AXIS_PTS_X 1 SBYTE INDEX_INCR DIRECT /end RECORD_LAYOUT
/begin RECORD_LAYOUT Lookup2D_UWORD FNC_VALUES 1 UWORD ROW_DIR DIRECT /end RECORD_LAYOUT
/begin RECORD_LAYOUT Lookup2D_X_UWORD AXIS_PTS_X 1 UWORD INDEX_INCR DIRECT /end RECORD_LAYOUT
/begin RECORD_LAYOUT Lookup2D_WORD FNC_VALUES 1 SWORD ROW_DIR DIRECT /end RECORD_LAYOUT
/begin RECORD_LAYOUT Lookup2D_ULONG FNC_VALUES 1 ULONG ROW_DIR DIRECT /end RECORD_LAYOUT
/begin RECORD_LAYOUT Lookup2D_X_ULONG AXIS_PTS_X 1 ULONG INDEX_INCR DIRECT /end RECORD_LAYOUT
/begin RECORD_LAYOUT Lookup2D_LONG FNC_VALUES 1 SLONG ROW_DIR DIRECT /end RECORD_LAYOUT
/begin RECORD_LAYOUT Lookup2D_X_LONG AXIS_PTS_X 1 SLONG INDEX_INCR DIRECT /end RECORD_LAYOUT
/begin RECORD_LAYOUT Lookup2D_FLOAT64_IEEE FNC_VALUES 1 FLOAT64_IEEE ROW_DIR DIRECT /end RECORD_LAYOUT
/begin RECORD_LAYOUT Lookup2D_X_FLOAT64_IEEE AXIS_PTS_X 1 FLOAT64_IEEE INDEX_INCR DIRECT /end RECORD_LAYOUT
/begin AXIS_PTS WM_NEng_A "Engine Speed Map Axis" 0x40050F48 /* @ECU_Address@WM_NEng_A@ */ EIP_NEng Lookup1D_X_FLOAT32_IEEE 0 EcuIntgdSwGend_CM_single_rpm 5 0.0 6000.0 /end AXIS_PTS
/begin CHARACTERISTIC WM_PRailUndLvl1_M "Rail Pressure Under Level 1 Map" CURVE 0x4005121C /* @ECU_Address@WM_PRailUndLvl1_M@ */ Lookup1D_FLOAT32_IEEE 0 EcuIntgdSwGend_CM_single_bar 0.0 2500.0
 /begin AXIS_DESCR COM_AXIS EIP_NEng EcuIntgdSwGend_CM_single_rpm 5 0.0 6000.0 AXIS_PTS_REF WM_NEng_A /end AXIS_DESCR
/end CHARACTERISTIC
/begin CHARACTERISTIC WM_PRailUndLvl2_M "Rail Pressure Under Level 2 Map" CURVE 0x40051230 /* @ECU_Address@WM_PRailUndLvl2_M@ */ Lookup1D_FLOAT32_IEEE 0 EcuIntgdSwGend_CM_single_bar 0.0 2500.0
 /begin AXIS_DESCR COM_AXIS EIP_NEng EcuIntgdSwGend_CM_single_rpm 5 0.0 6000.0 AXIS_PTS_REF WM_NEng_A /end AXIS_DESCR
/end CHARACTERISTIC
/begin CHARACTERISTIC WM_PRailUndLvl3_M "Rail Pressure Under Level 3 Map" CURVE 0x40051244 /* @ECU_Address@WM_PRailUndLvl3_M@ */ Lookup1D_FLOAT32_IEEE 0 EcuIntgdSwGend_CM_single_bar 0.0 2500.0
 /begin AXIS_DESCR COM_AXIS EIP_NEng EcuIntgdSwGend_CM_single_rpm 5 0.0 6000.0 AXIS_PTS_REF WM_NEng_A /end AXIS_DESCR
/end CHARACTERISTIC
/begin CHARACTERISTIC WM_TAirBoostOvLvl1_M "Air Boost Temperature Over Level 1 Map" CURVE 0x4005126C /* @ECU_Address@WM_TAirBoostOvLvl1_M@ */ Lookup1D_FLOAT32_IEEE 0 EcuIntgdSwGend_CM_single_degC -40.0 250.0
 /begin AXIS_DESCR COM_AXIS EIP_NEng EcuIntgdSwGend_CM_single_rpm 5 0.0 6000.0 AXIS_PTS_REF WM_NEng_A /end AXIS_DESCR
/end CHARACTERISTIC
/begin CHARACTERISTIC WM_TAirBoostOvLvl2_M "Air Boost Temperature Over Level 2 Map" CURVE 0x40051280 /* @ECU_Address@WM_TAirBoostOvLvl2_M@ */ Lookup1D_FLOAT32_IEEE 0 EcuIntgdSwGend_CM_single_degC -40.0 250.0
 /begin AXIS_DESCR COM_AXIS EIP_NEng EcuIntgdSwGend_CM_single_rpm 5 0.0 6000.0 AXIS_PTS_REF WM_NEng_A /end AXIS_DESCR
/end CHARACTERISTIC
/begin CHARACTERISTIC WM_TAirBoostOvLvl3_M "Air Boost Temperature Over Level 3 Map" CURVE 0x40051294 /* @ECU_Address@WM_TAirBoostOvLvl3_M@ */ Lookup1D_FLOAT32_IEEE 0 EcuIntgdSwGend_CM_single_degC -40.0 250.0
 /begin AXIS_DESCR COM_AXIS EIP_NEng EcuIntgdSwGend_CM_single_rpm 5 0.0 6000.0 AXIS_PTS_REF WM_NEng_A /end AXIS_DESCR
/end CHARACTERISTIC
/begin CHARACTERISTIC WM_TAirBoostUndLvl1_M "Air Boost Temperature Under Level 1 Map" CURVE 0x400512B8 /* @ECU_Address@WM_TAirBoostUndLvl1_M@ */ Lookup1D_FLOAT32_IEEE 0 EcuIntgdSwGend_CM_single_degC -40.0 250.0
 /begin AXIS_DESCR COM_AXIS EIP_NEng EcuIntgdSwGend_CM_single_rpm 5 0.0 6000.0 AXIS_PTS_REF WM_NEng_A /end AXIS_DESCR
/end CHARACTERISTIC
/begin CHARACTERISTIC WM_TAirBoostUndLvl2_M "Air Boost Temperature Under Level 2 Map" CURVE 0x400512CC /* @ECU_Address@WM_TAirBoostUndLvl2_M@ */ Lookup1D_FLOAT32_IEEE 0 EcuIntgdSwGend_CM_single_degC -40.0 250.0
 /begin AXIS_DESCR COM_AXIS EIP_NEng EcuIntgdSwGend_CM_single_rpm 5 0.0 6000.0 AXIS_PTS_REF WM_NEng_A /end AXIS_DESCR
/end CHARACTERISTIC
/begin CHARACTERISTIC WM_TAirBoostUndLvl3_M "Air Boost Temperature Under Level 3 Map" CURVE 0x400512E0 /* @ECU_Address@WM_TAirBoostUndLvl3_M@ */ Lookup1D_FLOAT32_IEEE 0 EcuIntgdSwGend_CM_single_degC -40.0 250.0
 /begin AXIS_DESCR COM_AXIS EIP_NEng EcuIntgdSwGend_CM_single_rpm 5 0.0 6000.0 AXIS_PTS_REF WM_NEng_A /end AXIS_DESCR
/end CHARACTERISTIC
/begin CHARACTERISTIC WM_TAmbAirOvLvl1_M "Ambient Air Temperature Over Level 1 Map" CURVE 0x40051304 /* @ECU_Address@WM_TAmbAirOvLvl1_M@ */ Lookup1D_FLOAT32_IEEE 0 EcuIntgdSwGend_CM_single_degC -40.0 250.0
 /begin AXIS_DESCR COM_AXIS EIP_NEng EcuIntgdSwGend_CM_single_rpm 5 0.0 6000.0 AXIS_PTS_REF WM_NEng_A /end AXIS_DESCR
/end CHARACTERISTIC
/begin CHARACTERISTIC WM_TAmbAirOvLvl2_M "Ambient Air Temperature Over Level 2 Map" CURVE 0x40051318 /* @ECU_Address@WM_TAmbAirOvLvl2_M@ */ Lookup1D_FLOAT32_IEEE 0 EcuIntgdSwGend_CM_single_degC -40.0 250.0
 /begin AXIS_DESCR COM_AXIS EIP_NEng EcuIntgdSwGend_CM_single_rpm 5 0.0 6000.0 AXIS_PTS_REF WM_NEng_A /end AXIS_DESCR
/end CHARACTERISTIC
/begin CHARACTERISTIC WM_TAmbAirOvLvl3_M "Ambient Air Temperature Over Level 3 Map" CURVE 0x4005132C /* @ECU_Address@WM_TAmbAirOvLvl3_M@ */ Lookup1D_FLOAT32_IEEE 0 EcuIntgdSwGend_CM_single_degC -40.0 250.0
 /begin AXIS_DESCR COM_AXIS EIP_NEng EcuIntgdSwGend_CM_single_rpm 5 0.0 6000.0 AXIS_PTS_REF WM_NEng_A /end AXIS_DESCR
/end CHARACTERISTIC
/begin CHARACTERISTIC WM_TAmbAirUndLvl1_M "Ambient Air Temperature Under Level 1 Map" CURVE 0x40051350 /* @ECU_Address@WM_TAmbAirUndLvl1_M@ */ Lookup1D_FLOAT32_IEEE 0 EcuIntgdSwGend_CM_single_degC -40.0 250.0
 /begin AXIS_DESCR COM_AXIS EIP_NEng EcuIntgdSwGend_CM_single_rpm 5 0.0 6000.0 AXIS_PTS_REF WM_NEng_A /end AXIS_DESCR
/end CHARACTERISTIC
/begin CHARACTERISTIC WM_TAmbAirUndLvl2_M "Ambient Air Temperature Under Level 2 Map" CURVE 0x40051364 /* @ECU_Address@WM_TAmbAirUndLvl2_M@ */ Lookup1D_FLOAT32_IEEE 0 EcuIntgdSwGend_CM_single_degC -40.0 250.0
 /begin AXIS_DESCR COM_AXIS EIP_NEng EcuIntgdSwGend_CM_single_rpm 5 0.0 6000.0 AXIS_PTS_REF WM_NEng_A /end AXIS_DESCR
/end CHARACTERISTIC
/begin CHARACTERISTIC WM_TAmbAirUndLvl3_M "Ambient Air Temperature Under Level 3 Map" CURVE 0x40051378 /* @ECU_Address@WM_TAmbAirUndLvl3_M@ */ Lookup1D_FLOAT32_IEEE 0 EcuIntgdSwGend_CM_single_degC -40.0 250.0
 /begin AXIS_DESCR COM_AXIS EIP_NEng EcuIntgdSwGend_CM_single_rpm 5 0.0 6000.0 AXIS_PTS_REF WM_NEng_A /end AXIS_DESCR
/end CHARACTERISTIC
/begin CHARACTERISTIC WM_TCooltOvLvl1_M "Coolant Temperature Over Level 1 Map" CURVE 0x4005139C /* @ECU_Address@WM_TCooltOvLvl1_M@ */ Lookup1D_FLOAT32_IEEE 0 EcuIntgdSwGend_CM_single_degC -40.0 250.0
 /begin AXIS_DESCR COM_AXIS EIP_NEng EcuIntgdSwGend_CM_single_rpm 5 0.0 6000.0 AXIS_PTS_REF WM_NEng_A /end AXIS_DESCR
/end CHARACTERISTIC
/begin CHARACTERISTIC WM_TCooltOvLvl2_M "Coolant Temperature Over Level 2 Map" CURVE 0x400513B0 /* @ECU_Address@WM_TCooltOvLvl2_M@ */ Lookup1D_FLOAT32_IEEE 0 EcuIntgdSwGend_CM_single_degC -40.0 250.0
 /begin AXIS_DESCR COM_AXIS EIP_NEng EcuIntgdSwGend_CM_single_rpm 5 0.0 6000.0 AXIS_PTS_REF WM_NEng_A /end AXIS_DESCR
/end CHARACTERISTIC
/begin CHARACTERISTIC WM_TCooltOvLvl3_M "Coolant Temperature Over Level 3 Map" CURVE 0x400513C4 /* @ECU_Address@WM_TCooltOvLvl3_M@ */ Lookup1D_FLOAT32_IEEE 0 EcuIntgdSwGend_CM_single_degC -40.0 250.0
 /begin AXIS_DESCR COM_AXIS EIP_NEng EcuIntgdSwGend_CM_single_rpm 5 0.0 6000.0 AXIS_PTS_REF WM_NEng_A /end AXIS_DESCR
/end CHARACTERISTIC
/begin CHARACTERISTIC WM_TCooltUndLvl1_M "Coolant Temperature Under Level 1 Map" CURVE 0x400513E8 /* @ECU_Address@WM_TCooltUndLvl1_M@ */ Lookup1D_FLOAT32_IEEE 0 EcuIntgdSwGend_CM_single_degC -40.0 250.0
 /begin AXIS_DESCR COM_AXIS EIP_NEng EcuIntgdSwGend_CM_single_rpm 5 0.0 6000.0 AXIS_PTS_REF WM_NEng_A /end AXIS_DESCR
/end CHARACTERISTIC
/begin CHARACTERISTIC WM_TCooltUndLvl2_M "Coolant Temperature Under Level 2 Map" CURVE 0x400513FC /* @ECU_Address@WM_TCooltUndLvl2_M@ */ Lookup1D_FLOAT32_IEEE 0 EcuIntgdSwGend_CM_single_degC -40.0 250.0
 /begin AXIS_DESCR COM_AXIS EIP_NEng EcuIntgdSwGend_CM_single_rpm 5 0.0 6000.0 AXIS_PTS_REF WM_NEng_A /end AXIS_DESCR
/end CHARACTERISTIC
/begin CHARACTERISTIC WM_TCooltUndLvl3_M "Coolant Temperature Under Level 3 Map" CURVE 0x40051410 /* @ECU_Address@WM_TCooltUndLvl3_M@ */ Lookup1D_FLOAT32_IEEE 0 EcuIntgdSwGend_CM_single_degC -40.0 250.0
 /begin AXIS_DESCR COM_AXIS EIP_NEng EcuIntgdSwGend_CM_single_rpm 5 0.0 6000.0 AXIS_PTS_REF WM_NEng_A /end AXIS_DESCR
/end CHARACTERISTIC
/begin CHARACTERISTIC WM_TFuOvLvl1_M "Fuel Temperature Over Level 1 Map" CURVE 0x40051450 /* @ECU_Address@WM_TFuOvLvl1_M@ */ Lookup1D_FLOAT32_IEEE 0 EcuIntgdSwGend_CM_single_degC -40.0 250.0
 /begin AXIS_DESCR COM_AXIS EIP_NEng EcuIntgdSwGend_CM_single_rpm 5 0.0 6000.0 AXIS_PTS_REF WM_NEng_A /end AXIS_DESCR
/end CHARACTERISTIC
/begin CHARACTERISTIC WM_TFuOvLvl2_M "Fuel Temperature Over Level 2 Map" CURVE 0x40051464 /* @ECU_Address@WM_TFuOvLvl2_M@ */ Lookup1D_FLOAT32_IEEE 0 EcuIntgdSwGend_CM_single_degC -40.0 250.0
 /begin AXIS_DESCR COM_AXIS EIP_NEng EcuIntgdSwGend_CM_single_rpm 5 0.0 6000.0 AXIS_PTS_REF WM_NEng_A /end AXIS_DESCR
/end CHARACTERISTIC
/begin CHARACTERISTIC WM_TFuOvLvl3_M "Fuel Temperature Over Level 3 Map" CURVE 0x40051478 /* @ECU_Address@WM_TFuOvLvl3_M@ */ Lookup1D_FLOAT32_IEEE 0 EcuIntgdSwGend_CM_single_degC -40.0 250.0
 /begin AXIS_DESCR COM_AXIS EIP_NEng EcuIntgdSwGend_CM_single_rpm 5 0.0 6000.0 AXIS_PTS_REF WM_NEng_A /end AXIS_DESCR
/end CHARACTERISTIC
/begin CHARACTERISTIC WM_TOilOvLvl1_M "Oil Temperature Over Level 1 Map" CURVE 0x4005149C /* @ECU_Address@WM_TOilOvLvl1_M@ */ Lookup1D_FLOAT32_IEEE 0 EcuIntgdSwGend_CM_single_degC -40.0 250.0
 /begin AXIS_DESCR COM_AXIS EIP_NEng EcuIntgdSwGend_CM_single_rpm 5 0.0 6000.0 AXIS_PTS_REF WM_NEng_A /end AXIS_DESCR
/end CHARACTERISTIC
/begin CHARACTERISTIC WM_TOilOvLvl2_M "Oil Temperature Over Level 2 Map" CURVE 0x400514B0 /* @ECU_Address@WM_TOilOvLvl2_M@ */ Lookup1D_FLOAT32_IEEE 0 EcuIntgdSwGend_CM_single_degC -40.0 250.0
 /begin AXIS_DESCR COM_AXIS EIP_NEng EcuIntgdSwGend_CM_single_rpm 5 0.0 6000.0 AXIS_PTS_REF WM_NEng_A /end AXIS_DESCR
/end CHARACTERISTIC
/begin CHARACTERISTIC WM_TOilOvLvl3_M "Oil Temperature Over Level 3 Map" CURVE 0x400514C4 /* @ECU_Address@WM_TOilOvLvl3_M@ */ Lookup1D_FLOAT32_IEEE 0 EcuIntgdSwGend_CM_single_degC -40.0 250.0
 /begin AXIS_DESCR COM_AXIS EIP_NEng EcuIntgdSwGend_CM_single_rpm 5 0.0 6000.0 AXIS_PTS_REF WM_NEng_A /end AXIS_DESCR
/end CHARACTERISTIC
/begin CHARACTERISTIC WM_TOilUndLvl1_M "Oil Temperature Under Level 1 Map" CURVE 0x400514E8 /* @ECU_Address@WM_TOilUndLvl1_M@ */ Lookup1D_FLOAT32_IEEE 0 EcuIntgdSwGend_CM_single_degC -40.0 250.0
 /begin AXIS_DESCR COM_AXIS EIP_NEng EcuIntgdSwGend_CM_single_rpm 5 0.0 6000.0 AXIS_PTS_REF WM_NEng_A /end AXIS_DESCR
/end CHARACTERISTIC
/begin CHARACTERISTIC WM_TOilUndLvl2_M "Oil Temperature Under Level 2 Map" CURVE 0x400514FC /* @ECU_Address@WM_TOilUndLvl2_M@ */ Lookup1D_FLOAT32_IEEE 0 EcuIntgdSwGend_CM_single_degC -40.0 250.0
 /begin AXIS_DESCR COM_AXIS EIP_NEng EcuIntgdSwGend_CM_single_rpm 5 0.0 6000.0 AXIS_PTS_REF WM_NEng_A /end AXIS_DESCR
/end CHARACTERISTIC
/begin CHARACTERISTIC WM_TOilUndLvl3_M "Oil Temperature Under Level 3 Map" CURVE 0x40051510 /* @ECU_Address@WM_TOilUndLvl3_M@ */ Lookup1D_FLOAT32_IEEE 0 EcuIntgdSwGend_CM_single_degC -40.0 250.0
 /begin AXIS_DESCR COM_AXIS EIP_NEng EcuIntgdSwGend_CM_single_rpm 5 0.0 6000.0 AXIS_PTS_REF WM_NEng_A /end AXIS_DESCR
/end CHARACTERISTIC
/begin CHARACTERISTIC DTqC_DynRateLoLim_P "Dynamic Rate Low Limit Parameter" VALUE 0x40041A20 /* @ECU_Address@DTqC_DynRateLoLim_P@ */ Scalar_FLOAT32_IEEE 0 EcuIntgdSwGend_CM_single -10000.0 0.0 /end CHARACTERISTIC
/begin CHARACTERISTIC DTqC_DynRateUpLim_P "Dynamic Rate Up Limit Parameter" VALUE 0x40041A24 /* @ECU_Address@DTqC_DynRateUpLim_P@ */ Scalar_FLOAT32_IEEE 0 EcuIntgdSwGend_CM_single 0.0 10000.0 /end CHARACTERISTIC
/begin CHARACTERISTIC DTqC_IntglRstCoeffKiThd_P "Idle Speed Controller Integral Reset Ki Coefficient Threshold" VALUE 0x40041C2C /* @ECU_Address@DTqC_IntglRstCoeffKiThd_P@ */ Scalar_FLOAT32_IEEE 0 EcuIntgdSwGend_CM_single -5000.0 5000.0 /end CHARACTERISTIC
/begin CHARACTERISTIC DTqC_IntglRstIdleErrThd_P "Idle Speed Controller Integral Reset Speed Error Threshold" VALUE 0x40041C30 /* @ECU_Address@DTqC_IntglRstIdleErrThd_P@ */ Scalar_FLOAT32_IEEE 0 EcuIntgdSwGend_CM_single -5000.0 5000.0 /end CHARACTERISTIC
/begin CHARACTERISTIC DTqC_TiMaxAcvHardLimLtch_P "" VALUE 0x400420A4 /* @ECU_Address@DTqC_TiMaxAcvHardLimLtch_P@ */ Scalar_FLOAT32_IEEE 0 EcuIntgdSwGend_CM_single_ms 0.0 50000.0 /end CHARACTERISTIC
/begin CHARACTERISTIC WM_NEngThdPRailNotCtld_P "Engine Speed Threshold for Rail Pressure Is Not Controlled Parameter" VALUE 0x40050F44 /* @ECU_Address@WM_NEngThdPRailNotCtld_P@ */ Scalar_FLOAT32_IEEE 0 EcuIntgdSwGend_CM_single_rpm 0.0 6000.0 /end CHARACTERISTIC
/begin CHARACTERISTIC WM_PRailNotCtldThd_P "Rail Pressure Is Not Controlled Threshold Parameter" VALUE 0x400511BC /* @ECU_Address@WM_PRailNotCtldThd_P@ */ Scalar_FLOAT32_IEEE 0 EcuIntgdSwGend_CM_single_bar 0.0 500.0 /end CHARACTERISTIC
/begin CHARACTERISTIC WM_PRailUndDesLvlQnty_P "Rail Pressure Under Desired Severity Level Quantity Parameter" VALUE 0x4005120C /* @ECU_Address@WM_PRailUndDesLvlQnty_P@ */ Scalar_FLOAT32_IEEE 0 EcuIntgdSwGend_CM_single 0.0 3.0 /end CHARACTERISTIC
/begin CHARACTERISTIC WM_PRailUndHysDeacLvl1_P "Rail Pressure Under Level 1 Hysteresis Deactivation Parameter" VALUE 0x40051210 /* @ECU_Address@WM_PRailUndHysDeacLvl1_P@ */ Scalar_FLOAT32_IEEE 0 EcuIntgdSwGend_CM_single_bar 0.0 2500.0 /end CHARACTERISTIC
/begin CHARACTERISTIC WM_PRailUndHysDeacLvl2_P "Rail Pressure Under Level 2 Hysteresis Deactivation Parameter" VALUE 0x40051214 /* @ECU_Address@WM_PRailUndHysDeacLvl2_P@ */ Scalar_FLOAT32_IEEE 0 EcuIntgdSwGend_CM_single_bar 0.0 2500.0 /end CHARACTERISTIC
/begin CHARACTERISTIC WM_PRailUndHysDeacLvl3_P "Rail Pressure Under Level 3 Hysteresis Deactivation Parameter" VALUE 0x40051218 /* @ECU_Address@WM_PRailUndHysDeacLvl3_P@ */ Scalar_FLOAT32_IEEE 0 EcuIntgdSwGend_CM_single_bar 0.0 2500.0 /end CHARACTERISTIC
/begin CHARACTERISTIC WM_TAirBoostOvDesLvlQnty_P "Air Boost Temperature Over Desired Severity Level Quantity Parameter" VALUE 0x4005125C /* @ECU_Address@WM_TAirBoostOvDesLvlQnty_P@ */ Scalar_FLOAT32_IEEE 0 EcuIntgdSwGend_CM_single 0.0 3.0 /end CHARACTERISTIC
/begin CHARACTERISTIC WM_TAirBoostOvHysDeacLvl1_P "Air Boost Temperature Over Level 1 Hysteresis Deactivation Parameter" VALUE 0x40051260 /* @ECU_Address@WM_TAirBoostOvHysDeacLvl1_P@ */ Scalar_FLOAT32_IEEE 0 EcuIntgdSwGend_CM_single_degC -40.0 250.0 /end CHARACTERISTIC
/begin CHARACTERISTIC WM_TAirBoostOvHysDeacLvl2_P "Air Boost Temperature Over Level 2 Hysteresis Deactivation Parameter" VALUE 0x40051264 /* @ECU_Address@WM_TAirBoostOvHysDeacLvl2_P@ */ Scalar_FLOAT32_IEEE 0 EcuIntgdSwGend_CM_single_degC -40.0 250.0 /end CHARACTERISTIC
/begin CHARACTERISTIC WM_TAirBoostOvHysDeacLvl3_P "Air Boost Temperature Over Level 3 Hysteresis Deactivation Parameter" VALUE 0x40051268 /* @ECU_Address@WM_TAirBoostOvHysDeacLvl3_P@ */ Scalar_FLOAT32_IEEE 0 EcuIntgdSwGend_CM_single_degC -40.0 250.0 /end CHARACTERISTIC
/begin CHARACTERISTIC WM_TAirBoostUndDesLvlQnty_P "Air Boost Temperature Under Desired Severity Level Quantity Parameter" VALUE 0x400512A8 /* @ECU_Address@WM_TAirBoostUndDesLvlQnty_P@ */ Scalar_FLOAT32_IEEE 0 EcuIntgdSwGend_CM_single 0.0 3.0 /end CHARACTERISTIC
/begin CHARACTERISTIC WM_TAirBoostUndHysDeacLvl1_P "Air Boost Temperature Under Level 1 Hysteresis Deactivation Parameter" VALUE 0x400512AC /* @ECU_Address@WM_TAirBoostUndHysDeacLvl1_P@ */ Scalar_FLOAT32_IEEE 0 EcuIntgdSwGend_CM_single_degC -40.0 250.0 /end CHARACTERISTIC
/begin CHARACTERISTIC WM_TAirBoostUndHysDeacLvl2_P "Air Boost Temperature Under Level 2 Hysteresis Deactivation Parameter" VALUE 0x400512B0 /* @ECU_Address@WM_TAirBoostUndHysDeacLvl2_P@ */ Scalar_FLOAT32_IEEE 0 EcuIntgdSwGend_CM_single_degC -40.0 250.0 /end CHARACTERISTIC
/begin CHARACTERISTIC WM_TAirBoostUndHysDeacLvl3_P "Air Boost Temperature Under Level 3 Hysteresis Deactivation Parameter" VALUE 0x400512B4 /* @ECU_Address@WM_TAirBoostUndHysDeacLvl3_P@ */ Scalar_FLOAT32_IEEE 0 EcuIntgdSwGend_CM_single_degC -40.0 250.0 /end CHARACTERISTIC
/begin CHARACTERISTIC WM_TAmbAirOvDesLvlQnty_P "Ambient Air Temperature Over Desired Severity Level Quantity Parameter" VALUE 0x400512F4 /* @ECU_Address@WM_TAmbAirOvDesLvlQnty_P@ */ Scalar_FLOAT32_IEEE 0 EcuIntgdSwGend_CM_single 0.0 3.0 /end CHARACTERISTIC
/begin CHARACTERISTIC WM_TAmbAirOvHysDeacLvl1_P "Ambient Air Temperature Over Level 1 Hysteresis Deactivation Parameter" VALUE 0x400512F8 /* @ECU_Address@WM_TAmbAirOvHysDeacLvl1_P@ */ Scalar_FLOAT32_IEEE 0 EcuIntgdSwGend_CM_single_degC -40.0 250.0 /end CHARACTERISTIC
/begin CHARACTERISTIC WM_TAmbAirOvHysDeacLvl2_P "Ambient Air Temperature Over Level 2 Hysteresis Deactivation Parameter" VALUE 0x400512FC /* @ECU_Address@WM_TAmbAirOvHysDeacLvl2_P@ */ Scalar_FLOAT32_IEEE 0 EcuIntgdSwGend_CM_single_degC -40.0 250.0 /end CHARACTERISTIC
/begin CHARACTERISTIC WM_TAmbAirOvHysDeacLvl3_P "Ambient Air Temperature Over Level 3 Hysteresis Deactivation Parameter" VALUE 0x40051300 /* @ECU_Address@WM_TAmbAirOvHysDeacLvl3_P@ */ Scalar_FLOAT32_IEEE 0 EcuIntgdSwGend_CM_single_degC -40.0 250.0 /end CHARACTERISTIC
/begin CHARACTERISTIC WM_TAmbAirUndDesLvlQnty_P "Ambient Air Temperature Under Desired Severity Level Quantity Parameter" VALUE 0x40051340 /* @ECU_Address@WM_TAmbAirUndDesLvlQnty_P@ */ Scalar_FLOAT32_IEEE 0 EcuIntgdSwGend_CM_single 0.0 3.0 /end CHARACTERISTIC
/begin CHARACTERISTIC WM_TAmbAirUndHysDeacLvl1_P "Ambient Air Temperature Under Level 1 Hysteresis Deactivation Parameter" VALUE 0x40051344 /* @ECU_Address@WM_TAmbAirUndHysDeacLvl1_P@ */ Scalar_FLOAT32_IEEE 0 EcuIntgdSwGend_CM_single_degC -40.0 250.0 /end CHARACTERISTIC
/begin CHARACTERISTIC WM_TAmbAirUndHysDeacLvl2_P "Ambient Air Temperature Under Level 2 Hysteresis Deactivation Parameter" VALUE 0x40051348 /* @ECU_Address@WM_TAmbAirUndHysDeacLvl2_P@ */ Scalar_FLOAT32_IEEE 0 EcuIntgdSwGend_CM_single_degC -40.0 250.0 /end CHARACTERISTIC
/begin CHARACTERISTIC WM_TAmbAirUndHysDeacLvl3_P "Ambient Air Temperature Under Level 3 Hysteresis Deactivation Parameter" VALUE 0x4005134C /* @ECU_Address@WM_TAmbAirUndHysDeacLvl3_P@ */ Scalar_FLOAT32_IEEE 0 EcuIntgdSwGend_CM_single_degC -40.0 250.0 /end CHARACTERISTIC
/begin CHARACTERISTIC WM_TCooltOvDesLvlQnty_P "Coolant Temperature Over Desired Severity Level Quantity Parameter" VALUE 0x4005138C /* @ECU_Address@WM_TCooltOvDesLvlQnty_P@ */ Scalar_FLOAT32_IEEE 0 EcuIntgdSwGend_CM_single 0.0 3.0 /end CHARACTERISTIC
/begin CHARACTERISTIC WM_TCooltOvHysDeacLvl1_P "Coolant Temperature Over Level 1 Hysteresis Deactivation Parameter" VALUE 0x40051390 /* @ECU_Address@WM_TCooltOvHysDeacLvl1_P@ */ Scalar_FLOAT32_IEEE 0 EcuIntgdSwGend_CM_single_degC -40.0 250.0 /end CHARACTERISTIC
/begin CHARACTERISTIC WM_TCooltOvHysDeacLvl2_P "Coolant Temperature Over Level 2 Hysteresis Deactivation Parameter" VALUE 0x40051394 /* @ECU_Address@WM_TCooltOvHysDeacLvl2_P@ */ Scalar_FLOAT32_IEEE 0 EcuIntgdSwGend_CM_single_degC -40.0 250.0 /end CHARACTERISTIC
/begin CHARACTERISTIC WM_TCooltOvHysDeacLvl3_P "Coolant Temperature Over Level 3 Hysteresis Deactivation Parameter" VALUE 0x40051398 /* @ECU_Address@WM_TCooltOvHysDeacLvl3_P@ */ Scalar_FLOAT32_IEEE 0 EcuIntgdSwGend_CM_single_degC -40.0 250.0 /end CHARACTERISTIC
/begin CHARACTERISTIC WM_TCooltUndDesLvlQnty_P "Coolant Temperature Under Desired Severity Level Quantity Parameter" VALUE 0x400513D8 /* @ECU_Address@WM_TCooltUndDesLvlQnty_P@ */ Scalar_FLOAT32_IEEE 0 EcuIntgdSwGend_CM_single 0.0 3.0 /end CHARACTERISTIC
/begin CHARACTERISTIC WM_TCooltUndHysDeacLvl1_P "Coolant Temperature Under Level 1 Hysteresis Deactivation Parameter" VALUE 0x400513DC /* @ECU_Address@WM_TCooltUndHysDeacLvl1_P@ */ Scalar_FLOAT32_IEEE 0 EcuIntgdSwGend_CM_single_degC -40.0 250.0 /end CHARACTERISTIC
/begin CHARACTERISTIC WM_TCooltUndHysDeacLvl2_P "Coolant Temperature Under Level 2 Hysteresis Deactivation Parameter" VALUE 0x400513E0 /* @ECU_Address@WM_TCooltUndHysDeacLvl2_P@ */ Scalar_FLOAT32_IEEE 0 EcuIntgdSwGend_CM_single_degC -40.0 250.0 /end CHARACTERISTIC
/begin CHARACTERISTIC WM_TCooltUndHysDeacLvl3_P "Coolant Temperature Under Level 3 Hysteresis Deactivation Parameter" VALUE 0x400513E4 /* @ECU_Address@WM_TCooltUndHysDeacLvl3_P@ */ Scalar_FLOAT32_IEEE 0 EcuIntgdSwGend_CM_single_degC -40.0 250.0 /end CHARACTERISTIC
/begin CHARACTERISTIC WM_TEcuDesLvlQnty_P "ECU Temperature Desired Severity Level Quantity Parameter" VALUE 0x40051424 /* @ECU_Address@WM_TEcuDesLvlQnty_P@ */ Scalar_FLOAT32_IEEE 0 EcuIntgdSwGend_CM_single 0.0 3.0 /end CHARACTERISTIC
/begin CHARACTERISTIC WM_TEcuHysDeacLvl1_P "ECU Temperature Level 1 Hysteresis Deactivation Parameter" VALUE 0x40051428 /* @ECU_Address@WM_TEcuHysDeacLvl1_P@ */ Scalar_FLOAT32_IEEE 0 EcuIntgdSwGend_CM_single_degC -40.0 250.0 /end CHARACTERISTIC
/begin CHARACTERISTIC WM_TEcuHysDeacLvl2_P "ECU Temperature Level 2 Hysteresis Deactivation Parameter" VALUE 0x4005142C /* @ECU_Address@WM_TEcuHysDeacLvl2_P@ */ Scalar_FLOAT32_IEEE 0 EcuIntgdSwGend_CM_single_degC -40.0 250.0 /end CHARACTERISTIC
/begin CHARACTERISTIC WM_TEcuHysDeacLvl3_P "ECU Temperature Level 3 Hysteresis Deactivation Parameter" VALUE 0x40051430 /* @ECU_Address@WM_TEcuHysDeacLvl3_P@ */ Scalar_FLOAT32_IEEE 0 EcuIntgdSwGend_CM_single_degC -40.0 250.0 /end CHARACTERISTIC
/begin CHARACTERISTIC WM_TEcuLvl1_P "ECU Temperature Level 1 Map" VALUE 0x40051434 /* @ECU_Address@WM_TEcuLvl1_P@ */ Scalar_FLOAT32_IEEE 0 EcuIntgdSwGend_CM_single_degC -40.0 250.0 /end CHARACTERISTIC
/begin CHARACTERISTIC WM_TEcuLvl2_P "ECU Temperature Level 2 Map" VALUE 0x40051438 /* @ECU_Address@WM_TEcuLvl2_P@ */ Scalar_FLOAT32_IEEE 0 EcuIntgdSwGend_CM_single_degC -40.0 250.0 /end CHARACTERISTIC
/begin CHARACTERISTIC WM_TEcuLvl3_P "ECU Temperature Level 3 Map" VALUE 0x4005143C /* @ECU_Address@WM_TEcuLvl3_P@ */ Scalar_FLOAT32_IEEE 0 EcuIntgdSwGend_CM_single_degC -40.0 250.0 /end CHARACTERISTIC
/begin CHARACTERISTIC WM_TFuOvDesLvlQnty_P "Fuel Temperature Over Desired Severity Level Quantity Parameter" VALUE 0x40051440 /* @ECU_Address@WM_TFuOvDesLvlQnty_P@ */ Scalar_FLOAT32_IEEE 0 EcuIntgdSwGend_CM_single 0.0 3.0 /end CHARACTERISTIC
/begin CHARACTERISTIC WM_TFuOvHysDeacLvl1_P "Fuel Temperature Over Level 1 Hysteresis Deactivation Parameter" VALUE 0x40051444 /* @ECU_Address@WM_TFuOvHysDeacLvl1_P@ */ Scalar_FLOAT32_IEEE 0 EcuIntgdSwGend_CM_single_degC -40.0 250.0 /end CHARACTERISTIC
/begin CHARACTERISTIC WM_TFuOvHysDeacLvl2_P "Fuel Temperature Over Level 2 Hysteresis Deactivation Parameter" VALUE 0x40051448 /* @ECU_Address@WM_TFuOvHysDeacLvl2_P@ */ Scalar_FLOAT32_IEEE 0 EcuIntgdSwGend_CM_single_degC -40.0 250.0 /end CHARACTERISTIC
/begin CHARACTERISTIC WM_TFuOvHysDeacLvl3_P "Fuel Temperature Over Level 3 Hysteresis Deactivation Parameter" VALUE 0x4005144C /* @ECU_Address@WM_TFuOvHysDeacLvl3_P@ */ Scalar_FLOAT32_IEEE 0 EcuIntgdSwGend_CM_single_degC -40.0 250.0 /end CHARACTERISTIC
/begin CHARACTERISTIC WM_TOilOvDesLvlQnty_P "Oil Temperature Over Desired Severity Level Quantity Parameter" VALUE 0x4005148C /* @ECU_Address@WM_TOilOvDesLvlQnty_P@ */ Scalar_FLOAT32_IEEE 0 EcuIntgdSwGend_CM_single 0.0 3.0 /end CHARACTERISTIC
/begin CHARACTERISTIC WM_TOilOvHysDeacLvl1_P "Oil Temperature Over Level 1 Hysteresis Deactivation Parameter" VALUE 0x40051490 /* @ECU_Address@WM_TOilOvHysDeacLvl1_P@ */ Scalar_FLOAT32_IEEE 0 EcuIntgdSwGend_CM_single_degC -40.0 250.0 /end CHARACTERISTIC
/begin CHARACTERISTIC WM_TOilOvHysDeacLvl2_P "Oil Temperature Over Level 2 Hysteresis Deactivation Parameter" VALUE 0x40051494 /* @ECU_Address@WM_TOilOvHysDeacLvl2_P@ */ Scalar_FLOAT32_IEEE 0 EcuIntgdSwGend_CM_single_degC -40.0 250.0 /end CHARACTERISTIC
/begin CHARACTERISTIC WM_TOilOvHysDeacLvl3_P "Oil Temperature Over Level 3 Hysteresis Deactivation Parameter" VALUE 0x40051498 /* @ECU_Address@WM_TOilOvHysDeacLvl3_P@ */ Scalar_FLOAT32_IEEE 0 EcuIntgdSwGend_CM_single_degC -40.0 250.0 /end CHARACTERISTIC
/begin CHARACTERISTIC WM_TOilUndDesLvlQnty_P "Oil Temperature Under Desired Severity Level Quantity Parameter" VALUE 0x400514D8 /* @ECU_Address@WM_TOilUndDesLvlQnty_P@ */ Scalar_FLOAT32_IEEE 0 EcuIntgdSwGend_CM_single 0.0 3.0 /end CHARACTERISTIC
/begin CHARACTERISTIC WM_TOilUndHysDeacLvl1_P "Oil Temperature Under Level 1 Hysteresis Deactivation Parameter" VALUE 0x400514DC /* @ECU_Address@WM_TOilUndHysDeacLvl1_P@ */ Scalar_FLOAT32_IEEE 0 EcuIntgdSwGend_CM_single_degC -40.0 250.0 /end CHARACTERISTIC
/begin CHARACTERISTIC WM_TOilUndHysDeacLvl2_P "Oil Temperature Under Level 2 Hysteresis Deactivation Parameter" VALUE 0x400514E0 /* @ECU_Address@WM_TOilUndHysDeacLvl2_P@ */ Scalar_FLOAT32_IEEE 0 EcuIntgdSwGend_CM_single_degC -40.0 250.0 /end CHARACTERISTIC
/begin CHARACTERISTIC WM_TOilUndHysDeacLvl3_P "Oil Temperature Under Level 3 Hysteresis Deactivation Parameter" VALUE 0x400514E4 /* @ECU_Address@WM_TOilUndHysDeacLvl3_P@ */ Scalar_FLOAT32_IEEE 0 EcuIntgdSwGend_CM_single_degC -40.0 250.0 /end CHARACTERISTIC
/begin CHARACTERISTIC WM_TiAcvWarnPRailNotCtldDeb_P "Rail Pressure Is Not Controlled Debouncer Activation Timer Parameter" VALUE 0x40051524 /* @ECU_Address@WM_TiAcvWarnPRailNotCtldDeb_P@ */ Scalar_FLOAT32_IEEE 0 EcuIntgdSwGend_CM_single_ms 0.0 25000.0 /end CHARACTERISTIC
/begin CHARACTERISTIC WM_TiPRailUndDebHi_P "Rail Pressure Under Debouncer High Time Parameter" VALUE 0x40051580 /* @ECU_Address@WM_TiPRailUndDebHi_P@ */ Scalar_FLOAT32_IEEE 0 EcuIntgdSwGend_CM_single_ms 0.0 25000.0 /end CHARACTERISTIC
/begin CHARACTERISTIC WM_TiPRailUndDebLo_P "Rail Pressure Under Debouncer Low Time Parameter" VALUE 0x40051584 /* @ECU_Address@WM_TiPRailUndDebLo_P@ */ Scalar_FLOAT32_IEEE 0 EcuIntgdSwGend_CM_single_ms 0.0 25000.0 /end CHARACTERISTIC
/begin CHARACTERISTIC WM_TiTAirBoostOvDebHi_P "Air Boost Temperature Over Debouncer High Time Parameter" VALUE 0x40051588 /* @ECU_Address@WM_TiTAirBoostOvDebHi_P@ */ Scalar_FLOAT32_IEEE 0 EcuIntgdSwGend_CM_single_ms 0.0 25000.0 /end CHARACTERISTIC
/begin CHARACTERISTIC WM_TiTAirBoostOvDebLo_P "Air Boost Temperature Over Debouncer Low Time Parameter" VALUE 0x4005158C /* @ECU_Address@WM_TiTAirBoostOvDebLo_P@ */ Scalar_FLOAT32_IEEE 0 EcuIntgdSwGend_CM_single_ms 0.0 25000.0 /end CHARACTERISTIC
/begin CHARACTERISTIC WM_TiTAirBoostUndDebHi_P "Air Boost Temperature Under Debouncer High Time Parameter" VALUE 0x40051590 /* @ECU_Address@WM_TiTAirBoostUndDebHi_P@ */ Scalar_FLOAT32_IEEE 0 EcuIntgdSwGend_CM_single_ms 0.0 25000.0 /end CHARACTERISTIC
/begin CHARACTERISTIC WM_TiTAirBoostUndDebLo_P "Air Boost Temperature Under Debouncer Low Time Parameter" VALUE 0x40051594 /* @ECU_Address@WM_TiTAirBoostUndDebLo_P@ */ Scalar_FLOAT32_IEEE 0 EcuIntgdSwGend_CM_single_ms 0.0 25000.0 /end CHARACTERISTIC
/begin CHARACTERISTIC WM_TiTAmbAirOvDebHi_P "Ambient Air Temperature Over Debouncer High Time Parameter" VALUE 0x40051598 /* @ECU_Address@WM_TiTAmbAirOvDebHi_P@ */ Scalar_FLOAT32_IEEE 0 EcuIntgdSwGend_CM_single_ms 0.0 25000.0 /end CHARACTERISTIC
/begin CHARACTERISTIC WM_TiTAmbAirOvDebLo_P "Ambient Air Temperature Over Debouncer Low Time Parameter" VALUE 0x4005159C /* @ECU_Address@WM_TiTAmbAirOvDebLo_P@ */ Scalar_FLOAT32_IEEE 0 EcuIntgdSwGend_CM_single_ms 0.0 25000.0 /end CHARACTERISTIC
/begin CHARACTERISTIC WM_TiTAmbAirUndDebHi_P "Ambient Air Temperature Under Debouncer High Time Parameter" VALUE 0x400515A0 /* @ECU_Address@WM_TiTAmbAirUndDebHi_P@ */ Scalar_FLOAT32_IEEE 0 EcuIntgdSwGend_CM_single_ms 0.0 25000.0 /end CHARACTERISTIC
/begin CHARACTERISTIC WM_TiTAmbAirUndDebLo_P "Ambient Air Temperature Under Debouncer Low Time Parameter" VALUE 0x400515A4 /* @ECU_Address@WM_TiTAmbAirUndDebLo_P@ */ Scalar_FLOAT32_IEEE 0 EcuIntgdSwGend_CM_single_ms 0.0 25000.0 /end CHARACTERISTIC
/begin CHARACTERISTIC WM_TiTCooltOvDebHi_P "Coolant Temperature Over Debouncer High Time Parameter" VALUE 0x400515A8 /* @ECU_Address@WM_TiTCooltOvDebHi_P@ */ Scalar_FLOAT32_IEEE 0 EcuIntgdSwGend_CM_single_ms 0.0 25000.0 /end CHARACTERISTIC
/begin CHARACTERISTIC WM_TiTCooltOvDebLo_P "Coolant Temperature Over Debouncer Low Time Parameter" VALUE 0x400515AC /* @ECU_Address@WM_TiTCooltOvDebLo_P@ */ Scalar_FLOAT32_IEEE 0 EcuIntgdSwGend_CM_single_ms 0.0 25000.0 /end CHARACTERISTIC
/begin CHARACTERISTIC WM_TiTCooltUndDebHi_P "Coolant Temperature Under Debouncer High Time Parameter" VALUE 0x400515B0 /* @ECU_Address@WM_TiTCooltUndDebHi_P@ */ Scalar_FLOAT32_IEEE 0 EcuIntgdSwGend_CM_single_ms 0.0 25000.0 /end CHARACTERISTIC
/begin CHARACTERISTIC WM_TiTCooltUndDebLo_P "Coolant Temperature Under Debouncer Low Time Parameter" VALUE 0x400515B4 /* @ECU_Address@WM_TiTCooltUndDebLo_P@ */ Scalar_FLOAT32_IEEE 0 EcuIntgdSwGend_CM_single_ms 0.0 25000.0 /end CHARACTERISTIC
/begin CHARACTERISTIC WM_TiTEcuDebHi_P "ECU Temperature Debouncer High Time Parameter" VALUE 0x400515B8 /* @ECU_Address@WM_TiTEcuDebHi_P@ */ Scalar_FLOAT32_IEEE 0 EcuIntgdSwGend_CM_single_ms 0.0 25000.0 /end CHARACTERISTIC
/begin CHARACTERISTIC WM_TiTEcuDebLo_P "ECU Temperature Debouncer Low Time Parameter" VALUE 0x400515BC /* @ECU_Address@WM_TiTEcuDebLo_P@ */ Scalar_FLOAT32_IEEE 0 EcuIntgdSwGend_CM_single_ms 0.0 25000.0 /end CHARACTERISTIC
/begin CHARACTERISTIC WM_TiTFuOvDebHi_P "Fuel Temperature Over Debouncer High Time Parameter" VALUE 0x400515C0 /* @ECU_Address@WM_TiTFuOvDebHi_P@ */ Scalar_FLOAT32_IEEE 0 EcuIntgdSwGend_CM_single_ms 0.0 25000.0 /end CHARACTERISTIC
/begin CHARACTERISTIC WM_TiTFuOvDebLo_P "Fuel Temperature Over Debouncer Low Time Parameter" VALUE 0x400515C4 /* @ECU_Address@WM_TiTFuOvDebLo_P@ */ Scalar_FLOAT32_IEEE 0 EcuIntgdSwGend_CM_single_ms 0.0 25000.0 /end CHARACTERISTIC
/begin CHARACTERISTIC WM_TiTOilOvDebHi_P "Oil Temperature Over Debouncer High Time Parameter" VALUE 0x400515C8 /* @ECU_Address@WM_TiTOilOvDebHi_P@ */ Scalar_FLOAT32_IEEE 0 EcuIntgdSwGend_CM_single_ms 0.0 25000.0 /end CHARACTERISTIC
/begin CHARACTERISTIC WM_TiTOilOvDebLo_P "Oil Temperature Over Debouncer Low Time Parameter" VALUE 0x400515CC /* @ECU_Address@WM_TiTOilOvDebLo_P@ */ Scalar_FLOAT32_IEEE 0 EcuIntgdSwGend_CM_single_ms 0.0 25000.0 /end CHARACTERISTIC
/begin CHARACTERISTIC WM_TiTOilUndDebHi_P "Oil Temperature Under Debouncer High Time Parameter" VALUE 0x400515D0 /* @ECU_Address@WM_TiTOilUndDebHi_P@ */ Scalar_FLOAT32_IEEE 0 EcuIntgdSwGend_CM_single_ms 0.0 25000.0 /end CHARACTERISTIC
/begin CHARACTERISTIC WM_TiTOilUndDebLo_P "Oil Temperature Under Debouncer Low Time Parameter" VALUE 0x400515D4 /* @ECU_Address@WM_TiTOilUndDebLo_P@ */ Scalar_FLOAT32_IEEE 0 EcuIntgdSwGend_CM_single_ms 0.0 25000.0 /end CHARACTERISTIC
/begin CHARACTERISTIC WM_MaskPRailUndEnaCond_P "Rail Pressure Under Global Enable Condition Parameter" VALUE 0x40050C7C /* @ECU_Address@WM_MaskPRailUndEnaCond_P@ */ Scalar_ULONG 0 EcuIntgdSwGend_CM_uint32 0.0 4.294967295E+9 /end CHARACTERISTIC
/begin CHARACTERISTIC WM_MaskRTNForErrComb1_P "Return To Normal Mask for Error Combo 1 Parameter" VALUE 0x40050C8C /* @ECU_Address@WM_MaskRTNForErrComb1_P@ */ Scalar_ULONG 0 EcuIntgdSwGend_CM_uint32 0.0 4.294967295E+9 /end CHARACTERISTIC
/begin CHARACTERISTIC WM_MaskRTNForErrComb2_P "Return To Normal Mask for Error Combo 2 Parameter" VALUE 0x40050C90 /* @ECU_Address@WM_MaskRTNForErrComb2_P@ */ Scalar_ULONG 0 EcuIntgdSwGend_CM_uint32 0.0 4.294967295E+9 /end CHARACTERISTIC
/begin CHARACTERISTIC WM_MaskRTNForErrComb3_P "Return To Normal Mask for Error Combo 3 Parameter" VALUE 0x40050C94 /* @ECU_Address@WM_MaskRTNForErrComb3_P@ */ Scalar_ULONG 0 EcuIntgdSwGend_CM_uint32 0.0 4.294967295E+9 /end CHARACTERISTIC
/begin CHARACTERISTIC WM_MaskRTNForErrComb4_P "Return To Normal Mask for Error Combo 4 Parameter" VALUE 0x40050C98 /* @ECU_Address@WM_MaskRTNForErrComb4_P@ */ Scalar_ULONG 0 EcuIntgdSwGend_CM_uint32 0.0 4.294967295E+9 /end CHARACTERISTIC
/begin CHARACTERISTIC WM_MaskRTNForErrComb5_P "Return To Normal Mask for Error Combo 5 Parameter" VALUE 0x40050C9C /* @ECU_Address@WM_MaskRTNForErrComb5_P@ */ Scalar_ULONG 0 EcuIntgdSwGend_CM_uint32 0.0 4.294967295E+9 /end CHARACTERISTIC
/begin CHARACTERISTIC WM_MaskRTNForErrPRailUnd_P "Return To Normal Mask for Rail Pressure Under Parameter" VALUE 0x40050CD0 /* @ECU_Address@WM_MaskRTNForErrPRailUnd_P@ */ Scalar_ULONG 0 EcuIntgdSwGend_CM_uint32 0.0 4.294967295E+9 /end CHARACTERISTIC
/begin CHARACTERISTIC WM_MaskRTNForErrTAirBoostOv_P "Return To Normal Mask for Air Boost Temperature Over Parameter" VALUE 0x40050CD4 /* @ECU_Address@WM_MaskRTNForErrTAirBoostOv_P@ */ Scalar_ULONG 0 EcuIntgdSwGend_CM_uint32 0.0 4.294967295E+9 /end CHARACTERISTIC
/begin CHARACTERISTIC WM_MaskRTNForErrTAirBoostUnd_P "Return To Normal Mask for Air Boost Temperature Under Parameter" VALUE 0x40050CD8 /* @ECU_Address@WM_MaskRTNForErrTAirBoostUnd_P@ */ Scalar_ULONG 0 EcuIntgdSwGend_CM_uint32 0.0 4.294967295E+9 /end CHARACTERISTIC
/begin CHARACTERISTIC WM_MaskRTNForErrTAmbAirOv_P "Return To Normal Mask for Ambient Air Temperature Over Parameter" VALUE 0x40050CDC /* @ECU_Address@WM_MaskRTNForErrTAmbAirOv_P@ */ Scalar_ULONG 0 EcuIntgdSwGend_CM_uint32 0.0 4.294967295E+9 /end CHARACTERISTIC
/begin CHARACTERISTIC WM_MaskRTNForErrTAmbAirUnd_P "Return To Normal Mask for Ambient Air Temperature Under Parameter" VALUE 0x40050CE0 /* @ECU_Address@WM_MaskRTNForErrTAmbAirUnd_P@ */ Scalar_ULONG 0 EcuIntgdSwGend_CM_uint32 0.0 4.294967295E+9 /end CHARACTERISTIC
/begin CHARACTERISTIC WM_MaskRTNForErrTCooltOv_P "Return To Normal Mask for Coolant Temperature Over Parameter" VALUE 0x40050CE4 /* @ECU_Address@WM_MaskRTNForErrTCooltOv_P@ */ Scalar_ULONG 0 EcuIntgdSwGend_CM_uint32 0.0 4.294967295E+9 /end CHARACTERISTIC
/begin CHARACTERISTIC WM_MaskRTNForErrTCooltUnd_P "Return To Normal Mask for Coolant Temperature Under Parameter" VALUE 0x40050CE8 /* @ECU_Address@WM_MaskRTNForErrTCooltUnd_P@ */ Scalar_ULONG 0 EcuIntgdSwGend_CM_uint32 0.0 4.294967295E+9 /end CHARACTERISTIC
/begin CHARACTERISTIC WM_MaskRTNForErrTEcu_P "Return To Normal Mask for ECU Temperature Parameter" VALUE 0x40050CEC /* @ECU_Address@WM_MaskRTNForErrTEcu_P@ */ Scalar_ULONG 0 EcuIntgdSwGend_CM_uint32 0.0 4.294967295E+9 /end CHARACTERISTIC
/begin CHARACTERISTIC WM_MaskRTNForErrTFuOv_P "Return To Normal Mask for Fuel Temperature Over Parameter" VALUE 0x40050CF0 /* @ECU_Address@WM_MaskRTNForErrTFuOv_P@ */ Scalar_ULONG 0 EcuIntgdSwGend_CM_uint32 0.0 4.294967295E+9 /end CHARACTERISTIC
/begin CHARACTERISTIC WM_MaskRTNForErrTOilOv_P "Return To Normal Mask for Fuel Temperature Under Parameter" VALUE 0x40050CF4 /* @ECU_Address@WM_MaskRTNForErrTOilOv_P@ */ Scalar_ULONG 0 EcuIntgdSwGend_CM_uint32 0.0 4.294967295E+9 /end CHARACTERISTIC
/begin CHARACTERISTIC WM_MaskRTNForErrTOilUnd_P "Return To Normal Mask for Oil Temperature Under Parameter" VALUE 0x40050CF8 /* @ECU_Address@WM_MaskRTNForErrTOilUnd_P@ */ Scalar_ULONG 0 EcuIntgdSwGend_CM_uint32 0.0 4.294967295E+9 /end CHARACTERISTIC
/begin CHARACTERISTIC WM_MaskRctnForErrComb1_P "Mask Reaction for Error Combo 1 Parameter" VALUE 0x40050D20 /* @ECU_Address@WM_MaskRctnForErrComb1_P@ */ Scalar_ULONG 0 EcuIntgdSwGend_CM_uint32 0.0 4.294967295E+9 /end CHARACTERISTIC
/begin CHARACTERISTIC WM_MaskRctnForErrComb2_P "Mask Reaction for Error Combo 2 Parameter" VALUE 0x40050D24 /* @ECU_Address@WM_MaskRctnForErrComb2_P@ */ Scalar_ULONG 0 EcuIntgdSwGend_CM_uint32 0.0 4.294967295E+9 /end CHARACTERISTIC
/begin CHARACTERISTIC WM_MaskRctnForErrComb3_P "Mask Reaction for Error Combo 3 Parameter" VALUE 0x40050D28 /* @ECU_Address@WM_MaskRctnForErrComb3_P@ */ Scalar_ULONG 0 EcuIntgdSwGend_CM_uint32 0.0 4.294967295E+9 /end CHARACTERISTIC
/begin CHARACTERISTIC WM_MaskRctnForErrComb4_P "Mask Reaction for Error Combo 4 Parameter" VALUE 0x40050D2C /* @ECU_Address@WM_MaskRctnForErrComb4_P@ */ Scalar_ULONG 0 EcuIntgdSwGend_CM_uint32 0.0 4.294967295E+9 /end CHARACTERISTIC
/begin CHARACTERISTIC WM_MaskRctnForErrComb5_P "Mask Reaction for Error Combo 5 Parameter" VALUE 0x40050D30 /* @ECU_Address@WM_MaskRctnForErrComb5_P@ */ Scalar_ULONG 0 EcuIntgdSwGend_CM_uint32 0.0 4.294967295E+9 /end CHARACTERISTIC
/begin CHARACTERISTIC WM_MaskRctnForPRailUndLvl1Err_P "Mask Reaction for Rail Pressure Under Level 1 Error Parameter" VALUE 0x40050DC4 /* @ECU_Address@WM_MaskRctnForPRailUndLvl1Err_P@ */ Scalar_ULONG 0 EcuIntgdSwGend_CM_uint32 0.0 4.294967295E+9 /end CHARACTERISTIC
/begin CHARACTERISTIC WM_MaskRctnForPRailUndLvl2Err_P "Mask Reaction for Rail Pressure Under Level 2 Error Parameter" VALUE 0x40050DC8 /* @ECU_Address@WM_MaskRctnForPRailUndLvl2Err_P@ */ Scalar_ULONG 0 EcuIntgdSwGend_CM_uint32 0.0 4.294967295E+9 /end CHARACTERISTIC
/begin CHARACTERISTIC WM_MaskRctnForPRailUndLvl3Err_P "Mask Reaction for Rail Pressure Under Level 3 Error Parameter" VALUE 0x40050DCC /* @ECU_Address@WM_MaskRctnForPRailUndLvl3Err_P@ */ Scalar_ULONG 0 EcuIntgdSwGend_CM_uint32 0.0 4.294967295E+9 /end CHARACTERISTIC
/begin CHARACTERISTIC WM_MaskRctnForTAirBoostOvLvl1Err_P "Mask Reaction for Air Boost Temperature Over Level 1 Error Parameter" VALUE 0x40050DD0 /* @ECU_Address@WM_MaskRctnForTAirBoostOvLvl1Err_P@ */ Scalar_ULONG 0 EcuIntgdSwGend_CM_uint32 0.0 4.294967295E+9 /end CHARACTERISTIC
/begin CHARACTERISTIC WM_MaskRctnForTAirBoostOvLvl2Err_P "Mask Reaction for Air Boost Temperature Over Level 2 Error Parameter" VALUE 0x40050DD4 /* @ECU_Address@WM_MaskRctnForTAirBoostOvLvl2Err_P@ */ Scalar_ULONG 0 EcuIntgdSwGend_CM_uint32 0.0 4.294967295E+9 /end CHARACTERISTIC
/begin CHARACTERISTIC WM_MaskRctnForTAirBoostOvLvl3Err_P "Mask Reaction for Air Boost Temperature Over Level 3 Error Parameter" VALUE 0x40050DD8 /* @ECU_Address@WM_MaskRctnForTAirBoostOvLvl3Err_P@ */ Scalar_ULONG 0 EcuIntgdSwGend_CM_uint32 0.0 4.294967295E+9 /end CHARACTERISTIC
/begin CHARACTERISTIC WM_MaskRctnForTAirBoostUndLvl1Err_P "Mask Reaction for Air Boost Temperature Under Level 1 Error Parameter" VALUE 0x40050DDC /* @ECU_Address@WM_MaskRctnForTAirBoostUndLvl1Err_P@ */ Scalar_ULONG 0 EcuIntgdSwGend_CM_uint32 0.0 4.294967295E+9 /end CHARACTERISTIC
/begin CHARACTERISTIC WM_MaskRctnForTAirBoostUndLvl2Err_P "Mask Reaction for Air Boost Temperature Under Level 2 Error Parameter" VALUE 0x40050DE0 /* @ECU_Address@WM_MaskRctnForTAirBoostUndLvl2Err_P@ */ Scalar_ULONG 0 EcuIntgdSwGend_CM_uint32 0.0 4.294967295E+9 /end CHARACTERISTIC
/begin CHARACTERISTIC WM_MaskRctnForTAirBoostUndLvl3Err_P "Mask Reaction for Air Boost Temperature Under Level 3 Error Parameter" VALUE 0x40050DE4 /* @ECU_Address@WM_MaskRctnForTAirBoostUndLvl3Err_P@ */ Scalar_ULONG 0 EcuIntgdSwGend_CM_uint32 0.0 4.294967295E+9 /end CHARACTERISTIC
/begin CHARACTERISTIC WM_MaskRctnForTAmbAirOvLvl1Err_P "Mask Reaction for Ambient Air Temperature Over Level 1 Error Parameter" VALUE 0x40050DE8 /* @ECU_Address@WM_MaskRctnForTAmbAirOvLvl1Err_P@ */ Scalar_ULONG 0 EcuIntgdSwGend_CM_uint32 0.0 4.294967295E+9 /end CHARACTERISTIC
/begin CHARACTERISTIC WM_MaskRctnForTAmbAirOvLvl2Err_P "Mask Reaction for Ambient Air Temperature Over Level 2 Error Parameter" VALUE 0x40050DEC /* @ECU_Address@WM_MaskRctnForTAmbAirOvLvl2Err_P@ */ Scalar_ULONG 0 EcuIntgdSwGend_CM_uint32 0.0 4.294967295E+9 /end CHARACTERISTIC
/begin CHARACTERISTIC WM_MaskRctnForTAmbAirOvLvl3Err_P "Mask Reaction for Ambient Air Temperature Over Level 3 Error Parameter" VALUE 0x40050DF0 /* @ECU_Address@WM_MaskRctnForTAmbAirOvLvl3Err_P@ */ Scalar_ULONG 0 EcuIntgdSwGend_CM_uint32 0.0 4.294967295E+9 /end CHARACTERISTIC
/begin CHARACTERISTIC WM_MaskRctnForTAmbAirUndLvl1Err_P "Mask Reaction for Ambient Air Temperature Under Level 1 Error Parameter" VALUE 0x40050DF4 /* @ECU_Address@WM_MaskRctnForTAmbAirUndLvl1Err_P@ */ Scalar_ULONG 0 EcuIntgdSwGend_CM_uint32 0.0 4.294967295E+9 /end CHARACTERISTIC
/begin CHARACTERISTIC WM_MaskRctnForTAmbAirUndLvl2Err_P "Mask Reaction for Ambient Air Temperature Under Level 2 Error Parameter" VALUE 0x40050DF8 /* @ECU_Address@WM_MaskRctnForTAmbAirUndLvl2Err_P@ */ Scalar_ULONG 0 EcuIntgdSwGend_CM_uint32 0.0 4.294967295E+9 /end CHARACTERISTIC
/begin CHARACTERISTIC WM_MaskRctnForTAmbAirUndLvl3Err_P "Mask Reaction for Ambient Air Temperature Under Level 3 Error Parameter" VALUE 0x40050DFC /* @ECU_Address@WM_MaskRctnForTAmbAirUndLvl3Err_P@ */ Scalar_ULONG 0 EcuIntgdSwGend_CM_uint32 0.0 4.294967295E+9 /end CHARACTERISTIC
/begin CHARACTERISTIC WM_MaskRctnForTCooltOvLvl1Err_P "Mask Reaction for Coolant Temperature Over Level 1 Error Parameter" VALUE 0x40050E00 /* @ECU_Address@WM_MaskRctnForTCooltOvLvl1Err_P@ */ Scalar_ULONG 0 EcuIntgdSwGend_CM_uint32 0.0 4.294967295E+9 /end CHARACTERISTIC
/begin CHARACTERISTIC WM_MaskRctnForTCooltOvLvl2Err_P "Mask Reaction for Coolant Temperature Over Level 2 Error Parameter" VALUE 0x40050E04 /* @ECU_Address@WM_MaskRctnForTCooltOvLvl2Err_P@ */ Scalar_ULONG 0 EcuIntgdSwGend_CM_uint32 0.0 4.294967295E+9 /end CHARACTERISTIC
/begin CHARACTERISTIC WM_MaskRctnForTCooltOvLvl3Err_P "Mask Reaction for Coolant Temperature Over Level 3 Error Parameter" VALUE 0x40050E08 /* @ECU_Address@WM_MaskRctnForTCooltOvLvl3Err_P@ */ Scalar_ULONG 0 EcuIntgdSwGend_CM_uint32 0.0 4.294967295E+9 /end CHARACTERISTIC
/begin CHARACTERISTIC WM_MaskRctnForTCooltUndLvl1Err_P "Mask Reaction for Coolant Temperature Under Level 1 Error Parameter" VALUE 0x40050E0C /* @ECU_Address@WM_MaskRctnForTCooltUndLvl1Err_P@ */ Scalar_ULONG 0 EcuIntgdSwGend_CM_uint32 0.0 4.294967295E+9 /end CHARACTERISTIC
/begin CHARACTERISTIC WM_MaskRctnForTCooltUndLvl2Err_P "Mask Reaction for Coolant Temperature Under Level 2 Error Parameter" VALUE 0x40050E10 /* @ECU_Address@WM_MaskRctnForTCooltUndLvl2Err_P@ */ Scalar_ULONG 0 EcuIntgdSwGend_CM_uint32 0.0 4.294967295E+9 /end CHARACTERISTIC
/begin CHARACTERISTIC WM_MaskRctnForTCooltUndLvl3Err_P "Mask Reaction for Coolant Temperature Under Level 3 Error Parameter" VALUE 0x40050E14 /* @ECU_Address@WM_MaskRctnForTCooltUndLvl3Err_P@ */ Scalar_ULONG 0 EcuIntgdSwGend_CM_uint32 0.0 4.294967295E+9 /end CHARACTERISTIC
/begin CHARACTERISTIC WM_MaskRctnForTEcuLvl1Err_P "Mask Reaction for ECU Temperature Level 1 Error Parameter" VALUE 0x40050E18 /* @ECU_Address@WM_MaskRctnForTEcuLvl1Err_P@ */ Scalar_ULONG 0 EcuIntgdSwGend_CM_uint32 0.0 4.294967295E+9 /end CHARACTERISTIC
/begin CHARACTERISTIC WM_MaskRctnForTEcuLvl2Err_P "Mask Reaction for ECU Temperature Level 2 Error Parameter" VALUE 0x40050E1C /* @ECU_Address@WM_MaskRctnForTEcuLvl2Err_P@ */ Scalar_ULONG 0 EcuIntgdSwGend_CM_uint32 0.0 4.294967295E+9 /end CHARACTERISTIC
/begin CHARACTERISTIC WM_MaskRctnForTEcuLvl3Err_P "Mask Reaction for ECU Temperature Level 3 Error Parameter" VALUE 0x40050E20 /* @ECU_Address@WM_MaskRctnForTEcuLvl3Err_P@ */ Scalar_ULONG 0 EcuIntgdSwGend_CM_uint32 0.0 4.294967295E+9 /end CHARACTERISTIC
/begin CHARACTERISTIC WM_MaskRctnForTFuOvLvl1Err_P "Mask Reaction for Fuel Temperature Over Level 1 Error Parameter" VALUE 0x40050E24 /* @ECU_Address@WM_MaskRctnForTFuOvLvl1Err_P@ */ Scalar_ULONG 0 EcuIntgdSwGend_CM_uint32 0.0 4.294967295E+9 /end CHARACTERISTIC
/begin CHARACTERISTIC WM_MaskRctnForTFuOvLvl2Err_P "Mask Reaction for Fuel Temperature Over Level 2 Error Parameter" VALUE 0x40050E28 /* @ECU_Address@WM_MaskRctnForTFuOvLvl2Err_P@ */ Scalar_ULONG 0 EcuIntgdSwGend_CM_uint32 0.0 4.294967295E+9 /end CHARACTERISTIC
/begin CHARACTERISTIC WM_MaskRctnForTFuOvLvl3Err_P "Mask Reaction for Fuel Temperature Over Level 3 Error Parameter" VALUE 0x40050E2C /* @ECU_Address@WM_MaskRctnForTFuOvLvl3Err_P@ */ Scalar_ULONG 0 EcuIntgdSwGend_CM_uint32 0.0 4.294967295E+9 /end CHARACTERISTIC
/begin CHARACTERISTIC WM_MaskRctnForTOilOvLvl1Err_P "Mask Reaction for Oil Temperature Over Level 1 Error Parameter" VALUE 0x40050E30 /* @ECU_Address@WM_MaskRctnForTOilOvLvl1Err_P@ */ Scalar_ULONG 0 EcuIntgdSwGend_CM_uint32 0.0 4.294967295E+9 /end CHARACTERISTIC
/begin CHARACTERISTIC WM_MaskRctnForTOilOvLvl2Err_P "Mask Reaction for Oil Temperature Over Level 2 Error Parameter" VALUE 0x40050E34 /* @ECU_Address@WM_MaskRctnForTOilOvLvl2Err_P@ */ Scalar_ULONG 0 EcuIntgdSwGend_CM_uint32 0.0 4.294967295E+9 /end CHARACTERISTIC
/begin CHARACTERISTIC WM_MaskRctnForTOilOvLvl3Err_P "Mask Reaction for Oil Temperature Over Level 3 Error Parameter" VALUE 0x40050E38 /* @ECU_Address@WM_MaskRctnForTOilOvLvl3Err_P@ */ Scalar_ULONG 0 EcuIntgdSwGend_CM_uint32 0.0 4.294967295E+9 /end CHARACTERISTIC
/begin CHARACTERISTIC WM_MaskRctnForTOilUndLvl1Err_P "Mask Reaction for Oil Temperature Under Level 1 Error Parameter" VALUE 0x40050E3C /* @ECU_Address@WM_MaskRctnForTOilUndLvl1Err_P@ */ Scalar_ULONG 0 EcuIntgdSwGend_CM_uint32 0.0 4.294967295E+9 /end CHARACTERISTIC
/begin CHARACTERISTIC WM_MaskRctnForTOilUndLvl2Err_P "Mask Reaction for Oil Temperature Under Level 2 Error Parameter" VALUE 0x40050E40 /* @ECU_Address@WM_MaskRctnForTOilUndLvl2Err_P@ */ Scalar_ULONG 0 EcuIntgdSwGend_CM_uint32 0.0 4.294967295E+9 /end CHARACTERISTIC
/begin CHARACTERISTIC WM_MaskRctnForTOilUndLvl3Err_P "Mask Reaction for Oil Temperature Under Level 3 Error Parameter" VALUE 0x40050E44 /* @ECU_Address@WM_MaskRctnForTOilUndLvl3Err_P@ */ Scalar_ULONG 0 EcuIntgdSwGend_CM_uint32 0.0 4.294967295E+9 /end CHARACTERISTIC
/begin CHARACTERISTIC WM_MaskTAirBoostOvEnaCond_P "Air Boost Temperature Over Global Enable Condition Parameter" VALUE 0x40050E68 /* @ECU_Address@WM_MaskTAirBoostOvEnaCond_P@ */ Scalar_ULONG 0 EcuIntgdSwGend_CM_uint32 0.0 4.294967295E+9 /end CHARACTERISTIC
/begin CHARACTERISTIC WM_MaskTAirBoostUndEnaCond_P "Air Boost Temperature Under Global Enable Condition Parameter" VALUE 0x40050E6C /* @ECU_Address@WM_MaskTAirBoostUndEnaCond_P@ */ Scalar_ULONG 0 EcuIntgdSwGend_CM_uint32 0.0 4.294967295E+9 /end CHARACTERISTIC
/begin CHARACTERISTIC WM_MaskTAmbAirOvEnaCond_P "Ambient Air Temperature Over Global Enable Condition Parameter" VALUE 0x40050E70 /* @ECU_Address@WM_MaskTAmbAirOvEnaCond_P@ */ Scalar_ULONG 0 EcuIntgdSwGend_CM_uint32 0.0 4.294967295E+9 /end CHARACTERISTIC
/begin CHARACTERISTIC WM_MaskTAmbAirUndEnaCond_P "Ambient Air Temperature Under Global Enable Condition Parameter" VALUE 0x40050E74 /* @ECU_Address@WM_MaskTAmbAirUndEnaCond_P@ */ Scalar_ULONG 0 EcuIntgdSwGend_CM_uint32 0.0 4.294967295E+9 /end CHARACTERISTIC
/begin CHARACTERISTIC WM_MaskTC1ErrComb1_P "Mask Error List 1 for Error Combo 1 Parameter" VALUE 0x40050E78 /* @ECU_Address@WM_MaskTC1ErrComb1_P@ */ Scalar_ULONG 0 EcuIntgdSwGend_CM_uint32 0.0 4.294967295E+9 /end CHARACTERISTIC
/begin CHARACTERISTIC WM_MaskTC1ErrComb2_P "Mask Error List 1 for Error Combo 2 Parameter" VALUE 0x40050E7C /* @ECU_Address@WM_MaskTC1ErrComb2_P@ */ Scalar_ULONG 0 EcuIntgdSwGend_CM_uint32 0.0 4.294967295E+9 /end CHARACTERISTIC
/begin CHARACTERISTIC WM_MaskTC1ErrComb3_P "Mask Error List 1 for Error Combo 3 Parameter" VALUE 0x40050E80 /* @ECU_Address@WM_MaskTC1ErrComb3_P@ */ Scalar_ULONG 0 EcuIntgdSwGend_CM_uint32 0.0 4.294967295E+9 /end CHARACTERISTIC
/begin CHARACTERISTIC WM_MaskTC1ErrComb4_P "Mask Error List 1 for Error Combo 4 Parameter" VALUE 0x40050E84 /* @ECU_Address@WM_MaskTC1ErrComb4_P@ */ Scalar_ULONG 0 EcuIntgdSwGend_CM_uint32 0.0 4.294967295E+9 /end CHARACTERISTIC
/begin CHARACTERISTIC WM_MaskTC1ErrComb5_P "Mask Error List 1 for Error Combo 5 Parameter" VALUE 0x40050E88 /* @ECU_Address@WM_MaskTC1ErrComb5_P@ */ Scalar_ULONG 0 EcuIntgdSwGend_CM_uint32 0.0 4.294967295E+9 /end CHARACTERISTIC
/begin CHARACTERISTIC WM_MaskTC1Ovv_P "Mask Error List 1 - Override Parameter" VALUE 0x40050E90 /* @ECU_Address@WM_MaskTC1Ovv_P@ */ Scalar_ULONG 0 EcuIntgdSwGend_CM_uint32 0.0 4.294967295E+9 /end CHARACTERISTIC
/begin CHARACTERISTIC WM_MaskTC2ErrComb1_P "Mask Error List 2 for Error Combo 1 Parameter" VALUE 0x40050E94 /* @ECU_Address@WM_MaskTC2ErrComb1_P@ */ Scalar_ULONG 0 EcuIntgdSwGend_CM_uint32 0.0 4.294967295E+9 /end CHARACTERISTIC
/begin CHARACTERISTIC WM_MaskTC2ErrComb2_P "Mask Error List 2 for Error Combo 2 Parameter" VALUE 0x40050E98 /* @ECU_Address@WM_MaskTC2ErrComb2_P@ */ Scalar_ULONG 0 EcuIntgdSwGend_CM_uint32 0.0 4.294967295E+9 /end CHARACTERISTIC
/begin CHARACTERISTIC WM_MaskTC2ErrComb3_P "Mask Error List 2 for Error Combo 3 Parameter" VALUE 0x40050E9C /* @ECU_Address@WM_MaskTC2ErrComb3_P@ */ Scalar_ULONG 0 EcuIntgdSwGend_CM_uint32 0.0 4.294967295E+9 /end CHARACTERISTIC
/begin CHARACTERISTIC WM_MaskTC2ErrComb4_P "Mask Error List 2 for Error Combo 4 Parameter" VALUE 0x40050EA0 /* @ECU_Address@WM_MaskTC2ErrComb4_P@ */ Scalar_ULONG 0 EcuIntgdSwGend_CM_uint32 0.0 4.294967295E+9 /end CHARACTERISTIC
/begin CHARACTERISTIC WM_MaskTC2ErrComb5_P "Mask Error List 2 for Error Combo 5 Parameter" VALUE 0x40050EA4 /* @ECU_Address@WM_MaskTC2ErrComb5_P@ */ Scalar_ULONG 0 EcuIntgdSwGend_CM_uint32 0.0 4.294967295E+9 /end CHARACTERISTIC
/begin CHARACTERISTIC WM_MaskTC2Ovv_P "Mask Error List 2 - Override Parameter" VALUE 0x40050EAC /* @ECU_Address@WM_MaskTC2Ovv_P@ */ Scalar_ULONG 0 EcuIntgdSwGend_CM_uint32 0.0 4.294967295E+9 /end CHARACTERISTIC
/begin CHARACTERISTIC WM_MaskTC3ErrComb1_P "Mask Error List 3 for Error Combo 1 Parameter" VALUE 0x40050EB0 /* @ECU_Address@WM_MaskTC3ErrComb1_P@ */ Scalar_ULONG 0 EcuIntgdSwGend_CM_uint32 0.0 4.294967295E+9 /end CHARACTERISTIC
/begin CHARACTERISTIC WM_MaskTC3ErrComb2_P "Mask Error List 3 for Error Combo 2 Parameter" VALUE 0x40050EB4 /* @ECU_Address@WM_MaskTC3ErrComb2_P@ */ Scalar_ULONG 0 EcuIntgdSwGend_CM_uint32 0.0 4.294967295E+9 /end CHARACTERISTIC
/begin CHARACTERISTIC WM_MaskTC3ErrComb3_P "Mask Error List 3 for Error Combo 3 Parameter" VALUE 0x40050EB8 /* @ECU_Address@WM_MaskTC3ErrComb3_P@ */ Scalar_ULONG 0 EcuIntgdSwGend_CM_uint32 0.0 4.294967295E+9 /end CHARACTERISTIC
/begin CHARACTERISTIC WM_MaskTC3ErrComb4_P "Mask Error List 3 for Error Combo 4 Parameter" VALUE 0x40050EBC /* @ECU_Address@WM_MaskTC3ErrComb4_P@ */ Scalar_ULONG 0 EcuIntgdSwGend_CM_uint32 0.0 4.294967295E+9 /end CHARACTERISTIC
/begin CHARACTERISTIC WM_MaskTC3ErrComb5_P "Mask Error List 3 for Error Combo 5 Parameter" VALUE 0x40050EC0 /* @ECU_Address@WM_MaskTC3ErrComb5_P@ */ Scalar_ULONG 0 EcuIntgdSwGend_CM_uint32 0.0 4.294967295E+9 /end CHARACTERISTIC
/begin CHARACTERISTIC WM_MaskTC3Ovv_P "Mask Error List 3 - Override Parameter" VALUE 0x40050EC8 /* @ECU_Address@WM_MaskTC3Ovv_P@ */ Scalar_ULONG 0 EcuIntgdSwGend_CM_uint32 0.0 4.294967295E+9 /end CHARACTERISTIC
/begin CHARACTERISTIC WM_MaskTC4ErrComb1_P "Mask Error List 4 for Error Combo 1 Parameter" VALUE 0x40050ECC /* @ECU_Address@WM_MaskTC4ErrComb1_P@ */ Scalar_ULONG 0 EcuIntgdSwGend_CM_uint32 0.0 4.294967295E+9 /end CHARACTERISTIC
/begin CHARACTERISTIC WM_MaskTC4ErrComb2_P "Mask Error List 4 for Error Combo 2 Parameter" VALUE 0x40050ED0 /* @ECU_Address@WM_MaskTC4ErrComb2_P@ */ Scalar_ULONG 0 EcuIntgdSwGend_CM_uint32 0.0 4.294967295E+9 /end CHARACTERISTIC
/begin CHARACTERISTIC WM_MaskTC4ErrComb3_P "Mask Error List 4 for Error Combo 3 Parameter" VALUE 0x40050ED4 /* @ECU_Address@WM_MaskTC4ErrComb3_P@ */ Scalar_ULONG 0 EcuIntgdSwGend_CM_uint32 0.0 4.294967295E+9 /end CHARACTERISTIC
/begin CHARACTERISTIC WM_MaskTC4ErrComb4_P "Mask Error List 4 for Error Combo 4 Parameter" VALUE 0x40050ED8 /* @ECU_Address@WM_MaskTC4ErrComb4_P@ */ Scalar_ULONG 0 EcuIntgdSwGend_CM_uint32 0.0 4.294967295E+9 /end CHARACTERISTIC
/begin CHARACTERISTIC WM_MaskTC4ErrComb5_P "Mask Error List 4 for Error Combo 5 Parameter" VALUE 0x40050EDC /* @ECU_Address@WM_MaskTC4ErrComb5_P@ */ Scalar_ULONG 0 EcuIntgdSwGend_CM_uint32 0.0 4.294967295E+9 /end CHARACTERISTIC
/begin CHARACTERISTIC WM_MaskTC4Ovv_P "Mask Error List 4 - Override Parameter" VALUE 0x40050EE4 /* @ECU_Address@WM_MaskTC4Ovv_P@ */ Scalar_ULONG 0 EcuIntgdSwGend_CM_uint32 0.0 4.294967295E+9 /end CHARACTERISTIC
/begin CHARACTERISTIC WM_MaskTCooltOvEnaCond_P "Coolant Temperature Over Global Enable Condition Parameter" VALUE 0x40050EE8 /* @ECU_Address@WM_MaskTCooltOvEnaCond_P@ */ Scalar_ULONG 0 EcuIntgdSwGend_CM_uint32 0.0 4.294967295E+9 /end CHARACTERISTIC
/begin CHARACTERISTIC WM_MaskTCooltUndEnaCond_P "Coolant Temperature Under Global Enable Condition Parameter" VALUE 0x40050EEC /* @ECU_Address@WM_MaskTCooltUndEnaCond_P@ */ Scalar_ULONG 0 EcuIntgdSwGend_CM_uint32 0.0 4.294967295E+9 /end CHARACTERISTIC
/begin CHARACTERISTIC WM_MaskTEcuEnaCond_P "ECU Temperature Global Enable Condition Parameter" VALUE 0x40050EF0 /* @ECU_Address@WM_MaskTEcuEnaCond_P@ */ Scalar_ULONG 0 EcuIntgdSwGend_CM_uint32 0.0 4.294967295E+9 /end CHARACTERISTIC
/begin CHARACTERISTIC WM_MaskTFuOvEnaCond_P "Fuel Temperature Over Global Enable Condition Parameter" VALUE 0x40050EF4 /* @ECU_Address@WM_MaskTFuOvEnaCond_P@ */ Scalar_ULONG 0 EcuIntgdSwGend_CM_uint32 0.0 4.294967295E+9 /end CHARACTERISTIC
/begin CHARACTERISTIC WM_MaskTOilOvEnaCond_P "Oil Temperature Under Global Enable Condition Parameter" VALUE 0x40050EF8 /* @ECU_Address@WM_MaskTOilOvEnaCond_P@ */ Scalar_ULONG 0 EcuIntgdSwGend_CM_uint32 0.0 4.294967295E+9 /end CHARACTERISTIC
/begin CHARACTERISTIC WM_MaskTOilUndEnaCond_P "Oil Temperature Over Global Enable Condition Parameter" VALUE 0x40050EFC /* @ECU_Address@WM_MaskTOilUndEnaCond_P@ */ Scalar_ULONG 0 EcuIntgdSwGend_CM_uint32 0.0 4.294967295E+9 /end CHARACTERISTIC
/begin CHARACTERISTIC DTqC_AcvHardLimLtchOvs_P "Engine Speed Hard Limit Latch Activation Override Switch" VALUE 0x40040738 /* @ECU_Address@DTqC_AcvHardLimLtchOvs_P@ */ Scalar_BOOLEAN 0 EcuIntgdSwGend_CM_boolean 0.0 1.0 /end CHARACTERISTIC
/begin CHARACTERISTIC DTqC_AcvHardLimLtchOvv_P "Engine Speed Hard Limit Latch Activation Override Value" VALUE 0x4004073C /* @ECU_Address@DTqC_AcvHardLimLtchOvv_P@ */ Scalar_BOOLEAN 0 EcuIntgdSwGend_CM_boolean 0.0 1.0 /end CHARACTERISTIC
/begin CHARACTERISTIC DTqC_IdleIntglRstEnaSwt_P "Idle Speed Controller Integral Reset Enable" VALUE 0x40041A8C /* @ECU_Address@DTqC_IdleIntglRstEnaSwt_P@ */ Scalar_BOOLEAN 0 EcuIntgdSwGend_CM_boolean 0.0 1.0 /end CHARACTERISTIC
/begin CHARACTERISTIC DTqC_bAcvRateLimOvs_P "Rate Limiter Activation Override Switch" VALUE 0x40044054 /* @ECU_Address@DTqC_bAcvRateLimOvs_P@ */ Scalar_BOOLEAN 0 EcuIntgdSwGend_CM_boolean 0.0 1.0 /end CHARACTERISTIC
/begin CHARACTERISTIC WM_MaskTC1Ovs_P "Mask Error List 1 - Override Switch" VALUE 0x40050E8C /* @ECU_Address@WM_MaskTC1Ovs_P@ */ Scalar_BOOLEAN 0 EcuIntgdSwGend_CM_boolean 0.0 1.0 /end CHARACTERISTIC
/begin CHARACTERISTIC WM_MaskTC2Ovs_P "Mask Error List 2 - Override Switch" VALUE 0x40050EA8 /* @ECU_Address@WM_MaskTC2Ovs_P@ */ Scalar_BOOLEAN 0 EcuIntgdSwGend_CM_boolean 0.0 1.0 /end CHARACTERISTIC
/begin CHARACTERISTIC WM_MaskTC3Ovs_P "Mask Error List 3 - Override Switch" VALUE 0x40050EC4 /* @ECU_Address@WM_MaskTC3Ovs_P@ */ Scalar_BOOLEAN 0 EcuIntgdSwGend_CM_boolean 0.0 1.0 /end CHARACTERISTIC
/begin CHARACTERISTIC WM_MaskTC4Ovs_P "Mask Error List 4 - Override Switch" VALUE 0x40050EE0 /* @ECU_Address@WM_MaskTC4Ovs_P@ */ Scalar_BOOLEAN 0 EcuIntgdSwGend_CM_boolean 0.0 1.0 /end CHARACTERISTIC
/begin CHARACTERISTIC WM_SteadyFlgEnaForPRailNotCtld_P "Engine Steady Flag Enable For Rail Pressure Not Controlled Message" VALUE 0x40051258 /* @ECU_Address@WM_SteadyFlgEnaForPRailNotCtld_P@ */ Scalar_BOOLEAN 0 EcuIntgdSwGend_CM_boolean 0.0 1.0 /end CHARACTERISTIC
/begin CHARACTERISTIC WM_bPRailNotCtldMsgWarnOvs_P "Rail Pressure Is Not Controlled Message - Override Switch" VALUE 0x400516B4 /* @ECU_Address@WM_bPRailNotCtldMsgWarnOvs_P@ */ Scalar_BOOLEAN 0 EcuIntgdSwGend_CM_boolean 0.0 1.0 /end CHARACTERISTIC
/begin CHARACTERISTIC WM_bPRailNotCtldMsgWarnOvv_P "Rail Pressure Is Not Controlled Message - Override Parameter" VALUE 0x400516B8 /* @ECU_Address@WM_bPRailNotCtldMsgWarnOvv_P@ */ Scalar_BOOLEAN 0 EcuIntgdSwGend_CM_boolean 0.0 1.0 /end CHARACTERISTIC
/begin MEASUREMENT WM_MaskRctnForTAirBoostOvErr "Mask Reaction for Air Boost Temperature Over Error" ULONG EcuIntgdSwGend_CM_uint32 0 0 0.0 4.294967295E+9 ECU_ADDRESS 0x4000E1B0 /* @ECU_Address@WM_MaskRctnForTAirBoostOvErr@ */ /end MEASUREMENT
/begin MEASUREMENT WM_MaskRctnForTAirBoostUndErr "Mask Reaction for Air Boost Temperature Under Error" ULONG EcuIntgdSwGend_CM_uint32 0 0 0.0 4.294967295E+9 ECU_ADDRESS 0x4000DC94 /* @ECU_Address@WM_MaskRctnForTAirBoostUndErr@ */ /end MEASUREMENT
/begin MEASUREMENT WM_MaskRctnForTAmbAirOvErr "Mask Reaction for Ambient Air Temperature Over Error" ULONG EcuIntgdSwGend_CM_uint32 0 0 0.0 4.294967295E+9 ECU_ADDRESS 0x4000E1E8 /* @ECU_Address@WM_MaskRctnForTAmbAirOvErr@ */ /end MEASUREMENT
/begin MEASUREMENT WM_MaskRctnForTAmbAirUndErr "Mask Reaction for Ambient Air Temperature Under Error" ULONG EcuIntgdSwGend_CM_uint32 0 0 0.0 4.294967295E+9 ECU_ADDRESS 0x4000D8CC /* @ECU_Address@WM_MaskRctnForTAmbAirUndErr@ */ /end MEASUREMENT
/begin MEASUREMENT WM_MaskRctnForTCooltOvErr "Mask Reaction for Coolant Temperature Over Error" ULONG EcuIntgdSwGend_CM_uint32 0 0 0.0 4.294967295E+9 ECU_ADDRESS 0x4000E078 /* @ECU_Address@WM_MaskRctnForTCooltOvErr@ */ /end MEASUREMENT
/begin MEASUREMENT WM_MaskRctnForTCooltUndErr "Mask Reaction for Coolant Temperature Under Error" ULONG EcuIntgdSwGend_CM_uint32 0 0 0.0 4.294967295E+9 ECU_ADDRESS 0x4000DBBC /* @ECU_Address@WM_MaskRctnForTCooltUndErr@ */ /end MEASUREMENT
/begin MEASUREMENT WM_MaskRctnForTEcuErr "Mask Reaction for ECU Temperature Error" ULONG EcuIntgdSwGend_CM_uint32 0 0 0.0 4.294967295E+9 ECU_ADDRESS 0x4000E640 /* @ECU_Address@WM_MaskRctnForTEcuErr@ */ /end MEASUREMENT
/begin MEASUREMENT WM_MaskRctnForTFuOvErr "Mask Reaction for Fuel Temperature Over Error" ULONG EcuIntgdSwGend_CM_uint32 0 0 0.0 4.294967295E+9 ECU_ADDRESS 0x4000E028 /* @ECU_Address@WM_MaskRctnForTFuOvErr@ */ /end MEASUREMENT
/begin MEASUREMENT WM_MaskRctnForTOilOvErr "Mask Reaction for Oil Temperature Over Error" ULONG EcuIntgdSwGend_CM_uint32 0 0 0.0 4.294967295E+9 ECU_ADDRESS 0x4000E278 /* @ECU_Address@WM_MaskRctnForTOilOvErr@ */ /end MEASUREMENT
/begin MEASUREMENT WM_MaskRctnForTOilUndErr "Mask Reaction for Oil Temperature Under Error" ULONG EcuIntgdSwGend_CM_uint32 0 0 0.0 4.294967295E+9 ECU_ADDRESS 0x4000E6C8 /* @ECU_Address@WM_MaskRctnForTOilUndErr@ */ /end MEASUREMENT
/begin MEASUREMENT WM_MaskTC4 "Mask Error List 4 " ULONG EcuIntgdSwGend_CM_uint32 0 0 0.0 4.294967295E+9 ECU_ADDRESS 0x4000E810 /* @ECU_Address@WM_MaskTC4@ */ /end MEASUREMENT
/begin MEASUREMENT WM_MaskTC3 "Mask Error List 3" ULONG EcuIntgdSwGend_CM_uint32 0 0 0.0 4.294967295E+9 ECU_ADDRESS 0x4000E454 /* @ECU_Address@WM_MaskTC3@ */ /end MEASUREMENT
/begin MEASUREMENT WM_MaskTC2 "Mask Error List 2" ULONG EcuIntgdSwGend_CM_uint32 0 0 0.0 4.294967295E+9 ECU_ADDRESS 0x4000DA14 /* @ECU_Address@WM_MaskTC2@ */ /end MEASUREMENT
/begin MEASUREMENT WM_MaskTC1 "Mask Error List 1 " ULONG EcuIntgdSwGend_CM_uint32 0 0 0.0 4.294967295E+9 ECU_ADDRESS 0x4000DDC0 /* @ECU_Address@WM_MaskTC1@ */ /end MEASUREMENT
/begin MEASUREMENT WM_MaskRctnForPRailUndErr "Mask Reaction for Rail Pressure Under Error" ULONG EcuIntgdSwGend_CM_uint32 0 0 0.0 4.294967295E+9 ECU_ADDRESS 0x4000D89C /* @ECU_Address@WM_MaskRctnForPRailUndErr@ */ /end MEASUREMENT
/begin MEASUREMENT WgC_AirMassFlowCalcZeroDiv "Air Mass Flow Calculation Division by Zero Output" FLOAT32_IEEE EcuIntgdSwGend_CM_single 0 0 -20000.0 20000.0 ECU_ADDRESS 0x4000DFE8 /* @ECU_Address@WgC_AirMassFlowCalcZeroDiv@ */ /end MEASUREMENT
/begin MEASUREMENT WgC_CoeffKpOut "Kp Coefficient Output" FLOAT32_IEEE EcuIntgdSwGend_CM_single 0 0 0.0 1000.0 ECU_ADDRESS 0x4000E5A8 /* @ECU_Address@WgC_CoeffKpOut@ */ /end MEASUREMENT
/begin MEASUREMENT WgC_CoeffKiOut "Ki Coefficient Output" FLOAT32_IEEE EcuIntgdSwGend_CM_single 0 0 0.0 1000.0 ECU_ADDRESS 0x4000DCA0 /* @ECU_Address@WgC_CoeffKiOut@ */ /end MEASUREMENT
/begin MEASUREMENT WgC_CoeffKdFbOut "Kd Coefficient Feedback Output" FLOAT32_IEEE EcuIntgdSwGend_CM_single 0 0 0.0 1000.0 ECU_ADDRESS 0x4000D8A8 /* @ECU_Address@WgC_CoeffKdFbOut@ */ /end MEASUREMENT
/begin MEASUREMENT WgC_CoeffKdOut "Kd Coefficient Output" FLOAT32_IEEE EcuIntgdSwGend_CM_single 0 0 0.0 1000.0 ECU_ADDRESS 0x4000E470 /* @ECU_Address@WgC_CoeffKdOut@ */ /end MEASUREMENT
/begin MEASUREMENT WgC_CoeffKiClampPreSatOut "Ki Coefficient Clamp Pre Saturation Output" FLOAT32_IEEE EcuIntgdSwGend_CM_single 0 0 0.0 1000.0 ECU_ADDRESS 0x4000E654 /* @ECU_Address@WgC_CoeffKiClampPreSatOut@ */ /end MEASUREMENT
/begin MEASUREMENT WgC_DutyWgtVlvPID "Wastegate Duty Valve PID" FLOAT32_IEEE EcuIntgdSwGend_CM_single__ 0 0 0.0 100.0 ECU_ADDRESS 0x4000E860 /* @ECU_Address@WgC_DutyWgtVlvPID@ */ /end MEASUREMENT
/begin MEASUREMENT WgC_CoeffKiClampOut "Ki Coefficient Clamp Output" FLOAT32_IEEE EcuIntgdSwGend_CM_single 0 0 0.0 1000.0 ECU_ADDRESS 0x4000DC1C /* @ECU_Address@WgC_CoeffKiClampOut@ */ /end MEASUREMENT
/begin MEASUREMENT WgC_CoeffKiClampSwtchOut "Ki Coefficient Clamp Switch Output" FLOAT32_IEEE EcuIntgdSwGend_CM_single 0 0 0.0 1000.0 ECU_ADDRESS 0x4000D870 /* @ECU_Address@WgC_CoeffKiClampSwtchOut@ */ /end MEASUREMENT
/begin MEASUREMENT WM_TiElpdNEngDetdThdRTN "Return To Normal Engine Speed Over Threshold Debouncer Elapsed Time" FLOAT32_IEEE EcuIntgdSwGend_CM_single_ms 0 0 0.0 25000.0 ECU_ADDRESS 0x4000DBB0 /* @ECU_Address@WM_TiElpdNEngDetdThdRTN@ */ /end MEASUREMENT
/begin MEASUREMENT WM_TiElpdPRailNotCtld "Rail Pressure Is Not Controlled Debouncer Elapsed Time" FLOAT32_IEEE EcuIntgdSwGend_CM_single_ms 0 0 0.0 25000.0 ECU_ADDRESS 0x4000DA94 /* @ECU_Address@WM_TiElpdPRailNotCtld@ */ /end MEASUREMENT
/begin MEASUREMENT RPG_TiElpdCoeffKiRst "Timer Elapsed Time Coefficient Integral Reset" FLOAT32_IEEE EcuIntgdSwGend_CM_single 0 0 0.0 10000.0 ECU_ADDRESS 0x4000E53C /* @ECU_Address@RPG_TiElpdCoeffKiRst@ */ /end MEASUREMENT
/begin MEASUREMENT DTqC_DynRateLimr "Dynamic Rate Limiter Signal" FLOAT32_IEEE EcuIntgdSwGend_CM_single_N_m 0 0 -2000.0 2000.0 ECU_ADDRESS 0x4000E418 /* @ECU_Address@DTqC_DynRateLimr@ */ /end MEASUREMENT
/begin MEASUREMENT DTqC_TqCtlTqBrk "Rate Limited Out of Break Torque Value" FLOAT32_IEEE EcuIntgdSwGend_CM_single_N_m 0 0 0.0 10000.0 ECU_ADDRESS 0x4000E4DC /* @ECU_Address@DTqC_TqCtlTqBrk@ */ /end MEASUREMENT
/begin MEASUREMENT DTqC_TSC1SpdReqTq "Break Torque of TCU Speed Request Control" FLOAT32_IEEE EcuIntgdSwGend_CM_single_N_m 0 0 0.0 10000.0 ECU_ADDRESS 0x4000DFD8 /* @ECU_Address@DTqC_TSC1SpdReqTq@ */ /end MEASUREMENT
/begin MEASUREMENT DTqC_CoeffKpOutEndSpd "" FLOAT32_IEEE EcuIntgdSwGend_CM_single 0 0 -1000.0 1000.0 ECU_ADDRESS 0x4000E1DC /* @ECU_Address@DTqC_CoeffKpOutEndSpd@ */ /end MEASUREMENT
/begin MEASUREMENT DTqC_CoeffKiOutEndSpd "" FLOAT32_IEEE EcuIntgdSwGend_CM_single 0 0 -1000.0 1000.0 ECU_ADDRESS 0x4000E56C /* @ECU_Address@DTqC_CoeffKiOutEndSpd@ */ /end MEASUREMENT
/begin MEASUREMENT DTqC_CoeffKdFbOutEndSpd "" FLOAT32_IEEE EcuIntgdSwGend_CM_single 0 0 -1000.0 1000.0 ECU_ADDRESS 0x4000E18C /* @ECU_Address@DTqC_CoeffKdFbOutEndSpd@ */ /end MEASUREMENT
/begin MEASUREMENT DTqC_CoeffKdOutEndSpd "" FLOAT32_IEEE EcuIntgdSwGend_CM_single 0 0 -1000.0 1000.0 ECU_ADDRESS 0x4000DBE4 /* @ECU_Address@DTqC_CoeffKdOutEndSpd@ */ /end MEASUREMENT
/begin MEASUREMENT DTqC_CoeffKiClampPreSatOutEndSpd "" FLOAT32_IEEE EcuIntgdSwGend_CM_single 0 0 -1000.0 1000.0 ECU_ADDRESS 0x4000D87C /* @ECU_Address@DTqC_CoeffKiClampPreSatOutEndSpd@ */ /end MEASUREMENT
/begin MEASUREMENT DTqC_TqSoftLimPID "Soft Limitation PID Torque" FLOAT32_IEEE EcuIntgdSwGend_CM_single_N_m 0 0 0.0 5000.0 ECU_ADDRESS 0x4000E214 /* @ECU_Address@DTqC_TqSoftLimPID@ */ /end MEASUREMENT
/begin MEASUREMENT DTqC_TiElpdAcvHardLimLtch "" FLOAT32_IEEE EcuIntgdSwGend_CM_single_ms 0 0 0.0 50000.0 ECU_ADDRESS 0x4000E4D0 /* @ECU_Address@DTqC_TiElpdAcvHardLimLtch@ */ /end MEASUREMENT
/begin MEASUREMENT DTqC_CoeffKiClampOutEndSpd "" FLOAT32_IEEE EcuIntgdSwGend_CM_single 0 0 -1000.0 1000.0 ECU_ADDRESS 0x4000E22C /* @ECU_Address@DTqC_CoeffKiClampOutEndSpd@ */ /end MEASUREMENT
/begin MEASUREMENT DTqC_CoeffKiClampSwtchOutEndSpd "" FLOAT32_IEEE EcuIntgdSwGend_CM_single 0 0 -1000.0 1000.0 ECU_ADDRESS 0x4000E034 /* @ECU_Address@DTqC_CoeffKiClampSwtchOutEndSpd@ */ /end MEASUREMENT
/begin MEASUREMENT CrsCtrl_TiElpdEngBrkLvl2Actvn "Engine Brake Level 2 Activation Elapsed Time" FLOAT32_IEEE EcuIntgdSwGend_CM_single_ms 0 0 0.0 10000.0 ECU_ADDRESS 0x4000E130 /* @ECU_Address@CrsCtrl_TiElpdEngBrkLvl2Actvn@ */ /end MEASUREMENT
/begin MEASUREMENT CrsCtrl_TiElpdEngBrkLvl1Actvn "Engine Brake Level 1 Activation Elapsed Time" FLOAT32_IEEE EcuIntgdSwGend_CM_single_ms 0 0 0.0 10000.0 ECU_ADDRESS 0x4000E790 /* @ECU_Address@CrsCtrl_TiElpdEngBrkLvl1Actvn@ */ /end MEASUREMENT
/begin MEASUREMENT WM_bTOilUndEna "Oil Temperature Under Error Enable" UBYTE EcuIntgdSwGend_CM_boolean 0 0 0.0 1.0 ECU_ADDRESS 0x4000E922 /* @ECU_Address@WM_bTOilUndEna@ */ /end MEASUREMENT
/begin MEASUREMENT WM_bErrTOilUndLvl1 "Oil Temperature Under Error Level 1" UBYTE EcuIntgdSwGend_CM_boolean 0 0 0.0 1.0 ECU_ADDRESS 0x4000DEB4 /* @ECU_Address@WM_bErrTOilUndLvl1@ */ /end MEASUREMENT
/begin MEASUREMENT WM_bErrTOilUndLvl2 "Oil Temperature Under Error Level 2" UBYTE EcuIntgdSwGend_CM_boolean 0 0 0.0 1.0 ECU_ADDRESS 0x4000E995 /* @ECU_Address@WM_bErrTOilUndLvl2@ */ /end MEASUREMENT
/begin MEASUREMENT WM_bErrTOilUndLvl3 "Oil Temperature Under Error Level 3" UBYTE EcuIntgdSwGend_CM_boolean 0 0 0.0 1.0 ECU_ADDRESS 0x4000D9B0 /* @ECU_Address@WM_bErrTOilUndLvl3@ */ /end MEASUREMENT
/begin MEASUREMENT WM_bErrTOilUnd "Oil Temperature Under Error" UBYTE EcuIntgdSwGend_CM_boolean 0 0 0.0 1.0 ECU_ADDRESS 0x4000E178 /* @ECU_Address@WM_bErrTOilUnd@ */ /end MEASUREMENT
/begin MEASUREMENT WM_bTOilOvEna "Oil Temperature Over Error Enable" UBYTE EcuIntgdSwGend_CM_boolean 0 0 0.0 1.0 ECU_ADDRESS 0x4000E78B /* @ECU_Address@WM_bTOilOvEna@ */ /end MEASUREMENT
/begin MEASUREMENT WM_bErrTOilOvLvl1 "Oil Temperature Over Error Level 1" UBYTE EcuIntgdSwGend_CM_boolean 0 0 0.0 1.0 ECU_ADDRESS 0x4000DC10 /* @ECU_Address@WM_bErrTOilOvLvl1@ */ /end MEASUREMENT
/begin MEASUREMENT WM_bErrTOilOvLvl2 "Oil Temperature Over Error Level 2" UBYTE EcuIntgdSwGend_CM_boolean 0 0 0.0 1.0 ECU_ADDRESS 0x4000DC11 /* @ECU_Address@WM_bErrTOilOvLvl2@ */ /end MEASUREMENT
/begin MEASUREMENT WM_bErrTOilOvLvl3 "Oil Temperature Over Error Level 3" UBYTE EcuIntgdSwGend_CM_boolean 0 0 0.0 1.0 ECU_ADDRESS 0x4000E2AC /* @ECU_Address@WM_bErrTOilOvLvl3@ */ /end MEASUREMENT
/begin MEASUREMENT WM_bErrTOilOv "Oil Temperature Over Error" UBYTE EcuIntgdSwGend_CM_boolean 0 0 0.0 1.0 ECU_ADDRESS 0x4000E669 /* @ECU_Address@WM_bErrTOilOv@ */ /end MEASUREMENT
/begin MEASUREMENT WM_bTFuOvEna "Coolant Temperature Over Error Enable" UBYTE EcuIntgdSwGend_CM_boolean 0 0 0.0 1.0 ECU_ADDRESS 0x4000D905 /* @ECU_Address@WM_bTFuOvEna@ */ /end MEASUREMENT
/begin MEASUREMENT WM_bErrTFuOvLvl1 "Fuel Temperature Over Error Level 1" UBYTE EcuIntgdSwGend_CM_boolean 0 0 0.0 1.0 ECU_ADDRESS 0x4000E3BF /* @ECU_Address@WM_bErrTFuOvLvl1@ */ /end MEASUREMENT
/begin MEASUREMENT WM_bErrTFuOvLvl2 "Fuel Temperature Over Error Level 2" UBYTE EcuIntgdSwGend_CM_boolean 0 0 0.0 1.0 ECU_ADDRESS 0x4000E3C0 /* @ECU_Address@WM_bErrTFuOvLvl2@ */ /end MEASUREMENT
/begin MEASUREMENT WM_bErrTFuOvLvl3 "Fuel Temperature Over Error Level 3" UBYTE EcuIntgdSwGend_CM_boolean 0 0 0.0 1.0 ECU_ADDRESS 0x4000E3C1 /* @ECU_Address@WM_bErrTFuOvLvl3@ */ /end MEASUREMENT
/begin MEASUREMENT WM_bErrTFuOv "Fuel Temperature Over Error" UBYTE EcuIntgdSwGend_CM_boolean 0 0 0.0 1.0 ECU_ADDRESS 0x4000E0F1 /* @ECU_Address@WM_bErrTFuOv@ */ /end MEASUREMENT
/begin MEASUREMENT WM_bTEcuEna "ECU Temperature Error Enable" UBYTE EcuIntgdSwGend_CM_boolean 0 0 0.0 1.0 ECU_ADDRESS 0x4000DAEC /* @ECU_Address@WM_bTEcuEna@ */ /end MEASUREMENT
/begin MEASUREMENT WM_bErrTEcuLvl1 "ECU Temperature Error Level 1" UBYTE EcuIntgdSwGend_CM_boolean 0 0 0.0 1.0 ECU_ADDRESS 0x4000D888 /* @ECU_Address@WM_bErrTEcuLvl1@ */ /end MEASUREMENT
/begin MEASUREMENT WM_bErrTEcuLvl2 "ECU Temperature Error Level 2" UBYTE EcuIntgdSwGend_CM_boolean 0 0 0.0 1.0 ECU_ADDRESS 0x4000D889 /* @ECU_Address@WM_bErrTEcuLvl2@ */ /end MEASUREMENT
/begin MEASUREMENT WM_bErrTEcuLvl3 "ECU Temperature Error Level 3" UBYTE EcuIntgdSwGend_CM_boolean 0 0 0.0 1.0 ECU_ADDRESS 0x4000D88A /* @ECU_Address@WM_bErrTEcuLvl3@ */ /end MEASUREMENT
/begin MEASUREMENT WM_bErrTEcu "ECU Temperature Error" UBYTE EcuIntgdSwGend_CM_boolean 0 0 0.0 1.0 ECU_ADDRESS 0x4000DD95 /* @ECU_Address@WM_bErrTEcu@ */ /end MEASUREMENT
/begin MEASUREMENT WM_bTCooltUndEna "Coolant Temperature Under Error Enable" UBYTE EcuIntgdSwGend_CM_boolean 0 0 0.0 1.0 ECU_ADDRESS 0x4000E06E /* @ECU_Address@WM_bTCooltUndEna@ */ /end MEASUREMENT
/begin MEASUREMENT WM_bErrTCooltUndLvl1 "Coolant Temperature Under Error Level 1" UBYTE EcuIntgdSwGend_CM_boolean 0 0 0.0 1.0 ECU_ADDRESS 0x4000E569 /* @ECU_Address@WM_bErrTCooltUndLvl1@ */ /end MEASUREMENT
/begin MEASUREMENT WM_bErrTCooltUndLvl2 "Coolant Temperature Under Error Level 2" UBYTE EcuIntgdSwGend_CM_boolean 0 0 0.0 1.0 ECU_ADDRESS 0x4000E56B /* @ECU_Address@WM_bErrTCooltUndLvl2@ */ /end MEASUREMENT
/begin MEASUREMENT WM_bErrTCooltUndLvl3 "Coolant Temperature Under Error Level 3" UBYTE EcuIntgdSwGend_CM_boolean 0 0 0.0 1.0 ECU_ADDRESS 0x4000DEB8 /* @ECU_Address@WM_bErrTCooltUndLvl3@ */ /end MEASUREMENT
/begin MEASUREMENT WM_bErrTCooltUnd "Coolant Temperature Under Error" UBYTE EcuIntgdSwGend_CM_boolean 0 0 0.0 1.0 ECU_ADDRESS 0x4000E275 /* @ECU_Address@WM_bErrTCooltUnd@ */ /end MEASUREMENT
/begin MEASUREMENT WM_bTCooltOvEna "Coolant Temperature Over Error Enable" UBYTE EcuIntgdSwGend_CM_boolean 0 0 0.0 1.0 ECU_ADDRESS 0x4000E254 /* @ECU_Address@WM_bTCooltOvEna@ */ /end MEASUREMENT
/begin MEASUREMENT WM_bErrTCooltOvLvl1 "Coolant Temperature Over Error Level 1" UBYTE EcuIntgdSwGend_CM_boolean 0 0 0.0 1.0 ECU_ADDRESS 0x4000E98C /* @ECU_Address@WM_bErrTCooltOvLvl1@ */ /end MEASUREMENT
/begin MEASUREMENT WM_bErrTCooltOvLvl2 "Coolant Temperature Over Error Level 2" UBYTE EcuIntgdSwGend_CM_boolean 0 0 0.0 1.0 ECU_ADDRESS 0x4000E281 /* @ECU_Address@WM_bErrTCooltOvLvl2@ */ /end MEASUREMENT
/begin MEASUREMENT WM_bErrTCooltOvLvl3 "Coolant Temperature Over Error Level 3" UBYTE EcuIntgdSwGend_CM_boolean 0 0 0.0 1.0 ECU_ADDRESS 0x4000E282 /* @ECU_Address@WM_bErrTCooltOvLvl3@ */ /end MEASUREMENT
/begin MEASUREMENT WM_bErrTCooltOv "Coolant Temperature Over Error" UBYTE EcuIntgdSwGend_CM_boolean 0 0 0.0 1.0 ECU_ADDRESS 0x4000D91B /* @ECU_Address@WM_bErrTCooltOv@ */ /end MEASUREMENT
/begin MEASUREMENT WM_bTAmbAirUndEna "Ambient Air Temperature Under Error Enable" UBYTE EcuIntgdSwGend_CM_boolean 0 0 0.0 1.0 ECU_ADDRESS 0x4000DC18 /* @ECU_Address@WM_bTAmbAirUndEna@ */ /end MEASUREMENT
/begin MEASUREMENT WM_bErrTAmbAirUndLvl1 "Ambient Air Temperature Under Error Level 1" UBYTE EcuIntgdSwGend_CM_boolean 0 0 0.0 1.0 ECU_ADDRESS 0x4000E684 /* @ECU_Address@WM_bErrTAmbAirUndLvl1@ */ /end MEASUREMENT
/begin MEASUREMENT WM_bErrTAmbAirUndLvl2 "Ambient Air Temperature Under Error Level 2" UBYTE EcuIntgdSwGend_CM_boolean 0 0 0.0 1.0 ECU_ADDRESS 0x4000E685 /* @ECU_Address@WM_bErrTAmbAirUndLvl2@ */ /end MEASUREMENT
/begin MEASUREMENT WM_bErrTAmbAirUndLvl3 "Ambient Air Temperature Under Error Level 3" UBYTE EcuIntgdSwGend_CM_boolean 0 0 0.0 1.0 ECU_ADDRESS 0x4000DF76 /* @ECU_Address@WM_bErrTAmbAirUndLvl3@ */ /end MEASUREMENT
/begin MEASUREMENT WM_bErrTAmbAirUnd "Ambient Air Temperature Under Error" UBYTE EcuIntgdSwGend_CM_boolean 0 0 0.0 1.0 ECU_ADDRESS 0x4000E780 /* @ECU_Address@WM_bErrTAmbAirUnd@ */ /end MEASUREMENT
/begin MEASUREMENT WM_bTAmbAirOvEna "Ambient Air Temperature Over Error Enable" UBYTE EcuIntgdSwGend_CM_boolean 0 0 0.0 1.0 ECU_ADDRESS 0x4000E62C /* @ECU_Address@WM_bTAmbAirOvEna@ */ /end MEASUREMENT
/begin MEASUREMENT WM_bErrTAmbAirOvLvl1 "Ambient Air Temperature Over Error Level 1" UBYTE EcuIntgdSwGend_CM_boolean 0 0 0.0 1.0 ECU_ADDRESS 0x4000E46C /* @ECU_Address@WM_bErrTAmbAirOvLvl1@ */ /end MEASUREMENT
/begin MEASUREMENT WM_bErrTAmbAirOvLvl2 "Ambient Air Temperature Over Error Level 2" UBYTE EcuIntgdSwGend_CM_boolean 0 0 0.0 1.0 ECU_ADDRESS 0x4000DE9C /* @ECU_Address@WM_bErrTAmbAirOvLvl2@ */ /end MEASUREMENT
/begin MEASUREMENT WM_bErrTAmbAirOvLvl3 "Ambient Air Temperature Over Error Level 3" UBYTE EcuIntgdSwGend_CM_boolean 0 0 0.0 1.0 ECU_ADDRESS 0x4000DE9D /* @ECU_Address@WM_bErrTAmbAirOvLvl3@ */ /end MEASUREMENT
/begin MEASUREMENT WM_bErrTAmbAirOv "Ambient Air Temperature Over Error" UBYTE EcuIntgdSwGend_CM_boolean 0 0 0.0 1.0 ECU_ADDRESS 0x4000E1A9 /* @ECU_Address@WM_bErrTAmbAirOv@ */ /end MEASUREMENT
/begin MEASUREMENT WM_bTAirBoostUndEna "Air Boost Temperature Under Error Enable" UBYTE EcuIntgdSwGend_CM_boolean 0 0 0.0 1.0 ECU_ADDRESS 0x4000E088 /* @ECU_Address@WM_bTAirBoostUndEna@ */ /end MEASUREMENT
/begin MEASUREMENT WM_bErrTAirBoostUndLvl1 "Air Boost Temperature Under Level 1" UBYTE EcuIntgdSwGend_CM_boolean 0 0 0.0 1.0 ECU_ADDRESS 0x4000E921 /* @ECU_Address@WM_bErrTAirBoostUndLvl1@ */ /end MEASUREMENT
/begin MEASUREMENT WM_bErrTAirBoostUndLvl2 "Air Boost Temperature Under Level 2" UBYTE EcuIntgdSwGend_CM_boolean 0 0 0.0 1.0 ECU_ADDRESS 0x4000E4CC /* @ECU_Address@WM_bErrTAirBoostUndLvl2@ */ /end MEASUREMENT
/begin MEASUREMENT WM_bErrTAirBoostUndLvl3 "Air Boost Temperature Under Level 3" UBYTE EcuIntgdSwGend_CM_boolean 0 0 0.0 1.0 ECU_ADDRESS 0x4000E923 /* @ECU_Address@WM_bErrTAirBoostUndLvl3@ */ /end MEASUREMENT
/begin MEASUREMENT WM_bErrTAirBoostUnd "Air Boost Temperature Under Error" UBYTE EcuIntgdSwGend_CM_boolean 0 0 0.0 1.0 ECU_ADDRESS 0x4000E6E8 /* @ECU_Address@WM_bErrTAirBoostUnd@ */ /end MEASUREMENT
/begin MEASUREMENT WM_bTAirBoostOvEna "Air Boost Temperature Over Error Enable" UBYTE EcuIntgdSwGend_CM_boolean 0 0 0.0 1.0 ECU_ADDRESS 0x4000E539 /* @ECU_Address@WM_bTAirBoostOvEna@ */ /end MEASUREMENT
/begin MEASUREMENT WM_bErrTAirBoostOvLvl1 "Air Boost Temperature Over Error Level 1" UBYTE EcuIntgdSwGend_CM_boolean 0 0 0.0 1.0 ECU_ADDRESS 0x4000E488 /* @ECU_Address@WM_bErrTAirBoostOvLvl1@ */ /end MEASUREMENT
/begin MEASUREMENT WM_bErrTAirBoostOvLvl2 "Air Boost Temperature Over Error Level 2" UBYTE EcuIntgdSwGend_CM_boolean 0 0 0.0 1.0 ECU_ADDRESS 0x4000E330 /* @ECU_Address@WM_bErrTAirBoostOvLvl2@ */ /end MEASUREMENT
/begin MEASUREMENT WM_bErrTAirBoostOvLvl3 "Air Boost Temperature Over Error Level 3" UBYTE EcuIntgdSwGend_CM_boolean 0 0 0.0 1.0 ECU_ADDRESS 0x4000E48A /* @ECU_Address@WM_bErrTAirBoostOvLvl3@ */ /end MEASUREMENT
/begin MEASUREMENT WM_bErrTAirBoostOv "Air Boost Temperature Over Error" UBYTE EcuIntgdSwGend_CM_boolean 0 0 0.0 1.0 ECU_ADDRESS 0x4000D824 /* @ECU_Address@WM_bErrTAirBoostOv@ */ /end MEASUREMENT
/begin MEASUREMENT WM_bNEngOverThdRTN "Engine Speed Over Threshold Return to Normal Active" UBYTE EcuIntgdSwGend_CM_boolean 0 0 0.0 1.0 ECU_ADDRESS 0x4000E14C /* @ECU_Address@WM_bNEngOverThdRTN@ */ /end MEASUREMENT
/begin MEASUREMENT WM_bErrComb1 "Error Combo 1" UBYTE EcuIntgdSwGend_CM_boolean 0 0 0.0 1.0 ECU_ADDRESS 0x4000E648 /* @ECU_Address@WM_bErrComb1@ */ /end MEASUREMENT
/begin MEASUREMENT WM_bErrComb2 "Error Combo 2" UBYTE EcuIntgdSwGend_CM_boolean 0 0 0.0 1.0 ECU_ADDRESS 0x4000E686 /* @ECU_Address@WM_bErrComb2@ */ /end MEASUREMENT
/begin MEASUREMENT WM_bErrComb3 "Error Combo 3" UBYTE EcuIntgdSwGend_CM_boolean 0 0 0.0 1.0 ECU_ADDRESS 0x4000E687 /* @ECU_Address@WM_bErrComb3@ */ /end MEASUREMENT
/begin MEASUREMENT WM_bErrComb4 "Error Combo 4" UBYTE EcuIntgdSwGend_CM_boolean 0 0 0.0 1.0 ECU_ADDRESS 0x4000E688 /* @ECU_Address@WM_bErrComb4@ */ /end MEASUREMENT
/begin MEASUREMENT WM_bErrComb5 "Error Combo 5" UBYTE EcuIntgdSwGend_CM_boolean 0 0 0.0 1.0 ECU_ADDRESS 0x4000E689 /* @ECU_Address@WM_bErrComb5@ */ /end MEASUREMENT
/begin MEASUREMENT WM_bAcvAmberWarn "MIL Warning Lamp Active" UBYTE EcuIntgdSwGend_CM_boolean 0 0 0.0 1.0 ECU_ADDRESS 0x4000DB6E /* @ECU_Address@WM_bAcvAmberWarn@ */ /end MEASUREMENT
/begin MEASUREMENT WM_bAcvRednLvl1 "Engine Torque Reaction Level 1 Active" UBYTE EcuIntgdSwGend_CM_boolean 0 0 0.0 1.0 ECU_ADDRESS 0x4000DED8 /* @ECU_Address@WM_bAcvRednLvl1@ */ /end MEASUREMENT
/begin MEASUREMENT WM_bAcvRednLvl2 "Engine Torque Reaction Level 2 Active" UBYTE EcuIntgdSwGend_CM_boolean 0 0 0.0 1.0 ECU_ADDRESS 0x4000DED9 /* @ECU_Address@WM_bAcvRednLvl2@ */ /end MEASUREMENT
/begin MEASUREMENT WM_bAcvLimp "Limp Active" UBYTE EcuIntgdSwGend_CM_boolean 0 0 0.0 1.0 ECU_ADDRESS 0x4000DB1C /* @ECU_Address@WM_bAcvLimp@ */ /end MEASUREMENT
/begin MEASUREMENT WM_bAcvEmgcyShtdwnLamp "Emergency Shutdown Lamp Active" UBYTE EcuIntgdSwGend_CM_boolean 0 0 0.0 1.0 ECU_ADDRESS 0x4000DC30 /* @ECU_Address@WM_bAcvEmgcyShtdwnLamp@ */ /end MEASUREMENT
/begin MEASUREMENT WM_bAcvEmgcyShtdwn "Emergency Shutdown Active" UBYTE EcuIntgdSwGend_CM_boolean 0 0 0.0 1.0 ECU_ADDRESS 0x4000E06B /* @ECU_Address@WM_bAcvEmgcyShtdwn@ */ /end MEASUREMENT
/begin MEASUREMENT WM_bAcvErrInjrShtdwnRctn "Injection Error Shutdown Reaction Active" UBYTE EcuIntgdSwGend_CM_boolean 0 0 0.0 1.0 ECU_ADDRESS 0x4000DFA4 /* @ECU_Address@WM_bAcvErrInjrShtdwnRctn@ */ /end MEASUREMENT
/begin MEASUREMENT WM_bAcvErrCamCrankTotLossRctn "Cam Crank Total Loss Reaction Active" UBYTE EcuIntgdSwGend_CM_boolean 0 0 0.0 1.0 ECU_ADDRESS 0x4000E2D5 /* @ECU_Address@WM_bAcvErrCamCrankTotLossRctn@ */ /end MEASUREMENT
/begin MEASUREMENT WM_bAcvErrEmgcyShtdwnForOvspdRctn "Emergency Shutdown for Overspeed Reaction Active" UBYTE EcuIntgdSwGend_CM_boolean 0 0 0.0 1.0 ECU_ADDRESS 0x4000E84C /* @ECU_Address@WM_bAcvErrEmgcyShtdwnForOvspdRctn@ */ /end MEASUREMENT
/begin MEASUREMENT WM_bAcvErrPRailNotCtldMsgRctn "Rail Pressure Is Not Controlled Reaction Active" UBYTE EcuIntgdSwGend_CM_boolean 0 0 0.0 1.0 ECU_ADDRESS 0x4000D9EC /* @ECU_Address@WM_bAcvErrPRailNotCtldMsgRctn@ */ /end MEASUREMENT
/begin MEASUREMENT WM_bAcvFlgOfWtrInFuRctn "Flag Of Water In Fuel Active" UBYTE EcuIntgdSwGend_CM_boolean 0 0 0.0 1.0 ECU_ADDRESS 0x4000D85C /* @ECU_Address@WM_bAcvFlgOfWtrInFuRctn@ */ /end MEASUREMENT
/begin MEASUREMENT WM_bActvLimpRctn "Limp Reaction Activation" UBYTE EcuIntgdSwGend_CM_boolean 0 0 0.0 1.0 ECU_ADDRESS 0x4000DB32 /* @ECU_Address@WM_bActvLimpRctn@ */ /end MEASUREMENT
/begin MEASUREMENT WM_bAcvErrComb5Rctn "Error Combo 5 Reaction Active" UBYTE EcuIntgdSwGend_CM_boolean 0 0 0.0 1.0 ECU_ADDRESS 0x4000E06F /* @ECU_Address@WM_bAcvErrComb5Rctn@ */ /end MEASUREMENT
/begin MEASUREMENT WM_bAcvErrComb4Rctn "Error Combo 4 Reaction Active" UBYTE EcuIntgdSwGend_CM_boolean 0 0 0.0 1.0 ECU_ADDRESS 0x4000E070 /* @ECU_Address@WM_bAcvErrComb4Rctn@ */ /end MEASUREMENT
/begin MEASUREMENT WM_bAcvErrComb3Rctn "Error Combo 3 Reaction Active" UBYTE EcuIntgdSwGend_CM_boolean 0 0 0.0 1.0 ECU_ADDRESS 0x4000E595 /* @ECU_Address@WM_bAcvErrComb3Rctn@ */ /end MEASUREMENT
/begin MEASUREMENT WM_bAcvErrComb2Rctn "Error Combo 2 Reaction Active" UBYTE EcuIntgdSwGend_CM_boolean 0 0 0.0 1.0 ECU_ADDRESS 0x4000E87D /* @ECU_Address@WM_bAcvErrComb2Rctn@ */ /end MEASUREMENT
/begin MEASUREMENT WM_bAcvErrComb1Rctn "Error Combo 1 Reaction Active" UBYTE EcuIntgdSwGend_CM_boolean 0 0 0.0 1.0 ECU_ADDRESS 0x4000D9A8 /* @ECU_Address@WM_bAcvErrComb1Rctn@ */ /end MEASUREMENT
/begin MEASUREMENT WM_bErrPRailUnd "Rail Pressure Under Error" UBYTE EcuIntgdSwGend_CM_boolean 0 0 0.0 1.0 ECU_ADDRESS 0x4000D8C9 /* @ECU_Address@WM_bErrPRailUnd@ */ /end MEASUREMENT
/begin MEASUREMENT WM_bTiAcvWarnPRailNotCtldDeb "Rail Pressure Is Not Controlled Debouncer Active" UBYTE EcuIntgdSwGend_CM_boolean 0 0 0.0 1.0 ECU_ADDRESS 0x4000E6AC /* @ECU_Address@WM_bTiAcvWarnPRailNotCtldDeb@ */ /end MEASUREMENT
/begin MEASUREMENT WM_bPRailNotCtldMsg "Rail Pressure Is Not Controlled Message" UBYTE EcuIntgdSwGend_CM_boolean 0 0 0.0 1.0 ECU_ADDRESS 0x4000E211 /* @ECU_Address@WM_bPRailNotCtldMsg@ */ /end MEASUREMENT
/begin MEASUREMENT WM_bPRailUndEna "Rail Pressure Under Error Enable" UBYTE EcuIntgdSwGend_CM_boolean 0 0 0.0 1.0 ECU_ADDRESS 0x4000E732 /* @ECU_Address@WM_bPRailUndEna@ */ /end MEASUREMENT
/begin MEASUREMENT WM_bErrPRailUndLvl1 "Rail Pressure Under Error Level 1" UBYTE EcuIntgdSwGend_CM_boolean 0 0 0.0 1.0 ECU_ADDRESS 0x4000E8CD /* @ECU_Address@WM_bErrPRailUndLvl1@ */ /end MEASUREMENT
/begin MEASUREMENT WM_bErrPRailUndLvl2 "Rail Pressure Under Error Level 2" UBYTE EcuIntgdSwGend_CM_boolean 0 0 0.0 1.0 ECU_ADDRESS 0x4000E8CE /* @ECU_Address@WM_bErrPRailUndLvl2@ */ /end MEASUREMENT
/begin MEASUREMENT WM_bErrPRailUndLvl3 "Rail Pressure Under Error Level 3" UBYTE EcuIntgdSwGend_CM_boolean 0 0 0.0 1.0 ECU_ADDRESS 0x4000E8CF /* @ECU_Address@WM_bErrPRailUndLvl3@ */ /end MEASUREMENT
/begin MEASUREMENT WM_bNEngOverThd1 "Global Enable Engine Speed Level 1" UBYTE EcuIntgdSwGend_CM_boolean 0 0 0.0 1.0 ECU_ADDRESS 0x4000D8C4 /* @ECU_Address@WM_bNEngOverThd1@ */ /end MEASUREMENT
/begin MEASUREMENT WM_bNEngOverThd2 "Global Enable Engine Speed Level 2" UBYTE EcuIntgdSwGend_CM_boolean 0 0 0.0 1.0 ECU_ADDRESS 0x4000D8C5 /* @ECU_Address@WM_bNEngOverThd2@ */ /end MEASUREMENT
/begin MEASUREMENT WM_bNEngOverThd3 "Global Enable Engine Speed Level 3" UBYTE EcuIntgdSwGend_CM_boolean 0 0 0.0 1.0 ECU_ADDRESS 0x4000D8C6 /* @ECU_Address@WM_bNEngOverThd3@ */ /end MEASUREMENT
/begin MEASUREMENT WM_bNEngOverThd4 "Global Enable Engine Speed Level 4" UBYTE EcuIntgdSwGend_CM_boolean 0 0 0.0 1.0 ECU_ADDRESS 0x4000D8C7 /* @ECU_Address@WM_bNEngOverThd4@ */ /end MEASUREMENT
/begin MEASUREMENT WM_bNEngOverThd5 "Global Enable Engine Speed Level 5" UBYTE EcuIntgdSwGend_CM_boolean 0 0 0.0 1.0 ECU_ADDRESS 0x4000D8C8 /* @ECU_Address@WM_bNEngOverThd5@ */ /end MEASUREMENT
/begin MEASUREMENT WM_bNEngOverThd6 "Global Enable Engine Speed Level 6" UBYTE EcuIntgdSwGend_CM_boolean 0 0 0.0 1.0 ECU_ADDRESS 0x4000DB6C /* @ECU_Address@WM_bNEngOverThd6@ */ /end MEASUREMENT
/begin MEASUREMENT WM_bNEngOverThd7 "Global Enable Engine Speed Level 7" UBYTE EcuIntgdSwGend_CM_boolean 0 0 0.0 1.0 ECU_ADDRESS 0x4000D8CA /* @ECU_Address@WM_bNEngOverThd7@ */ /end MEASUREMENT
/begin MEASUREMENT DTqC_AcvHardLimLtch "Engine Speed Hard Limit Latch Activation Flag" UBYTE EcuIntgdSwGend_CM_boolean 0 0 0.0 1.0 ECU_ADDRESS 0x4000E920 /* @ECU_Address@DTqC_AcvHardLimLtch@ */ /end MEASUREMENT
/begin MEASUREMENT CrsCtrl_bEngBrkLvl2Ena "Enable Engine Brake Level 2" UBYTE EcuIntgdSwGend_CM_boolean 0 0 0.0 1.0 ECU_ADDRESS 0x4000D920 /* @ECU_Address@CrsCtrl_bEngBrkLvl2Ena@ */ /end MEASUREMENT
/begin MEASUREMENT CrsCtrl_bEngBrkLvl1Ena "Enable Engine Brake Level 1" UBYTE EcuIntgdSwGend_CM_boolean 0 0 0.0 1.0 ECU_ADDRESS 0x4000E1C4 /* @ECU_Address@CrsCtrl_bEngBrkLvl1Ena@ */ /end MEASUREMENT
/begin COMPU_METHOD EcuIntgdSwGend_CM_single_N_m "Q = V" RAT_FUNC "%8.6" "N*m" COEFFS 0 1 0 0 0 1 /end COMPU_METHOD
/begin COMPU_METHOD EcuIntgdSwGend_CM_single_rpm "Q = V" RAT_FUNC "%8.6" "rpm" COEFFS 0 1 0 0 0 1 /end COMPU_METHOD
/begin COMPU_METHOD EcuIntgdSwGend_CM_single_degC "Q = V" RAT_FUNC "%8.6" "degC" COEFFS 0 1 0 0 0 1 /end COMPU_METHOD
/begin COMPU_METHOD EcuIntgdSwGend_CM_single__ "Q = V" RAT_FUNC "%8.6" "%" COEFFS 0 1 0 0 0 1 /end COMPU_METHOD
/begin COMPU_METHOD EcuIntgdSwGend_CM_single "Q = V" RAT_FUNC "%8.6" "" COEFFS 0 1 0 0 0 1 /end COMPU_METHOD
/begin COMPU_METHOD EcuIntgdSwGend_CM_single_ms "Q = V" RAT_FUNC "%8.6" "ms" COEFFS 0 1 0 0 0 1 /end COMPU_METHOD
/begin COMPU_METHOD EcuIntgdSwGend_CM_single_bar "Q = V" RAT_FUNC "%8.6" "bar" COEFFS 0 1 0 0 0 1 /end COMPU_METHOD
/begin COMPU_METHOD EcuIntgdSwGend_CM_single_J_kgK "Q = V" RAT_FUNC "%8.6" "J/kgK" COEFFS 0 1 0 0 0 1 /end COMPU_METHOD
/begin COMPU_METHOD EcuIntgdSwGend_CM_uint32 "Q = V" RAT_FUNC "%10.0" "" COEFFS 0 1 0 0 0 1 /end COMPU_METHOD
/begin COMPU_METHOD EcuIntgdSwGend_CM_uint16 "Q = V" RAT_FUNC "%5.0" "" COEFFS 0 1 0 0 0 1 /end COMPU_METHOD
/begin COMPU_METHOD EcuIntgdSwGend_CM_boolean "Q = V" RAT_FUNC "%1.0" "" COEFFS 0 1 0 0 0 1 /end COMPU_METHOD
/begin GROUP S735_Rail_Under_Pressure "EcuIntgdSwGend/ControlSoftware/WarnMong/Warning-Reduction-Shutdown Functions/Pressure/Rail Under Pressure" /begin SUB_GROUP S764_Low_and_Not_Control_Fuel_System_Message /end SUB_GROUP
 /begin REF_CHARACTERISTIC EG_Mask32Bit0_C EG_NmrInt0_C EG_NmrInt1_C EG_NmrInt2_C EG_NmrInt3_C EG_TsSw20_C EG_bFlgFalse_C EG_bFlgTrue_C WM_MaskPRailUndEnaCond_P WM_MaskRTNForErrPRailUnd_P WM_MaskRctnForPRailUndLvl1Err_P WM_MaskRctnForPRailUndLvl2Err_P WM_MaskRctnForPRailUndLvl3Err_P WM_PRailUndDesLvlQnty_P WM_PRailUndHysDeacLvl1_P WM_PRailUndHysDeacLvl2_P WM_PRailUndHysDeacLvl3_P WM_PRailUndLvl1_M WM_PRailUndLvl2_M WM_PRailUndLvl3_M WM_TiPRailUndDebHi_P WM_TiPRailUndDebLo_P /end REF_CHARACTERISTIC
 /begin REF_MEASUREMENT WM_MaskRctnForPRailUndErr WM_bErrPRailUnd WM_bErrPRailUndLvl1 WM_bErrPRailUndLvl2 WM_bErrPRailUndLvl3 WM_bPRailUndEna /end REF_MEASUREMENT
/end GROUP
/begin GROUP S736_Bit_Extract "EcuIntgdSwGend/ControlSoftware/WarnMong/Warning-Reduction-Shutdown Functions/Reaction/Bit Extract" /begin SUB_GROUP S777_BitwiseANDMask S777_BitwiseANDMask4 /end SUB_GROUP
 /begin REF_CHARACTERISTIC WM_MaskRctnAmberWarn_C WM_MaskRctnEngRednLvl1_C WM_MaskRctnEngRednLvl2_C WM_MaskRctnEngShtdwnWarn_C WM_MaskRctnEngShtdwn_C WM_MaskRctnLimp_C /end REF_CHARACTERISTIC
 /begin REF_MEASUREMENT WM_bAcvEmgcyShtdwn WM_bAcvLimp WM_bAcvRednLvl1 WM_bAcvRednLvl2 /end REF_MEASUREMENT
/end GROUP
/begin GROUP S736_Error_List "EcuIntgdSwGend/ControlSoftware/WarnMong/Warning-Reduction-Shutdown Functions/Reaction/Error List"
 /begin SUB_GROUP S778_Error_Combinations S778_TC1 S778_TC2 S778_TC3 S778_TC4 /end SUB_GROUP
 /begin REF_CHARACTERISTIC EG_NmrInt0_C EG_NmrInt1_C EG_bFlgFalse_C /end REF_CHARACTERISTIC
/end GROUP
/begin GROUP S736_SetResetFaultReaction "EcuIntgdSwGend/ControlSoftware/WarnMong/Warning-Reduction-Shutdown Functions/Reaction/SetResetFaultReaction" /begin SUB_GROUP S779_SetRstLtch /end SUB_GROUP /begin REF_CHARACTERISTIC EG_Mask32Bit0_C /end REF_CHARACTERISTIC /end GROUP
/begin GROUP S736_SetResetFaultReaction1 "EcuIntgdSwGend/ControlSoftware/WarnMong/Warning-Reduction-Shutdown Functions/Reaction/SetResetFaultReaction1" /begin SUB_GROUP S780_SetRstLtch /end SUB_GROUP /begin REF_CHARACTERISTIC EG_Mask32Bit0_C /end REF_CHARACTERISTIC /end GROUP
/begin GROUP S736_SetResetFaultReaction24 "EcuIntgdSwGend/ControlSoftware/WarnMong/Warning-Reduction-Shutdown Functions/Reaction/SetResetFaultReaction24" /begin SUB_GROUP S781_SetRstLtch /end SUB_GROUP /begin REF_CHARACTERISTIC EG_Mask32Bit0_C /end REF_CHARACTERISTIC /end GROUP
/begin GROUP S736_SetResetFaultReaction25 "EcuIntgdSwGend/ControlSoftware/WarnMong/Warning-Reduction-Shutdown Functions/Reaction/SetResetFaultReaction25" /begin SUB_GROUP S782_SetRstLtch /end SUB_GROUP /begin REF_CHARACTERISTIC EG_Mask32Bit0_C /end REF_CHARACTERISTIC /end GROUP
/begin GROUP S736_SetResetFaultReaction26 "EcuIntgdSwGend/ControlSoftware/WarnMong/Warning-Reduction-Shutdown Functions/Reaction/SetResetFaultReaction26" /begin SUB_GROUP S783_SetRstLtch /end SUB_GROUP /begin REF_CHARACTERISTIC EG_Mask32Bit0_C /end REF_CHARACTERISTIC /end GROUP
/begin GROUP S736_SetResetFaultReaction27 "EcuIntgdSwGend/ControlSoftware/WarnMong/Warning-Reduction-Shutdown Functions/Reaction/SetResetFaultReaction27" /begin SUB_GROUP S784_SetRstLtch /end SUB_GROUP /begin REF_CHARACTERISTIC EG_Mask32Bit0_C /end REF_CHARACTERISTIC /end GROUP
/begin GROUP S736_Warning_Monitoring_Diagnostic_Info "EcuIntgdSwGend/ControlSoftware/WarnMong/Warning-Reduction-Shutdown Functions/Reaction/Warning Monitoring Diagnostic Info"
 /begin REF_CHARACTERISTIC EG_DiagcSnsrFltInfoNone_C EG_DiagcSnsrFltInfoNotCtldMsg_C EG_DiagcSnsrFltInfoOv_C EG_DiagcSnsrFltInfoUnd_C EG_DiagcSnsrInfoCamCrankDfct_C EG_DiagcSnsrInfoCylMisf_C EG_DiagcSnsrInfoInjrDfct_C EG_DiagcSnsrInfoLvlOil_C EG_DiagcSnsrInfoOvspd_C EG_DiagcSnsrInfoPAirBoost_C EG_DiagcSnsrInfoPAmbAir_C EG_DiagcSnsrInfoPFu_C EG_DiagcSnsrInfoPOil_C EG_DiagcSnsrInfoPRail_C EG_DiagcSnsrInfoTAirBoost_C EG_DiagcSnsrInfoTAmbAir_C EG_DiagcSnsrInfoTCoolt_C EG_DiagcSnsrInfoTEcu_C EG_DiagcSnsrInfoTFu_C EG_DiagcSnsrInfoTOil_C EG_DiagcSnsrInfoUClmp30_C EG_DiagcSnsrInfoWtrInFu_C /end REF_CHARACTERISTIC
/end GROUP
/begin GROUP S737_Debouncer "EcuIntgdSwGend/ControlSoftware/WarnMong/Warning-Reduction-Shutdown Functions/Return To Normal/Debouncer" /begin REF_MEASUREMENT WM_TiElpdNEngDetdThdRTN WM_bNEngOverThdRTN /end REF_MEASUREMENT /end GROUP
/begin GROUP S738_Air_Boost_Over_Temperature "EcuIntgdSwGend/ControlSoftware/WarnMong/Warning-Reduction-Shutdown Functions/Temperature/Air Boost Over Temperature"
 /begin REF_CHARACTERISTIC EG_Mask32Bit0_C EG_NmrInt0_C EG_NmrInt1_C EG_NmrInt2_C EG_NmrInt3_C EG_TsSw20_C EG_bFlgFalse_C EG_bFlgTrue_C WM_MaskRTNForErrTAirBoostOv_P WM_MaskRctnForTAirBoostOvLvl1Err_P WM_MaskRctnForTAirBoostOvLvl2Err_P WM_MaskRctnForTAirBoostOvLvl3Err_P WM_MaskTAirBoostOvEnaCond_P WM_TAirBoostOvDesLvlQnty_P WM_TAirBoostOvHysDeacLvl1_P WM_TAirBoostOvHysDeacLvl2_P WM_TAirBoostOvHysDeacLvl3_P WM_TAirBoostOvLvl1_M WM_TAirBoostOvLvl2_M WM_TAirBoostOvLvl3_M WM_TiTAirBoostOvDebHi_P WM_TiTAirBoostOvDebLo_P /end REF_CHARACTERISTIC
 /begin REF_MEASUREMENT WM_MaskRctnForTAirBoostOvErr WM_bErrTAirBoostOv WM_bErrTAirBoostOvLvl1 WM_bErrTAirBoostOvLvl2 WM_bErrTAirBoostOvLvl3 WM_bTAirBoostOvEna /end REF_MEASUREMENT
/end GROUP
/begin GROUP S738_Air_Boost_Under_Temperature "EcuIntgdSwGend/ControlSoftware/WarnMong/Warning-Reduction-Shutdown Functions/Temperature/Air Boost Under Temperature"
 /begin REF_CHARACTERISTIC EG_Mask32Bit0_C EG_NmrInt0_C EG_NmrInt1_C EG_NmrInt2_C EG_NmrInt3_C EG_TsSw20_C EG_bFlgFalse_C EG_bFlgTrue_C WM_MaskRTNForErrTAirBoostUnd_P WM_MaskRctnForTAirBoostUndLvl1Err_P WM_MaskRctnForTAirBoostUndLvl2Err_P WM_MaskRctnForTAirBoostUndLvl3Err_P WM_MaskTAirBoostUndEnaCond_P WM_TAirBoostUndDesLvlQnty_P WM_TAirBoostUndHysDeacLvl1_P WM_TAirBoostUndHysDeacLvl2_P WM_TAirBoostUndHysDeacLvl3_P WM_TAirBoostUndLvl1_M WM_TAirBoostUndLvl2_M WM_TAirBoostUndLvl3_M WM_TiTAirBoostUndDebHi_P WM_TiTAirBoostUndDebLo_P /end REF_CHARACTERISTIC
 /begin REF_MEASUREMENT WM_MaskRctnForTAirBoostUndErr WM_bErrTAirBoostUnd WM_bErrTAirBoostUndLvl1 WM_bErrTAirBoostUndLvl2 WM_bErrTAirBoostUndLvl3 WM_bTAirBoostUndEna /end REF_MEASUREMENT
/end GROUP
/begin GROUP S738_Ambient_Air_Over_Temperature "EcuIntgdSwGend/ControlSoftware/WarnMong/Warning-Reduction-Shutdown Functions/Temperature/Ambient Air Over Temperature"
 /begin REF_CHARACTERISTIC EG_Mask32Bit0_C EG_NmrInt0_C EG_NmrInt1_C EG_NmrInt2_C EG_NmrInt3_C EG_TsSw20_C EG_bFlgFalse_C EG_bFlgTrue_C WM_MaskRTNForErrTAmbAirOv_P WM_MaskRctnForTAmbAirOvLvl1Err_P WM_MaskRctnForTAmbAirOvLvl2Err_P WM_MaskRctnForTAmbAirOvLvl3Err_P WM_MaskTAmbAirOvEnaCond_P WM_TAmbAirOvDesLvlQnty_P WM_TAmbAirOvHysDeacLvl1_P WM_TAmbAirOvHysDeacLvl2_P WM_TAmbAirOvHysDeacLvl3_P WM_TAmbAirOvLvl1_M WM_TAmbAirOvLvl2_M WM_TAmbAirOvLvl3_M WM_TiTAmbAirOvDebHi_P WM_TiTAmbAirOvDebLo_P /end REF_CHARACTERISTIC
 /begin REF_MEASUREMENT WM_MaskRctnForTAmbAirOvErr WM_bErrTAmbAirOv WM_bErrTAmbAirOvLvl1 WM_bErrTAmbAirOvLvl2 WM_bErrTAmbAirOvLvl3 WM_bTAmbAirOvEna /end REF_MEASUREMENT
/end GROUP
/begin GROUP S738_Ambient_Air_Under_Temperature "EcuIntgdSwGend/ControlSoftware/WarnMong/Warning-Reduction-Shutdown Functions/Temperature/Ambient Air Under Temperature"
 /begin REF_CHARACTERISTIC EG_Mask32Bit0_C EG_NmrInt0_C EG_NmrInt1_C EG_NmrInt2_C EG_NmrInt3_C EG_TsSw20_C EG_bFlgFalse_C EG_bFlgTrue_C WM_MaskRTNForErrTAmbAirUnd_P WM_MaskRctnForTAmbAirUndLvl1Err_P WM_MaskRctnForTAmbAirUndLvl2Err_P WM_MaskRctnForTAmbAirUndLvl3Err_P WM_MaskTAmbAirUndEnaCond_P WM_TAmbAirUndDesLvlQnty_P WM_TAmbAirUndHysDeacLvl1_P WM_TAmbAirUndHysDeacLvl2_P WM_TAmbAirUndHysDeacLvl3_P WM_TAmbAirUndLvl1_M WM_TAmbAirUndLvl2_M WM_TAmbAirUndLvl3_M WM_TiTAmbAirUndDebHi_P WM_TiTAmbAirUndDebLo_P /end REF_CHARACTERISTIC
 /begin REF_MEASUREMENT WM_MaskRctnForTAmbAirUndErr WM_bErrTAmbAirUnd WM_bErrTAmbAirUndLvl1 WM_bErrTAmbAirUndLvl2 WM_bErrTAmbAirUndLvl3 WM_bTAmbAirUndEna /end REF_MEASUREMENT
/end GROUP
/begin GROUP S738_Coolant_Over_Temperature "EcuIntgdSwGend/ControlSoftware/WarnMong/Warning-Reduction-Shutdown Functions/Temperature/Coolant Over Temperature"
 /begin REF_CHARACTERISTIC EG_Mask32Bit0_C EG_NmrInt0_C EG_NmrInt1_C EG_NmrInt2_C EG_NmrInt3_C EG_TsSw20_C EG_bFlgFalse_C EG_bFlgTrue_C WM_MaskRTNForErrTCooltOv_P WM_MaskRctnForTCooltOvLvl1Err_P WM_MaskRctnForTCooltOvLvl2Err_P WM_MaskRctnForTCooltOvLvl3Err_P WM_MaskTCooltOvEnaCond_P WM_TCooltOvDesLvlQnty_P WM_TCooltOvHysDeacLvl1_P WM_TCooltOvHysDeacLvl2_P WM_TCooltOvHysDeacLvl3_P WM_TCooltOvLvl1_M WM_TCooltOvLvl2_M WM_TCooltOvLvl3_M WM_TiTCooltOvDebHi_P WM_TiTCooltOvDebLo_P /end REF_CHARACTERISTIC
 /begin REF_MEASUREMENT WM_MaskRctnForTCooltOvErr WM_bErrTCooltOv WM_bErrTCooltOvLvl1 WM_bErrTCooltOvLvl2 WM_bErrTCooltOvLvl3 WM_bTCooltOvEna /end REF_MEASUREMENT
/end GROUP
/begin GROUP S738_Coolant_Under_Temperature "EcuIntgdSwGend/ControlSoftware/WarnMong/Warning-Reduction-Shutdown Functions/Temperature/Coolant Under Temperature"
 /begin REF_CHARACTERISTIC EG_Mask32Bit0_C EG_NmrInt0_C EG_NmrInt1_C EG_NmrInt2_C EG_NmrInt3_C EG_TsSw20_C EG_bFlgFalse_C EG_bFlgTrue_C WM_MaskRTNForErrTCooltUnd_P WM_MaskRctnForTCooltUndLvl1Err_P WM_MaskRctnForTCooltUndLvl2Err_P WM_MaskRctnForTCooltUndLvl3Err_P WM_MaskTCooltUndEnaCond_P WM_TCooltUndDesLvlQnty_P WM_TCooltUndHysDeacLvl1_P WM_TCooltUndHysDeacLvl2_P WM_TCooltUndHysDeacLvl3_P WM_TCooltUndLvl1_M WM_TCooltUndLvl2_M WM_TCooltUndLvl3_M WM_TiTCooltUndDebHi_P WM_TiTCooltUndDebLo_P /end REF_CHARACTERISTIC
 /begin REF_MEASUREMENT WM_MaskRctnForTCooltUndErr WM_bErrTCooltUnd WM_bErrTCooltUndLvl1 WM_bErrTCooltUndLvl2 WM_bErrTCooltUndLvl3 WM_bTCooltUndEna /end REF_MEASUREMENT
/end GROUP
/begin GROUP S738_ECU_Temperature "EcuIntgdSwGend/ControlSoftware/WarnMong/Warning-Reduction-Shutdown Functions/Temperature/ECU Temperature"
 /begin REF_CHARACTERISTIC EG_Mask32Bit0_C EG_NmrInt0_C EG_NmrInt1_C EG_NmrInt2_C EG_NmrInt3_C EG_TsSw20_C EG_bFlgFalse_C EG_bFlgTrue_C WM_MaskRTNForErrTEcu_P WM_MaskRctnForTEcuLvl1Err_P WM_MaskRctnForTEcuLvl2Err_P WM_MaskRctnForTEcuLvl3Err_P WM_MaskTEcuEnaCond_P WM_TEcuDesLvlQnty_P WM_TEcuHysDeacLvl1_P WM_TEcuHysDeacLvl2_P WM_TEcuHysDeacLvl3_P WM_TEcuLvl1_P WM_TEcuLvl2_P WM_TEcuLvl3_P WM_TiTEcuDebHi_P WM_TiTEcuDebLo_P /end REF_CHARACTERISTIC
 /begin REF_MEASUREMENT WM_MaskRctnForTEcuErr WM_bErrTEcu WM_bErrTEcuLvl1 WM_bErrTEcuLvl2 WM_bErrTEcuLvl3 WM_bTEcuEna /end REF_MEASUREMENT
/end GROUP
/begin GROUP S738_Fuel_Over_Temperature "EcuIntgdSwGend/ControlSoftware/WarnMong/Warning-Reduction-Shutdown Functions/Temperature/Fuel Over Temperature"
 /begin REF_CHARACTERISTIC EG_Mask32Bit0_C EG_NmrInt0_C EG_NmrInt1_C EG_NmrInt2_C EG_NmrInt3_C EG_TsSw20_C EG_bFlgFalse_C EG_bFlgTrue_C WM_MaskRTNForErrTFuOv_P WM_MaskRctnForTFuOvLvl1Err_P WM_MaskRctnForTFuOvLvl2Err_P WM_MaskRctnForTFuOvLvl3Err_P WM_MaskTFuOvEnaCond_P WM_TFuOvDesLvlQnty_P WM_TFuOvHysDeacLvl1_P WM_TFuOvHysDeacLvl2_P WM_TFuOvHysDeacLvl3_P WM_TFuOvLvl1_M WM_TFuOvLvl2_M WM_TFuOvLvl3_M WM_TiTFuOvDebHi_P WM_TiTFuOvDebLo_P /end REF_CHARACTERISTIC
 /begin REF_MEASUREMENT WM_MaskRctnForTFuOvErr WM_bErrTFuOv WM_bErrTFuOvLvl1 WM_bErrTFuOvLvl2 WM_bErrTFuOvLvl3 WM_bTFuOvEna /end REF_MEASUREMENT
/end GROUP
/begin GROUP S738_Oil_Over_Temperature "EcuIntgdSwGend/ControlSoftware/WarnMong/Warning-Reduction-Shutdown Functions/Temperature/Oil Over Temperature"
 /begin REF_CHARACTERISTIC EG_Mask32Bit0_C EG_NmrInt0_C EG_NmrInt1_C EG_NmrInt2_C EG_NmrInt3_C EG_TsSw20_C EG_bFlgFalse_C EG_bFlgTrue_C WM_MaskRTNForErrTOilOv_P WM_MaskRctnForTOilOvLvl1Err_P WM_MaskRctnForTOilOvLvl2Err_P WM_MaskRctnForTOilOvLvl3Err_P WM_MaskTOilOvEnaCond_P WM_TOilOvDesLvlQnty_P WM_TOilOvHysDeacLvl1_P WM_TOilOvHysDeacLvl2_P WM_TOilOvHysDeacLvl3_P WM_TOilOvLvl1_M WM_TOilOvLvl2_M WM_TOilOvLvl3_M WM_TiTOilOvDebHi_P WM_TiTOilOvDebLo_P /end REF_CHARACTERISTIC
 /begin REF_MEASUREMENT WM_MaskRctnForTOilOvErr WM_bErrTOilOv WM_bErrTOilOvLvl1 WM_bErrTOilOvLvl2 WM_bErrTOilOvLvl3 WM_bTOilOvEna /end REF_MEASUREMENT
/end GROUP
/begin GROUP S738_Oil_Under_Temperature "EcuIntgdSwGend/ControlSoftware/WarnMong/Warning-Reduction-Shutdown Functions/Temperature/Oil Under Temperature"
 /begin REF_CHARACTERISTIC EG_Mask32Bit0_C EG_NmrInt0_C EG_NmrInt1_C EG_NmrInt2_C EG_NmrInt3_C EG_TsSw20_C EG_bFlgFalse_C EG_bFlgTrue_C WM_MaskRTNForErrTOilUnd_P WM_MaskRctnForTOilUndLvl1Err_P WM_MaskRctnForTOilUndLvl2Err_P WM_MaskRctnForTOilUndLvl3Err_P WM_MaskTOilUndEnaCond_P WM_TOilUndDesLvlQnty_P WM_TOilUndHysDeacLvl1_P WM_TOilUndHysDeacLvl2_P WM_TOilUndHysDeacLvl3_P WM_TOilUndLvl1_M WM_TOilUndLvl2_M WM_TOilUndLvl3_M WM_TiTOilUndDebHi_P WM_TiTOilUndDebLo_P /end REF_CHARACTERISTIC
 /begin REF_MEASUREMENT WM_MaskRctnForTOilUndErr WM_bErrTOilUnd WM_bErrTOilUndLvl1 WM_bErrTOilUndLvl2 WM_bErrTOilUndLvl3 WM_bTOilUndEna /end REF_MEASUREMENT
/end GROUP
/begin GROUP S897_avoidzerodivision_max "EcuIntgdSwGend/ControlSoftware/WgtCtl/TurbochargerSpeedEstimation/AirMassFlowCalc/avoidzerodivision_max" /begin REF_CHARACTERISTIC EG_NmrIntEps_C /end REF_CHARACTERISTIC /begin REF_MEASUREMENT WgC_AirMassFlowCalcZeroDiv /end REF_MEASUREMENT /end GROUP
/begin GROUP S901_avoidzerodivision_single "EcuIntgdSwGend/ControlSoftware/WgtCtl/TurbochargerSpeedEstimation/CompressorPressureRatio/avoidzerodivision_single" /begin REF_CHARACTERISTIC EG_NmrSng0_C EG_NmrSng1_C /end REF_CHARACTERISTIC /end GROUP
/begin GROUP S908_PID_Controller "EcuIntgdSwGend/ControlSoftware/WgtCtl/Wastegate Control/BoostPressurePID/PID_Controller" /begin SUB_GROUP S911_clamping_unit /end SUB_GROUP /begin REF_CHARACTERISTIC EG_NmrInt0_C /end REF_CHARACTERISTIC
 /begin REF_MEASUREMENT WgC_CoeffKdFbOut WgC_CoeffKdOut WgC_CoeffKiClampOut WgC_CoeffKiClampPreSatOut WgC_CoeffKiClampSwtchOut WgC_CoeffKiOut WgC_CoeffKpOut WgC_DutyWgtVlvPID /end REF_MEASUREMENT
/end GROUP
/begin GROUP S26_clamping_unit "EcuIntgdSwGend/ControlSoftware/CrsCtrl/CruiseControl/CruiseControlPIDController/PID_Controller/clamping_unit" /begin SUB_GROUP S27_deadzone /end SUB_GROUP /begin REF_CHARACTERISTIC EG_NmrSng0_C /end REF_CHARACTERISTIC /end GROUP
/begin GROUP S31_Debouncer2 "EcuIntgdSwGend/ControlSoftware/CrsCtrl/Engine Brake Activation via Cruise Control/Engine Brake Level Activation Condition/Engine Brake Level 1 Activation Condition/Debouncer2" /begin REF_MEASUREMENT CrsCtrl_TiElpdEngBrkLvl1Actvn /end REF_MEASUREMENT /end GROUP
/begin GROUP S31_SetRstLtch "EcuIntgdSwGend/ControlSoftware/CrsCtrl/Engine Brake Activation via Cruise Control/Engine Brake Level Activation Condition/Engine Brake Level 1 Activation Condition/SetRstLtch" /begin REF_CHARACTERISTIC EG_bFlgFalse_C EG_bFlgTrue_C /end REF_CHARACTERISTIC /begin REF_MEASUREMENT CrsCtrl_bEngBrkLvl1Ena /end REF_MEASUREMENT /end GROUP
/begin GROUP S32_Debouncer "EcuIntgdSwGend/ControlSoftware/CrsCtrl/Engine Brake Activation via Cruise Control/Engine Brake Level Activation Condition/Engine Brake Level 2 Activation Condition/Debouncer" /begin REF_MEASUREMENT CrsCtrl_TiElpdEngBrkLvl2Actvn /end REF_MEASUREMENT /end GROUP
/begin GROUP S32_SetRstLtch3 "EcuIntgdSwGend/ControlSoftware/CrsCtrl/Engine Brake Activation via Cruise Control/Engine Brake Level Activation Condition/Engine Brake Level 2 Activation Condition/SetRstLtch3" /begin REF_CHARACTERISTIC EG_bFlgFalse_C EG_bFlgTrue_C /end REF_CHARACTERISTIC /begin REF_MEASUREMENT CrsCtrl_bEngBrkLvl2Ena /end REF_MEASUREMENT /end GROUP
/begin GROUP S56_Anti_Jerk_Algorithm "EcuIntgdSwGend/ControlSoftware/DesTqClcn/Running Mode/Driver Demand Torque Calculation/N-Map Interpolation for Brake Torque/Anti-Jerk Algorithm"
 /begin REF_CHARACTERISTIC DTqC_DynRateLoLim_P DTqC_DynRateUpLim_P DTqC_bAcvRateLimOvs_P /end REF_CHARACTERISTIC
 /begin REF_MEASUREMENT DTqC_DynRateLimr DTqC_TqCtlTqBrk /end REF_MEASUREMENT
/end GROUP
/begin GROUP S56_avoidzerodivision_single "EcuIntgdSwGend/ControlSoftware/DesTqClcn/Running Mode/Driver Demand Torque Calculation/N-Map Interpolation for Brake Torque/avoidzerodivision_single" /begin REF_CHARACTERISTIC EG_NmrSng0_C EG_NmrSng1_C /end REF_CHARACTERISTIC /end GROUP
/begin GROUP S56_avoidzerodivision_single1 "EcuIntgdSwGend/ControlSoftware/DesTqClcn/Running Mode/Driver Demand Torque Calculation/N-Map Interpolation for Brake Torque/avoidzerodivision_single1" /begin REF_CHARACTERISTIC EG_NmrSng0_C EG_NmrSng1_C /end REF_CHARACTERISTIC /end GROUP
/begin GROUP S64_PID_Controller "EcuIntgdSwGend/ControlSoftware/DesTqClcn/Running Mode/EndSpeed Governor/EndSpeed Soft Limit Governor/PID_Controller" /begin SUB_GROUP S67_clamping_unit /end SUB_GROUP /begin REF_CHARACTERISTIC EG_NmrSng0_C /end REF_CHARACTERISTIC
 /begin REF_MEASUREMENT DTqC_CoeffKdFbOutEndSpd DTqC_CoeffKdOutEndSpd DTqC_CoeffKiClampOutEndSpd DTqC_CoeffKiClampPreSatOutEndSpd DTqC_CoeffKiClampSwtchOutEndSpd DTqC_CoeffKiOutEndSpd DTqC_CoeffKpOutEndSpd DTqC_TqSoftLimPID /end REF_MEASUREMENT
/end GROUP
/begin GROUP S65_Hard_Limit_Latching "EcuIntgdSwGend/ControlSoftware/DesTqClcn/Running Mode/EndSpeed Governor/Engine Speed Hysteresis for Hard Limitation/Hard Limit Latching" /begin SUB_GROUP S70_CompTimer_Strt S70_Neg_Edge S70_Pos_Edge /end SUB_GROUP
 /begin REF_CHARACTERISTIC DTqC_AcvHardLimLtchOvs_P DTqC_AcvHardLimLtchOvv_P DTqC_TiMaxAcvHardLimLtch_P EG_NmrSng0_C EG_TsSw_C /end REF_CHARACTERISTIC
 /begin REF_MEASUREMENT DTqC_AcvHardLimLtch /end REF_MEASUREMENT
/end GROUP
/begin GROUP S75_Integrator_Reset "EcuIntgdSwGend/ControlSoftware/DesTqClcn/Running Mode/Idle Speed Controller/PID_Controller/Integrator Reset"
 /begin REF_CHARACTERISTIC DTqC_IdleIntglRstEnaSwt_P DTqC_IntglRstCoeffKiThd_P DTqC_IntglRstIdleErrThd_P /end REF_CHARACTERISTIC
/end GROUP
/begin GROUP S75_clamping_unit "EcuIntgdSwGend/ControlSoftware/DesTqClcn/Running Mode/Idle Speed Controller/PID_Controller/clamping_unit" /begin SUB_GROUP S77_deadzone /end SUB_GROUP /begin REF_CHARACTERISTIC EG_NmrSng0_C /end REF_CHARACTERISTIC /end GROUP
/begin GROUP S79_PID_Controller1 "EcuIntgdSwGend/ControlSoftware/DesTqClcn/Running Mode/TSC1 Control Purpose/TSC1 Request for Speed Control/PID_Controller1" /begin SUB_GROUP S80_clamping_unit /end SUB_GROUP /begin REF_CHARACTERISTIC EG_NmrSng0_C /end REF_CHARACTERISTIC /begin REF_MEASUREMENT DTqC_TSC1SpdReqTq /end REF_MEASUREMENT /end GROUP
/begin GROUP S106_LowPassFilter1 "EcuIntgdSwGend/ControlSoftware/EcuInpPrcsg/Additionals/Cylinder Balancing/Cylinder 1 Speed Error Calculation/LowPassFilter1" /begin REF_CHARACTERISTIC EG_NmrSng0_C EG_bFlgTrue_C /end REF_CHARACTERISTIC /end GROUP
/begin GROUP S106_LowPassFilter2 "EcuIntgdSwGend/ControlSoftware/EcuInpPrcsg/Additionals/Cylinder Balancing/Cylinder 1 Speed Error Calculation/LowPassFilter2" /begin REF_CHARACTERISTIC EG_NmrSng0_C EG_bFlgTrue_C /end REF_CHARACTERISTIC /end GROUP
/begin GROUP S107_LowPassFilter3 "EcuIntgdSwGend/ControlSoftware/EcuInpPrcsg/Additionals/Cylinder Balancing/Cylinder 2 Speed Error Calculation/LowPassFilter3" /begin REF_CHARACTERISTIC EG_NmrSng0_C EG_bFlgTrue_C /end REF_CHARACTERISTIC /end GROUP
/begin GROUP S108_LowPassFilter4 "EcuIntgdSwGend/ControlSoftware/EcuInpPrcsg/Additionals/Cylinder Balancing/Cylinder 3 Speed Error Calculation/LowPassFilter4" /begin REF_CHARACTERISTIC EG_NmrSng0_C EG_bFlgTrue_C /end REF_CHARACTERISTIC /end GROUP
/begin GROUP S109_LowPassFilter5 "EcuIntgdSwGend/ControlSoftware/EcuInpPrcsg/Additionals/Cylinder Balancing/Cylinder 4 Speed Error Calculation/LowPassFilter5" /begin REF_CHARACTERISTIC EG_NmrSng0_C EG_bFlgTrue_C /end REF_CHARACTERISTIC /end GROUP
/begin GROUP S110_LowPassFilter6 "EcuIntgdSwGend/ControlSoftware/EcuInpPrcsg/Additionals/Cylinder Balancing/Cylinder 5 Speed Error Calculation/LowPassFilter6" /begin REF_CHARACTERISTIC EG_NmrSng0_C EG_bFlgTrue_C /end REF_CHARACTERISTIC /end GROUP
/begin GROUP S111_LowPassFilter7 "EcuIntgdSwGend/ControlSoftware/EcuInpPrcsg/Additionals/Cylinder Balancing/Cylinder 6 Speed Error Calculation/LowPassFilter7" /begin REF_CHARACTERISTIC EG_NmrSng0_C EG_bFlgTrue_C /end REF_CHARACTERISTIC /end GROUP
/begin GROUP S456_clamping_unit "EcuIntgdSwGend/ControlSoftware/InjCtl/Cylinder Balancing/Cylinder Balancing PID Controllers /PID Controller for Cylinder 1/clamping_unit" /begin SUB_GROUP S462_deadzone /end SUB_GROUP /begin REF_CHARACTERISTIC EG_NmrSng0_C /end REF_CHARACTERISTIC /end GROUP
/begin GROUP S457_clamping_unit "EcuIntgdSwGend/ControlSoftware/InjCtl/Cylinder Balancing/Cylinder Balancing PID Controllers /PID Controller for Cylinder 2/clamping_unit" /begin SUB_GROUP S464_deadzone /end SUB_GROUP /begin REF_CHARACTERISTIC EG_NmrSng0_C /end REF_CHARACTERISTIC /end GROUP
/begin GROUP S458_clamping_unit "EcuIntgdSwGend/ControlSoftware/InjCtl/Cylinder Balancing/Cylinder Balancing PID Controllers /PID Controller for Cylinder 3/clamping_unit" /begin SUB_GROUP S466_deadzone /end SUB_GROUP /begin REF_CHARACTERISTIC EG_NmrSng0_C /end REF_CHARACTERISTIC /end GROUP
/begin GROUP S459_clamping_unit "EcuIntgdSwGend/ControlSoftware/InjCtl/Cylinder Balancing/Cylinder Balancing PID Controllers /PID Controller for Cylinder 4/clamping_unit" /begin SUB_GROUP S468_deadzone /end SUB_GROUP /begin REF_CHARACTERISTIC EG_NmrSng0_C /end REF_CHARACTERISTIC /end GROUP
/begin GROUP S460_clamping_unit "EcuIntgdSwGend/ControlSoftware/InjCtl/Cylinder Balancing/Cylinder Balancing PID Controllers /PID Controller for Cylinder 5/clamping_unit" /begin SUB_GROUP S470_deadzone /end SUB_GROUP /begin REF_CHARACTERISTIC EG_NmrSng0_C /end REF_CHARACTERISTIC /end GROUP
/begin GROUP S461_clamping_unit "EcuIntgdSwGend/ControlSoftware/InjCtl/Cylinder Balancing/Cylinder Balancing PID Controllers /PID Controller for Cylinder 6/clamping_unit" /begin SUB_GROUP S472_deadzone /end SUB_GROUP /begin REF_CHARACTERISTIC EG_NmrSng0_C /end REF_CHARACTERISTIC /end GROUP
/begin GROUP S572_avoidzerodivision_single "EcuIntgdSwGend/ControlSoftware/InjCtl/Start of Injection Angle for Pilot and Main Injection/Main SOI Reference Calculation/N-Map Interpolation for Main Start of Injection/avoidzerodivision_single" /begin REF_CHARACTERISTIC EG_NmrSng0_C EG_NmrSng1_C /end REF_CHARACTERISTIC /end GROUP
/begin GROUP S572_avoidzerodivision_single1 "EcuIntgdSwGend/ControlSoftware/InjCtl/Start of Injection Angle for Pilot and Main Injection/Main SOI Reference Calculation/N-Map Interpolation for Main Start of Injection/avoidzerodivision_single1" /begin REF_CHARACTERISTIC EG_NmrSng0_C EG_NmrSng1_C /end REF_CHARACTERISTIC /end GROUP
/begin GROUP S575_avoidzerodivision_single "EcuIntgdSwGend/ControlSoftware/InjCtl/Start of Injection Angle for Pilot and Main Injection/Pilot SOI Reference Calculation/N-Map Interpolation for Pre Start of Injection /avoidzerodivision_single" /begin REF_CHARACTERISTIC EG_NmrSng0_C EG_NmrSng1_C /end REF_CHARACTERISTIC /end GROUP
/begin GROUP S575_avoidzerodivision_single1 "EcuIntgdSwGend/ControlSoftware/InjCtl/Start of Injection Angle for Pilot and Main Injection/Pilot SOI Reference Calculation/N-Map Interpolation for Pre Start of Injection /avoidzerodivision_single1" /begin REF_CHARACTERISTIC EG_NmrSng0_C EG_NmrSng1_C /end REF_CHARACTERISTIC /end GROUP
/begin GROUP S606_deadzone "EcuIntgdSwGend/ControlSoftware/PtoCtrl/PTO PID/PID_Controller/clamping_unit/deadzone" /begin REF_CHARACTERISTIC EG_NmrSng0_C /end REF_CHARACTERISTIC /end GROUP
/begin GROUP S620_Debouncer "EcuIntgdSwGend/ControlSoftware/RailPGovr/Rail Pressure PID Controller/VCV Opening Percentage PID Controller/Integrator Reset/Debouncer" /begin REF_MEASUREMENT RPG_TiElpdCoeffKiRst /end REF_MEASUREMENT /end GROUP
/begin GROUP S621_deadzone "EcuIntgdSwGend/ControlSoftware/RailPGovr/Rail Pressure PID Controller/VCV Opening Percentage PID Controller/clamping_unit/deadzone" /begin REF_CHARACTERISTIC EG_NmrSng0_C /end REF_CHARACTERISTIC /end GROUP
/begin GROUP S642_clamping_unit "EcuIntgdSwGend/ControlSoftware/SpdLimr/Speed Limiter PID/SpeedLimiterPIDController/PID_Controller/clamping_unit" /begin SUB_GROUP S643_deadzone /end SUB_GROUP /begin REF_CHARACTERISTIC EG_NmrSng0_C /end REF_CHARACTERISTIC /end GROUP
/begin GROUP S739_Hysteresis_Switch "EcuIntgdSwGend/ControlSoftware/WarnMong/Warning-Reduction-Shutdown Functions/Global Enable/Engine Speed Level Check/Hysteresis_Switch" /begin REF_CHARACTERISTIC EG_NmrSng0_C EG_NmrSng1_C /end REF_CHARACTERISTIC /begin REF_MEASUREMENT WM_bNEngOverThd1 /end REF_MEASUREMENT /end GROUP
/begin GROUP S739_Hysteresis_Switch1 "EcuIntgdSwGend/ControlSoftware/WarnMong/Warning-Reduction-Shutdown Functions/Global Enable/Engine Speed Level Check/Hysteresis_Switch1" /begin REF_CHARACTERISTIC EG_NmrSng0_C EG_NmrSng1_C /end REF_CHARACTERISTIC /begin REF_MEASUREMENT WM_bNEngOverThd2 /end REF_MEASUREMENT /end GROUP
/begin GROUP S739_Hysteresis_Switch2 "EcuIntgdSwGend/ControlSoftware/WarnMong/Warning-Reduction-Shutdown Functions/Global Enable/Engine Speed Level Check/Hysteresis_Switch2" /begin REF_CHARACTERISTIC EG_NmrSng0_C EG_NmrSng1_C /end REF_CHARACTERISTIC /begin REF_MEASUREMENT WM_bNEngOverThd3 /end REF_MEASUREMENT /end GROUP
/begin GROUP S739_Hysteresis_Switch3 "EcuIntgdSwGend/ControlSoftware/WarnMong/Warning-Reduction-Shutdown Functions/Global Enable/Engine Speed Level Check/Hysteresis_Switch3" /begin REF_CHARACTERISTIC EG_NmrSng0_C EG_NmrSng1_C /end REF_CHARACTERISTIC /begin REF_MEASUREMENT WM_bNEngOverThd4 /end REF_MEASUREMENT /end GROUP
/begin GROUP S739_Hysteresis_Switch4 "EcuIntgdSwGend/ControlSoftware/WarnMong/Warning-Reduction-Shutdown Functions/Global Enable/Engine Speed Level Check/Hysteresis_Switch4" /begin REF_CHARACTERISTIC EG_NmrSng0_C EG_NmrSng1_C /end REF_CHARACTERISTIC /begin REF_MEASUREMENT WM_bNEngOverThd5 /end REF_MEASUREMENT /end GROUP
/begin GROUP S739_Hysteresis_Switch5 "EcuIntgdSwGend/ControlSoftware/WarnMong/Warning-Reduction-Shutdown Functions/Global Enable/Engine Speed Level Check/Hysteresis_Switch5" /begin REF_CHARACTERISTIC EG_NmrSng0_C EG_NmrSng1_C /end REF_CHARACTERISTIC /begin REF_MEASUREMENT WM_bNEngOverThd6 /end REF_MEASUREMENT /end GROUP
/begin GROUP S739_Hysteresis_Switch6 "EcuIntgdSwGend/ControlSoftware/WarnMong/Warning-Reduction-Shutdown Functions/Global Enable/Engine Speed Level Check/Hysteresis_Switch6" /begin REF_CHARACTERISTIC EG_NmrSng0_C EG_NmrSng1_C /end REF_CHARACTERISTIC /begin REF_MEASUREMENT WM_bNEngOverThd7 /end REF_MEASUREMENT /end GROUP
/begin GROUP S764_Low_and_Not_Control_Fuel_System_Message "EcuIntgdSwGend/ControlSoftware/WarnMong/Warning-Reduction-Shutdown Functions/Pressure/Rail Under Pressure/Low and Not Control Fuel System Message" /begin SUB_GROUP S775_Debouncer1 /end SUB_GROUP
 /begin REF_CHARACTERISTIC EG_NmrSng0_C EG_TsSw20_C WM_NEngThdPRailNotCtld_P WM_PRailNotCtldThd_P WM_SteadyFlgEnaForPRailNotCtld_P WM_TiAcvWarnPRailNotCtldDeb_P WM_bPRailNotCtldMsgWarnOvs_P WM_bPRailNotCtldMsgWarnOvv_P /end REF_CHARACTERISTIC
 /begin REF_MEASUREMENT WM_bPRailNotCtldMsg WM_bTiAcvWarnPRailNotCtldDeb /end REF_MEASUREMENT
/end GROUP
/begin GROUP S777_BitwiseANDMask "EcuIntgdSwGend/ControlSoftware/WarnMong/Warning-Reduction-Shutdown Functions/Reaction/Bit Extract/BitwiseANDMask" /begin REF_MEASUREMENT WM_bAcvAmberWarn /end REF_MEASUREMENT /end GROUP
/begin GROUP S777_BitwiseANDMask4 "EcuIntgdSwGend/ControlSoftware/WarnMong/Warning-Reduction-Shutdown Functions/Reaction/Bit Extract/BitwiseANDMask4" /begin REF_MEASUREMENT WM_bAcvEmgcyShtdwnLamp /end REF_MEASUREMENT /end GROUP
/begin GROUP S778_Error_Combinations "EcuIntgdSwGend/ControlSoftware/WarnMong/Warning-Reduction-Shutdown Functions/Reaction/Error List/Error Combinations"
 /begin SUB_GROUP S792_SetResetFaultReaction S792_SetResetFaultReaction1 S792_SetResetFaultReaction2 S792_SetResetFaultReaction3 S792_SetResetFaultReaction4 /end SUB_GROUP
 /begin REF_CHARACTERISTIC WM_MaskRTNForErrComb1_P WM_MaskRTNForErrComb2_P WM_MaskRTNForErrComb3_P WM_MaskRTNForErrComb4_P WM_MaskRTNForErrComb5_P WM_MaskRctnForErrComb1_P WM_MaskRctnForErrComb2_P WM_MaskRctnForErrComb3_P WM_MaskRctnForErrComb4_P WM_MaskRctnForErrComb5_P WM_MaskTC1ErrComb1_P WM_MaskTC1ErrComb2_P WM_MaskTC1ErrComb3_P WM_MaskTC1ErrComb4_P WM_MaskTC1ErrComb5_P WM_MaskTC2ErrComb1_P WM_MaskTC2ErrComb2_P WM_MaskTC2ErrComb3_P WM_MaskTC2ErrComb4_P WM_MaskTC2ErrComb5_P WM_MaskTC3ErrComb1_P WM_MaskTC3ErrComb2_P WM_MaskTC3ErrComb3_P WM_MaskTC3ErrComb4_P WM_MaskTC3ErrComb5_P WM_MaskTC4ErrComb1_P WM_MaskTC4ErrComb2_P WM_MaskTC4ErrComb3_P WM_MaskTC4ErrComb4_P WM_MaskTC4ErrComb5_P /end REF_CHARACTERISTIC
 /begin REF_MEASUREMENT WM_bErrComb1 WM_bErrComb2 WM_bErrComb3 WM_bErrComb4 WM_bErrComb5 /end REF_MEASUREMENT
/end GROUP
/begin GROUP S778_TC1 "EcuIntgdSwGend/ControlSoftware/WarnMong/Warning-Reduction-Shutdown Functions/Reaction/Error List/TC1"
 /begin REF_CHARACTERISTIC EG_Mask32Bit0_C EG_Mask32Bit1024_C EG_Mask32Bit1048576_C EG_Mask32Bit1073741824_C EG_Mask32Bit128_C EG_Mask32Bit131072_C EG_Mask32Bit134217728_C EG_Mask32Bit16384_C EG_Mask32Bit16777216_C EG_Mask32Bit16_C EG_Mask32Bit1_C EG_Mask32Bit2048_C EG_Mask32Bit2097152_C EG_Mask32Bit2147483648_C EG_Mask32Bit256_C EG_Mask32Bit262144_C EG_Mask32Bit268435456_C EG_Mask32Bit2_C EG_Mask32Bit32768_C EG_Mask32Bit32_C EG_Mask32Bit33554432_C EG_Mask32Bit4096_C EG_Mask32Bit4194304_C EG_Mask32Bit4_C EG_Mask32Bit512_C EG_Mask32Bit524288_C EG_Mask32Bit536870912_C EG_Mask32Bit64_C EG_Mask32Bit65536_C EG_Mask32Bit67108864_C EG_Mask32Bit8192_C EG_Mask32Bit8388608_C EG_Mask32Bit8_C WM_MaskTC1Ovs_P WM_MaskTC1Ovv_P /end REF_CHARACTERISTIC
 /begin REF_MEASUREMENT WM_MaskTC1 /end REF_MEASUREMENT
/end GROUP
/begin GROUP S778_TC2 "EcuIntgdSwGend/ControlSoftware/WarnMong/Warning-Reduction-Shutdown Functions/Reaction/Error List/TC2"
 /begin REF_CHARACTERISTIC EG_Mask32Bit0_C EG_Mask32Bit1024_C EG_Mask32Bit1048576_C EG_Mask32Bit1073741824_C EG_Mask32Bit128_C EG_Mask32Bit131072_C EG_Mask32Bit134217728_C EG_Mask32Bit16384_C EG_Mask32Bit16777216_C EG_Mask32Bit16_C EG_Mask32Bit1_C EG_Mask32Bit2048_C EG_Mask32Bit2097152_C EG_Mask32Bit2147483648_C EG_Mask32Bit256_C EG_Mask32Bit262144_C EG_Mask32Bit268435456_C EG_Mask32Bit2_C EG_Mask32Bit32768_C EG_Mask32Bit32_C EG_Mask32Bit33554432_C EG_Mask32Bit4096_C EG_Mask32Bit4194304_C EG_Mask32Bit4_C EG_Mask32Bit512_C EG_Mask32Bit524288_C EG_Mask32Bit536870912_C EG_Mask32Bit64_C EG_Mask32Bit65536_C EG_Mask32Bit67108864_C EG_Mask32Bit8192_C EG_Mask32Bit8388608_C EG_Mask32Bit8_C WM_MaskTC2Ovs_P WM_MaskTC2Ovv_P /end REF_CHARACTERISTIC
 /begin REF_MEASUREMENT WM_MaskTC2 /end REF_MEASUREMENT
/end GROUP
/begin GROUP S778_TC3 "EcuIntgdSwGend/ControlSoftware/WarnMong/Warning-Reduction-Shutdown Functions/Reaction/Error List/TC3"
 /begin REF_CHARACTERISTIC EG_Mask32Bit0_C EG_Mask32Bit1024_C EG_Mask32Bit1048576_C EG_Mask32Bit1073741824_C EG_Mask32Bit128_C EG_Mask32Bit131072_C EG_Mask32Bit134217728_C EG_Mask32Bit16384_C EG_Mask32Bit16777216_C EG_Mask32Bit16_C EG_Mask32Bit1_C EG_Mask32Bit2048_C EG_Mask32Bit2097152_C EG_Mask32Bit2147483648_C EG_Mask32Bit256_C EG_Mask32Bit262144_C EG_Mask32Bit268435456_C EG_Mask32Bit2_C EG_Mask32Bit32768_C EG_Mask32Bit32_C EG_Mask32Bit33554432_C EG_Mask32Bit4096_C EG_Mask32Bit4194304_C EG_Mask32Bit4_C EG_Mask32Bit512_C EG_Mask32Bit524288_C EG_Mask32Bit536870912_C EG_Mask32Bit64_C EG_Mask32Bit65536_C EG_Mask32Bit67108864_C EG_Mask32Bit8192_C EG_Mask32Bit8388608_C EG_Mask32Bit8_C WM_MaskTC3Ovs_P WM_MaskTC3Ovv_P /end REF_CHARACTERISTIC
 /begin REF_MEASUREMENT WM_MaskTC3 /end REF_MEASUREMENT
/end GROUP
/begin GROUP S778_TC4 "EcuIntgdSwGend/ControlSoftware/WarnMong/Warning-Reduction-Shutdown Functions/Reaction/Error List/TC4"
 /begin REF_CHARACTERISTIC EG_Mask32Bit0_C EG_Mask32Bit1024_C EG_Mask32Bit1048576_C EG_Mask32Bit1073741824_C EG_Mask32Bit128_C EG_Mask32Bit131072_C EG_Mask32Bit134217728_C EG_Mask32Bit16384_C EG_Mask32Bit16777216_C EG_Mask32Bit16_C EG_Mask32Bit1_C EG_Mask32Bit2048_C EG_Mask32Bit2097152_C EG_Mask32Bit2147483648_C EG_Mask32Bit256_C EG_Mask32Bit262144_C EG_Mask32Bit268435456_C EG_Mask32Bit2_C EG_Mask32Bit32768_C EG_Mask32Bit32_C EG_Mask32Bit33554432_C EG_Mask32Bit4096_C EG_Mask32Bit4194304_C EG_Mask32Bit4_C EG_Mask32Bit512_C EG_Mask32Bit524288_C EG_Mask32Bit536870912_C EG_Mask32Bit64_C EG_Mask32Bit65536_C EG_Mask32Bit67108864_C EG_Mask32Bit8192_C EG_Mask32Bit8388608_C EG_Mask32Bit8_C WM_MaskTC4Ovs_P WM_MaskTC4Ovv_P /end REF_CHARACTERISTIC
 /begin REF_MEASUREMENT WM_MaskTC4 /end REF_MEASUREMENT
/end GROUP
/begin GROUP S779_SetRstLtch "EcuIntgdSwGend/ControlSoftware/WarnMong/Warning-Reduction-Shutdown Functions/Reaction/SetResetFaultReaction/SetRstLtch" /begin REF_CHARACTERISTIC EG_bFlgFalse_C EG_bFlgTrue_C /end REF_CHARACTERISTIC /begin REF_MEASUREMENT WM_bActvLimpRctn /end REF_MEASUREMENT /end GROUP
/begin GROUP S780_SetRstLtch "EcuIntgdSwGend/ControlSoftware/WarnMong/Warning-Reduction-Shutdown Functions/Reaction/SetResetFaultReaction1/SetRstLtch" /begin REF_CHARACTERISTIC EG_bFlgFalse_C EG_bFlgTrue_C /end REF_CHARACTERISTIC /begin REF_MEASUREMENT WM_bAcvFlgOfWtrInFuRctn /end REF_MEASUREMENT /end GROUP
/begin GROUP S781_SetRstLtch "EcuIntgdSwGend/ControlSoftware/WarnMong/Warning-Reduction-Shutdown Functions/Reaction/SetResetFaultReaction24/SetRstLtch" /begin REF_CHARACTERISTIC EG_bFlgFalse_C EG_bFlgTrue_C /end REF_CHARACTERISTIC /begin REF_MEASUREMENT WM_bAcvErrPRailNotCtldMsgRctn /end REF_MEASUREMENT /end GROUP
/begin GROUP S782_SetRstLtch "EcuIntgdSwGend/ControlSoftware/WarnMong/Warning-Reduction-Shutdown Functions/Reaction/SetResetFaultReaction25/SetRstLtch" /begin REF_CHARACTERISTIC EG_bFlgFalse_C EG_bFlgTrue_C /end REF_CHARACTERISTIC /begin REF_MEASUREMENT WM_bAcvErrEmgcyShtdwnForOvspdRctn /end REF_MEASUREMENT /end GROUP
/begin GROUP S783_SetRstLtch "EcuIntgdSwGend/ControlSoftware/WarnMong/Warning-Reduction-Shutdown Functions/Reaction/SetResetFaultReaction26/SetRstLtch" /begin REF_CHARACTERISTIC EG_bFlgFalse_C EG_bFlgTrue_C /end REF_CHARACTERISTIC /begin REF_MEASUREMENT WM_bAcvErrCamCrankTotLossRctn /end REF_MEASUREMENT /end GROUP
/begin GROUP S784_SetRstLtch "EcuIntgdSwGend/ControlSoftware/WarnMong/Warning-Reduction-Shutdown Functions/Reaction/SetResetFaultReaction27/SetRstLtch" /begin REF_CHARACTERISTIC EG_bFlgFalse_C EG_bFlgTrue_C /end REF_CHARACTERISTIC /begin REF_MEASUREMENT WM_bAcvErrInjrShtdwnRctn /end REF_MEASUREMENT /end GROUP
/begin GROUP S911_clamping_unit "EcuIntgdSwGend/ControlSoftware/WgtCtl/Wastegate Control/BoostPressurePID/PID_Controller/clamping_unit" /begin SUB_GROUP S912_deadzone /end SUB_GROUP /begin REF_CHARACTERISTIC EG_NmrInt0_C /end REF_CHARACTERISTIC /end GROUP
/begin GROUP S27_deadzone "EcuIntgdSwGend/ControlSoftware/CrsCtrl/CruiseControl/CruiseControlPIDController/PID_Controller/clamping_unit/deadzone" /begin REF_CHARACTERISTIC EG_NmrSng0_C /end REF_CHARACTERISTIC /end GROUP
/begin GROUP S67_clamping_unit "EcuIntgdSwGend/ControlSoftware/DesTqClcn/Running Mode/EndSpeed Governor/EndSpeed Soft Limit Governor/PID_Controller/clamping_unit" /begin SUB_GROUP S68_deadzone /end SUB_GROUP /begin REF_CHARACTERISTIC EG_NmrSng0_C /end REF_CHARACTERISTIC /end GROUP
/begin GROUP S70_CompTimer_Strt "EcuIntgdSwGend/ControlSoftware/DesTqClcn/Running Mode/EndSpeed Governor/Engine Speed Hysteresis for Hard Limitation/Hard Limit Latching/CompTimer_Strt" /begin SUB_GROUP S71_SetRstLtch /end SUB_GROUP /begin REF_MEASUREMENT DTqC_TiElpdAcvHardLimLtch /end REF_MEASUREMENT /end GROUP
/begin GROUP S70_Neg_Edge "EcuIntgdSwGend/ControlSoftware/DesTqClcn/Running Mode/EndSpeed Governor/Engine Speed Hysteresis for Hard Limitation/Hard Limit Latching/Neg_Edge" /begin REF_CHARACTERISTIC EG_NmrSng0_C /end REF_CHARACTERISTIC /end GROUP
/begin GROUP S70_Pos_Edge "EcuIntgdSwGend/ControlSoftware/DesTqClcn/Running Mode/EndSpeed Governor/Engine Speed Hysteresis for Hard Limitation/Hard Limit Latching/Pos_Edge" /begin REF_CHARACTERISTIC EG_NmrSng0_C /end REF_CHARACTERISTIC /end GROUP
/begin GROUP S77_deadzone "EcuIntgdSwGend/ControlSoftware/DesTqClcn/Running Mode/Idle Speed Controller/PID_Controller/clamping_unit/deadzone" /begin REF_CHARACTERISTIC EG_NmrSng0_C /end REF_CHARACTERISTIC /end GROUP
/begin GROUP S80_clamping_unit "EcuIntgdSwGend/ControlSoftware/DesTqClcn/Running Mode/TSC1 Control Purpose/TSC1 Request for Speed Control/PID_Controller1/clamping_unit" /begin SUB_GROUP S81_deadzone /end SUB_GROUP /begin REF_CHARACTERISTIC EG_NmrSng0_C /end REF_CHARACTERISTIC /end GROUP
/begin GROUP S462_deadzone "EcuIntgdSwGend/ControlSoftware/InjCtl/Cylinder Balancing/Cylinder Balancing PID Controllers /PID Controller for Cylinder 1/clamping_unit/deadzone" /begin REF_CHARACTERISTIC EG_NmrSng0_C /end REF_CHARACTERISTIC /end GROUP
/begin GROUP S464_deadzone "EcuIntgdSwGend/ControlSoftware/InjCtl/Cylinder Balancing/Cylinder Balancing PID Controllers /PID Controller for Cylinder 2/clamping_unit/deadzone" /begin REF_CHARACTERISTIC EG_NmrSng0_C /end REF_CHARACTERISTIC /end GROUP
/begin GROUP S466_deadzone "EcuIntgdSwGend/ControlSoftware/InjCtl/Cylinder Balancing/Cylinder Balancing PID Controllers /PID Controller for Cylinder 3/clamping_unit/deadzone" /begin REF_CHARACTERISTIC EG_NmrSng0_C /end REF_CHARACTERISTIC /end GROUP
/begin GROUP S468_deadzone "EcuIntgdSwGend/ControlSoftware/InjCtl/Cylinder Balancing/Cylinder Balancing PID Controllers /PID Controller for Cylinder 4/clamping_unit/deadzone" /begin REF_CHARACTERISTIC EG_NmrSng0_C /end REF_CHARACTERISTIC /end GROUP
/begin GROUP S470_deadzone "EcuIntgdSwGend/ControlSoftware/InjCtl/Cylinder Balancing/Cylinder Balancing PID Controllers /PID Controller for Cylinder 5/clamping_unit/deadzone" /begin REF_CHARACTERISTIC EG_NmrSng0_C /end REF_CHARACTERISTIC /end GROUP
/begin GROUP S472_deadzone "EcuIntgdSwGend/ControlSoftware/InjCtl/Cylinder Balancing/Cylinder Balancing PID Controllers /PID Controller for Cylinder 6/clamping_unit/deadzone" /begin REF_CHARACTERISTIC EG_NmrSng0_C /end REF_CHARACTERISTIC /end GROUP
/begin GROUP S643_deadzone "EcuIntgdSwGend/ControlSoftware/SpdLimr/Speed Limiter PID/SpeedLimiterPIDController/PID_Controller/clamping_unit/deadzone" /begin REF_CHARACTERISTIC EG_NmrSng0_C /end REF_CHARACTERISTIC /end GROUP
/begin GROUP S775_Debouncer1 "EcuIntgdSwGend/ControlSoftware/WarnMong/Warning-Reduction-Shutdown Functions/Pressure/Rail Under Pressure/Low and Not Control Fuel System Message/Debouncer1" /begin REF_MEASUREMENT WM_TiElpdPRailNotCtld /end REF_MEASUREMENT /end GROUP
/begin GROUP S792_SetResetFaultReaction "EcuIntgdSwGend/ControlSoftware/WarnMong/Warning-Reduction-Shutdown Functions/Reaction/Error List/Error Combinations/SetResetFaultReaction" /begin SUB_GROUP S818_SetRstLtch /end SUB_GROUP /begin REF_CHARACTERISTIC EG_Mask32Bit0_C /end REF_CHARACTERISTIC /end GROUP
/begin GROUP S792_SetResetFaultReaction1 "EcuIntgdSwGend/ControlSoftware/WarnMong/Warning-Reduction-Shutdown Functions/Reaction/Error List/Error Combinations/SetResetFaultReaction1" /begin SUB_GROUP S819_SetRstLtch /end SUB_GROUP /begin REF_CHARACTERISTIC EG_Mask32Bit0_C /end REF_CHARACTERISTIC /end GROUP
/begin GROUP S792_SetResetFaultReaction2 "EcuIntgdSwGend/ControlSoftware/WarnMong/Warning-Reduction-Shutdown Functions/Reaction/Error List/Error Combinations/SetResetFaultReaction2" /begin SUB_GROUP S820_SetRstLtch /end SUB_GROUP /begin REF_CHARACTERISTIC EG_Mask32Bit0_C /end REF_CHARACTERISTIC /end GROUP
/begin GROUP S792_SetResetFaultReaction3 "EcuIntgdSwGend/ControlSoftware/WarnMong/Warning-Reduction-Shutdown Functions/Reaction/Error List/Error Combinations/SetResetFaultReaction3" /begin SUB_GROUP S821_SetRstLtch /end SUB_GROUP /begin REF_CHARACTERISTIC EG_Mask32Bit0_C /end REF_CHARACTERISTIC /end GROUP
/begin GROUP S792_SetResetFaultReaction4 "EcuIntgdSwGend/ControlSoftware/WarnMong/Warning-Reduction-Shutdown Functions/Reaction/Error List/Error Combinations/SetResetFaultReaction4" /begin SUB_GROUP S822_SetRstLtch /end SUB_GROUP /begin REF_CHARACTERISTIC EG_Mask32Bit0_C /end REF_CHARACTERISTIC /end GROUP
/begin GROUP S912_deadzone "EcuIntgdSwGend/ControlSoftware/WgtCtl/Wastegate Control/BoostPressurePID/PID_Controller/clamping_unit/deadzone" /begin REF_CHARACTERISTIC EG_NmrInt0_C /end REF_CHARACTERISTIC /end GROUP
/begin GROUP S68_deadzone "EcuIntgdSwGend/ControlSoftware/DesTqClcn/Running Mode/EndSpeed Governor/EndSpeed Soft Limit Governor/PID_Controller/clamping_unit/deadzone" /begin REF_CHARACTERISTIC EG_NmrSng0_C /end REF_CHARACTERISTIC /end GROUP
/begin GROUP S71_SetRstLtch "EcuIntgdSwGend/ControlSoftware/DesTqClcn/Running Mode/EndSpeed Governor/Engine Speed Hysteresis for Hard Limitation/Hard Limit Latching/CompTimer_Strt/SetRstLtch" /begin REF_CHARACTERISTIC EG_bFlgFalse_C EG_bFlgTrue_C /end REF_CHARACTERISTIC /end GROUP
/begin GROUP S81_deadzone "EcuIntgdSwGend/ControlSoftware/DesTqClcn/Running Mode/TSC1 Control Purpose/TSC1 Request for Speed Control/PID_Controller1/clamping_unit/deadzone" /begin REF_CHARACTERISTIC EG_NmrSng0_C /end REF_CHARACTERISTIC /end GROUP
/begin GROUP S818_SetRstLtch "EcuIntgdSwGend/ControlSoftware/WarnMong/Warning-Reduction-Shutdown Functions/Reaction/Error List/Error Combinations/SetResetFaultReaction/SetRstLtch" /begin REF_CHARACTERISTIC EG_bFlgFalse_C EG_bFlgTrue_C /end REF_CHARACTERISTIC /begin REF_MEASUREMENT WM_bAcvErrComb1Rctn /end REF_MEASUREMENT /end GROUP
/begin GROUP S819_SetRstLtch "EcuIntgdSwGend/ControlSoftware/WarnMong/Warning-Reduction-Shutdown Functions/Reaction/Error List/Error Combinations/SetResetFaultReaction1/SetRstLtch" /begin REF_CHARACTERISTIC EG_bFlgFalse_C EG_bFlgTrue_C /end REF_CHARACTERISTIC /begin REF_MEASUREMENT WM_bAcvErrComb2Rctn /end REF_MEASUREMENT /end GROUP
/begin GROUP S820_SetRstLtch "EcuIntgdSwGend/ControlSoftware/WarnMong/Warning-Reduction-Shutdown Functions/Reaction/Error List/Error Combinations/SetResetFaultReaction2/SetRstLtch" /begin REF_CHARACTERISTIC EG_bFlgFalse_C EG_bFlgTrue_C /end REF_CHARACTERISTIC /begin REF_MEASUREMENT WM_bAcvErrComb3Rctn /end REF_MEASUREMENT /end GROUP
/begin GROUP S821_SetRstLtch "EcuIntgdSwGend/ControlSoftware/WarnMong/Warning-Reduction-Shutdown Functions/Reaction/Error List/Error Combinations/SetResetFaultReaction3/SetRstLtch" /begin REF_CHARACTERISTIC EG_bFlgFalse_C EG_bFlgTrue_C /end REF_CHARACTERISTIC /begin REF_MEASUREMENT WM_bAcvErrComb4Rctn /end REF_MEASUREMENT /end GROUP
/begin GROUP S822_SetRstLtch "EcuIntgdSwGend/ControlSoftware/WarnMong/Warning-Reduction-Shutdown Functions/Reaction/Error List/Error Combinations/SetResetFaultReaction4/SetRstLtch" /begin REF_CHARACTERISTIC EG_bFlgFalse_C EG_bFlgTrue_C /end REF_CHARACTERISTIC /begin REF_MEASUREMENT WM_bAcvErrComb5Rctn /end REF_MEASUREMENT /end GROUP
/end MODULE
/end PROJECT
