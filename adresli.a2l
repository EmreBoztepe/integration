ASAP2_VERSION 1 6
/begin PROJECT ECEMTAG_CR8 ""
/begin MODULE DIM ""
/begin MOD_COMMON "Mod Common Comment Here" DEPOSIT ABSOLUTE BYTE_ORDER MSB_FIRST /end MOD_COMMON
/begin RECORD_LAYOUT FLOAT32_IEEE FNC_VALUES 1 FLOAT32_IEEE ROW_DIR DIRECT /end RECORD_LAYOUT
/begin RECORD_LAYOUT ULONG FNC_VALUES 1 ULONG ROW_DIR DIRECT /end RECORD_LAYOUT
/begin RECORD_LAYOUT UWORD FNC_VALUES 1 UWORD ROW_DIR DIRECT /end RECORD_LAYOUT
/begin RECORD_LAYOUT SWORD FNC_VALUES 1 SWORD ROW_DIR DIRECT /end RECORD_LAYOUT
/begin RECORD_LAYOUT UBYTE FNC_VALUES 1 UBYTE ROW_DIR DIRECT /end RECORD_LAYOUT
/******************************* From MATLAB ***************************************/ /* MATLAB_SECTION_START_1 */
/begin RECORD_LAYOUT Scalar_BOOLEAN FNC_VALUES 1 UBYTE ROW_DIR DIRECT /end RECORD_LAYOUT
/begin RECORD_LAYOUT Scalar_ULONG FNC_VALUES 1 ULONG ROW_DIR DIRECT /end RECORD_LAYOUT
/begin RECORD_LAYOUT Scalar_FLOAT32_IEEE FNC_VALUES 1 FLOAT32_IEEE ROW_DIR DIRECT /end RECORD_LAYOUT
/begin RECORD_LAYOUT Lookup1D_UBYTE FNC_VALUES 1 UBYTE ROW_DIR DIRECT /end RECORD_LAYOUT
/begin RECORD_LAYOUT Lookup1D_X_UBYTE AXIS_PTS_X 1 UBYTE INDEX_INCR DIRECT /end RECORD_LAYOUT
/begin RECORD_LAYOUT Lookup1D_UWORD FNC_VALUES 1 UWORD ROW_DIR DIRECT /end RECORD_LAYOUT
/begin RECORD_LAYOUT Lookup1D_X_UWORD AXIS_PTS_X 1 UWORD INDEX_INCR DIRECT /end RECORD_LAYOUT
/begin RECORD_LAYOUT Lookup1D_WORD FNC_VALUES 1 SWORD ROW_DIR DIRECT /end RECORD_LAYOUT
/begin RECORD_LAYOUT Lookup1D_ULONG FNC_VALUES 1 ULONG ROW_DIR DIRECT /end RECORD_LAYOUT
/begin RECORD_LAYOUT Lookup1D_X_ULONG AXIS_PTS_X 1 ULONG INDEX_INCR DIRECT /end RECORD_LAYOUT
/begin RECORD_LAYOUT Lookup1D_FLOAT32_IEEE FNC_VALUES 1 FLOAT32_IEEE ROW_DIR DIRECT /end RECORD_LAYOUT
/begin RECORD_LAYOUT Lookup1D_X_FLOAT32_IEEE AXIS_PTS_X 1 FLOAT32_IEEE INDEX_INCR DIRECT /end RECORD_LAYOUT
/begin RECORD_LAYOUT Lookup2D_FLOAT32_IEEE FNC_VALUES 1 FLOAT32_IEEE ROW_DIR DIRECT /end RECORD_LAYOUT
/begin RECORD_LAYOUT Lookup2D_X_FLOAT32_IEEE AXIS_PTS_X 1 FLOAT32_IEEE INDEX_INCR DIRECT /end RECORD_LAYOUT
/begin AXIS_PTS DTqC_NEng_A "Axis Values of Engine Speed for Break Torque Maps" 0x40041DB4 /* @ECU_Address@DTqC_NEng_A@ */ EIP_NEng Lookup2D_X_FLOAT32_IEEE 0 EcuIntgdSwGend_CM_single_rpm 20 0.0 6000.0 /end AXIS_PTS
/begin AXIS_PTS DTqC_ErrNEng_A "Axis Values of Error Engine Speed for PID Coefficient Maps" 0x40041A58 /* @ECU_Address@DTqC_ErrNEng_A@ */ DTqC_ErrNIdle Lookup2D_X_FLOAT32_IEEE 0 EcuIntgdSwGend_CM_single_rpm 10 -500.0 500.0 /end AXIS_PTS
/begin AXIS_PTS IC_PRailMaiLimd_A "Rail Pressure Limited Main Injection Duration Map Axis" 0x40045FA4 /* @ECU_Address@IC_PRailMaiLimd_A@ */ EIP_PRail Lookup1D_X_FLOAT32_IEEE 0 EcuIntgdSwGend_CM_single_bar 16 0.0 2500.0 /end AXIS_PTS
/begin CHARACTERISTIC IC_DurPltLimd_M "Limited Pilot Injection Duration Map" CURVE 0x40045048 /* @ECU_Address@IC_DurPltLimd_M@ */ Lookup1D_FLOAT32_IEEE 0 EcuIntgdSwGend_CM_single_us 0.0 5000.0
 /begin AXIS_DESCR COM_AXIS EIP_PRail EcuIntgdSwGend_CM_single_bar 16 0.0 2500.0 AXIS_PTS_REF IC_PRailMaiLimd_A /end AXIS_DESCR
/end CHARACTERISTIC
/begin CHARACTERISTIC IC_PAmbAirCorrForMainSOI_M "Ambient Air Pressure Correction Map for Main Start of Injection" CURVE 0x40045F2C /* @ECU_Address@IC_PAmbAirCorrForMainSOI_M@ */ Lookup1D_FLOAT32_IEEE 0 EcuIntgdSwGend_CM_single_deg -100.0 500.0
 /begin AXIS_DESCR COM_AXIS EIP_PAmbAir EcuIntgdSwGend_CM_single_mbar 5 0.0 3000.0 AXIS_PTS_REF IC_PAmbAirForSoiMainInjCorr_A /end AXIS_DESCR
/end CHARACTERISTIC
/begin AXIS_PTS IC_PAmbAirForSoiMainInjCorr_A "Ambient Air Pressure Map Axis for Main Start of Injection Correction" 0x40045F54 /* @ECU_Address@IC_PAmbAirForSoiMainInjCorr_A@ */ EIP_PAmbAir Lookup1D_X_FLOAT32_IEEE 0 EcuIntgdSwGend_CM_single_mbar 5 0.0 3000.0 /end AXIS_PTS
/begin CHARACTERISTIC IC_SoiMaiLimd_M "Limited Start of Main Injection Map" CURVE 0x40045FFC /* @ECU_Address@IC_SoiMaiLimd_M@ */ Lookup1D_FLOAT32_IEEE 0 EcuIntgdSwGend_CM_single_deg -100.0 500.0
 /begin AXIS_DESCR COM_AXIS EIP_NEng EcuIntgdSwGend_CM_single_rpm 24 0.0 3200.0 AXIS_PTS_REF IC_NEngMaiLimd_A /end AXIS_DESCR
/end CHARACTERISTIC
/begin AXIS_PTS IC_NEngMaiLimd_A "Engine Speed Map Axis for Limited Main Injection Duration Maps" 0x40045EA0 /* @ECU_Address@IC_NEngMaiLimd_A@ */ EIP_NEng Lookup1D_X_FLOAT32_IEEE 0 EcuIntgdSwGend_CM_single_rpm 24 0.0 3200.0 /end AXIS_PTS
/begin CHARACTERISTIC IC_TAirBoostCorrForMainSOI_M "Start of Main Injection Correction wrt Air Boost Temperature Map" CURVE 0x40048524 /* @ECU_Address@IC_TAirBoostCorrForMainSOI_M@ */ Lookup1D_FLOAT32_IEEE 0 EcuIntgdSwGend_CM_single_deg -100.0 500.0
 /begin AXIS_DESCR COM_AXIS EIP_TAirBoost EcuIntgdSwGend_CM_single_degC 5 -40.0 250.0 AXIS_PTS_REF IC_TAirBoostForSoiMainInjCorr_A /end AXIS_DESCR
/end CHARACTERISTIC
/begin AXIS_PTS IC_TAirBoostForSoiMainInjCorr_A "Start of Main Injection Correction wrt Air Boost Temperature Map Axis" 0x4004854C /* @ECU_Address@IC_TAirBoostForSoiMainInjCorr_A@ */ EIP_TAirBoost Lookup1D_X_FLOAT32_IEEE 0 EcuIntgdSwGend_CM_single_degC 5 -40.0 250.0 /end AXIS_PTS
/begin CHARACTERISTIC IC_TAmbAirCorrForMainSOI_M "Start of Main Injection Correction wrt Ambient Air Temperature Map" CURVE 0x40048574 /* @ECU_Address@IC_TAmbAirCorrForMainSOI_M@ */ Lookup1D_FLOAT32_IEEE 0 EcuIntgdSwGend_CM_single_deg -100.0 500.0
 /begin AXIS_DESCR COM_AXIS EIP_TAmbAir EcuIntgdSwGend_CM_single_degC 5 -40.0 250.0 AXIS_PTS_REF IC_TAmbAirForSoiMainInjCorr_A /end AXIS_DESCR
/end CHARACTERISTIC
/begin AXIS_PTS IC_TAmbAirForSoiMainInjCorr_A "Start of Main Injection Correction wrt Ambient Air Temperature Map Axis" 0x4004859C /* @ECU_Address@IC_TAmbAirForSoiMainInjCorr_A@ */ EIP_TAmbAir Lookup1D_X_FLOAT32_IEEE 0 EcuIntgdSwGend_CM_single_degC 5 -40.0 250.0 /end AXIS_PTS
/begin CHARACTERISTIC IC_TCooltCorrForMainSOI_M "Start of Main Injection Correction wrt Coolant Temperature Map" CURVE 0x400485C4 /* @ECU_Address@IC_TCooltCorrForMainSOI_M@ */ Lookup1D_FLOAT32_IEEE 0 EcuIntgdSwGend_CM_single_deg -100.0 500.0
 /begin AXIS_DESCR COM_AXIS EIP_TCoolt EcuIntgdSwGend_CM_single_degC 5 -40.0 250.0 AXIS_PTS_REF IC_TCooltForSoiMainInjCorr_A /end AXIS_DESCR
/end CHARACTERISTIC
/begin AXIS_PTS IC_TCooltForSoiMainInjCorr_A "Start of Main Injection Correction wrt Coolant Temperature Map Axis" 0x400485EC /* @ECU_Address@IC_TCooltForSoiMainInjCorr_A@ */ EIP_TCoolt Lookup1D_X_FLOAT32_IEEE 0 EcuIntgdSwGend_CM_single_degC 5 -40.0 250.0 /end AXIS_PTS
/begin CHARACTERISTIC IC_TOilCorrForMainSOI_M "Start of Main Injection Correction wrt Oil Temperature Map" CURVE 0x40048620 /* @ECU_Address@IC_TOilCorrForMainSOI_M@ */ Lookup1D_FLOAT32_IEEE 0 EcuIntgdSwGend_CM_single_deg -100.0 500.0
 /begin AXIS_DESCR COM_AXIS EIP_TOil EcuIntgdSwGend_CM_single_degC 5 -40.0 250.0 AXIS_PTS_REF IC_TOilForSoiMainInjCorr_A /end AXIS_DESCR
/end CHARACTERISTIC
/begin AXIS_PTS IC_TOilForSoiMainInjCorr_A "Start of Main Injection Correction wrt Oil Temperature Map Axis" 0x40048648 /* @ECU_Address@IC_TOilForSoiMainInjCorr_A@ */ EIP_TOil Lookup1D_X_FLOAT32_IEEE 0 EcuIntgdSwGend_CM_single_degC 5 -40.0 250.0 /end AXIS_PTS
/begin CHARACTERISTIC IC_PAmbAirCorrForPilotSOI_M "Ambient Air Pressure Correction Map for Pilot Start of Injection" CURVE 0x40045F40 /* @ECU_Address@IC_PAmbAirCorrForPilotSOI_M@ */ Lookup1D_FLOAT32_IEEE 0 EcuIntgdSwGend_CM_single_deg -100.0 500.0
 /begin AXIS_DESCR COM_AXIS EIP_PAmbAir EcuIntgdSwGend_CM_single_mbar 5 0.0 10000.0 AXIS_PTS_REF IC_PAmbAirForSoiPltinjCorr_A /end AXIS_DESCR
/end CHARACTERISTIC
/begin AXIS_PTS IC_PAmbAirForSoiPltinjCorr_A "Ambient Air Pressure Map Axis for for Pilot Start of Injection Correction" 0x40045F68 /* @ECU_Address@IC_PAmbAirForSoiPltinjCorr_A@ */ EIP_PAmbAir Lookup1D_X_FLOAT32_IEEE 0 EcuIntgdSwGend_CM_single_mbar 5 0.0 10000.0 /end AXIS_PTS
/begin CHARACTERISTIC IC_SoiPltLimd_M "Limited Start of Pilot Injection Map" CURVE 0x400484C4 /* @ECU_Address@IC_SoiPltLimd_M@ */ Lookup1D_FLOAT32_IEEE 0 EcuIntgdSwGend_CM_single_deg -100.0 5000.0
 /begin AXIS_DESCR COM_AXIS EIP_NEng EcuIntgdSwGend_CM_single_rpm 24 0.0 3200.0 AXIS_PTS_REF IC_NEngMaiLimd_A /end AXIS_DESCR
/end CHARACTERISTIC
/begin CHARACTERISTIC IC_TAirBoostCorrForPilotSOI_M "Start of Pilot Injection Correction wrt Air Boost Temperature Map" CURVE 0x40048538 /* @ECU_Address@IC_TAirBoostCorrForPilotSOI_M@ */ Lookup1D_FLOAT32_IEEE 0 EcuIntgdSwGend_CM_single_deg -100.0 500.0
 /begin AXIS_DESCR COM_AXIS EIP_TAirBoost EcuIntgdSwGend_CM_single_degC 5 -40.0 250.0 AXIS_PTS_REF IC_TAirBoostForSoiPltinjCorr_A /end AXIS_DESCR
/end CHARACTERISTIC
/begin AXIS_PTS IC_TAirBoostForSoiPltinjCorr_A "Start of Pilot Injection Correction wrt Air Boost Temperature Map Axis" 0x40048560 /* @ECU_Address@IC_TAirBoostForSoiPltinjCorr_A@ */ EIP_TAirBoost Lookup1D_X_FLOAT32_IEEE 0 EcuIntgdSwGend_CM_single_degC 5 -40.0 250.0 /end AXIS_PTS
/begin CHARACTERISTIC IC_TAmbAirCorrForPilotSOI_M "Start of Pilot Injection Correction wrt Ambient Air Temperature Map" CURVE 0x40048588 /* @ECU_Address@IC_TAmbAirCorrForPilotSOI_M@ */ Lookup1D_FLOAT32_IEEE 0 EcuIntgdSwGend_CM_single_deg -100.0 500.0
 /begin AXIS_DESCR COM_AXIS EIP_TAmbAir EcuIntgdSwGend_CM_single_degC 5 -40.0 250.0 AXIS_PTS_REF IC_TAmbAirForSoiPltinjCorr_A /end AXIS_DESCR
/end CHARACTERISTIC
/begin AXIS_PTS IC_TAmbAirForSoiPltinjCorr_A "Start of Pilot Injection Correction wrt Ambient Air Temperature Map Axis" 0x400485B0 /* @ECU_Address@IC_TAmbAirForSoiPltinjCorr_A@ */ EIP_TAmbAir Lookup1D_X_FLOAT32_IEEE 0 EcuIntgdSwGend_CM_single_degC 5 -40.0 250.0 /end AXIS_PTS
/begin CHARACTERISTIC IC_TCooltCorrForPilotSOI_M "Start of Pilot Injection Correction wrt Coolant Temperature Map" CURVE 0x400485D8 /* @ECU_Address@IC_TCooltCorrForPilotSOI_M@ */ Lookup1D_FLOAT32_IEEE 0 EcuIntgdSwGend_CM_single_deg -100.0 500.0
 /begin AXIS_DESCR COM_AXIS EIP_TCoolt EcuIntgdSwGend_CM_single_degC 5 -40.0 250.0 AXIS_PTS_REF IC_TCooltForSoiPltinjCorr_A /end AXIS_DESCR
/end CHARACTERISTIC
/begin AXIS_PTS IC_TCooltForSoiPltinjCorr_A "Start of Pilot Injection Correction wrt Coolant Temperature Map Axis" 0x40048600 /* @ECU_Address@IC_TCooltForSoiPltinjCorr_A@ */ EIP_TCoolt Lookup1D_X_FLOAT32_IEEE 0 EcuIntgdSwGend_CM_single_degC 5 -40.0 250.0 /end AXIS_PTS
/begin CHARACTERISTIC IC_TOilCorrForPilotSOI_M "Start of Pilot Injection Correction wrt Oil Temperature Map" CURVE 0x40048634 /* @ECU_Address@IC_TOilCorrForPilotSOI_M@ */ Lookup1D_FLOAT32_IEEE 0 EcuIntgdSwGend_CM_single_deg -100.0 500.0
 /begin AXIS_DESCR COM_AXIS EIP_TOil EcuIntgdSwGend_CM_single_degC 5 -40.0 250.0 AXIS_PTS_REF IC_TOilForSoiPltinjCorr_A /end AXIS_DESCR
/end CHARACTERISTIC
/begin AXIS_PTS IC_TOilForSoiPltinjCorr_A "Start of Pilot Injection Correction wrt Oil Temperature Map Axis" 0x4004865C /* @ECU_Address@IC_TOilForSoiPltinjCorr_A@ */ EIP_TOil Lookup1D_X_FLOAT32_IEEE 0 EcuIntgdSwGend_CM_single_degC 5 -40.0 250.0 /end AXIS_PTS
/begin CHARACTERISTIC RPG_PRailSetPoint1_M "Rail Pressure Set Point Calculation Map 1" MAP 0x40049B74 /* @ECU_Address@RPG_PRailSetPoint1_M@ */ Lookup2D_FLOAT32_IEEE 0 EcuIntgdSwGend_CM_single_bar 0.0 2500.0
 /begin AXIS_DESCR COM_AXIS TL_TqIndcdLimd EcuIntgdSwGend_CM_single_N_m 15 0.0 10000.0 AXIS_PTS_REF RPG_TqIndcdLimdForPRailSetPoint_A /end AXIS_DESCR
 /begin AXIS_DESCR COM_AXIS EIP_NEng EcuIntgdSwGend_CM_single_rpm 15 0.0 3500.0 AXIS_PTS_REF RPG_NEngCorrForPRailSetPoint_A /end AXIS_DESCR
/end CHARACTERISTIC
/begin AXIS_PTS RPG_TqIndcdLimdForPRailSetPoint_A "Limited Indicated Torque Map Axis for Rail Pressure Set Point Calcluation Maps" 0x4004B1E4 /* @ECU_Address@RPG_TqIndcdLimdForPRailSetPoint_A@ */ TL_TqIndcdLimd Lookup2D_X_FLOAT32_IEEE 0 EcuIntgdSwGend_CM_single_N_m 15 0.0 10000.0 /end AXIS_PTS
/begin AXIS_PTS RPG_NEngCorrForPRailSetPoint_A "Engine Speed Correction Map Axis for Rail Pressure Set Point Calculation" 0x40049878 /* @ECU_Address@RPG_NEngCorrForPRailSetPoint_A@ */ EIP_NEng Lookup2D_X_FLOAT32_IEEE 0 EcuIntgdSwGend_CM_single_rpm 15 0.0 3500.0 /end AXIS_PTS
/begin CHARACTERISTIC RPG_PRailSetPoint2_M "Rail Pressure Set Point Calculation Map 2" MAP 0x40049EF8 /* @ECU_Address@RPG_PRailSetPoint2_M@ */ Lookup2D_FLOAT32_IEEE 0 EcuIntgdSwGend_CM_single_bar 0.0 2500.0
 /begin AXIS_DESCR COM_AXIS TL_TqIndcdLimd EcuIntgdSwGend_CM_single_N_m 15 0.0 10000.0 AXIS_PTS_REF RPG_TqIndcdLimdForPRailSetPoint_A /end AXIS_DESCR
 /begin AXIS_DESCR COM_AXIS EIP_NEng EcuIntgdSwGend_CM_single_rpm 15 0.0 3500.0 AXIS_PTS_REF RPG_NEngCorrForPRailSetPoint_A /end AXIS_DESCR
/end CHARACTERISTIC
/begin CHARACTERISTIC RPG_PRailSetPoint3_M "Rail Pressure Set Point Calculation Map 3" MAP 0x4004A27C /* @ECU_Address@RPG_PRailSetPoint3_M@ */ Lookup2D_FLOAT32_IEEE 0 EcuIntgdSwGend_CM_single_bar 0.0 2500.0
 /begin AXIS_DESCR COM_AXIS TL_TqIndcdLimd EcuIntgdSwGend_CM_single_N_m 15 0.0 10000.0 AXIS_PTS_REF RPG_TqIndcdLimdForPRailSetPoint_A /end AXIS_DESCR
 /begin AXIS_DESCR COM_AXIS EIP_NEng EcuIntgdSwGend_CM_single_rpm 15 0.0 3500.0 AXIS_PTS_REF RPG_NEngCorrForPRailSetPoint_A /end AXIS_DESCR
/end CHARACTERISTIC
/begin CHARACTERISTIC SpdLimr_CoeffDForVehVCtrl_M "Coefficient Derrivate For Vehicle Velocity Control Map" CURVE 0x4004B2E0 /* @ECU_Address@SpdLimr_CoeffDForVehVCtrl_M@ */ Lookup1D_FLOAT32_IEEE 0 EcuIntgdSwGend_CM_single 0.0 10000.0
 /begin AXIS_DESCR COM_AXIS SpdLimr_ErrVehVRef EcuIntgdSwGend_CM_single 20 -300.0 300.0 AXIS_PTS_REF SpdLimr_ErrVehV_A /end AXIS_DESCR
/end CHARACTERISTIC
/begin AXIS_PTS SpdLimr_ErrVehV_A "Vehicle Speed Error Map Axis" 0x4004B448 /* @ECU_Address@SpdLimr_ErrVehV_A@ */ SpdLimr_ErrVehVRef Lookup1D_X_FLOAT32_IEEE 0 EcuIntgdSwGend_CM_single 20 -300.0 300.0 /end AXIS_PTS
/begin CHARACTERISTIC SpdLimr_CoeffFiltForVehVCtrl_M "Coefficient Filter for Vehicle Velocity Control Map" CURVE 0x4004B330 /* @ECU_Address@SpdLimr_CoeffFiltForVehVCtrl_M@ */ Lookup1D_FLOAT32_IEEE 0 EcuIntgdSwGend_CM_single 0.0 10000.0
 /begin AXIS_DESCR COM_AXIS SpdLimr_ErrVehVRef EcuIntgdSwGend_CM_single 20 -300.0 300.0 AXIS_PTS_REF SpdLimr_ErrVehV_A /end AXIS_DESCR
/end CHARACTERISTIC
/begin CHARACTERISTIC SpdLimr_CoeffIForVehVCtrl_M "Coefficient Integral For Vehicle Velocity Control Map" CURVE 0x4004B380 /* @ECU_Address@SpdLimr_CoeffIForVehVCtrl_M@ */ Lookup1D_FLOAT32_IEEE 0 EcuIntgdSwGend_CM_single 0.0 10000.0
 /begin AXIS_DESCR COM_AXIS SpdLimr_ErrVehVRef EcuIntgdSwGend_CM_single 20 -300.0 300.0 AXIS_PTS_REF SpdLimr_ErrVehV_A /end AXIS_DESCR
/end CHARACTERISTIC
/begin CHARACTERISTIC SpdLimr_CoeffPForVehVCtrl_M "Coefficient Proportional For Vehicle Velocity Control Map" CURVE 0x4004B3D0 /* @ECU_Address@SpdLimr_CoeffPForVehVCtrl_M@ */ Lookup1D_FLOAT32_IEEE 0 EcuIntgdSwGend_CM_single 0.0 10000.0
 /begin AXIS_DESCR COM_AXIS SpdLimr_ErrVehVRef EcuIntgdSwGend_CM_single 20 -300.0 300.0 AXIS_PTS_REF SpdLimr_ErrVehV_A /end AXIS_DESCR
/end CHARACTERISTIC
/begin CHARACTERISTIC SpdLimr_PIDMax_M "Maximum Value of PIF Map" MAP 0x4004B4E8 /* @ECU_Address@SpdLimr_PIDMax_M@ */ Lookup2D_FLOAT32_IEEE 0 EcuIntgdSwGend_CM_single_N_m 0.0 5000.0
 /begin AXIS_DESCR COM_AXIS EIP_CanTrsmCurrentGear EcuIntgdSwGend_CM_single 6 0.0 255.0 AXIS_PTS_REF SpdLimr_CurrentGear_A /end AXIS_DESCR
 /begin AXIS_DESCR COM_AXIS EIP_NEng EcuIntgdSwGend_CM_single_rpm 6 0.0 3000.0 AXIS_PTS_REF SpdLimr_NEngForPIDMax_A /end AXIS_DESCR
/end CHARACTERISTIC
/begin AXIS_PTS SpdLimr_CurrentGear_A "Current Gear Map Axis" 0x4004B420 /* @ECU_Address@SpdLimr_CurrentGear_A@ */ EIP_CanTrsmCurrentGear Lookup2D_X_FLOAT32_IEEE 0 EcuIntgdSwGend_CM_single 6 0.0 255.0 /end AXIS_PTS
/begin AXIS_PTS SpdLimr_NEngForPIDMax_A "Engine Speed for PID Max Map Axis" 0x4004B4B0 /* @ECU_Address@SpdLimr_NEngForPIDMax_A@ */ EIP_NEng Lookup2D_X_FLOAT32_IEEE 0 EcuIntgdSwGend_CM_single_rpm 6 0.0 3000.0 /end AXIS_PTS
/begin CHARACTERISTIC SpdLimr_TrfCaseStsFac_M "Speed Limiter Transfer Case Status Factor Map" CURVE 0x4004B5AC /* @ECU_Address@SpdLimr_TrfCaseStsFac_M@ */ Lookup1D_FLOAT32_IEEE 0 EcuIntgdSwGend_CM_single 0.0 100.0
 /begin AXIS_DESCR COM_AXIS EIP_CanTrfCaseSts EcuIntgdSwGend_CM_single 8 0.0 8.0 AXIS_PTS_REF SpdLimr_TrfCaseStsFacForFF_A /end AXIS_DESCR
/end CHARACTERISTIC
/begin AXIS_PTS SpdLimr_TrfCaseStsFacForFF_A "Speed Limiter Transfer Case Status Factor for Feedforward Map Axis" 0x4004B58C /* @ECU_Address@SpdLimr_TrfCaseStsFacForFF_A@ */ EIP_CanTrfCaseSts Lookup1D_X_FLOAT32_IEEE 0 EcuIntgdSwGend_CM_single 8 0.0 8.0 /end AXIS_PTS
/begin CHARACTERISTIC SpdLimr_TrsmTqCnvrRatFac_M "Speed Limiter Transmission Torque Convertor Ratio Factor Map" CURVE 0x4004B5CC /* @ECU_Address@SpdLimr_TrsmTqCnvrRatFac_M@ */ Lookup1D_FLOAT32_IEEE 0 EcuIntgdSwGend_CM_single 0.0 100.0
 /begin AXIS_DESCR COM_AXIS EIP_CanTrsmTqCnvrRat EcuIntgdSwGend_CM_single 8 0.0 100.0 AXIS_PTS_REF SpdLimr_TrsmTqCnvrRatForFF_A /end AXIS_DESCR
/end CHARACTERISTIC
/begin AXIS_PTS SpdLimr_TrsmTqCnvrRatForFF_A "Speed Limiter Transmission Torque Convertor Ratio Factor for Feedforward Map Axis" 0x4004B5EC /* @ECU_Address@SpdLimr_TrsmTqCnvrRatForFF_A@ */ EIP_CanTrsmTqCnvrRat Lookup1D_X_FLOAT32_IEEE 0 EcuIntgdSwGend_CM_single 8 0.0 100.0 /end AXIS_PTS
/begin CHARACTERISTIC TL_PercgTqLimnForTFu_M "Torque Limitation Percentage Map for Fuel Temperature" MAP 0x4004BFA8 /* @ECU_Address@TL_PercgTqLimnForTFu_M@ */ Lookup2D_FLOAT32_IEEE 0 EcuIntgdSwGend_CM_single__ 0.0 100.0
 /begin AXIS_DESCR COM_AXIS EIP_TFu EcuIntgdSwGend_CM_single_degC 10 -50.0 200.0 AXIS_PTS_REF TL_TFu_A /end AXIS_DESCR
 /begin AXIS_DESCR COM_AXIS EIP_NEng EcuIntgdSwGend_CM_single_rpm 10 0.0 5000.0 AXIS_PTS_REF TL_NEng_A /end AXIS_DESCR
/end CHARACTERISTIC
/begin AXIS_PTS TL_TFu_A "Axis Values of Fuel Temperature for Fuel Temperature Dependent Limitation Map" 0x4004C41C /* @ECU_Address@TL_TFu_A@ */ EIP_TFu Lookup2D_X_FLOAT32_IEEE 0 EcuIntgdSwGend_CM_single_degC 10 -50.0 200.0 /end AXIS_PTS
/begin AXIS_PTS TL_NEng_A "Axis Values of Engine Speed for Torque Limitation Maps" 0x4004B730 /* @ECU_Address@TL_NEng_A@ */ EIP_NEng Lookup2D_X_FLOAT32_IEEE 0 EcuIntgdSwGend_CM_single_rpm 10 0.0 5000.0 /end AXIS_PTS
/begin CHARACTERISTIC TL_PercgTqLimnForTAir_M "Torque Limitation Percentage Map for AirBoost Temperature" MAP 0x4004BC88 /* @ECU_Address@TL_PercgTqLimnForTAir_M@ */ Lookup2D_FLOAT32_IEEE 0 EcuIntgdSwGend_CM_single__ 0.0 100.0
 /begin AXIS_DESCR COM_AXIS TL_TAir EcuIntgdSwGend_CM_single_degC 10 -50.0 200.0 AXIS_PTS_REF TL_TAir_A /end AXIS_DESCR
 /begin AXIS_DESCR COM_AXIS EIP_NEng EcuIntgdSwGend_CM_single_rpm 10 0.0 5000.0 AXIS_PTS_REF TL_NEng_A /end AXIS_DESCR
/end CHARACTERISTIC
/begin AXIS_PTS TL_TAir_A "Axis Values of Air Temperature for Air Temperature Dependent Limitation Map" 0x4004C3CC /* @ECU_Address@TL_TAir_A@ */ TL_TAir Lookup2D_X_FLOAT32_IEEE 0 EcuIntgdSwGend_CM_single_degC 10 -50.0 200.0 /end AXIS_PTS
/begin CHARACTERISTIC TL_PercgTqLimnForPAmbAir_M "Torque Limitation Percentage Map for Ambient Air Pressure" MAP 0x4004B968 /* @ECU_Address@TL_PercgTqLimnForPAmbAir_M@ */ Lookup2D_FLOAT32_IEEE 0 EcuIntgdSwGend_CM_single__ 0.0 100.0
 /begin AXIS_DESCR COM_AXIS EIP_PAmbAir EcuIntgdSwGend_CM_single_mbar 10 0.0 10000.0 AXIS_PTS_REF TL_PAmbAir_A /end AXIS_DESCR
 /begin AXIS_DESCR COM_AXIS EIP_NEng EcuIntgdSwGend_CM_single_rpm 10 0.0 5000.0 AXIS_PTS_REF TL_NEng_A /end AXIS_DESCR
/end CHARACTERISTIC
/begin AXIS_PTS TL_PAmbAir_A "Axis Values of Ambient Air Pressure for Ambient Air Pressure Dependent Limitation Map" 0x4004B7A8 /* @ECU_Address@TL_PAmbAir_A@ */ EIP_PAmbAir Lookup2D_X_FLOAT32_IEEE 0 EcuIntgdSwGend_CM_single_mbar 10 0.0 10000.0 /end AXIS_PTS
/begin CHARACTERISTIC TL_PercgTqLimnForTCoolt_M "Torque Limitation Percentage Map for Coolant High Temperature" MAP 0x4004BE18 /* @ECU_Address@TL_PercgTqLimnForTCoolt_M@ */ Lookup2D_FLOAT32_IEEE 0 EcuIntgdSwGend_CM_single__ 0.0 100.0
 /begin AXIS_DESCR COM_AXIS EIP_TCoolt EcuIntgdSwGend_CM_single_degC 10 -50.0 200.0 AXIS_PTS_REF TL_TCoolt_A /end AXIS_DESCR
 /begin AXIS_DESCR COM_AXIS EIP_NEng EcuIntgdSwGend_CM_single_rpm 10 0.0 5000.0 AXIS_PTS_REF TL_NEng_A /end AXIS_DESCR
/end CHARACTERISTIC
/begin AXIS_PTS TL_TCoolt_A "Axis Values of Coolant High Temperature for Coolant High Dependent Temperature Limitation Map" 0x4004C3F4 /* @ECU_Address@TL_TCoolt_A@ */ EIP_TCoolt Lookup2D_X_FLOAT32_IEEE 0 EcuIntgdSwGend_CM_single_degC 10 -50.0 200.0 /end AXIS_PTS
/begin CHARACTERISTIC TL_PercgTqLimnForPBoostAir_M "Torque Limitation Percentage Map for AirBoost Pressure" MAP 0x4004BAF8 /* @ECU_Address@TL_PercgTqLimnForPBoostAir_M@ */ Lookup2D_FLOAT32_IEEE 0 EcuIntgdSwGend_CM_single__ 0.0 100.0
 /begin AXIS_DESCR COM_AXIS EIP_PAirBoost EcuIntgdSwGend_CM_single_mbar 10 0.0 10000.0 AXIS_PTS_REF TL_PAirBoost_A /end AXIS_DESCR
 /begin AXIS_DESCR COM_AXIS EIP_NEng EcuIntgdSwGend_CM_single_rpm 10 0.0 5000.0 AXIS_PTS_REF TL_NEng_A /end AXIS_DESCR
/end CHARACTERISTIC
/begin AXIS_PTS TL_PAirBoost_A "Axis Values of AirBoost Pressure for AirBoost Pressure Dependet Limitation Map" 0x4004B780 /* @ECU_Address@TL_PAirBoost_A@ */ EIP_PAirBoost Lookup2D_X_FLOAT32_IEEE 0 EcuIntgdSwGend_CM_single_mbar 10 0.0 10000.0 /end AXIS_PTS
/begin CHARACTERISTIC TL_PercgTqLimnForTOil_M "Torque Limitation Percentage Map for Oil Temperature" MAP 0x4004C138 /* @ECU_Address@TL_PercgTqLimnForTOil_M@ */ Lookup2D_FLOAT32_IEEE 0 EcuIntgdSwGend_CM_single__ 0.0 100.0
 /begin AXIS_DESCR COM_AXIS EIP_TOil EcuIntgdSwGend_CM_single_degC 10 -50.0 200.0 AXIS_PTS_REF TL_TOil_A /end AXIS_DESCR
 /begin AXIS_DESCR COM_AXIS EIP_NEng EcuIntgdSwGend_CM_single_rpm 10 0.0 5000.0 AXIS_PTS_REF TL_NEng_A /end AXIS_DESCR
/end CHARACTERISTIC
/begin AXIS_PTS TL_TOil_A "Axis Values of Oil Temperature for Oil Temperature Dependent Limitation Map" 0x4004C444 /* @ECU_Address@TL_TOil_A@ */ EIP_TOil Lookup2D_X_FLOAT32_IEEE 0 EcuIntgdSwGend_CM_single_degC 10 -50.0 200.0 /end AXIS_PTS
/begin CHARACTERISTIC TL_SurgeLineTqLimd_M "Surge Line Torque Limitation Map" MAP 0x4004C2CC /* @ECU_Address@TL_SurgeLineTqLimd_M@ */ Lookup2D_FLOAT32_IEEE 0 EcuIntgdSwGend_CM_single__ 0.0 100.0
 /begin AXIS_DESCR COM_AXIS EIP_NEng EcuIntgdSwGend_CM_single_rpm 8 0.0 3500.0 AXIS_PTS_REF TL_NEngForSurgeLine_A /end AXIS_DESCR
 /begin AXIS_DESCR COM_AXIS WgC_DifSurgeLine EcuIntgdSwGend_CM_single 8 -10.0 10.0 AXIS_PTS_REF TL_DifSurgeLine_A /end AXIS_DESCR
/end CHARACTERISTIC
/begin AXIS_PTS TL_NEngForSurgeLine_A "Engine Speed Map Axis for Surge Line" 0x4004B66C /* @ECU_Address@TL_NEngForSurgeLine_A@ */ EIP_NEng Lookup2D_X_FLOAT32_IEEE 0 EcuIntgdSwGend_CM_single_rpm 8 0.0 3500.0 /end AXIS_PTS
/begin AXIS_PTS TL_DifSurgeLine_A "Map Axis of Surge Line Difference" 0x4004B614 /* @ECU_Address@TL_DifSurgeLine_A@ */ WgC_DifSurgeLine Lookup2D_X_FLOAT32_IEEE 0 EcuIntgdSwGend_CM_single 8 -10.0 10.0 /end AXIS_PTS
/begin CHARACTERISTIC TL_PercgTqLimnForNExhTrbChrg_M "Torque Limitation Percentage Map for Turbo Charger Speed" MAP 0x4004B7D8 /* @ECU_Address@TL_PercgTqLimnForNExhTrbChrg_M@ */ Lookup2D_FLOAT32_IEEE 0 EcuIntgdSwGend_CM_single__ 0.0 100.0
 /begin AXIS_DESCR COM_AXIS WgC_NTrbChrg EcuIntgdSwGend_CM_single_rpm 10 0.0 120000.0 AXIS_PTS_REF TL_NTrbChrg_A /end AXIS_DESCR
 /begin AXIS_DESCR COM_AXIS EIP_NEng EcuIntgdSwGend_CM_single_rpm 10 0.0 5000.0 AXIS_PTS_REF TL_NEng_A /end AXIS_DESCR
/end CHARACTERISTIC
/begin AXIS_PTS TL_NTrbChrg_A "Axis Values of Turbo Charger Speed for Turbo Charger Dependent Limitation Map" 0x4004B758 /* @ECU_Address@TL_NTrbChrg_A@ */ WgC_NTrbChrg Lookup2D_X_FLOAT32_IEEE 0 EcuIntgdSwGend_CM_single_rpm 10 0.0 120000.0 /end AXIS_PTS
/begin CHARACTERISTIC WgC_PDropIco_M "Pressure Drop Map Out" CURVE 0x40052954 /* @ECU_Address@WgC_PDropIco_M@ */ Lookup1D_FLOAT32_IEEE 0 EcuIntgdSwGend_CM_single_mbar -1000.0 1000.0
 /begin AXIS_DESCR COM_AXIS WgC_MAirFlow EcuIntgdSwGend_CM_single 5 0.0 100.0 AXIS_PTS_REF WgC_MAirFlow_A /end AXIS_DESCR
/end CHARACTERISTIC
/begin AXIS_PTS WgC_MAirFlow_A "Mass Air Flow Map Axis" 0x4005208C /* @ECU_Address@WgC_MAirFlow_A@ */ WgC_MAirFlow Lookup1D_X_FLOAT32_IEEE 0 EcuIntgdSwGend_CM_single 5 0.0 100.0 /end AXIS_PTS
/begin CHARACTERISTIC WgC_PCmprOutltCalcd_M "Compressor Outlet Pressure Calculated Map" CURVE 0x40052940 /* @ECU_Address@WgC_PCmprOutltCalcd_M@ */ Lookup1D_FLOAT32_IEEE 0 EcuIntgdSwGend_CM_single_mbar -5000.0 5000.0
 /begin AXIS_DESCR COM_AXIS WgC_MAirFlow EcuIntgdSwGend_CM_single 5 0.0 100.0 AXIS_PTS_REF WgC_MAirFlow_A /end AXIS_DESCR
/end CHARACTERISTIC
/begin CHARACTERISTIC WgC_EffCmpr_M "Compressor Efficiency Map" MAP 0x40051C00 /* @ECU_Address@WgC_EffCmpr_M@ */ Lookup2D_FLOAT32_IEEE 0 EcuIntgdSwGend_CM_single 0.0 1000.0
 /begin AXIS_DESCR COM_AXIS WgC_RatPCmpr EcuIntgdSwGend_CM_single 15 0.0 15.0 AXIS_PTS_REF WgC_RatPCmpr_A /end AXIS_DESCR
 /begin AXIS_DESCR COM_AXIS WgC_MCorrdAirFlow EcuIntgdSwGend_CM_single 15 0.0 100.0 AXIS_PTS_REF WgC_MCorrdAirFlow_A /end AXIS_DESCR
/end CHARACTERISTIC
/begin AXIS_PTS WgC_RatPCmpr_A "Compressor Pressure Ratio Map Axis" 0x400529C4 /* @ECU_Address@WgC_RatPCmpr_A@ */ WgC_RatPCmpr Lookup2D_X_FLOAT32_IEEE 0 EcuIntgdSwGend_CM_single 15 0.0 15.0 /end AXIS_PTS
/begin AXIS_PTS WgC_MCorrdAirFlow_A "Corrected Mass Air Flow Map Axis" 0x40052104 /* @ECU_Address@WgC_MCorrdAirFlow_A@ */ WgC_MCorrdAirFlow Lookup2D_X_FLOAT32_IEEE 0 EcuIntgdSwGend_CM_single 15 0.0 100.0 /end AXIS_PTS
/begin CHARACTERISTIC WgC_MCorrAirFlowPCmprInlt_M "Mass Air Flow Correction for Compressor Inlet Pressure Map" CURVE 0x400520A0 /* @ECU_Address@WgC_MCorrAirFlowPCmprInlt_M@ */ Lookup1D_FLOAT32_IEEE 0 EcuIntgdSwGend_CM_single_kg_s 0.0 100.0
 /begin AXIS_DESCR COM_AXIS WgC_PCmprInltCalcd EcuIntgdSwGend_CM_single 5 0.0 5000.0 AXIS_PTS_REF WgC_PCmprInltCorrdFlow_A /end AXIS_DESCR
/end CHARACTERISTIC
/begin AXIS_PTS WgC_PCmprInltCorrdFlow_A "Corrected Compressor Inlet Pressure Flow Map Axis" 0x4005292C /* @ECU_Address@WgC_PCmprInltCorrdFlow_A@ */ WgC_PCmprInltCalcd Lookup1D_X_FLOAT32_IEEE 0 EcuIntgdSwGend_CM_single 5 0.0 5000.0 /end AXIS_PTS
/begin CHARACTERISTIC WgC_MCorrAirFlowTAmbAir_M "Mass Air Flow Correction for  Ambient Air Temperature Map" CURVE 0x400520B4 /* @ECU_Address@WgC_MCorrAirFlowTAmbAir_M@ */ Lookup1D_FLOAT32_IEEE 0 EcuIntgdSwGend_CM_single 0.0 100.0
 /begin AXIS_DESCR COM_AXIS EIP_TAmbAir EcuIntgdSwGend_CM_single_degC 5 -40.0 150.0 AXIS_PTS_REF WgC_TAmbAirCorrdFlow_A /end AXIS_DESCR
/end CHARACTERISTIC
/begin AXIS_PTS WgC_TAmbAirCorrdFlow_A "Ambient Air Temperature Corrected for Flow Map Axis" 0x40052A48 /* @ECU_Address@WgC_TAmbAirCorrdFlow_A@ */ EIP_TAmbAir Lookup1D_X_FLOAT32_IEEE 0 EcuIntgdSwGend_CM_single_degC 5 -40.0 150.0 /end AXIS_PTS
/begin CHARACTERISTIC WgC_SurgeLim_M "Surge Limitation Map" CURVE 0x40052A20 /* @ECU_Address@WgC_SurgeLim_M@ */ Lookup1D_FLOAT32_IEEE 0 EcuIntgdSwGend_CM_single 0.0 10.0
 /begin AXIS_DESCR COM_AXIS WgC_MCorrdAirFlow EcuIntgdSwGend_CM_single 10 0.0 100.0 AXIS_PTS_REF WgC_MAirFlowSurgeLim_A /end AXIS_DESCR
/end CHARACTERISTIC
/begin AXIS_PTS WgC_MAirFlowSurgeLim_A "Mass Air Flow for Surge Limit Map Axis" 0x40052064 /* @ECU_Address@WgC_MAirFlowSurgeLim_A@ */ WgC_MCorrdAirFlow Lookup1D_X_FLOAT32_IEEE 0 EcuIntgdSwGend_CM_single 10 0.0 100.0 /end AXIS_PTS
/begin CHARACTERISTIC WgC_NTrbChrg_M "Turbo Charge Speed Map" MAP 0x40052294 /* @ECU_Address@WgC_NTrbChrg_M@ */ Lookup2D_FLOAT32_IEEE 0 EcuIntgdSwGend_CM_single_rpm 0.0 150000.0
 /begin AXIS_DESCR COM_AXIS WgC_RatPCmpr EcuIntgdSwGend_CM_single 15 0.0 1000.0 AXIS_PTS_REF WgC_RatPCmprNTrb_A /end AXIS_DESCR
 /begin AXIS_DESCR COM_AXIS WgC_MCorrdAirFlow EcuIntgdSwGend_CM_single 15 0.0 100.0 AXIS_PTS_REF WgC_MCorrdAirFlowNTrb_A /end AXIS_DESCR
/end CHARACTERISTIC
/begin AXIS_PTS WgC_RatPCmprNTrb_A "Compressor Pressure Ratio for Turbocharger Speed" 0x40052988 /* @ECU_Address@WgC_RatPCmprNTrb_A@ */ WgC_RatPCmpr Lookup2D_X_FLOAT32_IEEE 0 EcuIntgdSwGend_CM_single 15 0.0 1000.0 /end AXIS_PTS
/begin AXIS_PTS WgC_MCorrdAirFlowNTrb_A "Corrected Mass Air Flow for Turbocharger Speed Map Axis" 0x400520C8 /* @ECU_Address@WgC_MCorrdAirFlowNTrb_A@ */ WgC_MCorrdAirFlow Lookup2D_X_FLOAT32_IEEE 0 EcuIntgdSwGend_CM_single 15 0.0 100.0 /end AXIS_PTS
/begin CHARACTERISTIC WgC_VolEff_M "Volumetric EfficiencyMap" MAP 0x40052B74 /* @ECU_Address@WgC_VolEff_M@ */ Lookup2D_FLOAT32_IEEE 0 EcuIntgdSwGend_CM_single 0.0 1000.0
 /begin AXIS_DESCR COM_AXIS NO_INPUT_QUANTITY EcuIntgdSwGend_CM_single_N_m 25 0.0 5000.0 AXIS_PTS_REF WgC_TqIndcdLimdVolEff_A /end AXIS_DESCR
 /begin AXIS_DESCR COM_AXIS EIP_NEng EcuIntgdSwGend_CM_single_rpm 25 0.0 3500.0 AXIS_PTS_REF WgC_NEngVolEff_A /end AXIS_DESCR
/end CHARACTERISTIC
/begin AXIS_PTS WgC_TqIndcdLimdVolEff_A "Limited Indicated Torque for Volumetric Effciency Map Axis" 0x40052B10 /* @ECU_Address@WgC_TqIndcdLimdVolEff_A@ */ NO_INPUT_QUANTITY Lookup2D_X_FLOAT32_IEEE 0 EcuIntgdSwGend_CM_single_N_m 25 0.0 5000.0 /end AXIS_PTS
/begin AXIS_PTS WgC_NEngVolEff_A "Volumetric Efficiency Engine Speed Map Axis" 0x40052228 /* @ECU_Address@WgC_NEngVolEff_A@ */ EIP_NEng Lookup2D_X_FLOAT32_IEEE 0 EcuIntgdSwGend_CM_single_rpm 25 0.0 3500.0 /end AXIS_PTS
/begin CHARACTERISTIC WgC_CoeffDForWgCCtl_M "Derivative Coefficient For Wastegate Control Map" MAP 0x400516BC /* @ECU_Address@WgC_CoeffDForWgCCtl_M@ */ Lookup2D_FLOAT32_IEEE 0 EcuIntgdSwGend_CM_single -100000.0 100000.0
 /begin AXIS_DESCR COM_AXIS EIP_NEng EcuIntgdSwGend_CM_single_rpm 5 0.0 3200.0 AXIS_PTS_REF WgC_NEngForPAirBoostCtl_A /end AXIS_DESCR
 /begin AXIS_DESCR COM_AXIS WgC_ErrPAirBoost EcuIntgdSwGend_CM_single_mbar 5 0.0 1000.0 AXIS_PTS_REF WgC_ErrPAirBoost_A /end AXIS_DESCR
/end CHARACTERISTIC
/begin AXIS_PTS WgC_NEngForPAirBoostCtl_A "Engine Speed for Air Boost Pressure Control Map Axis" 0x40052140 /* @ECU_Address@WgC_NEngForPAirBoostCtl_A@ */ EIP_NEng Lookup2D_X_FLOAT32_IEEE 0 EcuIntgdSwGend_CM_single_rpm 5 0.0 3200.0 /end AXIS_PTS
/begin AXIS_PTS WgC_ErrPAirBoost_A "Air Bosst Pressure Error Map Axis" 0x40051F84 /* @ECU_Address@WgC_ErrPAirBoost_A@ */ WgC_ErrPAirBoost Lookup2D_X_FLOAT32_IEEE 0 EcuIntgdSwGend_CM_single_mbar 5 0.0 1000.0 /end AXIS_PTS
/begin CHARACTERISTIC WgC_CoeffFiltForWgCCtl_M "Filter Coefficient For Wastegate Control Map" MAP 0x40051720 /* @ECU_Address@WgC_CoeffFiltForWgCCtl_M@ */ Lookup2D_FLOAT32_IEEE 0 EcuIntgdSwGend_CM_single -100000.0 100000.0
 /begin AXIS_DESCR COM_AXIS EIP_NEng EcuIntgdSwGend_CM_single_rpm 5 0.0 3200.0 AXIS_PTS_REF WgC_NEngForPAirBoostCtl_A /end AXIS_DESCR
 /begin AXIS_DESCR COM_AXIS WgC_ErrPAirBoost EcuIntgdSwGend_CM_single_mbar 5 0.0 1000.0 AXIS_PTS_REF WgC_ErrPAirBoost_A /end AXIS_DESCR
/end CHARACTERISTIC
/begin CHARACTERISTIC WgC_CoeffIForWgCCtl_M "Integrator Coefficient For Wastegate Control Map" MAP 0x40051784 /* @ECU_Address@WgC_CoeffIForWgCCtl_M@ */ Lookup2D_FLOAT32_IEEE 0 EcuIntgdSwGend_CM_single -100000.0 100000.0
 /begin AXIS_DESCR COM_AXIS EIP_NEng EcuIntgdSwGend_CM_single_rpm 5 0.0 3200.0 AXIS_PTS_REF WgC_NEngForPAirBoostCtl_A /end AXIS_DESCR
 /begin AXIS_DESCR COM_AXIS WgC_ErrPAirBoost EcuIntgdSwGend_CM_single_mbar 5 0.0 1000.0 AXIS_PTS_REF WgC_ErrPAirBoost_A /end AXIS_DESCR
/end CHARACTERISTIC
/begin CHARACTERISTIC WgC_CoeffPForWgCCtl_M "Proportional Coefficient For Wastegate Control Map" MAP 0x400517E8 /* @ECU_Address@WgC_CoeffPForWgCCtl_M@ */ Lookup2D_FLOAT32_IEEE 0 EcuIntgdSwGend_CM_single -100000.0 100000.0
 /begin AXIS_DESCR COM_AXIS EIP_NEng EcuIntgdSwGend_CM_single_rpm 5 0.0 3200.0 AXIS_PTS_REF WgC_NEngForPAirBoostCtl_A /end AXIS_DESCR
 /begin AXIS_DESCR COM_AXIS WgC_ErrPAirBoost EcuIntgdSwGend_CM_single_mbar 5 0.0 1000.0 AXIS_PTS_REF WgC_ErrPAirBoost_A /end AXIS_DESCR
/end CHARACTERISTIC
/begin CHARACTERISTIC WgC_PAirBoostRefMain_M "Reference Air Boost Pressure Map" MAP 0x40052638 /* @ECU_Address@WgC_PAirBoostRefMain_M@ */ Lookup2D_FLOAT32_IEEE 0 EcuIntgdSwGend_CM_single_mbar 0.0 5000.0
 /begin AXIS_DESCR COM_AXIS NO_INPUT_QUANTITY EcuIntgdSwGend_CM_single_N_m 5 0.0 5000.0 AXIS_PTS_REF WgC_TqIndcdLimdForPAirBoostRef_A /end AXIS_DESCR
 /begin AXIS_DESCR COM_AXIS EIP_NEng EcuIntgdSwGend_CM_single_rpm 20 0.0 3200.0 AXIS_PTS_REF WgC_NEngForPAirBoostRef_A /end AXIS_DESCR
/end CHARACTERISTIC
/begin AXIS_PTS WgC_TqIndcdLimdForPAirBoostRef_A "Limited Indicated Torque for Reference Air Boost Pressure Map Axis" 0x40052AFC /* @ECU_Address@WgC_TqIndcdLimdForPAirBoostRef_A@ */ NO_INPUT_QUANTITY Lookup2D_X_FLOAT32_IEEE 0 EcuIntgdSwGend_CM_single_N_m 5 0.0 5000.0 /end AXIS_PTS
/begin AXIS_PTS WgC_NEngForPAirBoostRef_A "Engine Speed for Air Boost Pressure Reference Map Axis" 0x400521B8 /* @ECU_Address@WgC_NEngForPAirBoostRef_A@ */ EIP_NEng Lookup2D_X_FLOAT32_IEEE 0 EcuIntgdSwGend_CM_single_rpm 20 0.0 3200.0 /end AXIS_PTS
/begin CHARACTERISTIC WgC_PAirBoostRefPAmbAirCorr_M "Ambient Air Reference Correction Map" CURVE 0x400527C8 /* @ECU_Address@WgC_PAirBoostRefPAmbAirCorr_M@ */ Lookup1D_FLOAT32_IEEE 0 EcuIntgdSwGend_CM_single_mbar -5000.0 5000.0
 /begin AXIS_DESCR COM_AXIS EIP_PAmbAir EcuIntgdSwGend_CM_single_mbar 5 -1000.0 1600.0 AXIS_PTS_REF WgC_PAmbAir_A /end AXIS_DESCR
/end CHARACTERISTIC
/begin AXIS_PTS WgC_PAmbAir_A "Ambient Air Reference Correction Map Axis" 0x40052918 /* @ECU_Address@WgC_PAmbAir_A@ */ EIP_PAmbAir Lookup1D_X_FLOAT32_IEEE 0 EcuIntgdSwGend_CM_single_mbar 5 -1000.0 1600.0 /end AXIS_PTS
/begin CHARACTERISTIC WgC_PAirBoostRefSurgeCorr_M "AirBoost Pressure Reference Correction for Surge" MAP 0x400527DC /* @ECU_Address@WgC_PAirBoostRefSurgeCorr_M@ */ Lookup2D_FLOAT32_IEEE 0 EcuIntgdSwGend_CM_single_mbar -15000.0 15000.0
 /begin AXIS_DESCR COM_AXIS EIP_NEng EcuIntgdSwGend_CM_single_rpm 8 0.0 3200.0 AXIS_PTS_REF WgC_NEngForSurgeCorr_A /end AXIS_DESCR
 /begin AXIS_DESCR COM_AXIS WgC_DifSurgeLine EcuIntgdSwGend_CM_single 8 -100.0 100.0 AXIS_PTS_REF WgC_DifSurgeLine_A /end AXIS_DESCR
/end CHARACTERISTIC
/begin AXIS_PTS WgC_NEngForSurgeCorr_A "Engine Speed for Surge Correction Map Axis" 0x40052208 /* @ECU_Address@WgC_NEngForSurgeCorr_A@ */ EIP_NEng Lookup2D_X_FLOAT32_IEEE 0 EcuIntgdSwGend_CM_single_rpm 8 0.0 3200.0 /end AXIS_PTS
/begin AXIS_PTS WgC_DifSurgeLine_A "Surge Line Difference Map Axis" 0x4005184C /* @ECU_Address@WgC_DifSurgeLine_A@ */ WgC_DifSurgeLine Lookup2D_X_FLOAT32_IEEE 0 EcuIntgdSwGend_CM_single 8 -100.0 100.0 /end AXIS_PTS
/begin CHARACTERISTIC WgC_PAirBoostRefTAmbAirCorr_M "Temperature Correction for Ambient Air Reference Map Axis" CURVE 0x400528DC /* @ECU_Address@WgC_PAirBoostRefTAmbAirCorr_M@ */ Lookup1D_FLOAT32_IEEE 0 EcuIntgdSwGend_CM_single_mbar -5000.0 5000.0
 /begin AXIS_DESCR COM_AXIS EIP_TAmbAir EcuIntgdSwGend_CM_single_degC 5 -40.0 150.0 AXIS_PTS_REF WgC_TAmbAir_A /end AXIS_DESCR
/end CHARACTERISTIC
/begin AXIS_PTS WgC_TAmbAir_A "Temperature Correction for Ambient Air Reference Map " 0x40052A5C /* @ECU_Address@WgC_TAmbAir_A@ */ EIP_TAmbAir Lookup1D_X_FLOAT32_IEEE 0 EcuIntgdSwGend_CM_single_degC 5 -40.0 150.0 /end AXIS_PTS
/begin CHARACTERISTIC WgC_PAirBoostRefTCooltCorr_M "Reference Air Boost Pressure for Coolant Temperature Correction Map" CURVE 0x400528F0 /* @ECU_Address@WgC_PAirBoostRefTCooltCorr_M@ */ Lookup1D_FLOAT32_IEEE 0 EcuIntgdSwGend_CM_single_mbar -5000.0 5000.0
 /begin AXIS_DESCR COM_AXIS EIP_TCoolt EcuIntgdSwGend_CM_single_degC 5 -40.0 150.0 AXIS_PTS_REF WgC_TCoolt_A /end AXIS_DESCR
/end CHARACTERISTIC
/begin AXIS_PTS WgC_TCoolt_A "Coolant Temperature Map Axis" 0x40052A70 /* @ECU_Address@WgC_TCoolt_A@ */ EIP_TCoolt Lookup1D_X_FLOAT32_IEEE 0 EcuIntgdSwGend_CM_single_degC 5 -40.0 150.0 /end AXIS_PTS
/begin CHARACTERISTIC WgC_PAirBoostRefTOilCorr_M "Temperature Correction for Oil Reference Temperature Map Axis" CURVE 0x40052904 /* @ECU_Address@WgC_PAirBoostRefTOilCorr_M@ */ Lookup1D_FLOAT32_IEEE 0 EcuIntgdSwGend_CM_single_mbar -5000.0 5000.0
 /begin AXIS_DESCR COM_AXIS EIP_TOil EcuIntgdSwGend_CM_single_degC 5 -40.0 150.0 AXIS_PTS_REF WgC_TOil_A /end AXIS_DESCR
/end CHARACTERISTIC
/begin AXIS_PTS WgC_TOil_A "Temperature Correction for Oil Reference Temperature Map Axis" 0x40052A84 /* @ECU_Address@WgC_TOil_A@ */ EIP_TOil Lookup1D_X_FLOAT32_IEEE 0 EcuIntgdSwGend_CM_single_degC 5 -40.0 150.0 /end AXIS_PTS
/begin CHARACTERISTIC DTqC_TqBrkMap1_M "Break Torque Map 1" MAP 0x400420AC /* @ECU_Address@DTqC_TqBrkMap1_M@ */ Lookup2D_FLOAT32_IEEE 0 EcuIntgdSwGend_CM_single_N_m -10000.0 10000.0
 /begin AXIS_DESCR COM_AXIS EIP_PercgAccr EcuIntgdSwGend_CM_single__ 20 0.0 100.0 AXIS_PTS_REF DTqC_PercgAccr_A /end AXIS_DESCR
 /begin AXIS_DESCR COM_AXIS EIP_NEng EcuIntgdSwGend_CM_single_rpm 20 0.0 6000.0 AXIS_PTS_REF DTqC_NEng_A /end AXIS_DESCR
/end CHARACTERISTIC
/begin AXIS_PTS DTqC_PercgAccr_A "Axis Values of Accelerator Pedal for Break Torque Maps" 0x40041E54 /* @ECU_Address@DTqC_PercgAccr_A@ */ EIP_PercgAccr Lookup2D_X_FLOAT32_IEEE 0 EcuIntgdSwGend_CM_single__ 20 0.0 100.0 /end AXIS_PTS
/begin CHARACTERISTIC DTqC_TqBrkMap2_M "Break Torque Map 2" MAP 0x400426EC /* @ECU_Address@DTqC_TqBrkMap2_M@ */ Lookup2D_FLOAT32_IEEE 0 EcuIntgdSwGend_CM_single_N_m -10000.0 10000.0
 /begin AXIS_DESCR COM_AXIS EIP_PercgAccr EcuIntgdSwGend_CM_single__ 20 0.0 100.0 AXIS_PTS_REF DTqC_PercgAccr_A /end AXIS_DESCR
 /begin AXIS_DESCR COM_AXIS EIP_NEng EcuIntgdSwGend_CM_single_rpm 20 0.0 6000.0 AXIS_PTS_REF DTqC_NEng_A /end AXIS_DESCR
/end CHARACTERISTIC
/begin CHARACTERISTIC DTqC_TqBrkMap3_M "Break Torque Map 3" MAP 0x40042D2C /* @ECU_Address@DTqC_TqBrkMap3_M@ */ Lookup2D_FLOAT32_IEEE 0 EcuIntgdSwGend_CM_single_N_m -10000.0 10000.0
 /begin AXIS_DESCR COM_AXIS EIP_PercgAccr EcuIntgdSwGend_CM_single__ 20 0.0 100.0 AXIS_PTS_REF DTqC_PercgAccr_A /end AXIS_DESCR
 /begin AXIS_DESCR COM_AXIS EIP_NEng EcuIntgdSwGend_CM_single_rpm 20 0.0 6000.0 AXIS_PTS_REF DTqC_NEng_A /end AXIS_DESCR
/end CHARACTERISTIC
/begin CHARACTERISTIC DTqC_CoeffDForEndSpdCtl_M "" MAP 0x40040740 /* @ECU_Address@DTqC_CoeffDForEndSpdCtl_M@ */ Lookup2D_FLOAT32_IEEE 0 EcuIntgdSwGend_CM_single -10000.0 10000.0
 /begin AXIS_DESCR COM_AXIS DTqC_NEngDelta EcuIntgdSwGend_CM_single_rpm 10 -500.0 500.0 AXIS_PTS_REF DTqC_ErrNEng_A /end AXIS_DESCR
 /begin AXIS_DESCR COM_AXIS EIP_TCoolt EcuIntgdSwGend_CM_single_degC 10 -50.0 200.0 AXIS_PTS_REF DTqC_TCooltForEndSpdCtl_A /end AXIS_DESCR
/end CHARACTERISTIC
/begin AXIS_PTS DTqC_TCooltForEndSpdCtl_A "" 0x40041EE0 /* @ECU_Address@DTqC_TCooltForEndSpdCtl_A@ */ EIP_TCoolt Lookup2D_X_FLOAT32_IEEE 0 EcuIntgdSwGend_CM_single_degC 10 -50.0 200.0 /end AXIS_PTS
/begin CHARACTERISTIC DTqC_CoeffFiltForEndSpdCtl_M "" MAP 0x40040BF0 /* @ECU_Address@DTqC_CoeffFiltForEndSpdCtl_M@ */ Lookup2D_FLOAT32_IEEE 0 EcuIntgdSwGend_CM_single -10000.0 10000.0
 /begin AXIS_DESCR COM_AXIS DTqC_NEngDelta EcuIntgdSwGend_CM_single_rpm 10 -500.0 500.0 AXIS_PTS_REF DTqC_ErrNEng_A /end AXIS_DESCR
 /begin AXIS_DESCR COM_AXIS EIP_TCoolt EcuIntgdSwGend_CM_single_degC 10 -50.0 200.0 AXIS_PTS_REF DTqC_TCooltForEndSpdCtl_A /end AXIS_DESCR
/end CHARACTERISTIC
/begin CHARACTERISTIC DTqC_CoeffIForEndSpdCtl_M "" MAP 0x400410B8 /* @ECU_Address@DTqC_CoeffIForEndSpdCtl_M@ */ Lookup2D_FLOAT32_IEEE 0 EcuIntgdSwGend_CM_single -10000.0 10000.0
 /begin AXIS_DESCR COM_AXIS DTqC_NEngDelta EcuIntgdSwGend_CM_single_rpm 10 -500.0 500.0 AXIS_PTS_REF DTqC_ErrNEng_A /end AXIS_DESCR
 /begin AXIS_DESCR COM_AXIS EIP_TCoolt EcuIntgdSwGend_CM_single_degC 10 -50.0 200.0 AXIS_PTS_REF DTqC_TCooltForEndSpdCtl_A /end AXIS_DESCR
/end CHARACTERISTIC
/begin CHARACTERISTIC DTqC_CoeffPForEndSpdCtl_M "" MAP 0x40041568 /* @ECU_Address@DTqC_CoeffPForEndSpdCtl_M@ */ Lookup2D_FLOAT32_IEEE 0 EcuIntgdSwGend_CM_single -10000.0 10000.0
 /begin AXIS_DESCR COM_AXIS DTqC_NEngDelta EcuIntgdSwGend_CM_single_rpm 10 -500.0 500.0 AXIS_PTS_REF DTqC_ErrNEng_A /end AXIS_DESCR
 /begin AXIS_DESCR COM_AXIS EIP_TCoolt EcuIntgdSwGend_CM_single_degC 10 -50.0 200.0 AXIS_PTS_REF DTqC_TCooltForEndSpdCtl_A /end AXIS_DESCR
/end CHARACTERISTIC
/begin CHARACTERISTIC DTqC_CoeffDForTSC1SpdCtl_M "Derivative Coefficient Map for Speed Controller" MAP 0x40040A60 /* @ECU_Address@DTqC_CoeffDForTSC1SpdCtl_M@ */ Lookup2D_FLOAT32_IEEE 0 EcuIntgdSwGend_CM_single -10000.0 10000.0
 /begin AXIS_DESCR COM_AXIS DTqC_ErrNSpdReq EcuIntgdSwGend_CM_single_rpm 10 -1000.0 1000.0 AXIS_PTS_REF DTqC_TSC1ErrNEng_A /end AXIS_DESCR
 /begin AXIS_DESCR COM_AXIS EIP_TCoolt EcuIntgdSwGend_CM_single_degC 10 -50.0 200.0 AXIS_PTS_REF DTqC_TCooltForTSC1SpdCtl_A /end AXIS_DESCR
/end CHARACTERISTIC
/begin AXIS_PTS DTqC_TSC1ErrNEng_A "Axis Values of Error Engine Speed for PID Coefficient Maps" 0x4004207C /* @ECU_Address@DTqC_TSC1ErrNEng_A@ */ DTqC_ErrNSpdReq Lookup2D_X_FLOAT32_IEEE 0 EcuIntgdSwGend_CM_single_rpm 10 -1000.0 1000.0 /end AXIS_PTS
/begin AXIS_PTS DTqC_TCooltForTSC1SpdCtl_A "Axis Values of Coolant Temperature for Speed Control Map" 0x40041F58 /* @ECU_Address@DTqC_TCooltForTSC1SpdCtl_A@ */ EIP_TCoolt Lookup2D_X_FLOAT32_IEEE 0 EcuIntgdSwGend_CM_single_degC 10 -50.0 200.0 /end AXIS_PTS
/begin CHARACTERISTIC DTqC_CoeffFiltForTSC1SpdCtl_M "Filter Coefficient Map for Speed Controller" MAP 0x40040F10 /* @ECU_Address@DTqC_CoeffFiltForTSC1SpdCtl_M@ */ Lookup2D_FLOAT32_IEEE 0 EcuIntgdSwGend_CM_single -10000.0 10000.0
 /begin AXIS_DESCR COM_AXIS DTqC_ErrNSpdReq EcuIntgdSwGend_CM_single_rpm 10 -1000.0 1000.0 AXIS_PTS_REF DTqC_TSC1ErrNEng_A /end AXIS_DESCR
 /begin AXIS_DESCR COM_AXIS EIP_TCoolt EcuIntgdSwGend_CM_single_degC 10 -50.0 200.0 AXIS_PTS_REF DTqC_TCooltForTSC1SpdCtl_A /end AXIS_DESCR
/end CHARACTERISTIC
/begin CHARACTERISTIC DTqC_CoeffIForTSC1SpdCtl_M "Integrator Coefficient Map for Speed Controller" MAP 0x400413D8 /* @ECU_Address@DTqC_CoeffIForTSC1SpdCtl_M@ */ Lookup2D_FLOAT32_IEEE 0 EcuIntgdSwGend_CM_single -10000.0 10000.0
 /begin AXIS_DESCR COM_AXIS DTqC_ErrNSpdReq EcuIntgdSwGend_CM_single_rpm 10 -1000.0 1000.0 AXIS_PTS_REF DTqC_TSC1ErrNEng_A /end AXIS_DESCR
 /begin AXIS_DESCR COM_AXIS EIP_TCoolt EcuIntgdSwGend_CM_single_degC 10 -50.0 200.0 AXIS_PTS_REF DTqC_TCooltForTSC1SpdCtl_A /end AXIS_DESCR
/end CHARACTERISTIC
/begin CHARACTERISTIC DTqC_CoeffPForTSC1SpdCtl_M "Proportional Coefficient Map for Speed Controller" MAP 0x40041888 /* @ECU_Address@DTqC_CoeffPForTSC1SpdCtl_M@ */ Lookup2D_FLOAT32_IEEE 0 EcuIntgdSwGend_CM_single -10000.0 10000.0
 /begin AXIS_DESCR COM_AXIS DTqC_ErrNSpdReq EcuIntgdSwGend_CM_single_rpm 10 -1000.0 1000.0 AXIS_PTS_REF DTqC_TSC1ErrNEng_A /end AXIS_DESCR
 /begin AXIS_DESCR COM_AXIS EIP_TCoolt EcuIntgdSwGend_CM_single_degC 10 -50.0 200.0 AXIS_PTS_REF DTqC_TCooltForTSC1SpdCtl_A /end AXIS_DESCR
/end CHARACTERISTIC
/begin CHARACTERISTIC CrsCtrl_EngBrkLvl1ActvnThd_P "Engine Brake Level 1 Activation Threshold Parameter" VALUE 0x40040534 /* @ECU_Address@CrsCtrl_EngBrkLvl1ActvnThd_P@ */ Scalar_FLOAT32_IEEE 0 EcuIntgdSwGend_CM_single_km_h -300.0 300.0 /end CHARACTERISTIC
/begin CHARACTERISTIC CrsCtrl_EngBrkLvl1DeactvnThd_P "Engine Brake Level 1 Deactivation Threshold Parameter" VALUE 0x40040538 /* @ECU_Address@CrsCtrl_EngBrkLvl1DeactvnThd_P@ */ Scalar_FLOAT32_IEEE 0 EcuIntgdSwGend_CM_single_km_h -300.0 300.0 /end CHARACTERISTIC
/begin CHARACTERISTIC CrsCtrl_EngBrkLvl2ActvnThd_P "Engine Brake Level 1 Activation Threshold Parameter" VALUE 0x4004053C /* @ECU_Address@CrsCtrl_EngBrkLvl2ActvnThd_P@ */ Scalar_FLOAT32_IEEE 0 EcuIntgdSwGend_CM_single_km_h -300.0 300.0 /end CHARACTERISTIC
/begin CHARACTERISTIC CrsCtrl_EngBrkLvl2DeactvnThd_P "Engine Brake Level 1 Deactivation Threshold Parameter" VALUE 0x40040540 /* @ECU_Address@CrsCtrl_EngBrkLvl2DeactvnThd_P@ */ Scalar_FLOAT32_IEEE 0 EcuIntgdSwGend_CM_single_km_h -300.0 300.0 /end CHARACTERISTIC
/begin CHARACTERISTIC CrsCtrl_TiEngBrkLvl1ActvnDeb_P "Engine Brake Level 1 Activation Debounce Time Parameter" VALUE 0x40040674 /* @ECU_Address@CrsCtrl_TiEngBrkLvl1ActvnDeb_P@ */ Scalar_FLOAT32_IEEE 0 EcuIntgdSwGend_CM_single_ms 0.0 10000.0 /end CHARACTERISTIC
/begin CHARACTERISTIC CrsCtrl_TiEngBrkLvl2ActvnDeb_P "Engine Brake Level 2 Activation Debounce Time Parameter" VALUE 0x40040678 /* @ECU_Address@CrsCtrl_TiEngBrkLvl2ActvnDeb_P@ */ Scalar_FLOAT32_IEEE 0 EcuIntgdSwGend_CM_single_ms 0.0 10000.0 /end CHARACTERISTIC
/begin CHARACTERISTIC DTqC_CoeffFiltKdEndSpdCtlOvv_P "" VALUE 0x400410A4 /* @ECU_Address@DTqC_CoeffFiltKdEndSpdCtlOvv_P@ */ Scalar_FLOAT32_IEEE 0 EcuIntgdSwGend_CM_single 0.0 1000.0 /end CHARACTERISTIC
/begin CHARACTERISTIC DTqC_CoeffFiltTSC1SpdCtlOvv_P "Derivative Coefficient Parameter for TCU Request Speed Controller - Override Value" VALUE 0x400410B4 /* @ECU_Address@DTqC_CoeffFiltTSC1SpdCtlOvv_P@ */ Scalar_FLOAT32_IEEE 0 EcuIntgdSwGend_CM_single -100.0 100.0 /end CHARACTERISTIC
/begin CHARACTERISTIC DTqC_FacSclPIDCoeffEndSpd_P "" VALUE 0x40041A80 /* @ECU_Address@DTqC_FacSclPIDCoeffEndSpd_P@ */ Scalar_FLOAT32_IEEE 0 EcuIntgdSwGend_CM_single 1.0 10000.0 /end CHARACTERISTIC
/begin CHARACTERISTIC DTqC_KdEndSpdCtlOvv_P "" VALUE 0x40041C38 /* @ECU_Address@DTqC_KdEndSpdCtlOvv_P@ */ Scalar_FLOAT32_IEEE 0 EcuIntgdSwGend_CM_single 0.0 1000.0 /end CHARACTERISTIC
/begin CHARACTERISTIC DTqC_KdTSC1SpdCtlOvv_P "Derivative Coefficient Parameter for TCU Request Speed Controller - Override Value" VALUE 0x40041C48 /* @ECU_Address@DTqC_KdTSC1SpdCtlOvv_P@ */ Scalar_FLOAT32_IEEE 0 EcuIntgdSwGend_CM_single -100.0 100.0 /end CHARACTERISTIC
/begin CHARACTERISTIC DTqC_KiEndSpdCtlOvv_P "" VALUE 0x40041C50 /* @ECU_Address@DTqC_KiEndSpdCtlOvv_P@ */ Scalar_FLOAT32_IEEE 0 EcuIntgdSwGend_CM_single 0.0 1000.0 /end CHARACTERISTIC
/begin CHARACTERISTIC DTqC_KiTSC1SpdCtlOvv_P "Integrator Coefficient Parameter for TCU Request Speed Controller - Override Value" VALUE 0x40041C60 /* @ECU_Address@DTqC_KiTSC1SpdCtlOvv_P@ */ Scalar_FLOAT32_IEEE 0 EcuIntgdSwGend_CM_single -100.0 100.0 /end CHARACTERISTIC
/begin CHARACTERISTIC DTqC_KpEndSpdCtlOvv_P "" VALUE 0x40041C68 /* @ECU_Address@DTqC_KpEndSpdCtlOvv_P@ */ Scalar_FLOAT32_IEEE 0 EcuIntgdSwGend_CM_single 0.0 1000.0 /end CHARACTERISTIC
/begin CHARACTERISTIC DTqC_KpTSC1SpdCtlOvv_P "Proportional Coefficient Parameter for TCU Request Speed Controller - Override Value" VALUE 0x40041C78 /* @ECU_Address@DTqC_KpTSC1SpdCtlOvv_P@ */ Scalar_FLOAT32_IEEE 0 EcuIntgdSwGend_CM_single -100.0 100.0 /end CHARACTERISTIC
/begin CHARACTERISTIC DTqC_TCooltMap1Thd_P "Coolant High Temperature Threshold for Break Torque Map 1" VALUE 0x40041FA8 /* @ECU_Address@DTqC_TCooltMap1Thd_P@ */ Scalar_FLOAT32_IEEE 0 EcuIntgdSwGend_CM_single_degC -20.0 100.0 /end CHARACTERISTIC
/begin CHARACTERISTIC DTqC_TCooltMap2Thd_P "Coolant High Temperature Threshold for Break Torque Map 2" VALUE 0x40041FAC /* @ECU_Address@DTqC_TCooltMap2Thd_P@ */ Scalar_FLOAT32_IEEE 0 EcuIntgdSwGend_CM_single_degC -20.0 100.0 /end CHARACTERISTIC
/begin CHARACTERISTIC DTqC_TCooltMap3Thd_P "Coolant High Temperature Threshold for Break Torque Map 3" VALUE 0x40041FB0 /* @ECU_Address@DTqC_TCooltMap3Thd_P@ */ Scalar_FLOAT32_IEEE 0 EcuIntgdSwGend_CM_single_degC -20.0 100.0 /end CHARACTERISTIC
/begin CHARACTERISTIC DTqC_TqDesSatPIDMaxEndSpd_P "" VALUE 0x40043390 /* @ECU_Address@DTqC_TqDesSatPIDMaxEndSpd_P@ */ Scalar_FLOAT32_IEEE 0 EcuIntgdSwGend_CM_single_N_m 0.0 2000.0 /end CHARACTERISTIC
/begin CHARACTERISTIC DTqC_TqDesSatPIDMinEndSpd_P "" VALUE 0x40043394 /* @ECU_Address@DTqC_TqDesSatPIDMinEndSpd_P@ */ Scalar_FLOAT32_IEEE 0 EcuIntgdSwGend_CM_single_N_m 0.0 2000.0 /end CHARACTERISTIC
/begin CHARACTERISTIC DTqC_TqDesTSC1ReqPIDMax_P "TCU Request PID Controller Saturation Max Parameter" VALUE 0x4004339C /* @ECU_Address@DTqC_TqDesTSC1ReqPIDMax_P@ */ Scalar_FLOAT32_IEEE 0 EcuIntgdSwGend_CM_single_N_m 0.0 10000.0 /end CHARACTERISTIC
/begin CHARACTERISTIC DTqC_TqDesTSC1ReqPIDMin_P "TCU Request PID Controller Saturation Min Parameter" VALUE 0x400433A0 /* @ECU_Address@DTqC_TqDesTSC1ReqPIDMin_P@ */ Scalar_FLOAT32_IEEE 0 EcuIntgdSwGend_CM_single_N_m -10000.0 10000.0 /end CHARACTERISTIC
/begin CHARACTERISTIC DTqC_TqLimdBrk1Ovv_P "Break Torque Map 1 Out - Override Value" VALUE 0x400439FC /* @ECU_Address@DTqC_TqLimdBrk1Ovv_P@ */ Scalar_FLOAT32_IEEE 0 EcuIntgdSwGend_CM_single_N_m 0.0 1000.0 /end CHARACTERISTIC
/begin CHARACTERISTIC DTqC_TqLimdBrk2Ovv_P "Break Torque Map 2 Out - Override Value" VALUE 0x40043A04 /* @ECU_Address@DTqC_TqLimdBrk2Ovv_P@ */ Scalar_FLOAT32_IEEE 0 EcuIntgdSwGend_CM_single_N_m 0.0 1000.0 /end CHARACTERISTIC
/begin CHARACTERISTIC DTqC_TqLimdBrk3Ovv_P "Break Torque Map 3 Out - Override Value" VALUE 0x40043A0C /* @ECU_Address@DTqC_TqLimdBrk3Ovv_P@ */ Scalar_FLOAT32_IEEE 0 EcuIntgdSwGend_CM_single_N_m 0.0 1000.0 /end CHARACTERISTIC
/begin CHARACTERISTIC EIP_NCyl1ErrOvv_P "Cylinder 1 Speed Difference Error Parameter - Override Value" VALUE 0x4004427C /* @ECU_Address@EIP_NCyl1ErrOvv_P@ */ Scalar_FLOAT32_IEEE 0 EcuIntgdSwGend_CM_single_rpm -100.0 100.0 /end CHARACTERISTIC
/begin CHARACTERISTIC EIP_NCyl1MinThd_P "Cylinder 1 Speed Minimium Threshold Parameter" VALUE 0x40044280 /* @ECU_Address@EIP_NCyl1MinThd_P@ */ Scalar_FLOAT32_IEEE 0 EcuIntgdSwGend_CM_single_rpm 0.0 3200.0 /end CHARACTERISTIC
/begin CHARACTERISTIC EIP_NCyl2ErrOvv_P "Cylinder 2 Speed Difference Error Parameter - Override Value" VALUE 0x40044288 /* @ECU_Address@EIP_NCyl2ErrOvv_P@ */ Scalar_FLOAT32_IEEE 0 EcuIntgdSwGend_CM_single_rpm -100.0 100.0 /end CHARACTERISTIC
/begin CHARACTERISTIC EIP_NCyl2MinThd_P "Cylinder 2 Speed Minimium Threshold Parameter" VALUE 0x4004428C /* @ECU_Address@EIP_NCyl2MinThd_P@ */ Scalar_FLOAT32_IEEE 0 EcuIntgdSwGend_CM_single_rpm 0.0 3200.0 /end CHARACTERISTIC
/begin CHARACTERISTIC EIP_NCyl3ErrOvv_P "Cylinder 3 Speed Difference Error Parameter - Override Value" VALUE 0x40044294 /* @ECU_Address@EIP_NCyl3ErrOvv_P@ */ Scalar_FLOAT32_IEEE 0 EcuIntgdSwGend_CM_single_rpm -100.0 100.0 /end CHARACTERISTIC
/begin CHARACTERISTIC EIP_NCyl3MinThd_P "Cylinder 3 Speed Minimium Threshold Parameter" VALUE 0x40044298 /* @ECU_Address@EIP_NCyl3MinThd_P@ */ Scalar_FLOAT32_IEEE 0 EcuIntgdSwGend_CM_single_rpm 0.0 3200.0 /end CHARACTERISTIC
/begin CHARACTERISTIC EIP_NCyl4ErrOvv_P "Cylinder 4 Speed Difference Error Parameter - Override Value" VALUE 0x400442A0 /* @ECU_Address@EIP_NCyl4ErrOvv_P@ */ Scalar_FLOAT32_IEEE 0 EcuIntgdSwGend_CM_single_rpm -100.0 100.0 /end CHARACTERISTIC
/begin CHARACTERISTIC EIP_NCyl4MinThd_P "Cylinder 4 Speed Minimium Threshold Parameter" VALUE 0x400442A4 /* @ECU_Address@EIP_NCyl4MinThd_P@ */ Scalar_FLOAT32_IEEE 0 EcuIntgdSwGend_CM_single_rpm 0.0 3200.0 /end CHARACTERISTIC
/begin CHARACTERISTIC EIP_NCyl5ErrOvv_P "Cylinder 5 Speed Difference Error Parameter - Override Value" VALUE 0x400442AC /* @ECU_Address@EIP_NCyl5ErrOvv_P@ */ Scalar_FLOAT32_IEEE 0 EcuIntgdSwGend_CM_single_rpm -100.0 100.0 /end CHARACTERISTIC
/begin CHARACTERISTIC EIP_NCyl5MinThd_P "Cylinder 5 Speed Minimium Threshold Parameter" VALUE 0x400442B0 /* @ECU_Address@EIP_NCyl5MinThd_P@ */ Scalar_FLOAT32_IEEE 0 EcuIntgdSwGend_CM_single_rpm 0.0 3200.0 /end CHARACTERISTIC
/begin CHARACTERISTIC EIP_NCyl6ErrOvv_P "Cylinder 6 Speed Difference  Error Parameter - Override Value" VALUE 0x400442B8 /* @ECU_Address@EIP_NCyl6ErrOvv_P@ */ Scalar_FLOAT32_IEEE 0 EcuIntgdSwGend_CM_single_rpm -100.0 100.0 /end CHARACTERISTIC
/begin CHARACTERISTIC EIP_NCylMaxThd_P "Cylinder Speed Max Threshold Parameter" VALUE 0x400442C0 /* @ECU_Address@EIP_NCylMaxThd_P@ */ Scalar_FLOAT32_IEEE 0 EcuIntgdSwGend_CM_single_rpm 0.0 250.0 /end CHARACTERISTIC
/begin CHARACTERISTIC EIP_NCylMinThd_P "Cylinder Speed Min Threshold Parameter" VALUE 0x400442C4 /* @ECU_Address@EIP_NCylMinThd_P@ */ Scalar_FLOAT32_IEEE 0 EcuIntgdSwGend_CM_single_rpm -250.0 0.0 /end CHARACTERISTIC
/begin CHARACTERISTIC EIP_TcNCyl1MinFil_P "Low Pass Filter Time Constant for Min Cylinder Speed 1" VALUE 0x40044648 /* @ECU_Address@EIP_TcNCyl1MinFil_P@ */ Scalar_FLOAT32_IEEE 0 EcuIntgdSwGend_CM_single_ms 0.0 2500.0 /end CHARACTERISTIC
/begin CHARACTERISTIC EIP_TcNCyl2MinFil_P "Low Pass Filter Time Constant for Min Cylinder Speed 2" VALUE 0x4004464C /* @ECU_Address@EIP_TcNCyl2MinFil_P@ */ Scalar_FLOAT32_IEEE 0 EcuIntgdSwGend_CM_single_ms 0.0 2500.0 /end CHARACTERISTIC
/begin CHARACTERISTIC EIP_TcNCyl3MinFil_P "Low Pass Filter Time Constant for Min Cylinder Speed 3" VALUE 0x40044650 /* @ECU_Address@EIP_TcNCyl3MinFil_P@ */ Scalar_FLOAT32_IEEE 0 EcuIntgdSwGend_CM_single_ms 0.0 2500.0 /end CHARACTERISTIC
/begin CHARACTERISTIC EIP_TcNCyl4MinFil_P "Low Pass Filter Time Constant for Min Cylinder Speed 4" VALUE 0x40044654 /* @ECU_Address@EIP_TcNCyl4MinFil_P@ */ Scalar_FLOAT32_IEEE 0 EcuIntgdSwGend_CM_single_ms 0.0 2500.0 /end CHARACTERISTIC
/begin CHARACTERISTIC EIP_TcNCyl5MinFil_P "Low Pass Filter Time Constant for Min Cylinder Speed 5" VALUE 0x40044658 /* @ECU_Address@EIP_TcNCyl5MinFil_P@ */ Scalar_FLOAT32_IEEE 0 EcuIntgdSwGend_CM_single_ms 0.0 2500.0 /end CHARACTERISTIC
/begin CHARACTERISTIC EIP_TcNCyl6MinFil_P "Low Pass Filter Time Constant for Min Cylinder Speed 6" VALUE 0x4004465C /* @ECU_Address@EIP_TcNCyl6MinFil_P@ */ Scalar_FLOAT32_IEEE 0 EcuIntgdSwGend_CM_single_ms 0.0 2500.0 /end CHARACTERISTIC
/begin CHARACTERISTIC EIP_TcNMeaCylMin_P "Low Pass Filter Time Constant for Min Mean Cylinder Speed" VALUE 0x40044664 /* @ECU_Address@EIP_TcNMeaCylMin_P@ */ Scalar_FLOAT32_IEEE 0 EcuIntgdSwGend_CM_single_ms 0.0 5000.0 /end CHARACTERISTIC
/begin CHARACTERISTIC IC_SoiMaiInjOvv_P "Start of Main Injection  - Override Value Parameter" VALUE 0x40045FF0 /* @ECU_Address@IC_SoiMaiInjOvv_P@ */ Scalar_FLOAT32_IEEE 0 EcuIntgdSwGend_CM_single_deg -100.0 100.0 /end CHARACTERISTIC
/begin CHARACTERISTIC IC_SoiMaiLimdHi_P "High Limited Start of Main Injection Parameter" VALUE 0x40045FF4 /* @ECU_Address@IC_SoiMaiLimdHi_P@ */ Scalar_FLOAT32_IEEE 0 EcuIntgdSwGend_CM_single_deg -100.0 1000.0 /end CHARACTERISTIC
/begin CHARACTERISTIC IC_SoiMaiLimdLo_P "Low LimitedStart of Main Injection Parameter" VALUE 0x40045FF8 /* @ECU_Address@IC_SoiMaiLimdLo_P@ */ Scalar_FLOAT32_IEEE 0 EcuIntgdSwGend_CM_single_deg -100.0 1000.0 /end CHARACTERISTIC
/begin CHARACTERISTIC IC_SoiPltInjOvv_P "Start of Pilot Injection  - Override Value Parameter" VALUE 0x40047DB0 /* @ECU_Address@IC_SoiPltInjOvv_P@ */ Scalar_FLOAT32_IEEE 0 EcuIntgdSwGend_CM_single_deg -100.0 100.0 /end CHARACTERISTIC
/begin CHARACTERISTIC IC_SoiPltLimdHi_P "High Limited Start of Pilot Injection Parameter" VALUE 0x400484BC /* @ECU_Address@IC_SoiPltLimdHi_P@ */ Scalar_FLOAT32_IEEE 0 EcuIntgdSwGend_CM_single_deg -100.0 1000.0 /end CHARACTERISTIC
/begin CHARACTERISTIC IC_SoiPltLimdLo_P "Low Limited Start of Pilot Injection Parameter" VALUE 0x400484C0 /* @ECU_Address@IC_SoiPltLimdLo_P@ */ Scalar_FLOAT32_IEEE 0 EcuIntgdSwGend_CM_single_deg -100.0 1000.0 /end CHARACTERISTIC
/begin CHARACTERISTIC RPG_PRailSetPointOvv_P "Rail Pressure Set Point - Override Value Parameter" VALUE 0x4004A604 /* @ECU_Address@RPG_PRailSetPointOvv_P@ */ Scalar_FLOAT32_IEEE 0 EcuIntgdSwGend_CM_single_bar 0.0 5000.0 /end CHARACTERISTIC
/begin CHARACTERISTIC RPG_TCooltMap1Thd_P "Coolant High Temperature Map 1 Threshold Parameter" VALUE 0x4004B0B8 /* @ECU_Address@RPG_TCooltMap1Thd_P@ */ Scalar_FLOAT32_IEEE 0 EcuIntgdSwGend_CM_single_degC -40.0 250.0 /end CHARACTERISTIC
/begin CHARACTERISTIC RPG_TCooltMap2Thd_P "Coolant High Temperature Map 2 Threshold Parameter" VALUE 0x4004B0BC /* @ECU_Address@RPG_TCooltMap2Thd_P@ */ Scalar_FLOAT32_IEEE 0 EcuIntgdSwGend_CM_single_degC -40.0 250.0 /end CHARACTERISTIC
/begin CHARACTERISTIC RPG_TCooltMap3Thd_P "Coolant High Temperature Map 3 Threshold Parameter" VALUE 0x4004B0C0 /* @ECU_Address@RPG_TCooltMap3Thd_P@ */ Scalar_FLOAT32_IEEE 0 EcuIntgdSwGend_CM_single_degC -40.0 250.0 /end CHARACTERISTIC
/begin CHARACTERISTIC SC_LvlFuPreTestMin_P "" VALUE 0x4004B230 /* @ECU_Address@SC_LvlFuPreTestMin_P@ */ Scalar_FLOAT32_IEEE 0 EcuIntgdSwGend_CM_single__ 0.0 100.0 /end CHARACTERISTIC
/begin CHARACTERISTIC SC_LvlOilPreTestMin_P "" VALUE 0x4004B238 /* @ECU_Address@SC_LvlOilPreTestMin_P@ */ Scalar_FLOAT32_IEEE 0 EcuIntgdSwGend_CM_single__ 0.0 100.0 /end CHARACTERISTIC
/begin CHARACTERISTIC SC_NEngThdForOvrHeatProtn_P "Engine Speed Threshold Parameter for OverHeat Protection" VALUE 0x4004B248 /* @ECU_Address@SC_NEngThdForOvrHeatProtn_P@ */ Scalar_FLOAT32_IEEE 0 EcuIntgdSwGend_CM_single_rpm 0.0 800.0 /end CHARACTERISTIC
/begin CHARACTERISTIC SC_NEngThdForStrtTurn_P "Engine Speed Threshold Parameter for Engine Not Turn" VALUE 0x4004B24C /* @ECU_Address@SC_NEngThdForStrtTurn_P@ */ Scalar_FLOAT32_IEEE 0 EcuIntgdSwGend_CM_single_rpm 0.0 200.0 /end CHARACTERISTIC
/begin CHARACTERISTIC SC_TiAcvnErrPCVDeb_P "PCV Error Debouncer Activation Timer Parameter" VALUE 0x4004B254 /* @ECU_Address@SC_TiAcvnErrPCVDeb_P@ */ Scalar_FLOAT32_IEEE 0 EcuIntgdSwGend_CM_single_ms 0.0 50000.0 /end CHARACTERISTIC
/begin CHARACTERISTIC SC_TiAcvnErrVCVDeb_P "VCV Error Debouncer Activation Timer Parameter" VALUE 0x4004B258 /* @ECU_Address@SC_TiAcvnErrVCVDeb_P@ */ Scalar_FLOAT32_IEEE 0 EcuIntgdSwGend_CM_single_ms 0.0 50000.0 /end CHARACTERISTIC
/begin CHARACTERISTIC SC_TiAcvnLvlFuDeb_P "Fuel Level Debouncer Activation Timer Parameter" VALUE 0x4004B25C /* @ECU_Address@SC_TiAcvnLvlFuDeb_P@ */ Scalar_FLOAT32_IEEE 0 EcuIntgdSwGend_CM_single_ms 0.0 50000.0 /end CHARACTERISTIC
/begin CHARACTERISTIC SC_TiAcvnLvlOilDeb_P "Oil Level Debouncer Activation Timer Parameter" VALUE 0x4004B260 /* @ECU_Address@SC_TiAcvnLvlOilDeb_P@ */ Scalar_FLOAT32_IEEE 0 EcuIntgdSwGend_CM_single_ms 0.0 50000.0 /end CHARACTERISTIC
/begin CHARACTERISTIC SC_TiEngNotTurnTiEna_P "Timer Time Parameter of Engine Not Turn" VALUE 0x4004B288 /* @ECU_Address@SC_TiEngNotTurnTiEna_P@ */ Scalar_FLOAT32_IEEE 0 EcuIntgdSwGend_CM_single_ms 0.0 100000.0 /end CHARACTERISTIC
/begin CHARACTERISTIC SC_TiForEngProtn_P "Timer Parameter for Engine OverHeat Protection" VALUE 0x4004B28C /* @ECU_Address@SC_TiForEngProtn_P@ */ Scalar_FLOAT32_IEEE 0 EcuIntgdSwGend_CM_single_ms 0.0 100000.0 /end CHARACTERISTIC
/begin CHARACTERISTIC SpdLimr_EngBrkLvl1ActvnThd_P "Engine Brake Level 1 Activaiton Threshold Parameter" VALUE 0x4004B438 /* @ECU_Address@SpdLimr_EngBrkLvl1ActvnThd_P@ */ Scalar_FLOAT32_IEEE 0 EcuIntgdSwGend_CM_single_km_h -300.0 300.0 /end CHARACTERISTIC
/begin CHARACTERISTIC SpdLimr_EngBrkLvl1DeactvnThd_P "Engine Brake Level 1 Deactivation Threshold Parameter" VALUE 0x4004B43C /* @ECU_Address@SpdLimr_EngBrkLvl1DeactvnThd_P@ */ Scalar_FLOAT32_IEEE 0 EcuIntgdSwGend_CM_single_km_h -300.0 300.0 /end CHARACTERISTIC
/begin CHARACTERISTIC SpdLimr_EngBrkLvl2ActvnThd_P "Engine Brake Level 2 Activation Threshold Parameter" VALUE 0x4004B440 /* @ECU_Address@SpdLimr_EngBrkLvl2ActvnThd_P@ */ Scalar_FLOAT32_IEEE 0 EcuIntgdSwGend_CM_single_km_h -300.0 300.0 /end CHARACTERISTIC
/begin CHARACTERISTIC SpdLimr_EngBrkLvl2DeactvnThd_P "Engine Brake Level 2 Deactivation Threshold Parameter" VALUE 0x4004B444 /* @ECU_Address@SpdLimr_EngBrkLvl2DeactvnThd_P@ */ Scalar_FLOAT32_IEEE 0 EcuIntgdSwGend_CM_single_km_h -300.0 300.0 /end CHARACTERISTIC
/begin CHARACTERISTIC SpdLimr_IntglRstErrVehThd_P "Integral Reset Vehicle Speed Error Threshold" VALUE 0x4004B498 /* @ECU_Address@SpdLimr_IntglRstErrVehThd_P@ */ Scalar_FLOAT32_IEEE 0 EcuIntgdSwGend_CM_single_km_h -100.0 100.0 /end CHARACTERISTIC
/begin CHARACTERISTIC SpdLimr_PIDCoeffDOvv_P "PID Derivative Coefficient for Cruise Control - Override Value" VALUE 0x4004B4CC /* @ECU_Address@SpdLimr_PIDCoeffDOvv_P@ */ Scalar_FLOAT32_IEEE 0 EcuIntgdSwGend_CM_single 0.0 1000.0 /end CHARACTERISTIC
/begin CHARACTERISTIC SpdLimr_PIDCoeffFiltOvv_P "PID Filter Coefficient for Cruise Control - Override Value" VALUE 0x4004B4D4 /* @ECU_Address@SpdLimr_PIDCoeffFiltOvv_P@ */ Scalar_FLOAT32_IEEE 0 EcuIntgdSwGend_CM_single 0.0 1000.0 /end CHARACTERISTIC
/begin CHARACTERISTIC SpdLimr_PIDCoeffIOvv_P "PID Integrator Coefficient for Cruise Control - Override Value" VALUE 0x4004B4DC /* @ECU_Address@SpdLimr_PIDCoeffIOvv_P@ */ Scalar_FLOAT32_IEEE 0 EcuIntgdSwGend_CM_single 0.0 1000.0 /end CHARACTERISTIC
/begin CHARACTERISTIC SpdLimr_PIDCoeffPOvv_P "PID Proportional Coefficient for Cruise Control - Override Value" VALUE 0x4004B4E4 /* @ECU_Address@SpdLimr_PIDCoeffPOvv_P@ */ Scalar_FLOAT32_IEEE 0 EcuIntgdSwGend_CM_single 0.0 1000.0 /end CHARACTERISTIC
/begin CHARACTERISTIC SpdLimr_PIDMin_P "Minimum Value of PID Parameter" VALUE 0x4004B578 /* @ECU_Address@SpdLimr_PIDMin_P@ */ Scalar_FLOAT32_IEEE 0 EcuIntgdSwGend_CM_single_N_m -5000.0 5000.0 /end CHARACTERISTIC
/begin CHARACTERISTIC SpdLimr_TiEngBrkLvl1ActvnDeb_P "Elapsed Time Engine Brake Level 1 Activation Debouncer Parameter" VALUE 0x4004B584 /* @ECU_Address@SpdLimr_TiEngBrkLvl1ActvnDeb_P@ */ Scalar_FLOAT32_IEEE 0 EcuIntgdSwGend_CM_single_ms 0.0 10000.0 /end CHARACTERISTIC
/begin CHARACTERISTIC SpdLimr_TiEngBrkLvl2ActvnDeb_P "Elapsed Time Engine Brake Level 2 Activation Debouncer Parameter" VALUE 0x4004B588 /* @ECU_Address@SpdLimr_TiEngBrkLvl2ActvnDeb_P@ */ Scalar_FLOAT32_IEEE 0 EcuIntgdSwGend_CM_single_ms 0.0 10000.0 /end CHARACTERISTIC
/begin CHARACTERISTIC TL_NEngAcvTqLimnForNExhTrbChrg_P "Engine Speed Torque Limitation Activation Threshold for Turbo Charger Speed" VALUE 0x4004B650 /* @ECU_Address@TL_NEngAcvTqLimnForNExhTrbChrg_P@ */ Scalar_FLOAT32_IEEE 0 EcuIntgdSwGend_CM_single_rpm 0.0 5000.0 /end CHARACTERISTIC
/begin CHARACTERISTIC TL_NEngAcvTqLimnForPAirAmb_P "Engine Speed Torque Limitation Activation Threshold for Ambient Air Pressure" VALUE 0x4004B654 /* @ECU_Address@TL_NEngAcvTqLimnForPAirAmb_P@ */ Scalar_FLOAT32_IEEE 0 EcuIntgdSwGend_CM_single_rpm 0.0 5000.0 /end CHARACTERISTIC
/begin CHARACTERISTIC TL_NEngAcvTqLimnForPAirBoost_P "Engine Speed Torque Limitation Activation Threshold for AirBoost Pressure" VALUE 0x4004B658 /* @ECU_Address@TL_NEngAcvTqLimnForPAirBoost_P@ */ Scalar_FLOAT32_IEEE 0 EcuIntgdSwGend_CM_single_rpm 0.0 5000.0 /end CHARACTERISTIC
/begin CHARACTERISTIC TL_NEngAcvTqLimnForTAir_P "Engine Speed Torque Limitation Activation Threshold for Air Boost Temperature" VALUE 0x4004B65C /* @ECU_Address@TL_NEngAcvTqLimnForTAir_P@ */ Scalar_FLOAT32_IEEE 0 EcuIntgdSwGend_CM_single_rpm 0.0 5000.0 /end CHARACTERISTIC
/begin CHARACTERISTIC TL_NEngAcvTqLimnForTCoolt_P "Engine Speed Torque Limitation Activation Threshold for Coolant High Temperature" VALUE 0x4004B660 /* @ECU_Address@TL_NEngAcvTqLimnForTCoolt_P@ */ Scalar_FLOAT32_IEEE 0 EcuIntgdSwGend_CM_single_rpm 0.0 5000.0 /end CHARACTERISTIC
/begin CHARACTERISTIC TL_NEngAcvTqLimnForTFu_P "Engine Speed Torque Limitation Activation Threshold for Fuel Temperature" VALUE 0x4004B664 /* @ECU_Address@TL_NEngAcvTqLimnForTFu_P@ */ Scalar_FLOAT32_IEEE 0 EcuIntgdSwGend_CM_single_rpm 0.0 5000.0 /end CHARACTERISTIC
/begin CHARACTERISTIC TL_NEngAcvTqLimnForTOil_P "Engine Speed Torque Limitation Activation Threshold for Oil Temperature" VALUE 0x4004B668 /* @ECU_Address@TL_NEngAcvTqLimnForTOil_P@ */ Scalar_FLOAT32_IEEE 0 EcuIntgdSwGend_CM_single_rpm 0.0 5000.0 /end CHARACTERISTIC
/begin CHARACTERISTIC TL_PercgTqLimnForErrTCooltSnsr_P "Percentage Parameter of Torque Limitation for Coolant High Temperature Sensor Error Dependent" VALUE 0x4004B7D0 /* @ECU_Address@TL_PercgTqLimnForErrTCooltSnsr_P@ */ Scalar_FLOAT32_IEEE 0 EcuIntgdSwGend_CM_single__ 0.0 100.0 /end CHARACTERISTIC
/begin CHARACTERISTIC TL_PercgTqLimnForErrTOilSnsr_P "Percentage Parameter of Torque Limitation for Oil Temperature Sensor Error Dependent" VALUE 0x4004B7D4 /* @ECU_Address@TL_PercgTqLimnForErrTOilSnsr_P@ */ Scalar_FLOAT32_IEEE 0 EcuIntgdSwGend_CM_single__ 0.0 100.0 /end CHARACTERISTIC
/begin CHARACTERISTIC TL_TiTqLimnForNExhTrbChrgDeb_P "Time Value of Engine Dependent Activation for Turbo Charger Speed Limitation" VALUE 0x4004C46C /* @ECU_Address@TL_TiTqLimnForNExhTrbChrgDeb_P@ */ Scalar_FLOAT32_IEEE 0 EcuIntgdSwGend_CM_single_ms 0.0 100000.0 /end CHARACTERISTIC
/begin CHARACTERISTIC TL_TiTqLimnForPAirAmbDeb_P "Time Value of Engine Dependent Activation for Ambient Air Pressure Limitation" VALUE 0x4004C470 /* @ECU_Address@TL_TiTqLimnForPAirAmbDeb_P@ */ Scalar_FLOAT32_IEEE 0 EcuIntgdSwGend_CM_single_ms 0.0 100000.0 /end CHARACTERISTIC
/begin CHARACTERISTIC TL_TiTqLimnForPAirBoostDeb_P "Time Value of Engine Dependent Activation for Air Boost Pressure Limitation" VALUE 0x4004C474 /* @ECU_Address@TL_TiTqLimnForPAirBoostDeb_P@ */ Scalar_FLOAT32_IEEE 0 EcuIntgdSwGend_CM_single_ms 0.0 100000.0 /end CHARACTERISTIC
/begin CHARACTERISTIC TL_TiTqLimnForTAirDeb_P "Time Value of Engine Dependent Activation for Air Boost Temperature Limitation" VALUE 0x4004C478 /* @ECU_Address@TL_TiTqLimnForTAirDeb_P@ */ Scalar_FLOAT32_IEEE 0 EcuIntgdSwGend_CM_single_ms 0.0 100000.0 /end CHARACTERISTIC
/begin CHARACTERISTIC TL_TiTqLimnForTCooltDeb_P "Time Value of Engine Dependent Activation for Coolant High Temperature Limitation" VALUE 0x4004C47C /* @ECU_Address@TL_TiTqLimnForTCooltDeb_P@ */ Scalar_FLOAT32_IEEE 0 EcuIntgdSwGend_CM_single_ms 0.0 100000.0 /end CHARACTERISTIC
/begin CHARACTERISTIC TL_TiTqLimnForTFuDeb_P "Time Value of Engine Dependent Activation for Fuel Temperature Limitation" VALUE 0x4004C480 /* @ECU_Address@TL_TiTqLimnForTFuDeb_P@ */ Scalar_FLOAT32_IEEE 0 EcuIntgdSwGend_CM_single_ms 0.0 100000.0 /end CHARACTERISTIC
/begin CHARACTERISTIC TL_TiTqLimnForTOilDeb_P "Time Value of Engine Dependent Activation for Oil Temperature Limitation" VALUE 0x4004C484 /* @ECU_Address@TL_TiTqLimnForTOilDeb_P@ */ Scalar_FLOAT32_IEEE 0 EcuIntgdSwGend_CM_single_ms 0.0 100000.0 /end CHARACTERISTIC
/begin CHARACTERISTIC WM_NEngDetdThdRTN_P "Return To Normal Engine Speed Level Check Threshold Parameter" VALUE 0x40050F08 /* @ECU_Address@WM_NEngDetdThdRTN_P@ */ Scalar_FLOAT32_IEEE 0 EcuIntgdSwGend_CM_single_rpm 0.0 6000.0 /end CHARACTERISTIC
/begin CHARACTERISTIC WM_TiMaxNEngDetdThdRTN_P "Engine Speed Over Threshold Return to Normal Debouncer Parameter" VALUE 0x40051534 /* @ECU_Address@WM_TiMaxNEngDetdThdRTN_P@ */ Scalar_FLOAT32_IEEE 0 EcuIntgdSwGend_CM_single_ms 0.0 25000.0 /end CHARACTERISTIC
/begin CHARACTERISTIC WgC_DutySatPIDMax_P "PID Duty Max Saturation Parameter" VALUE 0x4005186C /* @ECU_Address@WgC_DutySatPIDMax_P@ */ Scalar_FLOAT32_IEEE 0 EcuIntgdSwGend_CM_single__ -100.0 100.0 /end CHARACTERISTIC
/begin CHARACTERISTIC WgC_DutySatPIDMin_P "PID Duty Min Saturation Parameter" VALUE 0x40051870 /* @ECU_Address@WgC_DutySatPIDMin_P@ */ Scalar_FLOAT32_IEEE 0 EcuIntgdSwGend_CM_single__ -100.0 100.0 /end CHARACTERISTIC
/begin CHARACTERISTIC WgC_FacSclPIDCoeff_P "PID Scaling Coefficient Factor Parameter" VALUE 0x40051F98 /* @ECU_Address@WgC_FacSclPIDCoeff_P@ */ Scalar_FLOAT32_IEEE 0 EcuIntgdSwGend_CM_single 1.0 10000.0 /end CHARACTERISTIC
/begin CHARACTERISTIC WgC_NTrbChrgOvv_P "Turbo Charge Speed - Override Value Parameter" VALUE 0x40052290 /* @ECU_Address@WgC_NTrbChrgOvv_P@ */ Scalar_FLOAT32_IEEE 0 EcuIntgdSwGend_CM_single_rpm 0.0 150000.0 /end CHARACTERISTIC
/begin CHARACTERISTIC WgC_PIDCoeffDOvv_P "PID D Coeffcient - Override Value Parameter" VALUE 0x4005296C /* @ECU_Address@WgC_PIDCoeffDOvv_P@ */ Scalar_FLOAT32_IEEE 0 EcuIntgdSwGend_CM_single 0.0 10000.0 /end CHARACTERISTIC
/begin CHARACTERISTIC WgC_PIDCoeffFiltOvv_P "PID Filter Coeffcient - Override Value Parameter" VALUE 0x40052974 /* @ECU_Address@WgC_PIDCoeffFiltOvv_P@ */ Scalar_FLOAT32_IEEE 0 EcuIntgdSwGend_CM_single 0.0 10000.0 /end CHARACTERISTIC
/begin CHARACTERISTIC WgC_PIDCoeffIOvv_P "PID I Coefficient - Override Value Parameter" VALUE 0x4005297C /* @ECU_Address@WgC_PIDCoeffIOvv_P@ */ Scalar_FLOAT32_IEEE 0 EcuIntgdSwGend_CM_single 0.0 10000.0 /end CHARACTERISTIC
/begin CHARACTERISTIC WgC_PIDCoeffPOvv_P "PID P Coefficient - Override Value Parameter" VALUE 0x40052984 /* @ECU_Address@WgC_PIDCoeffPOvv_P@ */ Scalar_FLOAT32_IEEE 0 EcuIntgdSwGend_CM_single 0.0 10000.0 /end CHARACTERISTIC
/begin CHARACTERISTIC WgC_VolEng_P "Engine Volume Parameter" VALUE 0x40053538 /* @ECU_Address@WgC_VolEng_P@ */ Scalar_FLOAT32_IEEE 0 EcuIntgdSwGend_CM_single 0.0 100.0 /end CHARACTERISTIC
/begin CHARACTERISTIC WM_MaskGEOvv_P "Global Enable Mask - Override Parameter" VALUE 0x40050C50 /* @ECU_Address@WM_MaskGEOvv_P@ */ Scalar_ULONG 0 EcuIntgdSwGend_CM_uint32 0.0 4.294967295E+9 /end CHARACTERISTIC
/begin CHARACTERISTIC WM_MaskRTNForAcvLimp_P "Return To Normal Mask for Limp Activation Parameter" VALUE 0x40050C80 /* @ECU_Address@WM_MaskRTNForAcvLimp_P@ */ Scalar_ULONG 0 EcuIntgdSwGend_CM_uint32 0.0 4.294967295E+9 /end CHARACTERISTIC
/begin CHARACTERISTIC WM_MaskRTNForEmgcyShtdwnForOvspd_P "Return To Normal Mask for Emergency Shutdown for Overspeed" VALUE 0x40050C84 /* @ECU_Address@WM_MaskRTNForEmgcyShtdwnForOvspd_P@ */ Scalar_ULONG 0 EcuIntgdSwGend_CM_uint32 0.0 4.294967295E+9 /end CHARACTERISTIC
/begin CHARACTERISTIC WM_MaskRTNForErrCamCrankTotLoss_P "Return To Normal Mask for Cam Crank Total Loss" VALUE 0x40050C88 /* @ECU_Address@WM_MaskRTNForErrCamCrankTotLoss_P@ */ Scalar_ULONG 0 EcuIntgdSwGend_CM_uint32 0.0 4.294967295E+9 /end CHARACTERISTIC
/begin CHARACTERISTIC WM_MaskRTNForErrInjrShtdwn_P "Return To Normal Mask for Injection Error Shutdown" VALUE 0x40050CA4 /* @ECU_Address@WM_MaskRTNForErrInjrShtdwn_P@ */ Scalar_ULONG 0 EcuIntgdSwGend_CM_uint32 0.0 4.294967295E+9 /end CHARACTERISTIC
/begin CHARACTERISTIC WM_MaskRTNForFlgOfWtrInFu_P "Return To Normal Mask for Water In Fuel Parameter" VALUE 0x40050D04 /* @ECU_Address@WM_MaskRTNForFlgOfWtrInFu_P@ */ Scalar_ULONG 0 EcuIntgdSwGend_CM_uint32 0.0 4.294967295E+9 /end CHARACTERISTIC
/begin CHARACTERISTIC WM_MaskRTNForPRailNotCtldMsg_P "Return To Normal Mask for Rail Pressure is Not Controlled Message Parameter" VALUE 0x40050D08 /* @ECU_Address@WM_MaskRTNForPRailNotCtldMsg_P@ */ Scalar_ULONG 0 EcuIntgdSwGend_CM_uint32 0.0 4.294967295E+9 /end CHARACTERISTIC
/begin CHARACTERISTIC WM_MaskRTNOvv_P "Return To Normal Mask - Override Parameter" VALUE 0x40050D10 /* @ECU_Address@WM_MaskRTNOvv_P@ */ Scalar_ULONG 0 EcuIntgdSwGend_CM_uint32 0.0 4.294967295E+9 /end CHARACTERISTIC
/begin CHARACTERISTIC WM_MaskRctnForAcvLimp_P "Mask Reaction for Limp Active Parameter" VALUE 0x40050D14 /* @ECU_Address@WM_MaskRctnForAcvLimp_P@ */ Scalar_ULONG 0 EcuIntgdSwGend_CM_uint32 0.0 4.294967295E+9 /end CHARACTERISTIC
/begin CHARACTERISTIC WM_MaskRctnForEmgcyShtdwnForOvspd_P "Mask Reaction for Emergency Shutdown for Overspeed Parameter" VALUE 0x40050D18 /* @ECU_Address@WM_MaskRctnForEmgcyShtdwnForOvspd_P@ */ Scalar_ULONG 0 EcuIntgdSwGend_CM_uint32 0.0 4.294967295E+9 /end CHARACTERISTIC
/begin CHARACTERISTIC WM_MaskRctnForErrCamCrankTotLoss_P "Mask Reaction for Cam Crank Total Loss Parameter" VALUE 0x40050D1C /* @ECU_Address@WM_MaskRctnForErrCamCrankTotLoss_P@ */ Scalar_ULONG 0 EcuIntgdSwGend_CM_uint32 0.0 4.294967295E+9 /end CHARACTERISTIC
/begin CHARACTERISTIC WM_MaskRctnForErrInjrShtdwn_P "Mask Reaction for Injection Error Shutdown Parameter" VALUE 0x40050D40 /* @ECU_Address@WM_MaskRctnForErrInjrShtdwn_P@ */ Scalar_ULONG 0 EcuIntgdSwGend_CM_uint32 0.0 4.294967295E+9 /end CHARACTERISTIC
/begin CHARACTERISTIC WM_MaskRctnForFlgOfWtrInFu_P "Mask Reaction for Water In Fuel Parameter" VALUE 0x40050D44 /* @ECU_Address@WM_MaskRctnForFlgOfWtrInFu_P@ */ Scalar_ULONG 0 EcuIntgdSwGend_CM_uint32 0.0 4.294967295E+9 /end CHARACTERISTIC
/begin CHARACTERISTIC WM_MaskRctnForPRailNotCtldMsg_P "Mask Reaction for Rail Pressure Is Not Controlled Message Parameter" VALUE 0x40050DB4 /* @ECU_Address@WM_MaskRctnForPRailNotCtldMsg_P@ */ Scalar_ULONG 0 EcuIntgdSwGend_CM_uint32 0.0 4.294967295E+9 /end CHARACTERISTIC
/begin CHARACTERISTIC WM_MaskRctnOvv_P "Mask Reaction - Override Parameter" VALUE 0x40050E64 /* @ECU_Address@WM_MaskRctnOvv_P@ */ Scalar_ULONG 0 EcuIntgdSwGend_CM_uint32 0.0 4.294967295E+9 /end CHARACTERISTIC
/begin CHARACTERISTIC DTqC_CoeffFiltKdEndSpdCtlOvs_P "" VALUE 0x400410A0 /* @ECU_Address@DTqC_CoeffFiltKdEndSpdCtlOvs_P@ */ Scalar_BOOLEAN 0 EcuIntgdSwGend_CM_boolean 0.0 1.0 /end CHARACTERISTIC
/begin CHARACTERISTIC DTqC_CoeffFiltTSC1SpdCtlOvs_P "Derivative Coefficient Parameter for TCU Request Speed Controller - Override Switch" VALUE 0x400410B0 /* @ECU_Address@DTqC_CoeffFiltTSC1SpdCtlOvs_P@ */ Scalar_BOOLEAN 0 EcuIntgdSwGend_CM_boolean 0.0 1.0 /end CHARACTERISTIC
/begin CHARACTERISTIC DTqC_HardLimEnaSwt_P "" VALUE 0x40041A88 /* @ECU_Address@DTqC_HardLimEnaSwt_P@ */ Scalar_BOOLEAN 0 EcuIntgdSwGend_CM_boolean 0.0 1.0 /end CHARACTERISTIC
/begin CHARACTERISTIC DTqC_KdEndSpdCtlOvs_P "" VALUE 0x40041C34 /* @ECU_Address@DTqC_KdEndSpdCtlOvs_P@ */ Scalar_BOOLEAN 0 EcuIntgdSwGend_CM_boolean 0.0 1.0 /end CHARACTERISTIC
/begin CHARACTERISTIC DTqC_KdTSC1SpdCtlOvs_P "Derivative Coefficient Parameter for TCU Request Speed Controller - Override Switch" VALUE 0x40041C44 /* @ECU_Address@DTqC_KdTSC1SpdCtlOvs_P@ */ Scalar_BOOLEAN 0 EcuIntgdSwGend_CM_boolean 0.0 1.0 /end CHARACTERISTIC
/begin CHARACTERISTIC DTqC_KiEndSpdCtlOvs_P "" VALUE 0x40041C4C /* @ECU_Address@DTqC_KiEndSpdCtlOvs_P@ */ Scalar_BOOLEAN 0 EcuIntgdSwGend_CM_boolean 0.0 1.0 /end CHARACTERISTIC
/begin CHARACTERISTIC DTqC_KiTSC1SpdCtlOvs_P "Integrator Coefficient Parameter for TCU Request Speed Controller - Override Switch" VALUE 0x40041C5C /* @ECU_Address@DTqC_KiTSC1SpdCtlOvs_P@ */ Scalar_BOOLEAN 0 EcuIntgdSwGend_CM_boolean 0.0 1.0 /end CHARACTERISTIC
/begin CHARACTERISTIC DTqC_KpEndSpdCtlOvs_P "" VALUE 0x40041C64 /* @ECU_Address@DTqC_KpEndSpdCtlOvs_P@ */ Scalar_BOOLEAN 0 EcuIntgdSwGend_CM_boolean 0.0 1.0 /end CHARACTERISTIC
/begin CHARACTERISTIC DTqC_KpTSC1SpdCtlOvs_P "Proportional Coefficient Parameter for TCU Request Speed Controller - Override Switch" VALUE 0x40041C74 /* @ECU_Address@DTqC_KpTSC1SpdCtlOvs_P@ */ Scalar_BOOLEAN 0 EcuIntgdSwGend_CM_boolean 0.0 1.0 /end CHARACTERISTIC
/begin CHARACTERISTIC DTqC_SoftLimEnaSwt_P "" VALUE 0x40041EB0 /* @ECU_Address@DTqC_SoftLimEnaSwt_P@ */ Scalar_BOOLEAN 0 EcuIntgdSwGend_CM_boolean 0.0 1.0 /end CHARACTERISTIC
/begin CHARACTERISTIC DTqC_TqLimdBrk1Ovs_P "Break Torque Map 1 Out - Override Switch" VALUE 0x400439F8 /* @ECU_Address@DTqC_TqLimdBrk1Ovs_P@ */ Scalar_BOOLEAN 0 EcuIntgdSwGend_CM_boolean 0.0 1.0 /end CHARACTERISTIC
/begin CHARACTERISTIC DTqC_TqLimdBrk2Ovs_P "Break Torque Map 2 Out - Override Switch" VALUE 0x40043A00 /* @ECU_Address@DTqC_TqLimdBrk2Ovs_P@ */ Scalar_BOOLEAN 0 EcuIntgdSwGend_CM_boolean 0.0 1.0 /end CHARACTERISTIC
/begin CHARACTERISTIC DTqC_TqLimdBrk3Ovs_P "Break Torque Map 3 Out - Override Switch" VALUE 0x40043A08 /* @ECU_Address@DTqC_TqLimdBrk3Ovs_P@ */ Scalar_BOOLEAN 0 EcuIntgdSwGend_CM_boolean 0.0 1.0 /end CHARACTERISTIC
/begin CHARACTERISTIC EIP_NCyl1ErrOvs_P "Cylinder 1 Speed Difference Error Parameter - Override Switch" VALUE 0x40044278 /* @ECU_Address@EIP_NCyl1ErrOvs_P@ */ Scalar_BOOLEAN 0 EcuIntgdSwGend_CM_boolean 0.0 1.0 /end CHARACTERISTIC
/begin CHARACTERISTIC EIP_NCyl2ErrOvs_P "Cylinder 2 Speed Difference Error Parameter - Override Switch" VALUE 0x40044284 /* @ECU_Address@EIP_NCyl2ErrOvs_P@ */ Scalar_BOOLEAN 0 EcuIntgdSwGend_CM_boolean 0.0 1.0 /end CHARACTERISTIC
/begin CHARACTERISTIC EIP_NCyl3ErrOvs_P "Cylinder 3 Speed Difference Error Parameter - Override Switch" VALUE 0x40044290 /* @ECU_Address@EIP_NCyl3ErrOvs_P@ */ Scalar_BOOLEAN 0 EcuIntgdSwGend_CM_boolean 0.0 1.0 /end CHARACTERISTIC
/begin CHARACTERISTIC EIP_NCyl4ErrOvs_P "Cylinder 4 Speed Difference Error Parameter - Override Switch" VALUE 0x4004429C /* @ECU_Address@EIP_NCyl4ErrOvs_P@ */ Scalar_BOOLEAN 0 EcuIntgdSwGend_CM_boolean 0.0 1.0 /end CHARACTERISTIC
/begin CHARACTERISTIC EIP_NCyl5ErrOvs_P "Cylinder 5 Speed Difference Error Parameter - Override Switch" VALUE 0x400442A8 /* @ECU_Address@EIP_NCyl5ErrOvs_P@ */ Scalar_BOOLEAN 0 EcuIntgdSwGend_CM_boolean 0.0 1.0 /end CHARACTERISTIC
/begin CHARACTERISTIC EIP_NCyl6ErrOvs_P "Cylinder 6 Speed Difference Error Parameter - Override Switch" VALUE 0x400442B4 /* @ECU_Address@EIP_NCyl6ErrOvs_P@ */ Scalar_BOOLEAN 0 EcuIntgdSwGend_CM_boolean 0.0 1.0 /end CHARACTERISTIC
/begin CHARACTERISTIC IC_SoiMaiInjNotCorrdOvs_P "Start of Main Injection is Not Corrected - Override Switch Parameter" VALUE 0x40045FE8 /* @ECU_Address@IC_SoiMaiInjNotCorrdOvs_P@ */ Scalar_BOOLEAN 0 EcuIntgdSwGend_CM_boolean 0.0 1.0 /end CHARACTERISTIC
/begin CHARACTERISTIC IC_SoiMaiInjOvs_P "Start of Main Injection - Override Switch Parameter" VALUE 0x40045FEC /* @ECU_Address@IC_SoiMaiInjOvs_P@ */ Scalar_BOOLEAN 0 EcuIntgdSwGend_CM_boolean 0.0 1.0 /end CHARACTERISTIC
/begin CHARACTERISTIC IC_SoiPltInjNotCorrdOvs_P "Start of Pilot Injection is Not Corrected - Override Switch Parameter" VALUE 0x40047DA8 /* @ECU_Address@IC_SoiPltInjNotCorrdOvs_P@ */ Scalar_BOOLEAN 0 EcuIntgdSwGend_CM_boolean 0.0 1.0 /end CHARACTERISTIC
/begin CHARACTERISTIC IC_SoiPltInjOvs_P "Start of Pilot Injection - Override Switch Parameter" VALUE 0x40047DAC /* @ECU_Address@IC_SoiPltInjOvs_P@ */ Scalar_BOOLEAN 0 EcuIntgdSwGend_CM_boolean 0.0 1.0 /end CHARACTERISTIC
/begin CHARACTERISTIC RPG_PRailSetPointOvs_P "Rail Pressure Set Point - Override Switch Parameter" VALUE 0x4004A600 /* @ECU_Address@RPG_PRailSetPointOvs_P@ */ Scalar_BOOLEAN 0 EcuIntgdSwGend_CM_boolean 0.0 1.0 /end CHARACTERISTIC
/begin CHARACTERISTIC SC_LvlFuInhEnaSwt_P "" VALUE 0x4004B22C /* @ECU_Address@SC_LvlFuInhEnaSwt_P@ */ Scalar_BOOLEAN 0 EcuIntgdSwGend_CM_boolean 0.0 1.0 /end CHARACTERISTIC
/begin CHARACTERISTIC SC_LvlOilInhEnaSwt_P "" VALUE 0x4004B234 /* @ECU_Address@SC_LvlOilInhEnaSwt_P@ */ Scalar_BOOLEAN 0 EcuIntgdSwGend_CM_boolean 0.0 1.0 /end CHARACTERISTIC
/begin CHARACTERISTIC SC_bAcvStrtrOvrHeatProtnOvs_P "OverHeat Protection - Override Switch Parameter" VALUE 0x4004B2BC /* @ECU_Address@SC_bAcvStrtrOvrHeatProtnOvs_P@ */ Scalar_BOOLEAN 0 EcuIntgdSwGend_CM_boolean 0.0 1.0 /end CHARACTERISTIC
/begin CHARACTERISTIC SC_bAcvStrtrOvrHeatProtnOvv_P "OverHeat Protection - Override Value Parameter" VALUE 0x4004B2C0 /* @ECU_Address@SC_bAcvStrtrOvrHeatProtnOvv_P@ */ Scalar_BOOLEAN 0 EcuIntgdSwGend_CM_boolean 0.0 1.0 /end CHARACTERISTIC
/begin CHARACTERISTIC SC_bEngNotTurnOvs_P "Engine Not Turn Override Switch Parameter" VALUE 0x4004B2CC /* @ECU_Address@SC_bEngNotTurnOvs_P@ */ Scalar_BOOLEAN 0 EcuIntgdSwGend_CM_boolean 0.0 1.0 /end CHARACTERISTIC
/begin CHARACTERISTIC SC_bEngNotTurnOvv_P "Engine Not Turn Override Value Parameter" VALUE 0x4004B2D0 /* @ECU_Address@SC_bEngNotTurnOvv_P@ */ Scalar_BOOLEAN 0 EcuIntgdSwGend_CM_boolean 0.0 1.0 /end CHARACTERISTIC
/begin CHARACTERISTIC SpdLimr_PIDCoeffDOvs_P "PID Derivative Coefficient for Cruise Control - Override Switch" VALUE 0x4004B4C8 /* @ECU_Address@SpdLimr_PIDCoeffDOvs_P@ */ Scalar_BOOLEAN 0 EcuIntgdSwGend_CM_boolean 0.0 1.0 /end CHARACTERISTIC
/begin CHARACTERISTIC SpdLimr_PIDCoeffFiltOvs_P "PID Filter Coefficient for Cruise Control - Override Switch" VALUE 0x4004B4D0 /* @ECU_Address@SpdLimr_PIDCoeffFiltOvs_P@ */ Scalar_BOOLEAN 0 EcuIntgdSwGend_CM_boolean 0.0 1.0 /end CHARACTERISTIC
/begin CHARACTERISTIC SpdLimr_PIDCoeffIOvs_P "PID Integrator Coefficient for Cruise Control - Override Switch" VALUE 0x4004B4D8 /* @ECU_Address@SpdLimr_PIDCoeffIOvs_P@ */ Scalar_BOOLEAN 0 EcuIntgdSwGend_CM_boolean 0.0 1.0 /end CHARACTERISTIC
/begin CHARACTERISTIC SpdLimr_PIDCoeffPOvs_P "PID Proportional Coefficient for Cruise Control - Override Switch" VALUE 0x4004B4E0 /* @ECU_Address@SpdLimr_PIDCoeffPOvs_P@ */ Scalar_BOOLEAN 0 EcuIntgdSwGend_CM_boolean 0.0 1.0 /end CHARACTERISTIC
/begin CHARACTERISTIC TL_SnsrSwtForTAirLimn_P "Air Temperature Limitation Sensor Selection" VALUE 0x4004C2C8 /* @ECU_Address@TL_SnsrSwtForTAirLimn_P@ */ Scalar_BOOLEAN 0 EcuIntgdSwGend_CM_boolean 0.0 1.0 /end CHARACTERISTIC
/begin CHARACTERISTIC WM_MaskGEOvs_P "Global Enable Mask - Override Switch Parameter" VALUE 0x40050C4C /* @ECU_Address@WM_MaskGEOvs_P@ */ Scalar_BOOLEAN 0 EcuIntgdSwGend_CM_boolean 0.0 1.0 /end CHARACTERISTIC
/begin CHARACTERISTIC WM_MaskRTNOvs_P "Return To Normal Mask - Override Switch Parameter" VALUE 0x40050D0C /* @ECU_Address@WM_MaskRTNOvs_P@ */ Scalar_BOOLEAN 0 EcuIntgdSwGend_CM_boolean 0.0 1.0 /end CHARACTERISTIC
/begin CHARACTERISTIC WM_MaskRctnOvs_P "Mask Reaction - Override Switch" VALUE 0x40050E60 /* @ECU_Address@WM_MaskRctnOvs_P@ */ Scalar_BOOLEAN 0 EcuIntgdSwGend_CM_boolean 0.0 1.0 /end CHARACTERISTIC
/begin CHARACTERISTIC WM_bErrLvlOilSnsrLimp_P "Oil Level Sensor Limp Error Activation Parameter" VALUE 0x40051680 /* @ECU_Address@WM_bErrLvlOilSnsrLimp_P@ */ Scalar_BOOLEAN 0 EcuIntgdSwGend_CM_boolean 0.0 1.0 /end CHARACTERISTIC
/begin CHARACTERISTIC WM_bErrPAirBoostSnsrLimp_P "Air Boost Pressure Sensor Limp Error Activation Parameter" VALUE 0x40051684 /* @ECU_Address@WM_bErrPAirBoostSnsrLimp_P@ */ Scalar_BOOLEAN 0 EcuIntgdSwGend_CM_boolean 0.0 1.0 /end CHARACTERISTIC
/begin CHARACTERISTIC WM_bErrPAmbAirSnsrLimp_P "Ambient Air Pressure Sensor Limp Error Activation Parameter" VALUE 0x40051688 /* @ECU_Address@WM_bErrPAmbAirSnsrLimp_P@ */ Scalar_BOOLEAN 0 EcuIntgdSwGend_CM_boolean 0.0 1.0 /end CHARACTERISTIC
/begin CHARACTERISTIC WM_bErrPFuSnsrLimp_P "Fuel Pressure Sensor Limp Error Activation Parameter" VALUE 0x4005168C /* @ECU_Address@WM_bErrPFuSnsrLimp_P@ */ Scalar_BOOLEAN 0 EcuIntgdSwGend_CM_boolean 0.0 1.0 /end CHARACTERISTIC
/begin CHARACTERISTIC WM_bErrPOilSnsrLimp_P "Oil Pressure Sensor Limp Error Activation Parameter" VALUE 0x40051690 /* @ECU_Address@WM_bErrPOilSnsrLimp_P@ */ Scalar_BOOLEAN 0 EcuIntgdSwGend_CM_boolean 0.0 1.0 /end CHARACTERISTIC
/begin CHARACTERISTIC WM_bErrTAirBoostSnsrLimp_P "Air Boost Temperature Sensor Limp Error Activation Parameter" VALUE 0x40051694 /* @ECU_Address@WM_bErrTAirBoostSnsrLimp_P@ */ Scalar_BOOLEAN 0 EcuIntgdSwGend_CM_boolean 0.0 1.0 /end CHARACTERISTIC
/begin CHARACTERISTIC WM_bErrTAmbAirSnsrLimp_P "Ambient Air Temperature Sensor Limp Error Activation Parameter" VALUE 0x40051698 /* @ECU_Address@WM_bErrTAmbAirSnsrLimp_P@ */ Scalar_BOOLEAN 0 EcuIntgdSwGend_CM_boolean 0.0 1.0 /end CHARACTERISTIC
/begin CHARACTERISTIC WM_bErrTCooltSnsrLimp_P "Coolant Temperature Sensor Limp Error Activation Parameter" VALUE 0x4005169C /* @ECU_Address@WM_bErrTCooltSnsrLimp_P@ */ Scalar_BOOLEAN 0 EcuIntgdSwGend_CM_boolean 0.0 1.0 /end CHARACTERISTIC
/begin CHARACTERISTIC WM_bErrTEcuSnsrLimp_P "ECU Temperature Sensor Limp Error Activation Parameter" VALUE 0x400516A0 /* @ECU_Address@WM_bErrTEcuSnsrLimp_P@ */ Scalar_BOOLEAN 0 EcuIntgdSwGend_CM_boolean 0.0 1.0 /end CHARACTERISTIC
/begin CHARACTERISTIC WM_bErrTFuSnsrLimp_P "Fuel Temperature Sensor Limp Error Activation Parameter" VALUE 0x400516A4 /* @ECU_Address@WM_bErrTFuSnsrLimp_P@ */ Scalar_BOOLEAN 0 EcuIntgdSwGend_CM_boolean 0.0 1.0 /end CHARACTERISTIC
/begin CHARACTERISTIC WM_bErrTOilSnsrLimp_P "Oil Temperature Sensor Limp Error Activation Parameter" VALUE 0x400516A8 /* @ECU_Address@WM_bErrTOilSnsrLimp_P@ */ Scalar_BOOLEAN 0 EcuIntgdSwGend_CM_boolean 0.0 1.0 /end CHARACTERISTIC
/begin CHARACTERISTIC WM_bErrUClmp30SnsrLimp_P "Batter Voltage Sensor Limp Error Activation Parameter" VALUE 0x400516AC /* @ECU_Address@WM_bErrUClmp30SnsrLimp_P@ */ Scalar_BOOLEAN 0 EcuIntgdSwGend_CM_boolean 0.0 1.0 /end CHARACTERISTIC
/begin CHARACTERISTIC WM_bErrWgLimp_P "Wastegate Sensor Limp Error Activation Parameter" VALUE 0x400516B0 /* @ECU_Address@WM_bErrWgLimp_P@ */ Scalar_BOOLEAN 0 EcuIntgdSwGend_CM_boolean 0.0 1.0 /end CHARACTERISTIC
/begin CHARACTERISTIC WgC_NTrbChrgOvs_P "Turbo Charge Speed - Override Switch Param" VALUE 0x4005228C /* @ECU_Address@WgC_NTrbChrgOvs_P@ */ Scalar_BOOLEAN 0 EcuIntgdSwGend_CM_boolean 0.0 1.0 /end CHARACTERISTIC
/begin CHARACTERISTIC WgC_PIDCoeffDOvs_P "PID D Coeffcient - Override Switch Parameter" VALUE 0x40052968 /* @ECU_Address@WgC_PIDCoeffDOvs_P@ */ Scalar_BOOLEAN 0 EcuIntgdSwGend_CM_boolean 0.0 1.0 /end CHARACTERISTIC
/begin CHARACTERISTIC WgC_PIDCoeffFiltOvs_P "PID Filter Coeffcient - Override Switch Parameter" VALUE 0x40052970 /* @ECU_Address@WgC_PIDCoeffFiltOvs_P@ */ Scalar_BOOLEAN 0 EcuIntgdSwGend_CM_boolean 0.0 1.0 /end CHARACTERISTIC
/begin CHARACTERISTIC WgC_PIDCoeffIOvs_P "PID I Coefficient - Override Switch Parameter" VALUE 0x40052978 /* @ECU_Address@WgC_PIDCoeffIOvs_P@ */ Scalar_BOOLEAN 0 EcuIntgdSwGend_CM_boolean 0.0 1.0 /end CHARACTERISTIC
/begin CHARACTERISTIC WgC_PIDCoeffPOvs_P "PID P Coefficient - Override Switch Parameter" VALUE 0x40052980 /* @ECU_Address@WgC_PIDCoeffPOvs_P@ */ Scalar_BOOLEAN 0 EcuIntgdSwGend_CM_boolean 0.0 1.0 /end CHARACTERISTIC
/begin MEASUREMENT WM_MaskRTN "Return To Normal Mask" ULONG EcuIntgdSwGend_CM_uint32 0 0 0.0 4.294967295E+9 ECU_ADDRESS 0x4000D82C /* @ECU_Address@WM_MaskRTN@ */ /end MEASUREMENT
/begin MEASUREMENT WM_MaskRctn "Mask Reaction" ULONG EcuIntgdSwGend_CM_uint32 0 0 0.0 4.294967295E+9 ECU_ADDRESS 0x4000DA24 /* @ECU_Address@WM_MaskRctn@ */ /end MEASUREMENT
/begin MEASUREMENT WM_MaskGE "Global Enable Mask" ULONG EcuIntgdSwGend_CM_uint32 0 0 0.0 4.294967295E+9 ECU_ADDRESS 0x4000D9C4 /* @ECU_Address@WM_MaskGE@ */ /end MEASUREMENT
/begin MEASUREMENT WgC_VolEff "Volumetric Efficiency" FLOAT32_IEEE EcuIntgdSwGend_CM_single 0 0 0.0 1000.0 ECU_ADDRESS 0x4000E878 /* @ECU_Address@WgC_VolEff@ */ /end MEASUREMENT
/begin MEASUREMENT WgC_AirMassFlowCalcMultiOut "Air Mass Flow Calculation Multiplication Output" FLOAT32_IEEE EcuIntgdSwGend_CM_single 0 0 -20000.0 20000.0 ECU_ADDRESS 0x4000E3CC /* @ECU_Address@WgC_AirMassFlowCalcMultiOut@ */ /end MEASUREMENT
/begin MEASUREMENT WgC_MAirFlow "Mass Air Flow" FLOAT32_IEEE EcuIntgdSwGend_CM_single_kg_s 0 0 0.0 1000.0 ECU_ADDRESS 0x4000E188 /* @ECU_Address@WgC_MAirFlow@ */ /end MEASUREMENT
/begin MEASUREMENT WgC_PDropIcoMapOut "Pressure Drop Map Out" FLOAT32_IEEE EcuIntgdSwGend_CM_single_mbar 0 0 0.0 1000.0 ECU_ADDRESS 0x4000E70C /* @ECU_Address@WgC_PDropIcoMapOut@ */ /end MEASUREMENT
/begin MEASUREMENT WgC_PCmprInltCalcd "Compressor Inlet Pressure Calculated" FLOAT32_IEEE EcuIntgdSwGend_CM_single_mbar 0 0 -1000.0 3000.0 ECU_ADDRESS 0x4000E284 /* @ECU_Address@WgC_PCmprInltCalcd@ */ /end MEASUREMENT
/begin MEASUREMENT WgC_PCmprOutltMapOut "Compressor Outlet Pressure Calculated Map Out" FLOAT32_IEEE EcuIntgdSwGend_CM_single 0 0 0.0 1000.0 ECU_ADDRESS 0x4000DE68 /* @ECU_Address@WgC_PCmprOutltMapOut@ */ /end MEASUREMENT
/begin MEASUREMENT WgC_PCmprOutltCalcd "Compressor Outlet Pressure Calculated" FLOAT32_IEEE EcuIntgdSwGend_CM_single_mbar 0 0 -5000.0 5000.0 ECU_ADDRESS 0x4000E7CC /* @ECU_Address@WgC_PCmprOutltCalcd@ */ /end MEASUREMENT
/begin MEASUREMENT WgC_RatPCmpr "Compressor Pressure Ratio" FLOAT32_IEEE EcuIntgdSwGend_CM_single 0 0 0.0 1000.0 ECU_ADDRESS 0x4000DC7C /* @ECU_Address@WgC_RatPCmpr@ */ /end MEASUREMENT
/begin MEASUREMENT WgC_MCorrAirFlowTCmprInlt "Mass Air Flow Correction for Compressor Inlet Temperature Map" FLOAT32_IEEE EcuIntgdSwGend_CM_single_kg_s 0 0 0.0 1000.0 ECU_ADDRESS 0x4000DA38 /* @ECU_Address@WgC_MCorrAirFlowTCmprInlt@ */ /end MEASUREMENT
/begin MEASUREMENT WgC_MCorrAirFlowPCmprInlt "Mass Air Flow Correction for Compressor Inlet Pressure" FLOAT32_IEEE EcuIntgdSwGend_CM_single 0 0 0.0 1000.0 ECU_ADDRESS 0x4000DC60 /* @ECU_Address@WgC_MCorrAirFlowPCmprInlt@ */ /end MEASUREMENT
/begin MEASUREMENT WgC_MCorrdAirFlow "Corrected Mass Air Flow" FLOAT32_IEEE EcuIntgdSwGend_CM_single_kg_s 0 0 0.0 100.0 ECU_ADDRESS 0x4000DC58 /* @ECU_Address@WgC_MCorrdAirFlow@ */ /end MEASUREMENT
/begin MEASUREMENT WgC_DifSurgeLine "Surge Line Difference" FLOAT32_IEEE EcuIntgdSwGend_CM_single 0 0 -100.0 100.0 ECU_ADDRESS 0x4000E578 /* @ECU_Address@WgC_DifSurgeLine@ */ /end MEASUREMENT
/begin MEASUREMENT WgC_EffCmpr "Compressor Efficiency" FLOAT32_IEEE EcuIntgdSwGend_CM_single 0 0 0.0 1000.0 ECU_ADDRESS 0x4000E3C8 /* @ECU_Address@WgC_EffCmpr@ */ /end MEASUREMENT
/begin MEASUREMENT WgC_NTrbChrg "Turbo Charge Speed" FLOAT32_IEEE EcuIntgdSwGend_CM_single_rpm 0 0 0.0 150000.0 ECU_ADDRESS 0x4000E368 /* @ECU_Address@WgC_NTrbChrg@ */ /end MEASUREMENT
/begin MEASUREMENT WgC_PAirBoostRefMain "Reference Air Boost Pressure Map Out" FLOAT32_IEEE EcuIntgdSwGend_CM_single_mbar 0 0 0.0 5000.0 ECU_ADDRESS 0x4000DB90 /* @ECU_Address@WgC_PAirBoostRefMain@ */ /end MEASUREMENT
/begin MEASUREMENT WgC_PAirBoostRefTCooltCorr "Reference Air Boost Pressure for Coolant Temperature Correction" FLOAT32_IEEE EcuIntgdSwGend_CM_single_mbar 0 0 0.0 5000.0 ECU_ADDRESS 0x4000DDA4 /* @ECU_Address@WgC_PAirBoostRefTCooltCorr@ */ /end MEASUREMENT
/begin MEASUREMENT WgC_PAirBoostRefPAmbAirCorr "Ambient Air Reference Correction" FLOAT32_IEEE EcuIntgdSwGend_CM_single_mbar 0 0 0.0 5000.0 ECU_ADDRESS 0x4000DF50 /* @ECU_Address@WgC_PAirBoostRefPAmbAirCorr@ */ /end MEASUREMENT
/begin MEASUREMENT WgC_PAirBoostRefTAmbAirCorr "Temperature Correction for Ambient Air Reference " FLOAT32_IEEE EcuIntgdSwGend_CM_single_mbar 0 0 0.0 5000.0 ECU_ADDRESS 0x4000E6A4 /* @ECU_Address@WgC_PAirBoostRefTAmbAirCorr@ */ /end MEASUREMENT
/begin MEASUREMENT WgC_PAirBoostRefTOilCorr "Temperature Correction for Oil Reference Temperature" FLOAT32_IEEE EcuIntgdSwGend_CM_single_mbar 0 0 0.0 5000.0 ECU_ADDRESS 0x4000E934 /* @ECU_Address@WgC_PAirBoostRefTOilCorr@ */ /end MEASUREMENT
/begin MEASUREMENT WgC_PAirBoostRefSurgeCorr "Reference Air Boost Pressure for Surge Correction" FLOAT32_IEEE EcuIntgdSwGend_CM_single_mbar 0 0 -15000.0 15000.0 ECU_ADDRESS 0x4000E75C /* @ECU_Address@WgC_PAirBoostRefSurgeCorr@ */ /end MEASUREMENT
/begin MEASUREMENT WgC_PAirBoostRef "Reference Air Boost Pressure" FLOAT32_IEEE EcuIntgdSwGend_CM_single_mbar 0 0 0.0 5000.0 ECU_ADDRESS 0x4000DF48 /* @ECU_Address@WgC_PAirBoostRef@ */ /end MEASUREMENT
/begin MEASUREMENT WgC_ErrPAirBoost "Air Bosst Pressure Error for PID" FLOAT32_IEEE EcuIntgdSwGend_CM_single_mbar 0 0 0.0 1000.0 ECU_ADDRESS 0x4000E7FC /* @ECU_Address@WgC_ErrPAirBoost@ */ /end MEASUREMENT
/begin MEASUREMENT WgC_CoeffPForWgCCtlMapOut "Proportional Coefficient For Wastegate Control Map Output" FLOAT32_IEEE EcuIntgdSwGend_CM_single 0 0 -100000.0 100000.0 ECU_ADDRESS 0x4000E174 /* @ECU_Address@WgC_CoeffPForWgCCtlMapOut@ */ /end MEASUREMENT
/begin MEASUREMENT WgC_PIDCoeffP "PID P Coefficient" FLOAT32_IEEE EcuIntgdSwGend_CM_single 0 0 -100.0 100.0 ECU_ADDRESS 0x4000DA04 /* @ECU_Address@WgC_PIDCoeffP@ */ /end MEASUREMENT
/begin MEASUREMENT WgC_CoeffDForWgCCtlMapOut "Derivative Coefficient For Wastegate Control Map Output" FLOAT32_IEEE EcuIntgdSwGend_CM_single 0 0 -100000.0 100000.0 ECU_ADDRESS 0x4000E2E8 /* @ECU_Address@WgC_CoeffDForWgCCtlMapOut@ */ /end MEASUREMENT
/begin MEASUREMENT WgC_PIDCoeffD "PID D Coeffcient" FLOAT32_IEEE EcuIntgdSwGend_CM_single 0 0 -100.0 100.0 ECU_ADDRESS 0x4000E764 /* @ECU_Address@WgC_PIDCoeffD@ */ /end MEASUREMENT
/begin MEASUREMENT WgC_CoeffFiltForWgCCtlMapOut "Filter Coefficient For Wastegate Control Map Output" FLOAT32_IEEE EcuIntgdSwGend_CM_single 0 0 -100000.0 100000.0 ECU_ADDRESS 0x4000E13C /* @ECU_Address@WgC_CoeffFiltForWgCCtlMapOut@ */ /end MEASUREMENT
/begin MEASUREMENT WgC_PIDCoeffFilt "PID Filter Coeffcient" FLOAT32_IEEE EcuIntgdSwGend_CM_single 0 0 -100.0 100.0 ECU_ADDRESS 0x4000E3E0 /* @ECU_Address@WgC_PIDCoeffFilt@ */ /end MEASUREMENT
/begin MEASUREMENT WgC_CoeffIForWgCCtlMapOut "Integrator Coefficient For Wastegate Control Map Output" FLOAT32_IEEE EcuIntgdSwGend_CM_single 0 0 -100000.0 100000.0 ECU_ADDRESS 0x4000DF20 /* @ECU_Address@WgC_CoeffIForWgCCtlMapOut@ */ /end MEASUREMENT
/begin MEASUREMENT WgC_PIDCoeffI "PID I Coefficient" FLOAT32_IEEE EcuIntgdSwGend_CM_single 0 0 -100.0 100.0 ECU_ADDRESS 0x4000D9B4 /* @ECU_Address@WgC_PIDCoeffI@ */ /end MEASUREMENT
/begin MEASUREMENT TL_PercgTqLimnForTCoolt "Torque Limitation Percentage Map Out for Coolant High Temperature" FLOAT32_IEEE EcuIntgdSwGend_CM_single__ 0 0 0.0 100.0 ECU_ADDRESS 0x4000DCE0 /* @ECU_Address@TL_PercgTqLimnForTCoolt@ */ /end MEASUREMENT
/begin MEASUREMENT TL_PercgTqLimnForTFu "Torque Limitation Percentage Map Out for Fuel Temperature" FLOAT32_IEEE EcuIntgdSwGend_CM_single__ 0 0 0.0 100.0 ECU_ADDRESS 0x4000E5A4 /* @ECU_Address@TL_PercgTqLimnForTFu@ */ /end MEASUREMENT
/begin MEASUREMENT TL_PercgTqLimnForNExhTrbChrg "Torque Limitation Percentage Map Out for Turbo Charger Speed " FLOAT32_IEEE EcuIntgdSwGend_CM_single__ 0 0 0.0 100.0 ECU_ADDRESS 0x4000E590 /* @ECU_Address@TL_PercgTqLimnForNExhTrbChrg@ */ /end MEASUREMENT
/begin MEASUREMENT TL_PercgTqLimnForPAirBoost "Torque Limitation Percentage Map Out for AirBoost Pressure" FLOAT32_IEEE EcuIntgdSwGend_CM_single__ 0 0 0.0 100.0 ECU_ADDRESS 0x4000E4A8 /* @ECU_Address@TL_PercgTqLimnForPAirBoost@ */ /end MEASUREMENT
/begin MEASUREMENT TL_TAir "Axis Values of Air Boost Temperature for Air Boost Temperature Dependent Limitation Map" FLOAT32_IEEE EcuIntgdSwGend_CM_single_degC 0 0 -50.0 200.0 ECU_ADDRESS 0x4000D98C /* @ECU_Address@TL_TAir@ */ /end MEASUREMENT
/begin MEASUREMENT TL_PercgTqLimnForTAir "Torque Limitation Percentage Map Out for AirBoost Temperature" FLOAT32_IEEE EcuIntgdSwGend_CM_single__ 0 0 0.0 100.0 ECU_ADDRESS 0x4000DE70 /* @ECU_Address@TL_PercgTqLimnForTAir@ */ /end MEASUREMENT
/begin MEASUREMENT TL_PercgTqLimnForPAmbAir "Torque Limitation Percentage Map Out for Ambient Air Pressure" FLOAT32_IEEE EcuIntgdSwGend_CM_single__ 0 0 0.0 100.0 ECU_ADDRESS 0x4000DFDC /* @ECU_Address@TL_PercgTqLimnForPAmbAir@ */ /end MEASUREMENT
/begin MEASUREMENT TL_PercgTqLimnForTOil "Torque Limitation Percentage Map Out for Oil Temperature" FLOAT32_IEEE EcuIntgdSwGend_CM_single__ 0 0 0.0 100.0 ECU_ADDRESS 0x4000E7C0 /* @ECU_Address@TL_PercgTqLimnForTOil@ */ /end MEASUREMENT
/begin MEASUREMENT TL_PercgTqLimnForSurge "Limited Torque According to Surge Flag" FLOAT32_IEEE EcuIntgdSwGend_CM_single__ 0 0 0.0 100.0 ECU_ADDRESS 0x4000E5E8 /* @ECU_Address@TL_PercgTqLimnForSurge@ */ /end MEASUREMENT
/begin MEASUREMENT TL_TqLimnForSurge "Surge Line Torque Limitation Map" FLOAT32_IEEE EcuIntgdSwGend_CM_single_N_m 0 0 0.0 10000.0 ECU_ADDRESS 0x4000E2C0 /* @ECU_Address@TL_TqLimnForSurge@ */ /end MEASUREMENT
/begin MEASUREMENT TrC_RatAirFuCalc "Air Fuel Rate Calculation" FLOAT32_IEEE EcuIntgdSwGend_CM_single 0 0 0.0 100.0 ECU_ADDRESS 0x4000E63C /* @ECU_Address@TrC_RatAirFuCalc@ */ /end MEASUREMENT
/begin MEASUREMENT TrC_MMaiFuQntyPreForEngDmdTq "Pre Main Fuel Quantity For Endine Demand Torque Message" FLOAT32_IEEE EcuIntgdSwGend_CM_single_mm_3_stk 0 0 0.0 1000.0 ECU_ADDRESS 0x4000E988 /* @ECU_Address@TrC_MMaiFuQntyPreForEngDmdTq@ */ /end MEASUREMENT
/begin MEASUREMENT TrC_MMaiFuQntyCorrdForEngDmdTq "Corrected Main Fuel Quantity For Engine Demand Torque Message" FLOAT32_IEEE EcuIntgdSwGend_CM_single_mm_3_stk 0 0 0.0 1000.0 ECU_ADDRESS 0x4000E360 /* @ECU_Address@TrC_MMaiFuQntyCorrdForEngDmdTq@ */ /end MEASUREMENT
/begin MEASUREMENT TrC_MPltFuQntyForEngDmdTq "" FLOAT32_IEEE EcuIntgdSwGend_CM_single_mm_3_stk 0 0 0.0 1000.0 ECU_ADDRESS 0x4000DC0C /* @ECU_Address@TrC_MPltFuQntyForEngDmdTq@ */ /end MEASUREMENT
/begin MEASUREMENT TrC_MPltFuQntyCorrForEngDmdTq "Pilot Fuel Quantity Correction For Endine Demand Torque Message" FLOAT32_IEEE EcuIntgdSwGend_CM_single_mm_3_stk 0 0 0.0 1000.0 ECU_ADDRESS 0x4000DD24 /* @ECU_Address@TrC_MPltFuQntyCorrForEngDmdTq@ */ /end MEASUREMENT
/begin MEASUREMENT TrC_MMaiFuQntyLimdForEngDmdTq "Limited Main Fuel Quantity For Endine Demand Torque Message" FLOAT32_IEEE EcuIntgdSwGend_CM_single_mm_3_stk 0 0 0.0 1000.0 ECU_ADDRESS 0x4000E2D0 /* @ECU_Address@TrC_MMaiFuQntyLimdForEngDmdTq@ */ /end MEASUREMENT
/begin MEASUREMENT SC_TiElpdEnaAcvnStrtr "Timer Elapsed Time to Enable Activation Starter" FLOAT32_IEEE EcuIntgdSwGend_CM_single_ms 0 0 0.0 50000.0 ECU_ADDRESS 0x4000D8B4 /* @ECU_Address@SC_TiElpdEnaAcvnStrtr@ */ /end MEASUREMENT
/begin MEASUREMENT SC_TiElpdComplDebStrtLock "Debouncer Elapsed Time for Starter Locking" FLOAT32_IEEE EcuIntgdSwGend_CM_single_ms 0 0 0.0 50000.0 ECU_ADDRESS 0x4000E1D4 /* @ECU_Address@SC_TiElpdComplDebStrtLock@ */ /end MEASUREMENT
/begin MEASUREMENT SC_TiElpdEngAlrdyRunngThd "Engine Running Activation Elapsed Time for Engine Already Running" FLOAT32_IEEE EcuIntgdSwGend_CM_single_ms 0 0 0.0 100000.0 ECU_ADDRESS 0x4000E1B8 /* @ECU_Address@SC_TiElpdEngAlrdyRunngThd@ */ /end MEASUREMENT
/begin MEASUREMENT SC_TiElpdNEngStrtrInhThd "Debouncer Elapsed Time for Start Inhibition Engine Speed Threshold" FLOAT32_IEEE EcuIntgdSwGend_CM_single_ms 0 0 0.0 50000.0 ECU_ADDRESS 0x4000E77C /* @ECU_Address@SC_TiElpdNEngStrtrInhThd@ */ /end MEASUREMENT
/begin MEASUREMENT SC_TiElpdNEngRunDeacThd "Debouncer Elapsed Time for Engine Speed Deactivation Threshold" FLOAT32_IEEE EcuIntgdSwGend_CM_single_ms 0 0 0.0 50000.0 ECU_ADDRESS 0x4000E888 /* @ECU_Address@SC_TiElpdNEngRunDeacThd@ */ /end MEASUREMENT
/begin MEASUREMENT SpdLimr_TrfCaseStsFac "Speed Limiter Transfer Case Status Factor" FLOAT32_IEEE EcuIntgdSwGend_CM_single 0 0 0.0 100.0 ECU_ADDRESS 0x4000DBEC /* @ECU_Address@SpdLimr_TrfCaseStsFac@ */ /end MEASUREMENT
/begin MEASUREMENT SpdLimr_CoeffPForVehVCtrl "Coefficient Proportional For Vehicle Velocity Control" FLOAT32_IEEE EcuIntgdSwGend_CM_single 0 0 0.0 10000.0 ECU_ADDRESS 0x4000E4C8 /* @ECU_Address@SpdLimr_CoeffPForVehVCtrl@ */ /end MEASUREMENT
/begin MEASUREMENT SpdLimr_CoeffDForVehVCtrl "Coefficient Derrivate For Vehicle Velocity Control" FLOAT32_IEEE EcuIntgdSwGend_CM_single 0 0 0.0 10000.0 ECU_ADDRESS 0x4000E144 /* @ECU_Address@SpdLimr_CoeffDForVehVCtrl@ */ /end MEASUREMENT
/begin MEASUREMENT SpdLimr_CoeffFiltForVehVCtrl "Coefficient Filter for Vehicle Velocity Control" FLOAT32_IEEE EcuIntgdSwGend_CM_single 0 0 0.0 10000.0 ECU_ADDRESS 0x4000DA40 /* @ECU_Address@SpdLimr_CoeffFiltForVehVCtrl@ */ /end MEASUREMENT
/begin MEASUREMENT SpdLimr_PIDMax "Maximum Value of PID" FLOAT32_IEEE EcuIntgdSwGend_CM_single_N_m 0 0 0.0 5000.0 ECU_ADDRESS 0x4000DDCC /* @ECU_Address@SpdLimr_PIDMax@ */ /end MEASUREMENT
/begin MEASUREMENT SpdLimr_TrsmTqCnvrRatFac "Speed Limiter Transmission Torque Convertor Ratio Factor" FLOAT32_IEEE EcuIntgdSwGend_CM_single 0 0 0.0 100.0 ECU_ADDRESS 0x4000DBD0 /* @ECU_Address@SpdLimr_TrsmTqCnvrRatFac@ */ /end MEASUREMENT
/begin MEASUREMENT SpdLimr_CoeffIForVehVCtrl "Coefficient Integral For Vehicle Velocity Control" FLOAT32_IEEE EcuIntgdSwGend_CM_single 0 0 0.0 10000.0 ECU_ADDRESS 0x4000DF00 /* @ECU_Address@SpdLimr_CoeffIForVehVCtrl@ */ /end MEASUREMENT
/begin MEASUREMENT RPG_PRailSetPointFromMap1 "Rail Pressure Set Point Calcuation From Map 1" FLOAT32_IEEE EcuIntgdSwGend_CM_single_bar 0 0 0.0 25000.0 ECU_ADDRESS 0x4000E3B8 /* @ECU_Address@RPG_PRailSetPointFromMap1@ */ /end MEASUREMENT
/begin MEASUREMENT RPG_PRailSetPointFromMap2 "Rail Pressure Set Point Calcuation From Map 2" FLOAT32_IEEE EcuIntgdSwGend_CM_single_bar 0 0 0.0 25000.0 ECU_ADDRESS 0x4000D81C /* @ECU_Address@RPG_PRailSetPointFromMap2@ */ /end MEASUREMENT
/begin MEASUREMENT RPG_PRailSetPoint1to2Intp "Rail Pressure Set Point Calcluation Map 1 to Map 2 Interpolation" FLOAT32_IEEE EcuIntgdSwGend_CM_single_bar 0 0 0.0 5000.0 ECU_ADDRESS 0x4000E800 /* @ECU_Address@RPG_PRailSetPoint1to2Intp@ */ /end MEASUREMENT
/begin MEASUREMENT RPG_PRailSetPointFromMap3 "Rail Pressure Set Point Calcuation From Map 3" FLOAT32_IEEE EcuIntgdSwGend_CM_single_bar 0 0 0.0 25000.0 ECU_ADDRESS 0x4000D820 /* @ECU_Address@RPG_PRailSetPointFromMap3@ */ /end MEASUREMENT
/begin MEASUREMENT RPG_PRailSetPoint2to3Intp "Rail Pressure Set Point Calcluation Map 2 to Map 3 Interpolation" FLOAT32_IEEE EcuIntgdSwGend_CM_single_bar 0 0 0.0 5000.0 ECU_ADDRESS 0x4000E0A0 /* @ECU_Address@RPG_PRailSetPoint2to3Intp@ */ /end MEASUREMENT
/begin MEASUREMENT RPG_PRailSetPoint "Rail Pressure Set Point" FLOAT32_IEEE EcuIntgdSwGend_CM_single_bar 0 0 0.0 5000.0 ECU_ADDRESS 0x4000DFD0 /* @ECU_Address@RPG_PRailSetPoint@ */ /end MEASUREMENT
/begin MEASUREMENT RPG_CoeffKiOut "Rail Pressure Controller Ki Coefficient Output" FLOAT32_IEEE EcuIntgdSwGend_CM_single 0 0 -1000.0 1000.0 ECU_ADDRESS 0x4000E6C0 /* @ECU_Address@RPG_CoeffKiOut@ */ /end MEASUREMENT
/begin MEASUREMENT RPG_CoeffKpOut "Rail Pressure Controller Kp Coefficient Output" FLOAT32_IEEE EcuIntgdSwGend_CM_single 0 0 -1000.0 1000.0 ECU_ADDRESS 0x4000E770 /* @ECU_Address@RPG_CoeffKpOut@ */ /end MEASUREMENT
/begin MEASUREMENT RPG_CoeffKdFbOut "Rail Pressure Controller Kd Coefficient Feedback Output" FLOAT32_IEEE EcuIntgdSwGend_CM_single 0 0 -1000.0 1000.0 ECU_ADDRESS 0x4000E1A4 /* @ECU_Address@RPG_CoeffKdFbOut@ */ /end MEASUREMENT
/begin MEASUREMENT RPG_CoeffKdOut "Rail Pressure Controller Kd Coefficient Output" FLOAT32_IEEE EcuIntgdSwGend_CM_single 0 0 -1000.0 1000.0 ECU_ADDRESS 0x4000DF7C /* @ECU_Address@RPG_CoeffKdOut@ */ /end MEASUREMENT
/begin MEASUREMENT RPG_CoeffKiClampPreSatOut "Rail Pressure Controller Ki Coefficient Output before Saturation" FLOAT32_IEEE EcuIntgdSwGend_CM_single 0 0 -1000.0 1000.0 ECU_ADDRESS 0x4000D9B8 /* @ECU_Address@RPG_CoeffKiClampPreSatOut@ */ /end MEASUREMENT
/begin MEASUREMENT RPG_PercgVolCtrlVlv "Fuel Metering Unit Valve (FMU) Percentage" FLOAT32_IEEE EcuIntgdSwGend_CM_single__ 0 0 0.0 100.0 ECU_ADDRESS 0x4000DC34 /* @ECU_Address@RPG_PercgVolCtrlVlv@ */ /end MEASUREMENT
/begin MEASUREMENT RPG_CoeffKiClampOut "Rail Pressure Controller Ki Clmaping Coefficient" FLOAT32_IEEE EcuIntgdSwGend_CM_single 0 0 -1000.0 1000.0 ECU_ADDRESS 0x4000DB20 /* @ECU_Address@RPG_CoeffKiClampOut@ */ /end MEASUREMENT
/begin MEASUREMENT RPG_CoeffKiClampSwtchOut "Rail Pressure Controller Ki Coefficient after Clamping Switch Output" FLOAT32_IEEE EcuIntgdSwGend_CM_single 0 0 -1000.0 1000.0 ECU_ADDRESS 0x4000E0B4 /* @ECU_Address@RPG_CoeffKiClampSwtchOut@ */ /end MEASUREMENT
/begin MEASUREMENT RPG_TiElpdCompNEngThdAcvnPRail "Debouncer Elapsed Time for Rail Pressure Correction Activation wrt Comparision with Engine Speed" FLOAT32_IEEE EcuIntgdSwGend_CM_single_ms 0 0 0.0 50000.0 ECU_ADDRESS 0x4000E110 /* @ECU_Address@RPG_TiElpdCompNEngThdAcvnPRail@ */ /end MEASUREMENT
/begin MEASUREMENT PtoCtrl_CoeffKpOut "PID Controller Proportional Out" FLOAT32_IEEE EcuIntgdSwGend_CM_single 0 0 -10000.0 10000.0 ECU_ADDRESS 0x4000D9DC /* @ECU_Address@PtoCtrl_CoeffKpOut@ */ /end MEASUREMENT
/begin MEASUREMENT PtoCtrl_CoeffKdFbOut "PID Controller Derivative Feedback Out" FLOAT32_IEEE EcuIntgdSwGend_CM_single 0 0 -10000.0 10000.0 ECU_ADDRESS 0x4000E270 /* @ECU_Address@PtoCtrl_CoeffKdFbOut@ */ /end MEASUREMENT
/begin MEASUREMENT PtoCtrl_CoeffKdOut "PID Controller Derivative Out" FLOAT32_IEEE EcuIntgdSwGend_CM_single 0 0 -10000.0 10000.0 ECU_ADDRESS 0x4000DC68 /* @ECU_Address@PtoCtrl_CoeffKdOut@ */ /end MEASUREMENT
/begin MEASUREMENT PtoCtrl_CoeffKiClampPreSatOut "PID Controller Integrator Clamp Pre Saturation Out" FLOAT32_IEEE EcuIntgdSwGend_CM_single 0 0 -10000.0 10000.0 ECU_ADDRESS 0x4000E584 /* @ECU_Address@PtoCtrl_CoeffKiClampPreSatOut@ */ /end MEASUREMENT
/begin MEASUREMENT PtoCtrl_PIDOut "PID Out" FLOAT32_IEEE EcuIntgdSwGend_CM_single_N_m 0 0 -10000.0 10000.0 ECU_ADDRESS 0x4000E850 /* @ECU_Address@PtoCtrl_PIDOut@ */ /end MEASUREMENT
/begin MEASUREMENT PtoCtrl_CoeffKiClampOut "PID Controller Integrator Clamp Out" FLOAT32_IEEE EcuIntgdSwGend_CM_single 0 0 -10000.0 10000.0 ECU_ADDRESS 0x4000DE7C /* @ECU_Address@PtoCtrl_CoeffKiClampOut@ */ /end MEASUREMENT
/begin MEASUREMENT PHC_TiElpdOnStsErrGridHeatrDeb "Timer Elapsed Time of Error Grid Heater On Status" FLOAT32_IEEE EcuIntgdSwGend_CM_single_ms 0 0 0.0 100000.0 ECU_ADDRESS 0x4000E660 /* @ECU_Address@PHC_TiElpdOnStsErrGridHeatrDeb@ */ /end MEASUREMENT
/begin MEASUREMENT PHC_TiElpdOffStsErrGridHeatrDeb "Timer Elapsed Time of Error Grid Heater Off Status" FLOAT32_IEEE EcuIntgdSwGend_CM_single_ms 0 0 0.0 100000.0 ECU_ADDRESS 0x4000DFE0 /* @ECU_Address@PHC_TiElpdOffStsErrGridHeatrDeb@ */ /end MEASUREMENT
/begin MEASUREMENT PHC_TiElpdPostAcvnGridDeb "Timer Elapsed Time for Grid Heater Activation After Starter" FLOAT32_IEEE EcuIntgdSwGend_CM_single_ms 0 0 0.0 500000.0 ECU_ADDRESS 0x4000E468 /* @ECU_Address@PHC_TiElpdPostAcvnGridDeb@ */ /end MEASUREMENT
/begin MEASUREMENT PHC_TiElpdPreAcvnGridDeb "Timer Elapsed Time for Grid Heater Activation Before Starter" FLOAT32_IEEE EcuIntgdSwGend_CM_single_ms 0 0 0.0 500000.0 ECU_ADDRESS 0x4000DF30 /* @ECU_Address@PHC_TiElpdPreAcvnGridDeb@ */ /end MEASUREMENT
/begin MEASUREMENT IC_SoiPltInjCorrTCoolt "Start of Pilot Injection Correction wrt Coolant Temperature" FLOAT32_IEEE EcuIntgdSwGend_CM_single_deg 0 0 -100.0 500.0 ECU_ADDRESS 0x4000D9FC /* @ECU_Address@IC_SoiPltInjCorrTCoolt@ */ /end MEASUREMENT
/begin MEASUREMENT IC_SoiPltInjCorrPAmbAir "Start of Pilot Injection Correction wrt Ambient Air Pressure" FLOAT32_IEEE EcuIntgdSwGend_CM_single_deg 0 0 -100.0 500.0 ECU_ADDRESS 0x4000D9A4 /* @ECU_Address@IC_SoiPltInjCorrPAmbAir@ */ /end MEASUREMENT
/begin MEASUREMENT IC_SoiPltInjCorrTAmbAir "Start of Pilot Injection Correction wrt Ambient Air Temperature" FLOAT32_IEEE EcuIntgdSwGend_CM_single_deg 0 0 -100.0 500.0 ECU_ADDRESS 0x4000E5E4 /* @ECU_Address@IC_SoiPltInjCorrTAmbAir@ */ /end MEASUREMENT
/begin MEASUREMENT IC_SoiPltInjCorrTOil "Start of Pilot Injection Correction wrt Oil Temperature" FLOAT32_IEEE EcuIntgdSwGend_CM_single_deg 0 0 -100.0 500.0 ECU_ADDRESS 0x4000E2FC /* @ECU_Address@IC_SoiPltInjCorrTOil@ */ /end MEASUREMENT
/begin MEASUREMENT IC_SoiPltInjCorrTAirBoost "Start of Pilot Injection Correction wrt AirBoost Temperature" FLOAT32_IEEE EcuIntgdSwGend_CM_single_deg 0 0 -100.0 500.0 ECU_ADDRESS 0x4000E900 /* @ECU_Address@IC_SoiPltInjCorrTAirBoost@ */ /end MEASUREMENT
/begin MEASUREMENT IC_SoiPltInj "Start of Pilot Injection" FLOAT32_IEEE EcuIntgdSwGend_CM_single_deg 0 0 -100.0 100.0 ECU_ADDRESS 0x4000DC4C /* @ECU_Address@IC_SoiPltInj@ */ /end MEASUREMENT
/begin MEASUREMENT IC_SoiMainInjCorrTCoolt "Start of Main Injection Correction wrtCoolant Temperature" FLOAT32_IEEE EcuIntgdSwGend_CM_single_deg 0 0 -100.0 500.0 ECU_ADDRESS 0x4000DC38 /* @ECU_Address@IC_SoiMainInjCorrTCoolt@ */ /end MEASUREMENT
/begin MEASUREMENT IC_SoiMainInjCorrPAmbAir "Start of Main Injection Correction wrt Ambient Air Pressure" FLOAT32_IEEE EcuIntgdSwGend_CM_single_deg 0 0 -100.0 500.0 ECU_ADDRESS 0x4000E734 /* @ECU_Address@IC_SoiMainInjCorrPAmbAir@ */ /end MEASUREMENT
/begin MEASUREMENT IC_SoiMainInjCorrTAmbAir "Start of Main Injection Correction wrt Ambient Air Temperature" FLOAT32_IEEE EcuIntgdSwGend_CM_single_deg 0 0 -100.0 500.0 ECU_ADDRESS 0x4000D924 /* @ECU_Address@IC_SoiMainInjCorrTAmbAir@ */ /end MEASUREMENT
/begin MEASUREMENT IC_SoiMainInjCorrTOil "Start of Main Injection Correction wrt Oil Temperature" FLOAT32_IEEE EcuIntgdSwGend_CM_single_deg 0 0 -100.0 500.0 ECU_ADDRESS 0x4000E854 /* @ECU_Address@IC_SoiMainInjCorrTOil@ */ /end MEASUREMENT
/begin MEASUREMENT IC_SoiMainInjCorrTAirBoost "Start of Main Injection Correction wrt AirBoost Temperature" FLOAT32_IEEE EcuIntgdSwGend_CM_single_deg 0 0 -100.0 500.0 ECU_ADDRESS 0x4000E1EC /* @ECU_Address@IC_SoiMainInjCorrTAirBoost@ */ /end MEASUREMENT
/begin MEASUREMENT IC_SoiMaiInj "Start of Main Injection" FLOAT32_IEEE EcuIntgdSwGend_CM_single_deg 0 0 -100.0 100.0 ECU_ADDRESS 0x4000DAF8 /* @ECU_Address@IC_SoiMaiInj@ */ /end MEASUREMENT
/begin MEASUREMENT IC_DurPltInjCyl1 "Pilot Injection Duration for Cylinder 1" FLOAT32_IEEE EcuIntgdSwGend_CM_single_us 0 0 0.0 10000.0 ECU_ADDRESS 0x4000E4E8 /* @ECU_Address@IC_DurPltInjCyl1@ */ /end MEASUREMENT
/begin MEASUREMENT IC_DurPltInjCyl2 "Pilot Injection Duration for Cylinder 2" FLOAT32_IEEE EcuIntgdSwGend_CM_single_us 0 0 0.0 10000.0 ECU_ADDRESS 0x4000E4EC /* @ECU_Address@IC_DurPltInjCyl2@ */ /end MEASUREMENT
/begin MEASUREMENT IC_DurPltInjCyl3 "Pilot Injection Duration for Cylinder 3" FLOAT32_IEEE EcuIntgdSwGend_CM_single_us 0 0 0.0 10000.0 ECU_ADDRESS 0x4000E4F0 /* @ECU_Address@IC_DurPltInjCyl3@ */ /end MEASUREMENT
/begin MEASUREMENT IC_DurPltInjCyl4 "Pilot Injection Duration for Cylinder 4" FLOAT32_IEEE EcuIntgdSwGend_CM_single_us 0 0 0.0 10000.0 ECU_ADDRESS 0x4000E4F4 /* @ECU_Address@IC_DurPltInjCyl4@ */ /end MEASUREMENT
/begin MEASUREMENT IC_DurPltInjCyl6 "Pilot Injection Duration for Cylinder 6" FLOAT32_IEEE EcuIntgdSwGend_CM_single_us 0 0 0.0 10000.0 ECU_ADDRESS 0x4000E4FC /* @ECU_Address@IC_DurPltInjCyl6@ */ /end MEASUREMENT
/begin MEASUREMENT IC_DurPltInjCyl5 "Pilot Injection Duration for Cylinder 5" FLOAT32_IEEE EcuIntgdSwGend_CM_single_us 0 0 0.0 10000.0 ECU_ADDRESS 0x4000E4F8 /* @ECU_Address@IC_DurPltInjCyl5@ */ /end MEASUREMENT
/begin MEASUREMENT EIP_TiElpdIdleMod "Elapsed Time for Idle Mod" FLOAT32_IEEE EcuIntgdSwGend_CM_single_ms 0 0 0.0 50000.0 ECU_ADDRESS 0x4000E268 /* @ECU_Address@EIP_TiElpdIdleMod@ */ /end MEASUREMENT
/begin MEASUREMENT EIP_NCyl1Dif "Cylinder 1 Speed Difference" FLOAT32_IEEE EcuIntgdSwGend_CM_single_rpm 0 0 -2000.0 2000.0 ECU_ADDRESS 0x4000E080 /* @ECU_Address@EIP_NCyl1Dif@ */ /end MEASUREMENT
/begin MEASUREMENT EIP_ErrNCyl1 "Cylinder Speed Error For Cylinder 1" FLOAT32_IEEE EcuIntgdSwGend_CM_single_rpm 0 0 -4000.0 4000.0 ECU_ADDRESS 0x4000DD44 /* @ECU_Address@EIP_ErrNCyl1@ */ /end MEASUREMENT
/begin MEASUREMENT EIP_NCyl2Dif "Cylinder 2 Speed Difference" FLOAT32_IEEE EcuIntgdSwGend_CM_single_rpm 0 0 -2000.0 2000.0 ECU_ADDRESS 0x4000E938 /* @ECU_Address@EIP_NCyl2Dif@ */ /end MEASUREMENT
/begin MEASUREMENT EIP_ErrNCyl2 "Cylinder Speed Error For Cylinder 2" FLOAT32_IEEE EcuIntgdSwGend_CM_single_rpm 0 0 -4000.0 4000.0 ECU_ADDRESS 0x4000DD48 /* @ECU_Address@EIP_ErrNCyl2@ */ /end MEASUREMENT
/begin MEASUREMENT EIP_NCyl3Dif "Cylinder 3 Speed Difference" FLOAT32_IEEE EcuIntgdSwGend_CM_single_rpm 0 0 -2000.0 2000.0 ECU_ADDRESS 0x4000E0B0 /* @ECU_Address@EIP_NCyl3Dif@ */ /end MEASUREMENT
/begin MEASUREMENT EIP_ErrNCyl3 "Cylinder Speed Error For Cylinder 3" FLOAT32_IEEE EcuIntgdSwGend_CM_single_rpm 0 0 -4000.0 4000.0 ECU_ADDRESS 0x4000DD4C /* @ECU_Address@EIP_ErrNCyl3@ */ /end MEASUREMENT
/begin MEASUREMENT EIP_NCyl4Dif "Cylinder 4 Speed Difference" FLOAT32_IEEE EcuIntgdSwGend_CM_single_rpm 0 0 -2000.0 2000.0 ECU_ADDRESS 0x4000E964 /* @ECU_Address@EIP_NCyl4Dif@ */ /end MEASUREMENT
/begin MEASUREMENT EIP_ErrNCyl4 "Cylinder Speed Error For Cylinder 4" FLOAT32_IEEE EcuIntgdSwGend_CM_single_rpm 0 0 -4000.0 4000.0 ECU_ADDRESS 0x4000DD50 /* @ECU_Address@EIP_ErrNCyl4@ */ /end MEASUREMENT
/begin MEASUREMENT EIP_NCyl6Dif "Cylinder 6 Speed Difference" FLOAT32_IEEE EcuIntgdSwGend_CM_single_rpm 0 0 -2000.0 2000.0 ECU_ADDRESS 0x4000E998 /* @ECU_Address@EIP_NCyl6Dif@ */ /end MEASUREMENT
/begin MEASUREMENT EIP_ErrNCyl6 "Cylinder Speed Error For Cylinder 6" FLOAT32_IEEE EcuIntgdSwGend_CM_single_rpm 0 0 -4000.0 4000.0 ECU_ADDRESS 0x4000DD58 /* @ECU_Address@EIP_ErrNCyl6@ */ /end MEASUREMENT
/begin MEASUREMENT EIP_NCyl5Dif "Cylinder 5 Speed Difference" FLOAT32_IEEE EcuIntgdSwGend_CM_single_rpm 0 0 -2000.0 2000.0 ECU_ADDRESS 0x4000E0DC /* @ECU_Address@EIP_NCyl5Dif@ */ /end MEASUREMENT
/begin MEASUREMENT EIP_ErrNCyl5 "Cylinder Speed Error For Cylinder 5" FLOAT32_IEEE EcuIntgdSwGend_CM_single_rpm 0 0 -4000.0 4000.0 ECU_ADDRESS 0x4000DD54 /* @ECU_Address@EIP_ErrNCyl5@ */ /end MEASUREMENT
/begin MEASUREMENT EIP_TiElpdErrInjrShtdwn "Elapsed Time for Error Injection Shutdown" FLOAT32_IEEE EcuIntgdSwGend_CM_single_ms 0 0 0.0 250000.0 ECU_ADDRESS 0x4000E294 /* @ECU_Address@EIP_TiElpdErrInjrShtdwn@ */ /end MEASUREMENT
/begin MEASUREMENT DTqC_DrvrDmdPercTq "Driver Demand Percentage Torque" FLOAT32_IEEE EcuIntgdSwGend_CM_single__ 0 0 0.0 100.0 ECU_ADDRESS 0x4000E244 /* @ECU_Address@DTqC_DrvrDmdPercTq@ */ /end MEASUREMENT
/begin MEASUREMENT DTqC_CoeffKpOut "PID Controller Proportional Out" FLOAT32_IEEE EcuIntgdSwGend_CM_single 0 0 -1000.0 1000.0 ECU_ADDRESS 0x4000DB9C /* @ECU_Address@DTqC_CoeffKpOut@ */ /end MEASUREMENT
/begin MEASUREMENT DTqC_CoeffKiOut "PID Controller Integrator Out" FLOAT32_IEEE EcuIntgdSwGend_CM_single 0 0 -1000.0 1000.0 ECU_ADDRESS 0x4000E354 /* @ECU_Address@DTqC_CoeffKiOut@ */ /end MEASUREMENT
/begin MEASUREMENT DTqC_CoeffKdFbOut "PID Controller Derivative Feedback Out" FLOAT32_IEEE EcuIntgdSwGend_CM_single 0 0 -1000.0 1000.0 ECU_ADDRESS 0x4000E6F4 /* @ECU_Address@DTqC_CoeffKdFbOut@ */ /end MEASUREMENT
/begin MEASUREMENT DTqC_CoeffKdOut "PID Controller Derivative Out" FLOAT32_IEEE EcuIntgdSwGend_CM_single 0 0 -1000.0 1000.0 ECU_ADDRESS 0x4000DA6C /* @ECU_Address@DTqC_CoeffKdOut@ */ /end MEASUREMENT
/begin MEASUREMENT DTqC_CoeffKiClampPreSatOut "PID Controller Integrator Clamp Pre Saturation Out" FLOAT32_IEEE EcuIntgdSwGend_CM_single 0 0 -1000.0 1000.0 ECU_ADDRESS 0x4000DBE0 /* @ECU_Address@DTqC_CoeffKiClampPreSatOut@ */ /end MEASUREMENT
/begin MEASUREMENT DTqC_IdleSpdCtlPIDOut "Idle Speed Controller PID Out" FLOAT32_IEEE EcuIntgdSwGend_CM_single_N_m 0 0 -10000.0 10000.0 ECU_ADDRESS 0x4000D950 /* @ECU_Address@DTqC_IdleSpdCtlPIDOut@ */ /end MEASUREMENT
/begin MEASUREMENT DTqC_TqBrkMap1 "Break Torque Map 1 Signal" FLOAT32_IEEE EcuIntgdSwGend_CM_single_N_m 0 0 -1000.0 10000.0 ECU_ADDRESS 0x4000DACC /* @ECU_Address@DTqC_TqBrkMap1@ */ /end MEASUREMENT
/begin MEASUREMENT DTqC_TqBrkMap2 "Break Torque Map 2 Signal" FLOAT32_IEEE EcuIntgdSwGend_CM_single_N_m 0 0 -1000.0 10000.0 ECU_ADDRESS 0x4000DAD0 /* @ECU_Address@DTqC_TqBrkMap2@ */ /end MEASUREMENT
/begin MEASUREMENT DTqC_TqLimdBrk1to2Intp "Break Torque Value Interpolation Between Map 1 and 2" FLOAT32_IEEE EcuIntgdSwGend_CM_single_N_m 0 0 0.0 10000.0 ECU_ADDRESS 0x4000D9F8 /* @ECU_Address@DTqC_TqLimdBrk1to2Intp@ */ /end MEASUREMENT
/begin MEASUREMENT DTqC_TqBrkMap3 "Break Torque Map 3 Signal" FLOAT32_IEEE EcuIntgdSwGend_CM_single_N_m 0 0 -1000.0 10000.0 ECU_ADDRESS 0x4000DAD4 /* @ECU_Address@DTqC_TqBrkMap3@ */ /end MEASUREMENT
/begin MEASUREMENT DTqC_TqLimdBrk2To3Intp "Break Torque Value Interpolation Between Map 2 and 3" FLOAT32_IEEE EcuIntgdSwGend_CM_single_N_m 0 0 0.0 10000.0 ECU_ADDRESS 0x4000E5F0 /* @ECU_Address@DTqC_TqLimdBrk2To3Intp@ */ /end MEASUREMENT
/begin MEASUREMENT DTqC_TqLimdBrk "Driver Demand Break Torque" FLOAT32_IEEE EcuIntgdSwGend_CM_single_N_m 0 0 0.0 10000.0 ECU_ADDRESS 0x4000E298 /* @ECU_Address@DTqC_TqLimdBrk@ */ /end MEASUREMENT
/begin MEASUREMENT DTqC_ErrNSpdReq "TCU Speed Request and Engine Speed Differences" FLOAT32_IEEE EcuIntgdSwGend_CM_single_rpm 0 0 -10000.0 10000.0 ECU_ADDRESS 0x4000DC04 /* @ECU_Address@DTqC_ErrNSpdReq@ */ /end MEASUREMENT
/begin MEASUREMENT DTqC_CoeffPForTSC1ReqSpdCtlMapOut "Proportional Coefficient Map Out Signal for TCU Request Speed Controller" FLOAT32_IEEE EcuIntgdSwGend_CM_single 0 0 -10000.0 10000.0 ECU_ADDRESS 0x4000E944 /* @ECU_Address@DTqC_CoeffPForTSC1ReqSpdCtlMapOut@ */ /end MEASUREMENT
/begin MEASUREMENT DTqC_CoeffPForTSC1ReqSpdCtl "Proportional Coefficient Signal for TCU Request Speed Controller" FLOAT32_IEEE EcuIntgdSwGend_CM_single 0 0 -100.0 100.0 ECU_ADDRESS 0x4000DB98 /* @ECU_Address@DTqC_CoeffPForTSC1ReqSpdCtl@ */ /end MEASUREMENT
/begin MEASUREMENT DTqC_CoeffDForTSC1ReqSpdCtlMapOut "Derivative Coefficient Map Out Signal for TCU Request Speed Controller" FLOAT32_IEEE EcuIntgdSwGend_CM_single 0 0 -10000.0 10000.0 ECU_ADDRESS 0x4000E968 /* @ECU_Address@DTqC_CoeffDForTSC1ReqSpdCtlMapOut@ */ /end MEASUREMENT
/begin MEASUREMENT DTqC_CoeffDForTSC1ReqSpdCtl "Derivative Coefficient Signal for TCU Request Speed Controller" FLOAT32_IEEE EcuIntgdSwGend_CM_single 0 0 -100.0 100.0 ECU_ADDRESS 0x4000D970 /* @ECU_Address@DTqC_CoeffDForTSC1ReqSpdCtl@ */ /end MEASUREMENT
/begin MEASUREMENT DTqC_CoeffFiltForTSC1ReqSpdCtlMapOut "Filter Coefficient Map Out Signal for TCU Request Speed Controller" FLOAT32_IEEE EcuIntgdSwGend_CM_single 0 0 -10000.0 10000.0 ECU_ADDRESS 0x4000DFF8 /* @ECU_Address@DTqC_CoeffFiltForTSC1ReqSpdCtlMapOut@ */ /end MEASUREMENT
/begin MEASUREMENT DTqC_CoeffFiltForTSC1ReqSpdCtl "Filter Coefficient Signal for TCU Request Speed Controller" FLOAT32_IEEE EcuIntgdSwGend_CM_single 0 0 -100.0 100.0 ECU_ADDRESS 0x4000DE40 /* @ECU_Address@DTqC_CoeffFiltForTSC1ReqSpdCtl@ */ /end MEASUREMENT
/begin MEASUREMENT DTqC_NEngDelta "" FLOAT32_IEEE EcuIntgdSwGend_CM_single_rpm 0 0 -3300.0 3300.0 ECU_ADDRESS 0x4000DA8C /* @ECU_Address@DTqC_NEngDelta@ */ /end MEASUREMENT
/begin MEASUREMENT DTqC_CoeffPForEndSpdCtlMapOut "" FLOAT32_IEEE EcuIntgdSwGend_CM_single 0 0 -10000.0 10000.0 ECU_ADDRESS 0x4000DFC8 /* @ECU_Address@DTqC_CoeffPForEndSpdCtlMapOut@ */ /end MEASUREMENT
/begin MEASUREMENT DTqC_CoeffPForSpdCtlEndSpd "" FLOAT32_IEEE EcuIntgdSwGend_CM_single 0 0 -100.0 100.0 ECU_ADDRESS 0x4000E4D8 /* @ECU_Address@DTqC_CoeffPForSpdCtlEndSpd@ */ /end MEASUREMENT
/begin MEASUREMENT DTqC_CoeffDForEndSpdCtlMapOut "" FLOAT32_IEEE EcuIntgdSwGend_CM_single 0 0 -10000.0 10000.0 ECU_ADDRESS 0x4000DD68 /* @ECU_Address@DTqC_CoeffDForEndSpdCtlMapOut@ */ /end MEASUREMENT
/begin MEASUREMENT DTqC_CoeffDForSpdCtlEndSpd "" FLOAT32_IEEE EcuIntgdSwGend_CM_single 0 0 -100.0 100.0 ECU_ADDRESS 0x4000DED4 /* @ECU_Address@DTqC_CoeffDForSpdCtlEndSpd@ */ /end MEASUREMENT
/begin MEASUREMENT DTqC_CoeffFiltForEndSpdCtlMapOut "" FLOAT32_IEEE EcuIntgdSwGend_CM_single 0 0 -10000.0 10000.0 ECU_ADDRESS 0x4000DDF8 /* @ECU_Address@DTqC_CoeffFiltForEndSpdCtlMapOut@ */ /end MEASUREMENT
/begin MEASUREMENT DTqC_CoeffFiltForSpdCtlEndSpd "" FLOAT32_IEEE EcuIntgdSwGend_CM_single 0 0 -100.0 100.0 ECU_ADDRESS 0x4000DDB8 /* @ECU_Address@DTqC_CoeffFiltForSpdCtlEndSpd@ */ /end MEASUREMENT
/begin MEASUREMENT DTqC_CoeffIForEndSpdCtlMapOut "" FLOAT32_IEEE EcuIntgdSwGend_CM_single 0 0 -10000.0 10000.0 ECU_ADDRESS 0x4000D92C /* @ECU_Address@DTqC_CoeffIForEndSpdCtlMapOut@ */ /end MEASUREMENT
/begin MEASUREMENT DTqC_CoeffIForSpdCtlEndSpd "" FLOAT32_IEEE EcuIntgdSwGend_CM_single 0 0 -100.0 100.0 ECU_ADDRESS 0x4000DA64 /* @ECU_Address@DTqC_CoeffIForSpdCtlEndSpd@ */ /end MEASUREMENT
/begin MEASUREMENT DTqC_CoeffIForTSC1ReqSpdCtlMapOut "Integrator Coefficient Map Out Signal for TCU Request Speed Controller" FLOAT32_IEEE EcuIntgdSwGend_CM_single 0 0 -10000.0 10000.0 ECU_ADDRESS 0x4000E4C4 /* @ECU_Address@DTqC_CoeffIForTSC1ReqSpdCtlMapOut@ */ /end MEASUREMENT
/begin MEASUREMENT DTqC_CoeffIForTSC1ReqSpdCtl "Integrator Coefficient Signal for TCU Request Speed Controller" FLOAT32_IEEE EcuIntgdSwGend_CM_single 0 0 -100.0 100.0 ECU_ADDRESS 0x4000E6FC /* @ECU_Address@DTqC_CoeffIForTSC1ReqSpdCtl@ */ /end MEASUREMENT
/begin MEASUREMENT DTqC_CoeffKiClampOut "PID Controller Integrator Clamp Out" FLOAT32_IEEE EcuIntgdSwGend_CM_single 0 0 -1000.0 1000.0 ECU_ADDRESS 0x4000E4B4 /* @ECU_Address@DTqC_CoeffKiClampOut@ */ /end MEASUREMENT
/begin MEASUREMENT DTqC_CoeffKiClampSwtchOut "PID Controller Integrator Clamp Switch Out" FLOAT32_IEEE EcuIntgdSwGend_CM_single 0 0 -1000.0 1000.0 ECU_ADDRESS 0x4000E120 /* @ECU_Address@DTqC_CoeffKiClampSwtchOut@ */ /end MEASUREMENT
/begin MEASUREMENT CrsCtrl_CoeffKdFbOut "PID Controller Derivative Feedback Out" FLOAT32_IEEE EcuIntgdSwGend_CM_single 0 0 -10000.0 10000.0 ECU_ADDRESS 0x4000E154 /* @ECU_Address@CrsCtrl_CoeffKdFbOut@ */ /end MEASUREMENT
/begin MEASUREMENT CrsCtrl_CoeffKdOut "PID Controller Derivative Out" FLOAT32_IEEE EcuIntgdSwGend_CM_single 0 0 -10000.0 10000.0 ECU_ADDRESS 0x4000DFA8 /* @ECU_Address@CrsCtrl_CoeffKdOut@ */ /end MEASUREMENT
/begin MEASUREMENT CrsCtrl_CoeffKpOut "PID Controller Proportional Out" FLOAT32_IEEE EcuIntgdSwGend_CM_single 0 0 -10000.0 10000.0 ECU_ADDRESS 0x4000E79C /* @ECU_Address@CrsCtrl_CoeffKpOut@ */ /end MEASUREMENT
/begin MEASUREMENT CrsCtrl_CoeffKiClampPreSatOut "PID Controller Integrator Clamp Pre Saturation Out" FLOAT32_IEEE EcuIntgdSwGend_CM_single 0 0 -10000.0 10000.0 ECU_ADDRESS 0x4000D9E4 /* @ECU_Address@CrsCtrl_CoeffKiClampPreSatOut@ */ /end MEASUREMENT
/begin MEASUREMENT CrsCtrl_PIDOutCrsCtrlTq "Cruise Control PID Out Torque" FLOAT32_IEEE EcuIntgdSwGend_CM_single_N_m 0 0 -10000.0 10000.0 ECU_ADDRESS 0x4000E43C /* @ECU_Address@CrsCtrl_PIDOutCrsCtrlTq@ */ /end MEASUREMENT
/begin MEASUREMENT CrsCtrl_CoeffKiClampOut "PID Controller Integrator Clamp Out" FLOAT32_IEEE EcuIntgdSwGend_CM_single 0 0 -10000.0 10000.0 ECU_ADDRESS 0x4000E924 /* @ECU_Address@CrsCtrl_CoeffKiClampOut@ */ /end MEASUREMENT
/begin MEASUREMENT WgC_bAcvSurgeLim "Surge Limitation Active" UBYTE EcuIntgdSwGend_CM_boolean 0 0 0.0 1.0 ECU_ADDRESS 0x4000DE04 /* @ECU_Address@WgC_bAcvSurgeLim@ */ /end MEASUREMENT
/begin MEASUREMENT WM_bErrLvlOilSnsrLimp "Oil Level Sensor Limp Error" UBYTE EcuIntgdSwGend_CM_boolean 0 0 0.0 1.0 ECU_ADDRESS 0x4000E31D /* @ECU_Address@WM_bErrLvlOilSnsrLimp@ */ /end MEASUREMENT
/begin MEASUREMENT WM_bErrTFuSnsrLimp "Fuel Temperature Sensor Limp Error" UBYTE EcuIntgdSwGend_CM_boolean 0 0 0.0 1.0 ECU_ADDRESS 0x4000DD94 /* @ECU_Address@WM_bErrTFuSnsrLimp@ */ /end MEASUREMENT
/begin MEASUREMENT WM_bErrTAirBoostSnsrLimp "Air Boost Temperature Sensor Limp Error" UBYTE EcuIntgdSwGend_CM_boolean 0 0 0.0 1.0 ECU_ADDRESS 0x4000DA1C /* @ECU_Address@WM_bErrTAirBoostSnsrLimp@ */ /end MEASUREMENT
/begin MEASUREMENT WM_bErrTAmbAirSnsrLimp "Ambient Air Temperature Sensor Limp Error" UBYTE EcuIntgdSwGend_CM_boolean 0 0 0.0 1.0 ECU_ADDRESS 0x4000E41C /* @ECU_Address@WM_bErrTAmbAirSnsrLimp@ */ /end MEASUREMENT
/begin MEASUREMENT WM_bErrPFuSnsrLimp "Fuel Pressure Sensor Limp Error" UBYTE EcuIntgdSwGend_CM_boolean 0 0 0.0 1.0 ECU_ADDRESS 0x4000D8EB /* @ECU_Address@WM_bErrPFuSnsrLimp@ */ /end MEASUREMENT
/begin MEASUREMENT WM_bErrPAmbAirSnsrLimp "Ambient Air Pressure Sensor Limp Error" UBYTE EcuIntgdSwGend_CM_boolean 0 0 0.0 1.0 ECU_ADDRESS 0x4000DDB0 /* @ECU_Address@WM_bErrPAmbAirSnsrLimp@ */ /end MEASUREMENT
/begin MEASUREMENT WM_bErrPAirBoostSnsrLimp "Air Boost Pressure Sensor Limp Error" UBYTE EcuIntgdSwGend_CM_boolean 0 0 0.0 1.0 ECU_ADDRESS 0x4000DC12 /* @ECU_Address@WM_bErrPAirBoostSnsrLimp@ */ /end MEASUREMENT
/begin MEASUREMENT WM_bErrTEcuLimp "ECU Temperature Sensor Limp Error" UBYTE EcuIntgdSwGend_CM_boolean 0 0 0.0 1.0 ECU_ADDRESS 0x4000E072 /* @ECU_Address@WM_bErrTEcuLimp@ */ /end MEASUREMENT
/begin MEASUREMENT WM_bErrUClmp30SnsrLimp "Batter Voltage Sensor Limp Error" UBYTE EcuIntgdSwGend_CM_boolean 0 0 0.0 1.0 ECU_ADDRESS 0x4000E038 /* @ECU_Address@WM_bErrUClmp30SnsrLimp@ */ /end MEASUREMENT
/begin MEASUREMENT WM_bErrWgLimp "Wastegate Sensor Limp Error" UBYTE EcuIntgdSwGend_CM_boolean 0 0 0.0 1.0 ECU_ADDRESS 0x4000E994 /* @ECU_Address@WM_bErrWgLimp@ */ /end MEASUREMENT
/begin MEASUREMENT WM_bErrPOilSnsrLimp "Oil Pressure Sensor Limp Error" UBYTE EcuIntgdSwGend_CM_boolean 0 0 0.0 1.0 ECU_ADDRESS 0x4000DD40 /* @ECU_Address@WM_bErrPOilSnsrLimp@ */ /end MEASUREMENT
/begin MEASUREMENT WM_bErrTOilSnsrLimp "Oil Temperature Sensor Limp Error" UBYTE EcuIntgdSwGend_CM_boolean 0 0 0.0 1.0 ECU_ADDRESS 0x4000E3E4 /* @ECU_Address@WM_bErrTOilSnsrLimp@ */ /end MEASUREMENT
/begin MEASUREMENT WM_bErrTCooltSnsrLimp "Coolant Temperature Sensor Limp Error" UBYTE EcuIntgdSwGend_CM_boolean 0 0 0.0 1.0 ECU_ADDRESS 0x4000DA98 /* @ECU_Address@WM_bErrTCooltSnsrLimp@ */ /end MEASUREMENT
/begin MEASUREMENT WM_bAcvLimpRctn "Limp Reaction Active" UBYTE EcuIntgdSwGend_CM_boolean 0 0 0.0 1.0 ECU_ADDRESS 0x4000DA60 /* @ECU_Address@WM_bAcvLimpRctn@ */ /end MEASUREMENT
/begin MEASUREMENT TL_bEnaTmrNEngAcvForTCoolt "Timer Enable Condition for Coolant High Temperature Limit Activation" UBYTE EcuIntgdSwGend_CM_boolean 0 0 0.0 1.0 ECU_ADDRESS 0x4000E3E5 /* @ECU_Address@TL_bEnaTmrNEngAcvForTCoolt@ */ /end MEASUREMENT
/begin MEASUREMENT TL_bEnaTmrNEngAcvForTFu "Timer Enable Condition for Fuel Temperature Limit Activation" UBYTE EcuIntgdSwGend_CM_boolean 0 0 0.0 1.0 ECU_ADDRESS 0x4000E344 /* @ECU_Address@TL_bEnaTmrNEngAcvForTFu@ */ /end MEASUREMENT
/begin MEASUREMENT TL_bEnaTmrNEngAcvForNExhTrbChrg "Timer Enable Condition for Turbo Charger Limit Activation" UBYTE EcuIntgdSwGend_CM_boolean 0 0 0.0 1.0 ECU_ADDRESS 0x4000E0E5 /* @ECU_Address@TL_bEnaTmrNEngAcvForNExhTrbChrg@ */ /end MEASUREMENT
/begin MEASUREMENT TL_bEnaTmrNEngAcvForPAirBoost "Timer Enable Condition for Air Boost Pressure Limit Activation" UBYTE EcuIntgdSwGend_CM_boolean 0 0 0.0 1.0 ECU_ADDRESS 0x4000E794 /* @ECU_Address@TL_bEnaTmrNEngAcvForPAirBoost@ */ /end MEASUREMENT
/begin MEASUREMENT TL_bErrTAirSnsr "Air Temperature Sensor Error" UBYTE EcuIntgdSwGend_CM_boolean 0 0 0.0 1.0 ECU_ADDRESS 0x4000E6AD /* @ECU_Address@TL_bErrTAirSnsr@ */ /end MEASUREMENT
/begin MEASUREMENT TL_bEnaTmrNEngAcvForTAir "Timer Enable Condition for Air Boost Temperature Limit Activation" UBYTE EcuIntgdSwGend_CM_boolean 0 0 0.0 1.0 ECU_ADDRESS 0x4000E7D8 /* @ECU_Address@TL_bEnaTmrNEngAcvForTAir@ */ /end MEASUREMENT
/begin MEASUREMENT TL_bEnaTmrNEngAcvForPAirAmb "Timer Enable Condition for Ambient Pressure Limit Activation" UBYTE EcuIntgdSwGend_CM_boolean 0 0 0.0 1.0 ECU_ADDRESS 0x4000E8F4 /* @ECU_Address@TL_bEnaTmrNEngAcvForPAirAmb@ */ /end MEASUREMENT
/begin MEASUREMENT TL_bEnaTmrNEngAcvForTOil "Timer Enable Condition for Oil Temperature Limit Activation" UBYTE EcuIntgdSwGend_CM_boolean 0 0 0.0 1.0 ECU_ADDRESS 0x4000E46E /* @ECU_Address@TL_bEnaTmrNEngAcvForTOil@ */ /end MEASUREMENT
/begin MEASUREMENT SC_bAcvStrtOvrHeatProtn "Starter OverHeat Protection" UBYTE EcuIntgdSwGend_CM_boolean 0 0 0.0 1.0 ECU_ADDRESS 0x4000E728 /* @ECU_Address@SC_bAcvStrtOvrHeatProtn@ */ /end MEASUREMENT
/begin MEASUREMENT SC_bNEngRunDeacThd "Debouncer Flag for Deactivation Engine Speed Threshold" UBYTE EcuIntgdSwGend_CM_boolean 0 0 0.0 1.0 ECU_ADDRESS 0x4000E39C /* @ECU_Address@SC_bNEngRunDeacThd@ */ /end MEASUREMENT
/begin MEASUREMENT SC_bNEngStrtrInhThd "Debouncer Flag for Start Inhibition Engine Speed Threshold" UBYTE EcuIntgdSwGend_CM_boolean 0 0 0.0 1.0 ECU_ADDRESS 0x4000DE12 /* @ECU_Address@SC_bNEngStrtrInhThd@ */ /end MEASUREMENT
/begin MEASUREMENT SC_bAcvEngRunng "Engine is Running Flag" UBYTE EcuIntgdSwGend_CM_boolean 0 0 0.0 1.0 ECU_ADDRESS 0x4000E170 /* @ECU_Address@SC_bAcvEngRunng@ */ /end MEASUREMENT
/begin MEASUREMENT SC_bEngNotTurnTiEna "Engine Not Turn Timer Enable" UBYTE EcuIntgdSwGend_CM_boolean 0 0 0.0 1.0 ECU_ADDRESS 0x4000DA8A /* @ECU_Address@SC_bEngNotTurnTiEna@ */ /end MEASUREMENT
/begin MEASUREMENT SC_bEngNotTurn "Engine Not Turn Signal" UBYTE EcuIntgdSwGend_CM_boolean 0 0 0.0 1.0 ECU_ADDRESS 0x4000E538 /* @ECU_Address@SC_bEngNotTurn@ */ /end MEASUREMENT
/begin MEASUREMENT SC_bComplDebNEngStrtLock "Debouncer Flag for Starter Locking" UBYTE EcuIntgdSwGend_CM_boolean 0 0 0.0 1.0 ECU_ADDRESS 0x4000E055 /* @ECU_Address@SC_bComplDebNEngStrtLock@ */ /end MEASUREMENT
/begin MEASUREMENT SC_EngRunngActvnforEngAlrdyRunng "Engine Runnig Activation for Engine Already Running" UBYTE EcuIntgdSwGend_CM_boolean 0 0 0.0 1.0 ECU_ADDRESS 0x4000E2A4 /* @ECU_Address@SC_EngRunngActvnforEngAlrdyRunng@ */ /end MEASUREMENT
/begin MEASUREMENT SC_bInhErrElectFailPreTest "Inhibition Engine Start Electrical Failure Pre Test" UBYTE EcuIntgdSwGend_CM_boolean 0 0 0.0 1.0 ECU_ADDRESS 0x4000E68A /* @ECU_Address@SC_bInhErrElectFailPreTest@ */ /end MEASUREMENT
/begin MEASUREMENT SC_bTiAcvnLvlFuDeb "Fuel Level Debouncer Activation" UBYTE EcuIntgdSwGend_CM_boolean 0 0 0.0 1.0 ECU_ADDRESS 0x4000E213 /* @ECU_Address@SC_bTiAcvnLvlFuDeb@ */ /end MEASUREMENT
/begin MEASUREMENT SC_bTiAcvnLvlOilDeb "Oil Level Debouncer Activation" UBYTE EcuIntgdSwGend_CM_boolean 0 0 0.0 1.0 ECU_ADDRESS 0x4000E180 /* @ECU_Address@SC_bTiAcvnLvlOilDeb@ */ /end MEASUREMENT
/begin MEASUREMENT SC_bInhEngStrtPreTest "Inhibition Engine Start Pre Test" UBYTE EcuIntgdSwGend_CM_boolean 0 0 0.0 1.0 ECU_ADDRESS 0x4000D944 /* @ECU_Address@SC_bInhEngStrtPreTest@ */ /end MEASUREMENT
/begin MEASUREMENT SpdLimr_ErrCanTrtCaseSts "Error CAN Transfer Case Status" UBYTE EcuIntgdSwGend_CM_boolean 0 0 0.0 1.0 ECU_ADDRESS 0x4000D99F /* @ECU_Address@SpdLimr_ErrCanTrtCaseSts@ */ /end MEASUREMENT
/begin MEASUREMENT SpdLimr_ErrCanTrsmTqCnvrRat "Error CAN Transmission Torque Convertor Ratio" UBYTE EcuIntgdSwGend_CM_boolean 0 0 0.0 1.0 ECU_ADDRESS 0x4000E68B /* @ECU_Address@SpdLimr_ErrCanTrsmTqCnvrRat@ */ /end MEASUREMENT
/begin MEASUREMENT RPG_bCompNEngThdAcvnPRail "Debouncer Flag for Rail Pressure Correction Activation wrt Comparision with Engine Speed" UBYTE EcuIntgdSwGend_CM_boolean 0 0 0.0 1.0 ECU_ADDRESS 0x4000E440 /* @ECU_Address@RPG_bCompNEngThdAcvnPRail@ */ /end MEASUREMENT
/begin MEASUREMENT PHC_bGridHeatrFault "Grid Heater Fault" UBYTE EcuIntgdSwGend_CM_boolean 0 0 0.0 1.0 ECU_ADDRESS 0x4000E670 /* @ECU_Address@PHC_bGridHeatrFault@ */ /end MEASUREMENT
/begin MEASUREMENT PHC_bErrAcvGridHeatrOffSts "Grid Heater Error Off Status" UBYTE EcuIntgdSwGend_CM_boolean 0 0 0.0 1.0 ECU_ADDRESS 0x4000DDF0 /* @ECU_Address@PHC_bErrAcvGridHeatrOffSts@ */ /end MEASUREMENT
/begin MEASUREMENT PHC_bErrAcvGridHeatrOnSts "Grid Heater Error On Status" UBYTE EcuIntgdSwGend_CM_boolean 0 0 0.0 1.0 ECU_ADDRESS 0x4000E8FD /* @ECU_Address@PHC_bErrAcvGridHeatrOnSts@ */ /end MEASUREMENT
/begin MEASUREMENT EIP_bAcvIdleModDebOut "Idle Mode Debouncer Active" UBYTE EcuIntgdSwGend_CM_boolean 0 0 0.0 1.0 ECU_ADDRESS 0x4000E41D /* @ECU_Address@EIP_bAcvIdleModDebOut@ */ /end MEASUREMENT
/begin MEASUREMENT DTqC_AcvSoftLim "Engine Speed Soft Limit Activation Flag" UBYTE EcuIntgdSwGend_CM_boolean 0 0 0.0 1.0 ECU_ADDRESS 0x4000DFD4 /* @ECU_Address@DTqC_AcvSoftLim@ */ /end MEASUREMENT
/begin MEASUREMENT DTqC_AcvHardLim "Engine Speed Hard Limit Activation Flag" UBYTE EcuIntgdSwGend_CM_boolean 0 0 0.0 1.0 ECU_ADDRESS 0x4000E426 /* @ECU_Address@DTqC_AcvHardLim@ */ /end MEASUREMENT
/begin COMPU_METHOD EcuIntgdSwGend_CM_single_N_m "Q = V" RAT_FUNC "%8.6" "N*m" COEFFS 0 1 0 0 0 1 /end COMPU_METHOD
/begin COMPU_METHOD EcuIntgdSwGend_CM_single_rpm "Q = V" RAT_FUNC "%8.6" "rpm" COEFFS 0 1 0 0 0 1 /end COMPU_METHOD
/begin COMPU_METHOD EcuIntgdSwGend_CM_single_degC "Q = V" RAT_FUNC "%8.6" "degC" COEFFS 0 1 0 0 0 1 /end COMPU_METHOD
/begin COMPU_METHOD EcuIntgdSwGend_CM_single__ "Q = V" RAT_FUNC "%8.6" "%" COEFFS 0 1 0 0 0 1 /end COMPU_METHOD
/begin COMPU_METHOD EcuIntgdSwGend_CM_single "Q = V" RAT_FUNC "%8.6" "" COEFFS 0 1 0 0 0 1 /end COMPU_METHOD
/begin COMPU_METHOD EcuIntgdSwGend_CM_single_deg "Q = V" RAT_FUNC "%8.6" "deg" COEFFS 0 1 0 0 0 1 /end COMPU_METHOD
/begin COMPU_METHOD EcuIntgdSwGend_CM_single_ms "Q = V" RAT_FUNC "%8.6" "ms" COEFFS 0 1 0 0 0 1 /end COMPU_METHOD
/begin COMPU_METHOD EcuIntgdSwGend_CM_single_mbar "Q = V" RAT_FUNC "%8.6" "mbar" COEFFS 0 1 0 0 0 1 /end COMPU_METHOD
/begin COMPU_METHOD EcuIntgdSwGend_CM_single_bar "Q = V" RAT_FUNC "%8.6" "bar" COEFFS 0 1 0 0 0 1 /end COMPU_METHOD
/begin COMPU_METHOD EcuIntgdSwGend_CM_single_mm_3_stk "Q = V" RAT_FUNC "%8.6" "mm^3/stk" COEFFS 0 1 0 0 0 1 /end COMPU_METHOD
/begin COMPU_METHOD EcuIntgdSwGend_CM_single_km_h "Q = V" RAT_FUNC "%8.6" "km/h" COEFFS 0 1 0 0 0 1 /end COMPU_METHOD
/begin COMPU_METHOD EcuIntgdSwGend_CM_single_us "Q = V" RAT_FUNC "%8.6" "us" COEFFS 0 1 0 0 0 1 /end COMPU_METHOD
/begin COMPU_METHOD EcuIntgdSwGend_CM_single_kg_s "Q = V" RAT_FUNC "%8.6" "kg/s" COEFFS 0 1 0 0 0 1 /end COMPU_METHOD
/begin COMPU_METHOD EcuIntgdSwGend_CM_uint32 "Q = V" RAT_FUNC "%10.0" "" COEFFS 0 1 0 0 0 1 /end COMPU_METHOD
/begin COMPU_METHOD EcuIntgdSwGend_CM_boolean "Q = V" RAT_FUNC "%1.0" "" COEFFS 0 1 0 0 0 1 /end COMPU_METHOD
/begin GROUP S446__Injector_1_Characteristic_Calibration "EcuIntgdSwGend/ControlSoftware/InjCtl/Pilot Injector Characteristic Maps/ Injector 1 Characteristic Calibration" /begin REF_CHARACTERISTIC IC_DurPltLimd_M /end REF_CHARACTERISTIC /end GROUP
/begin GROUP S446__Injector_2_Characteristic "EcuIntgdSwGend/ControlSoftware/InjCtl/Pilot Injector Characteristic Maps/ Injector 2 Characteristic"
 /begin SUB_GROUP S524_Injector_2_Characteristic_Map_1 S524_Injector_2_Characteristic_Map_2 S524_Injector_2_Characteristic_Map_3 S524_Injector_2_Characteristic_Map_4 S524_Injector_2_Characteristic_Map_5 /end SUB_GROUP
/end GROUP
/begin GROUP S446__Injector_2_Characteristic_Calibration "EcuIntgdSwGend/ControlSoftware/InjCtl/Pilot Injector Characteristic Maps/ Injector 2 Characteristic Calibration" /begin REF_CHARACTERISTIC IC_DurPltLimd_M /end REF_CHARACTERISTIC /end GROUP
/begin GROUP S446__Injector_3_Characteristic "EcuIntgdSwGend/ControlSoftware/InjCtl/Pilot Injector Characteristic Maps/ Injector 3 Characteristic"
 /begin SUB_GROUP S526_Injector_3_Characteristic_Map_1 S526_Injector_3_Characteristic_Map_2 S526_Injector_3_Characteristic_Map_3 S526_Injector_3_Characteristic_Map_4 S526_Injector_3_Characteristic_Map_5 /end SUB_GROUP
/end GROUP
/begin GROUP S446__Injector_3_Characteristic_Calibration "EcuIntgdSwGend/ControlSoftware/InjCtl/Pilot Injector Characteristic Maps/ Injector 3 Characteristic Calibration" /begin REF_CHARACTERISTIC IC_DurPltLimd_M /end REF_CHARACTERISTIC /end GROUP
/begin GROUP S446__Injector_4_Characteristic "EcuIntgdSwGend/ControlSoftware/InjCtl/Pilot Injector Characteristic Maps/ Injector 4 Characteristic"
 /begin SUB_GROUP S528_Injector_4_Characteristic_Map_1 S528_Injector_4_Characteristic_Map_2 S528_Injector_4_Characteristic_Map_3 S528_Injector_4_Characteristic_Map_4 S528_Injector_4_Characteristic_Map_5 /end SUB_GROUP
/end GROUP
/begin GROUP S446__Injector_4_Characteristic_Calibration "EcuIntgdSwGend/ControlSoftware/InjCtl/Pilot Injector Characteristic Maps/ Injector 4 Characteristic Calibration" /begin REF_CHARACTERISTIC IC_DurPltLimd_M /end REF_CHARACTERISTIC /end GROUP
/begin GROUP S446__Injector_5_Characteristic "EcuIntgdSwGend/ControlSoftware/InjCtl/Pilot Injector Characteristic Maps/ Injector 5 Characteristic"
 /begin SUB_GROUP S530_Injector_5_Characteristic_Map_1 S530_Injector_5_Characteristic_Map_2 S530_Injector_5_Characteristic_Map_3 S530_Injector_5_Characteristic_Map_4 S530_Injector_5_Characteristic_Map_5 /end SUB_GROUP
/end GROUP
/begin GROUP S446__Injector_5_Characteristic_Calibration "EcuIntgdSwGend/ControlSoftware/InjCtl/Pilot Injector Characteristic Maps/ Injector 5 Characteristic Calibration" /begin REF_CHARACTERISTIC IC_DurPltLimd_M /end REF_CHARACTERISTIC /end GROUP
/begin GROUP S446__Injector_6_Characteristic "EcuIntgdSwGend/ControlSoftware/InjCtl/Pilot Injector Characteristic Maps/ Injector 6 Characteristic"
 /begin SUB_GROUP S532_Injector_6_Characteristic_Map_1 S532_Injector_6_Characteristic_Map_2 S532_Injector_6_Characteristic_Map_3 S532_Injector_6_Characteristic_Map_4 S532_Injector_6_Characteristic_Map_5 /end SUB_GROUP
/end GROUP
/begin GROUP S446__Injector_6_Characteristic_Calibration "EcuIntgdSwGend/ControlSoftware/InjCtl/Pilot Injector Characteristic Maps/ Injector 6 Characteristic Calibration" /begin REF_CHARACTERISTIC IC_DurPltLimd_M /end REF_CHARACTERISTIC /end GROUP
/begin GROUP S446_Duration_Injection_1_Pre "EcuIntgdSwGend/ControlSoftware/InjCtl/Pilot Injector Characteristic Maps/Duration Injection 1 Pre" /begin REF_MEASUREMENT IC_DurPltInjCyl1 /end REF_MEASUREMENT /end GROUP
/begin GROUP S446_Duration_Injection_2_Pre "EcuIntgdSwGend/ControlSoftware/InjCtl/Pilot Injector Characteristic Maps/Duration Injection 2 Pre" /begin REF_MEASUREMENT IC_DurPltInjCyl2 /end REF_MEASUREMENT /end GROUP
/begin GROUP S446_Duration_Injection_3_Pre "EcuIntgdSwGend/ControlSoftware/InjCtl/Pilot Injector Characteristic Maps/Duration Injection 3 Pre" /begin REF_MEASUREMENT IC_DurPltInjCyl3 /end REF_MEASUREMENT /end GROUP
/begin GROUP S446_Duration_Injection_4_Pre "EcuIntgdSwGend/ControlSoftware/InjCtl/Pilot Injector Characteristic Maps/Duration Injection 4 Pre" /begin REF_MEASUREMENT IC_DurPltInjCyl4 /end REF_MEASUREMENT /end GROUP
/begin GROUP S446_Duration_Injection_5_Pre "EcuIntgdSwGend/ControlSoftware/InjCtl/Pilot Injector Characteristic Maps/Duration Injection 5 Pre" /begin REF_MEASUREMENT IC_DurPltInjCyl5 /end REF_MEASUREMENT /end GROUP
/begin GROUP S446_Duration_Injection_6_Pre "EcuIntgdSwGend/ControlSoftware/InjCtl/Pilot Injector Characteristic Maps/Duration Injection 6 Pre" /begin REF_MEASUREMENT IC_DurPltInjCyl6 /end REF_MEASUREMENT /end GROUP
/begin GROUP S448_Main_SOI_Reference_Calculation "EcuIntgdSwGend/ControlSoftware/InjCtl/Start of Injection Angle for Pilot and Main Injection/Main SOI Reference Calculation" /begin SUB_GROUP S570_N_Map_Interpolation_for_Main_Start_of_Injection /end SUB_GROUP
 /begin REF_CHARACTERISTIC IC_PAmbAirCorrForMainSOI_M IC_SoiMaiInjNotCorrdOvs_P IC_SoiMaiInjOvs_P IC_SoiMaiInjOvv_P IC_SoiMaiLimdHi_P IC_SoiMaiLimdLo_P IC_SoiMaiLimd_M IC_TAirBoostCorrForMainSOI_M IC_TAmbAirCorrForMainSOI_M IC_TCooltCorrForMainSOI_M IC_TOilCorrForMainSOI_M /end REF_CHARACTERISTIC
 /begin REF_MEASUREMENT IC_SoiMaiInj IC_SoiMainInjCorrPAmbAir IC_SoiMainInjCorrTAirBoost IC_SoiMainInjCorrTAmbAir IC_SoiMainInjCorrTCoolt IC_SoiMainInjCorrTOil /end REF_MEASUREMENT
/end GROUP
/begin GROUP S448_Pilot_SOI_Reference_Calculation "EcuIntgdSwGend/ControlSoftware/InjCtl/Start of Injection Angle for Pilot and Main Injection/Pilot SOI Reference Calculation" /begin SUB_GROUP S571_N_Map_Interpolation_for_Pre_Start_of_Injection_ /end SUB_GROUP
 /begin REF_CHARACTERISTIC IC_PAmbAirCorrForPilotSOI_M IC_SoiPltInjNotCorrdOvs_P IC_SoiPltInjOvs_P IC_SoiPltInjOvv_P IC_SoiPltLimdHi_P IC_SoiPltLimdLo_P IC_SoiPltLimd_M IC_TAirBoostCorrForPilotSOI_M IC_TAmbAirCorrForPilotSOI_M IC_TCooltCorrForPilotSOI_M IC_TOilCorrForPilotSOI_M /end REF_CHARACTERISTIC
 /begin REF_MEASUREMENT IC_SoiPltInj IC_SoiPltInjCorrPAmbAir IC_SoiPltInjCorrTAirBoost IC_SoiPltInjCorrTAmbAir IC_SoiPltInjCorrTCoolt IC_SoiPltInjCorrTOil /end REF_MEASUREMENT
/end GROUP
/begin GROUP S578_SetRstLtch "EcuIntgdSwGend/ControlSoftware/PrhtgCtl/Grid Heater Activation/SetRstLtch" /begin REF_CHARACTERISTIC EG_bFlgFalse_C EG_bFlgTrue_C /end REF_CHARACTERISTIC /begin REF_MEASUREMENT PHC_bGridHeatrFault /end REF_MEASUREMENT /end GROUP
/begin GROUP S579_CompRstTmr "EcuIntgdSwGend/ControlSoftware/PrhtgCtl/Grid Heater Activation After Starter/CompRstTmr" /begin REF_CHARACTERISTIC EG_NmrInt0_C /end REF_CHARACTERISTIC /begin REF_MEASUREMENT PHC_TiElpdPostAcvnGridDeb /end REF_MEASUREMENT /end GROUP
/begin GROUP S579_Neg_Edge "EcuIntgdSwGend/ControlSoftware/PrhtgCtl/Grid Heater Activation After Starter/Neg_Edge" /begin REF_CHARACTERISTIC EG_NmrSng0_C /end REF_CHARACTERISTIC /end GROUP
/begin GROUP S579_Pos_Edge "EcuIntgdSwGend/ControlSoftware/PrhtgCtl/Grid Heater Activation After Starter/Pos_Edge" /begin REF_CHARACTERISTIC EG_NmrSng0_C /end REF_CHARACTERISTIC /end GROUP
/begin GROUP S579_SetRstLtch "EcuIntgdSwGend/ControlSoftware/PrhtgCtl/Grid Heater Activation After Starter/SetRstLtch" /begin REF_CHARACTERISTIC EG_bFlgFalse_C EG_bFlgTrue_C /end REF_CHARACTERISTIC /end GROUP
/begin GROUP S580_CompRstTmr "EcuIntgdSwGend/ControlSoftware/PrhtgCtl/Grid Heater Activation Before Starter/CompRstTmr" /begin REF_CHARACTERISTIC EG_NmrInt0_C /end REF_CHARACTERISTIC /begin REF_MEASUREMENT PHC_TiElpdPreAcvnGridDeb /end REF_MEASUREMENT /end GROUP
/begin GROUP S580_Neg_Edge1 "EcuIntgdSwGend/ControlSoftware/PrhtgCtl/Grid Heater Activation Before Starter/Neg_Edge1" /begin REF_CHARACTERISTIC EG_NmrSng0_C /end REF_CHARACTERISTIC /end GROUP
/begin GROUP S580_Neg_Edge2 "EcuIntgdSwGend/ControlSoftware/PrhtgCtl/Grid Heater Activation Before Starter/Neg_Edge2" /begin REF_CHARACTERISTIC EG_NmrSng0_C /end REF_CHARACTERISTIC /end GROUP
/begin GROUP S580_Pos_Edge "EcuIntgdSwGend/ControlSoftware/PrhtgCtl/Grid Heater Activation Before Starter/Pos_Edge" /begin REF_CHARACTERISTIC EG_NmrSng0_C /end REF_CHARACTERISTIC /end GROUP
/begin GROUP S580_SetRstLtch "EcuIntgdSwGend/ControlSoftware/PrhtgCtl/Grid Heater Activation Before Starter/SetRstLtch" /begin REF_CHARACTERISTIC EG_bFlgFalse_C EG_bFlgTrue_C /end REF_CHARACTERISTIC /end GROUP
/begin GROUP S581_Debouncer "EcuIntgdSwGend/ControlSoftware/PrhtgCtl/Grid Heater Fault/Debouncer" /begin REF_MEASUREMENT PHC_TiElpdOnStsErrGridHeatrDeb /end REF_MEASUREMENT /end GROUP
/begin GROUP S581_Debouncer1 "EcuIntgdSwGend/ControlSoftware/PrhtgCtl/Grid Heater Fault/Debouncer1" /begin REF_MEASUREMENT PHC_TiElpdOffStsErrGridHeatrDeb /end REF_MEASUREMENT /end GROUP
/begin GROUP S581_SetRstLtch1 "EcuIntgdSwGend/ControlSoftware/PrhtgCtl/Grid Heater Fault/SetRstLtch1" /begin REF_CHARACTERISTIC EG_bFlgFalse_C EG_bFlgTrue_C /end REF_CHARACTERISTIC /begin REF_MEASUREMENT PHC_bErrAcvGridHeatrOnSts /end REF_MEASUREMENT /end GROUP
/begin GROUP S581_SetRstLtch2 "EcuIntgdSwGend/ControlSoftware/PrhtgCtl/Grid Heater Fault/SetRstLtch2" /begin REF_CHARACTERISTIC EG_bFlgFalse_C EG_bFlgTrue_C /end REF_CHARACTERISTIC /begin REF_MEASUREMENT PHC_bErrAcvGridHeatrOffSts /end REF_MEASUREMENT /end GROUP
/begin GROUP S599_PID_Controller "EcuIntgdSwGend/ControlSoftware/PtoCtrl/PTO PID/PID_Controller" /begin SUB_GROUP S605_clamping_unit /end SUB_GROUP /begin REF_CHARACTERISTIC EG_NmrSng0_C /end REF_CHARACTERISTIC
 /begin REF_MEASUREMENT PtoCtrl_CoeffKdFbOut PtoCtrl_CoeffKdOut PtoCtrl_CoeffKiClampOut PtoCtrl_CoeffKiClampPreSatOut PtoCtrl_CoeffKpOut PtoCtrl_PIDOut /end REF_MEASUREMENT
/end GROUP
/begin GROUP S601_Pos_Edge3 "EcuIntgdSwGend/ControlSoftware/PtoCtrl/Remote PTO/Pos_Edge3" /begin REF_CHARACTERISTIC EG_NmrSng0_C /end REF_CHARACTERISTIC /end GROUP
/begin GROUP S613_avoidzerodivision_single "EcuIntgdSwGend/ControlSoftware/RailPGovr/Rail Pressure Control FeedForward Map /avoidzerodivision_single" /begin REF_CHARACTERISTIC EG_NmrSng0_C EG_NmrSng1_C /end REF_CHARACTERISTIC /end GROUP
/begin GROUP S613_avoidzerodivision_single1 "EcuIntgdSwGend/ControlSoftware/RailPGovr/Rail Pressure Control FeedForward Map /avoidzerodivision_single1" /begin REF_CHARACTERISTIC EG_NmrSng0_C EG_NmrSng1_C /end REF_CHARACTERISTIC /end GROUP
/begin GROUP S614_VCV_Opening_Percentage_PID_Controller "EcuIntgdSwGend/ControlSoftware/RailPGovr/Rail Pressure PID Controller/VCV Opening Percentage PID Controller" /begin SUB_GROUP S619_Integrator_Reset S619_clamping_unit /end SUB_GROUP /begin REF_CHARACTERISTIC EG_NmrSng0_C /end REF_CHARACTERISTIC
 /begin REF_MEASUREMENT RPG_CoeffKdFbOut RPG_CoeffKdOut RPG_CoeffKiClampOut RPG_CoeffKiClampPreSatOut RPG_CoeffKiClampSwtchOut RPG_CoeffKiOut RPG_CoeffKpOut RPG_PercgVolCtrlVlv /end REF_MEASUREMENT
/end GROUP
/begin GROUP S615_Debouncer "EcuIntgdSwGend/ControlSoftware/RailPGovr/Rail Pressure Reference Calculation/Debouncer" /begin REF_MEASUREMENT RPG_TiElpdCompNEngThdAcvnPRail RPG_bCompNEngThdAcvnPRail /end REF_MEASUREMENT /end GROUP
/begin GROUP S615_N_Map_Interpolation_for_Rail_Pressure_Reference "EcuIntgdSwGend/ControlSoftware/RailPGovr/Rail Pressure Reference Calculation/N-Map Interpolation for Rail Pressure Reference"
 /begin SUB_GROUP S625_avoidzerodivision_single S625_avoidzerodivision_single1 /end SUB_GROUP
 /begin REF_CHARACTERISTIC RPG_PRailSetPoint1_M RPG_PRailSetPoint2_M RPG_PRailSetPoint3_M RPG_PRailSetPointOvs_P RPG_PRailSetPointOvv_P RPG_TCooltMap1Thd_P RPG_TCooltMap2Thd_P RPG_TCooltMap3Thd_P /end REF_CHARACTERISTIC
 /begin REF_MEASUREMENT RPG_PRailSetPoint RPG_PRailSetPoint1to2Intp RPG_PRailSetPoint2to3Intp RPG_PRailSetPointFromMap1 RPG_PRailSetPointFromMap2 RPG_PRailSetPointFromMap3 /end REF_MEASUREMENT
/end GROUP
/begin GROUP S630_Engine_Brake_Level_1_Activation_Condition "EcuIntgdSwGend/ControlSoftware/SpdLimr/Engine Brake Activation Via Speed Limiter/Engine Brake Level 1 Activation Condition" /begin SUB_GROUP S633_Debouncer S633_SetRstLtch1 /end SUB_GROUP
 /begin REF_CHARACTERISTIC EG_NmrSng0_C EG_TsSw_C SpdLimr_EngBrkLvl1ActvnThd_P SpdLimr_EngBrkLvl1DeactvnThd_P SpdLimr_TiEngBrkLvl1ActvnDeb_P /end REF_CHARACTERISTIC
/end GROUP
/begin GROUP S630_Engine_Brake_Level_2_Activation_Condition "EcuIntgdSwGend/ControlSoftware/SpdLimr/Engine Brake Activation Via Speed Limiter/Engine Brake Level 2 Activation Condition" /begin SUB_GROUP S634_Debouncer1 S634_SetRstLtch2 /end SUB_GROUP
 /begin REF_CHARACTERISTIC EG_NmrSng0_C EG_TsSw_C SpdLimr_EngBrkLvl2ActvnThd_P SpdLimr_EngBrkLvl2DeactvnThd_P SpdLimr_TiEngBrkLvl2ActvnDeb_P /end REF_CHARACTERISTIC
/end GROUP
/begin GROUP S632_SpeedLimiterPIDController "EcuIntgdSwGend/ControlSoftware/SpdLimr/Speed Limiter PID/SpeedLimiterPIDController" /begin SUB_GROUP S641_PID_Controller /end SUB_GROUP
 /begin REF_CHARACTERISTIC EG_NmrSng1_C EG_VldInpSt_C SpdLimr_CoeffDForVehVCtrl_M SpdLimr_CoeffFiltForVehVCtrl_M SpdLimr_CoeffIForVehVCtrl_M SpdLimr_CoeffPForVehVCtrl_M SpdLimr_IntglRstErrVehThd_P SpdLimr_PIDCoeffDOvs_P SpdLimr_PIDCoeffDOvv_P SpdLimr_PIDCoeffFiltOvs_P SpdLimr_PIDCoeffFiltOvv_P SpdLimr_PIDCoeffIOvs_P SpdLimr_PIDCoeffIOvv_P SpdLimr_PIDCoeffPOvs_P SpdLimr_PIDCoeffPOvv_P SpdLimr_PIDMax_M SpdLimr_PIDMin_P SpdLimr_TrfCaseStsFac_M SpdLimr_TrsmTqCnvrRatFac_M /end REF_CHARACTERISTIC
 /begin REF_MEASUREMENT SpdLimr_CoeffDForVehVCtrl SpdLimr_CoeffFiltForVehVCtrl SpdLimr_CoeffIForVehVCtrl SpdLimr_CoeffPForVehVCtrl SpdLimr_ErrCanTrsmTqCnvrRat SpdLimr_ErrCanTrtCaseSts SpdLimr_PIDMax SpdLimr_TrfCaseStsFac SpdLimr_TrsmTqCnvrRatFac /end REF_MEASUREMENT
/end GROUP
/begin GROUP S645_Debouncer "EcuIntgdSwGend/ControlSoftware/StrtrCtl/Enabling & Disabling Starter/Debouncer" /begin REF_MEASUREMENT SC_TiElpdNEngStrtrInhThd SC_bNEngStrtrInhThd /end REF_MEASUREMENT /end GROUP
/begin GROUP S645_Debouncer1 "EcuIntgdSwGend/ControlSoftware/StrtrCtl/Enabling & Disabling Starter/Debouncer1" /begin REF_MEASUREMENT SC_TiElpdNEngRunDeacThd SC_bNEngRunDeacThd /end REF_MEASUREMENT /end GROUP
/begin GROUP S645_Debouncer2 "EcuIntgdSwGend/ControlSoftware/StrtrCtl/Enabling & Disabling Starter/Debouncer2" /begin REF_MEASUREMENT SC_EngRunngActvnforEngAlrdyRunng SC_TiElpdEngAlrdyRunngThd /end REF_MEASUREMENT /end GROUP
/begin GROUP S645_SetRstLtch "EcuIntgdSwGend/ControlSoftware/StrtrCtl/Enabling & Disabling Starter/SetRstLtch" /begin REF_CHARACTERISTIC EG_bFlgFalse_C EG_bFlgTrue_C /end REF_CHARACTERISTIC /begin REF_MEASUREMENT SC_bAcvEngRunng /end REF_MEASUREMENT /end GROUP
/begin GROUP S646_CompRstTmr "EcuIntgdSwGend/ControlSoftware/StrtrCtl/Maximum Allowable Cranking Time Calculation/CompRstTmr" /begin REF_CHARACTERISTIC EG_NmrInt0_C /end REF_CHARACTERISTIC /begin REF_MEASUREMENT SC_TiElpdEnaAcvnStrtr /end REF_MEASUREMENT /end GROUP
/begin GROUP S646_Neg_Edge "EcuIntgdSwGend/ControlSoftware/StrtrCtl/Maximum Allowable Cranking Time Calculation/Neg_Edge" /begin REF_CHARACTERISTIC EG_NmrSng0_C /end REF_CHARACTERISTIC /end GROUP
/begin GROUP S647_Engine_Not_Turn "EcuIntgdSwGend/ControlSoftware/StrtrCtl/Start Error Detect Algorithms /Engine Not Turn" /begin SUB_GROUP S656_CompRstTmr S656_Pos_Edge2 S656_SetRstLtch1 /end SUB_GROUP
 /begin REF_CHARACTERISTIC EG_NmrSng0_C EG_TsSw_C SC_NEngThdForStrtTurn_P SC_TiEngNotTurnTiEna_P SC_bEngNotTurnOvs_P SC_bEngNotTurnOvv_P /end REF_CHARACTERISTIC
 /begin REF_MEASUREMENT SC_bEngNotTurn SC_bEngNotTurnTiEna /end REF_MEASUREMENT
/end GROUP
/begin GROUP S647_Engine_Over_Heating_Protection "EcuIntgdSwGend/ControlSoftware/StrtrCtl/Start Error Detect Algorithms /Engine Over Heating Protection" /begin SUB_GROUP S657_CompRstTmr1 S657_Neg_Edge S657_SetRstLtch /end SUB_GROUP
 /begin REF_CHARACTERISTIC EG_NmrSng0_C EG_TsSw_C SC_NEngThdForOvrHeatProtn_P SC_TiForEngProtn_P SC_bAcvStrtrOvrHeatProtnOvs_P SC_bAcvStrtrOvrHeatProtnOvv_P /end REF_CHARACTERISTIC
 /begin REF_MEASUREMENT SC_bAcvStrtOvrHeatProtn /end REF_MEASUREMENT
/end GROUP
/begin GROUP S648_Electrical_Failure_Dependent_Sensor_Inhibitor "EcuIntgdSwGend/ControlSoftware/StrtrCtl/StartInhibitor/Electrical Failure Dependent Sensor Inhibitor" /begin SUB_GROUP S664_Debouncer S664_Debouncer1 /end SUB_GROUP
 /begin REF_CHARACTERISTIC EG_NmrSng0_C EG_TsSw_C SC_TiAcvnErrPCVDeb_P SC_TiAcvnErrVCVDeb_P /end REF_CHARACTERISTIC
 /begin REF_MEASUREMENT SC_bInhErrElectFailPreTest /end REF_MEASUREMENT
/end GROUP
/begin GROUP S648_Sensor_Inhibitor "EcuIntgdSwGend/ControlSoftware/StrtrCtl/StartInhibitor/Sensor Inhibitor" /begin SUB_GROUP S665_Debouncer1 S665_Debouncer2 /end SUB_GROUP
 /begin REF_CHARACTERISTIC EG_NmrSng0_C EG_TsSw_C SC_LvlFuInhEnaSwt_P SC_LvlFuPreTestMin_P SC_LvlOilInhEnaSwt_P SC_LvlOilPreTestMin_P SC_TiAcvnLvlFuDeb_P SC_TiAcvnLvlOilDeb_P /end REF_CHARACTERISTIC
 /begin REF_MEASUREMENT SC_bInhEngStrtPreTest SC_bTiAcvnLvlFuDeb SC_bTiAcvnLvlOilDeb /end REF_MEASUREMENT
/end GROUP
/begin GROUP S649_Debouncer "EcuIntgdSwGend/ControlSoftware/StrtrCtl/Starter Locking/Debouncer" /begin REF_MEASUREMENT SC_TiElpdComplDebStrtLock SC_bComplDebNEngStrtLock /end REF_MEASUREMENT /end GROUP
/begin GROUP S649_Neg_Edge "EcuIntgdSwGend/ControlSoftware/StrtrCtl/Starter Locking/Neg_Edge" /begin REF_CHARACTERISTIC EG_NmrSng0_C /end REF_CHARACTERISTIC /end GROUP
/begin GROUP S649_SetRstLtch "EcuIntgdSwGend/ControlSoftware/StrtrCtl/Starter Locking/SetRstLtch" /begin REF_CHARACTERISTIC EG_bFlgFalse_C EG_bFlgTrue_C /end REF_CHARACTERISTIC /end GROUP
/begin GROUP S675_avoidzerodivision_single "EcuIntgdSwGend/ControlSoftware/TqCnvn/N-Map Interpolation for Main Quantity/avoidzerodivision_single" /begin REF_CHARACTERISTIC EG_NmrSng0_C EG_NmrSng1_C /end REF_CHARACTERISTIC /end GROUP
/begin GROUP S675_avoidzerodivision_single1 "EcuIntgdSwGend/ControlSoftware/TqCnvn/N-Map Interpolation for Main Quantity/avoidzerodivision_single1" /begin REF_CHARACTERISTIC EG_NmrSng0_C EG_NmrSng1_C /end REF_CHARACTERISTIC /end GROUP
/begin GROUP S676_avoidzerodivision_single "EcuIntgdSwGend/ControlSoftware/TqCnvn/N-Map Interpolation for Pre Quantity/avoidzerodivision_single" /begin REF_CHARACTERISTIC EG_NmrSng0_C EG_NmrSng1_C /end REF_CHARACTERISTIC /end GROUP
/begin GROUP S676_avoidzerodivision_single1 "EcuIntgdSwGend/ControlSoftware/TqCnvn/N-Map Interpolation for Pre Quantity/avoidzerodivision_single1" /begin REF_CHARACTERISTIC EG_NmrSng0_C EG_NmrSng1_C /end REF_CHARACTERISTIC /end GROUP
/begin GROUP S678_avoidzerodivision_single "EcuIntgdSwGend/ControlSoftware/TqCnvn/Smoke Limitation/avoidzerodivision_single" /begin REF_CHARACTERISTIC EG_NmrSng0_C EG_NmrSng1_C /end REF_CHARACTERISTIC /end GROUP
/begin GROUP S678_avoidzerodivision_single1 "EcuIntgdSwGend/ControlSoftware/TqCnvn/Smoke Limitation/avoidzerodivision_single1" /begin REF_CHARACTERISTIC EG_NmrSng0_C EG_NmrSng1_C /end REF_CHARACTERISTIC /end GROUP
/begin GROUP S678_avoidzerodivision_single2 "EcuIntgdSwGend/ControlSoftware/TqCnvn/Smoke Limitation/avoidzerodivision_single2" /begin REF_CHARACTERISTIC EG_NmrSng0_C EG_NmrSng1_C /end REF_CHARACTERISTIC /end GROUP
/begin GROUP S678_saturation "EcuIntgdSwGend/ControlSoftware/TqCnvn/Smoke Limitation/saturation" /begin REF_MEASUREMENT TrC_RatAirFuCalc /end REF_MEASUREMENT /end GROUP
/begin GROUP S679_Main_Quantity_Correction "EcuIntgdSwGend/ControlSoftware/TqCnvn/Torque Conversion For SPN  2432 - Engine Demand Torque/Main Quantity Correction" /begin REF_MEASUREMENT TrC_MMaiFuQntyCorrdForEngDmdTq /end REF_MEASUREMENT /end GROUP
/begin GROUP S679_N_Map_Interpolation_for_Main_Quantity "EcuIntgdSwGend/ControlSoftware/TqCnvn/Torque Conversion For SPN  2432 - Engine Demand Torque/N-Map Interpolation for Main Quantity"
 /begin SUB_GROUP S689_avoidzerodivision_single S689_avoidzerodivision_single1 /end SUB_GROUP
 /begin REF_MEASUREMENT TrC_MMaiFuQntyPreForEngDmdTq /end REF_MEASUREMENT
/end GROUP
/begin GROUP S679_N_Map_Interpolation_for_Pre_Quantity "EcuIntgdSwGend/ControlSoftware/TqCnvn/Torque Conversion For SPN  2432 - Engine Demand Torque/N-Map Interpolation for Pre Quantity"
 /begin SUB_GROUP S690_avoidzerodivision_single S690_avoidzerodivision_single1 /end SUB_GROUP
 /begin REF_MEASUREMENT TrC_MPltFuQntyForEngDmdTq /end REF_MEASUREMENT
/end GROUP
/begin GROUP S679_Pilot_Quantity_Correction "EcuIntgdSwGend/ControlSoftware/TqCnvn/Torque Conversion For SPN  2432 - Engine Demand Torque/Pilot Quantity Correction" /begin REF_MEASUREMENT TrC_MPltFuQntyCorrForEngDmdTq /end REF_MEASUREMENT /end GROUP
/begin GROUP S679_Smoke_Limitation "EcuIntgdSwGend/ControlSoftware/TqCnvn/Torque Conversion For SPN  2432 - Engine Demand Torque/Smoke Limitation"
 /begin SUB_GROUP S692_avoidzerodivision_single S692_avoidzerodivision_single1 S692_avoidzerodivision_single2 /end SUB_GROUP
 /begin REF_CHARACTERISTIC EG_CnvnMm3ToMg_C EG_NmrSng2_C TrC_CnvnKgDivideSecToMgDivideMin_C TrC_InjrCfg4Cyl_C TrC_InjrCfg6Cyl_C /end REF_CHARACTERISTIC
 /begin REF_MEASUREMENT TrC_MMaiFuQntyLimdForEngDmdTq /end REF_MEASUREMENT
/end GROUP
/begin GROUP S704_Torque_Limitation_For_Fuel_Temperature "EcuIntgdSwGend/ControlSoftware/TqLim/Engine Protection/Torque Limitation For Fuel Temperature" /begin SUB_GROUP S713_Debouncer /end SUB_GROUP
 /begin REF_CHARACTERISTIC EG_NmrSng0_C EG_NmrSng100_C EG_TsSw_C TL_NEngAcvTqLimnForTFu_P TL_PercgTqLimnForTFu_M TL_TiTqLimnForTFuDeb_P /end REF_CHARACTERISTIC
 /begin REF_MEASUREMENT TL_PercgTqLimnForTFu TL_bEnaTmrNEngAcvForTFu /end REF_MEASUREMENT
/end GROUP
/begin GROUP S704_Torque_Limitation_for_Air_Temperature "EcuIntgdSwGend/ControlSoftware/TqLim/Engine Protection/Torque Limitation for Air Temperature" /begin SUB_GROUP S714_Debouncer /end SUB_GROUP
 /begin REF_CHARACTERISTIC EG_NmrSng0_C EG_NmrSng100_C EG_TsSw_C TL_NEngAcvTqLimnForTAir_P TL_PercgTqLimnForTAir_M TL_SnsrSwtForTAirLimn_P TL_TiTqLimnForTAirDeb_P /end REF_CHARACTERISTIC
 /begin REF_MEASUREMENT TL_PercgTqLimnForTAir TL_TAir TL_bEnaTmrNEngAcvForTAir TL_bErrTAirSnsr /end REF_MEASUREMENT
/end GROUP
/begin GROUP S704_Torque_Limitation_for_Ambient_Air_Pressure "EcuIntgdSwGend/ControlSoftware/TqLim/Engine Protection/Torque Limitation for Ambient Air Pressure" /begin SUB_GROUP S715_Debouncer /end SUB_GROUP
 /begin REF_CHARACTERISTIC EG_NmrSng0_C EG_NmrSng100_C EG_TsSw_C TL_NEngAcvTqLimnForPAirAmb_P TL_PercgTqLimnForPAmbAir_M TL_TiTqLimnForPAirAmbDeb_P /end REF_CHARACTERISTIC
 /begin REF_MEASUREMENT TL_PercgTqLimnForPAmbAir TL_bEnaTmrNEngAcvForPAirAmb /end REF_MEASUREMENT
/end GROUP
/begin GROUP S704_Torque_Limitation_for_Coolant_Temperature "EcuIntgdSwGend/ControlSoftware/TqLim/Engine Protection/Torque Limitation for Coolant Temperature" /begin SUB_GROUP S716_Debouncer /end SUB_GROUP
 /begin REF_CHARACTERISTIC EG_NmrSng0_C EG_NmrSng100_C EG_TsSw_C TL_NEngAcvTqLimnForTCoolt_P TL_PercgTqLimnForErrTCooltSnsr_P TL_PercgTqLimnForTCoolt_M TL_TiTqLimnForTCooltDeb_P /end REF_CHARACTERISTIC
 /begin REF_MEASUREMENT TL_PercgTqLimnForTCoolt TL_bEnaTmrNEngAcvForTCoolt /end REF_MEASUREMENT
/end GROUP
/begin GROUP S704_Torque_Limitation_for_Intake_Air_Pressure "EcuIntgdSwGend/ControlSoftware/TqLim/Engine Protection/Torque Limitation for Intake Air Pressure" /begin SUB_GROUP S717_Debouncer /end SUB_GROUP
 /begin REF_CHARACTERISTIC EG_NmrSng0_C EG_NmrSng100_C EG_TsSw_C TL_NEngAcvTqLimnForPAirBoost_P TL_PercgTqLimnForPBoostAir_M TL_TiTqLimnForPAirBoostDeb_P /end REF_CHARACTERISTIC
 /begin REF_MEASUREMENT TL_PercgTqLimnForPAirBoost TL_bEnaTmrNEngAcvForPAirBoost /end REF_MEASUREMENT
/end GROUP
/begin GROUP S704_Torque_Limitation_for_Oil_Temperature "EcuIntgdSwGend/ControlSoftware/TqLim/Engine Protection/Torque Limitation for Oil Temperature" /begin SUB_GROUP S718_Debouncer1 /end SUB_GROUP
 /begin REF_CHARACTERISTIC EG_NmrSng0_C EG_NmrSng100_C EG_TsSw_C TL_NEngAcvTqLimnForTOil_P TL_PercgTqLimnForErrTOilSnsr_P TL_PercgTqLimnForTOil_M TL_TiTqLimnForTOilDeb_P /end REF_CHARACTERISTIC
 /begin REF_MEASUREMENT TL_PercgTqLimnForTOil TL_bEnaTmrNEngAcvForTOil /end REF_MEASUREMENT
/end GROUP
/begin GROUP S704_Torque_Limitation_for_Surge_Protection "EcuIntgdSwGend/ControlSoftware/TqLim/Engine Protection/Torque Limitation for Surge Protection" /begin REF_CHARACTERISTIC EG_NmrSng100_C TL_SurgeLineTqLimd_M /end REF_CHARACTERISTIC /begin REF_MEASUREMENT TL_PercgTqLimnForSurge TL_TqLimnForSurge /end REF_MEASUREMENT /end GROUP
/begin GROUP S704_Torque_Limitation_for_Turbo_Charge_Speed "EcuIntgdSwGend/ControlSoftware/TqLim/Engine Protection/Torque Limitation for Turbo Charge Speed" /begin SUB_GROUP S720_Debouncer /end SUB_GROUP
 /begin REF_CHARACTERISTIC EG_NmrSng0_C EG_NmrSng100_C EG_TsSw_C TL_NEngAcvTqLimnForNExhTrbChrg_P TL_PercgTqLimnForNExhTrbChrg_M TL_TiTqLimnForNExhTrbChrgDeb_P /end REF_CHARACTERISTIC
 /begin REF_MEASUREMENT TL_PercgTqLimnForNExhTrbChrg TL_bEnaTmrNEngAcvForNExhTrbChrg /end REF_MEASUREMENT
/end GROUP
/begin GROUP S731_Global_Enable "EcuIntgdSwGend/ControlSoftware/WarnMong/Warning-Reduction-Shutdown Functions/Global Enable" /begin SUB_GROUP S732_Engine_Speed_Level_Check /end SUB_GROUP
 /begin REF_CHARACTERISTIC EG_Mask32Bit0_C EG_Mask32Bit128_C EG_Mask32Bit16_C EG_Mask32Bit1_C EG_Mask32Bit2_C EG_Mask32Bit32_C EG_Mask32Bit4_C EG_Mask32Bit64_C EG_Mask32Bit8_C WM_MaskGEOvs_P WM_MaskGEOvv_P /end REF_CHARACTERISTIC
 /begin REF_MEASUREMENT WM_MaskGE /end REF_MEASUREMENT
/end GROUP
/begin GROUP S731_Internal "EcuIntgdSwGend/ControlSoftware/WarnMong/Warning-Reduction-Shutdown Functions/Internal"
 /begin SUB_GROUP S733_Battery_Over_Voltage S733_Battery_Under_Voltage S733_Cylinder_Misfire S733_Oil_Under_Level /end SUB_GROUP
/end GROUP
/begin GROUP S731_Limp "EcuIntgdSwGend/ControlSoftware/WarnMong/Warning-Reduction-Shutdown Functions/Limp"
 /begin REF_CHARACTERISTIC WM_bErrLvlOilSnsrLimp_P WM_bErrPAirBoostSnsrLimp_P WM_bErrPAmbAirSnsrLimp_P WM_bErrPFuSnsrLimp_P WM_bErrPOilSnsrLimp_P WM_bErrTAirBoostSnsrLimp_P WM_bErrTAmbAirSnsrLimp_P WM_bErrTCooltSnsrLimp_P WM_bErrTEcuSnsrLimp_P WM_bErrTFuSnsrLimp_P WM_bErrTOilSnsrLimp_P WM_bErrUClmp30SnsrLimp_P WM_bErrWgLimp_P /end REF_CHARACTERISTIC
 /begin REF_MEASUREMENT WM_bAcvLimpRctn WM_bErrLvlOilSnsrLimp WM_bErrPAirBoostSnsrLimp WM_bErrPAmbAirSnsrLimp WM_bErrPFuSnsrLimp WM_bErrPOilSnsrLimp WM_bErrTAirBoostSnsrLimp WM_bErrTAmbAirSnsrLimp WM_bErrTCooltSnsrLimp WM_bErrTEcuLimp WM_bErrTFuSnsrLimp WM_bErrTOilSnsrLimp WM_bErrUClmp30SnsrLimp WM_bErrWgLimp /end REF_MEASUREMENT
/end GROUP
/begin GROUP S731_Pressure "EcuIntgdSwGend/ControlSoftware/WarnMong/Warning-Reduction-Shutdown Functions/Pressure"
 /begin SUB_GROUP S735_Air_Boost_Over_Pressure S735_Air_Boost_Under_Pressure S735_Ambient_Air_Over_Pressure S735_Ambient_Air_Under_Pressure S735_Fuel_Over_Pressure S735_Fuel_Under_Pressure S735_Oil_Over_Pressure S735_Oil_Under_Pressure S735_Rail_Over_Pressure S735_Rail_Under_Pressure /end SUB_GROUP
/end GROUP
/begin GROUP S731_Reaction "EcuIntgdSwGend/ControlSoftware/WarnMong/Warning-Reduction-Shutdown Functions/Reaction"
 /begin SUB_GROUP S736_Bit_Extract S736_Error_List S736_SetResetFaultReaction S736_SetResetFaultReaction1 S736_SetResetFaultReaction24 S736_SetResetFaultReaction25 S736_SetResetFaultReaction26 S736_SetResetFaultReaction27 S736_Warning_Monitoring_Diagnostic_Info /end SUB_GROUP
 /begin REF_CHARACTERISTIC WM_MaskRTNForAcvLimp_P WM_MaskRTNForEmgcyShtdwnForOvspd_P WM_MaskRTNForErrCamCrankTotLoss_P WM_MaskRTNForErrInjrShtdwn_P WM_MaskRTNForFlgOfWtrInFu_P WM_MaskRTNForPRailNotCtldMsg_P WM_MaskRctnForAcvLimp_P WM_MaskRctnForEmgcyShtdwnForOvspd_P WM_MaskRctnForErrCamCrankTotLoss_P WM_MaskRctnForErrInjrShtdwn_P WM_MaskRctnForFlgOfWtrInFu_P WM_MaskRctnForPRailNotCtldMsg_P WM_MaskRctnOvs_P WM_MaskRctnOvv_P /end REF_CHARACTERISTIC
 /begin REF_MEASUREMENT WM_MaskRctn /end REF_MEASUREMENT
/end GROUP
/begin GROUP S731_Return_To_Normal "EcuIntgdSwGend/ControlSoftware/WarnMong/Warning-Reduction-Shutdown Functions/Return To Normal" /begin SUB_GROUP S737_Debouncer /end SUB_GROUP
 /begin REF_CHARACTERISTIC EG_Mask32Bit0_C EG_Mask32Bit128_C EG_Mask32Bit16_C EG_Mask32Bit1_C EG_Mask32Bit2_C EG_Mask32Bit32_C EG_Mask32Bit4_C EG_Mask32Bit64_C EG_Mask32Bit8_C EG_NmrSng0_C EG_TsSw20_C WM_MaskRTNOvs_P WM_MaskRTNOvv_P WM_NEngDetdThdRTN_P WM_TiMaxNEngDetdThdRTN_P /end REF_CHARACTERISTIC
 /begin REF_MEASUREMENT WM_MaskRTN /end REF_MEASUREMENT
/end GROUP
/begin GROUP S731_Temperature "EcuIntgdSwGend/ControlSoftware/WarnMong/Warning-Reduction-Shutdown Functions/Temperature"
 /begin SUB_GROUP S738_Air_Boost_Over_Temperature S738_Air_Boost_Under_Temperature S738_Ambient_Air_Over_Temperature S738_Ambient_Air_Under_Temperature S738_Coolant_Over_Temperature S738_Coolant_Under_Temperature S738_ECU_Temperature S738_Fuel_Over_Temperature S738_Oil_Over_Temperature S738_Oil_Under_Temperature /end SUB_GROUP
/end GROUP
/begin GROUP S895_AirMassFlowCalc "EcuIntgdSwGend/ControlSoftware/WgtCtl/TurbochargerSpeedEstimation/AirMassFlowCalc" /begin SUB_GROUP S897_avoidzerodivision_max /end SUB_GROUP
 /begin REF_CHARACTERISTIC EG_NmrSng1000_C EG_NmrSng2_C EG_NmrSngK_C WgC_AirGas_C WgC_NoStkEng_C WgC_VolEng_P /end REF_CHARACTERISTIC
 /begin REF_MEASUREMENT WgC_AirMassFlowCalcMultiOut WgC_MAirFlow /end REF_MEASUREMENT
/end GROUP
/begin GROUP S895_CalculatedCompressorInletPressure "EcuIntgdSwGend/ControlSoftware/WgtCtl/TurbochargerSpeedEstimation/CalculatedCompressorInletPressure" /begin REF_CHARACTERISTIC WgC_PDropIco_M /end REF_CHARACTERISTIC /begin REF_MEASUREMENT WgC_PCmprInltCalcd WgC_PDropIcoMapOut /end REF_MEASUREMENT /end GROUP
/begin GROUP S895_CalculatedCompressorOutletPressure "EcuIntgdSwGend/ControlSoftware/WgtCtl/TurbochargerSpeedEstimation/CalculatedCompressorOutletPressure" /begin REF_CHARACTERISTIC WgC_PCmprOutltCalcd_M /end REF_CHARACTERISTIC /begin REF_MEASUREMENT WgC_PCmprOutltCalcd WgC_PCmprOutltMapOut /end REF_MEASUREMENT /end GROUP
/begin GROUP S895_CompressorEfficiency "EcuIntgdSwGend/ControlSoftware/WgtCtl/TurbochargerSpeedEstimation/CompressorEfficiency" /begin REF_CHARACTERISTIC WgC_EffCmpr_M /end REF_CHARACTERISTIC /begin REF_MEASUREMENT WgC_EffCmpr /end REF_MEASUREMENT /end GROUP
/begin GROUP S895_CompressorPressureRatio "EcuIntgdSwGend/ControlSoftware/WgtCtl/TurbochargerSpeedEstimation/CompressorPressureRatio" /begin SUB_GROUP S901_avoidzerodivision_single /end SUB_GROUP /begin REF_MEASUREMENT WgC_RatPCmpr /end REF_MEASUREMENT /end GROUP
/begin GROUP S895_CorrectedAirMassFlow "EcuIntgdSwGend/ControlSoftware/WgtCtl/TurbochargerSpeedEstimation/CorrectedAirMassFlow" /begin REF_CHARACTERISTIC WgC_MCorrAirFlowPCmprInlt_M WgC_MCorrAirFlowTAmbAir_M /end REF_CHARACTERISTIC
 /begin REF_MEASUREMENT WgC_MCorrAirFlowPCmprInlt WgC_MCorrAirFlowTCmprInlt WgC_MCorrdAirFlow /end REF_MEASUREMENT
/end GROUP
/begin GROUP S895_SurgeCheck "EcuIntgdSwGend/ControlSoftware/WgtCtl/TurbochargerSpeedEstimation/SurgeCheck" /begin REF_CHARACTERISTIC WgC_SurgeLim_M /end REF_CHARACTERISTIC /begin REF_MEASUREMENT WgC_DifSurgeLine WgC_bAcvSurgeLim /end REF_MEASUREMENT /end GROUP
/begin GROUP S895_TurbochargerSpeed "EcuIntgdSwGend/ControlSoftware/WgtCtl/TurbochargerSpeedEstimation/TurbochargerSpeed" /begin REF_CHARACTERISTIC WgC_NTrbChrgOvs_P WgC_NTrbChrgOvv_P WgC_NTrbChrg_M /end REF_CHARACTERISTIC /begin REF_MEASUREMENT WgC_NTrbChrg /end REF_MEASUREMENT /end GROUP
/begin GROUP S895_VolumetricEfficiency "EcuIntgdSwGend/ControlSoftware/WgtCtl/TurbochargerSpeedEstimation/VolumetricEfficiency" /begin REF_CHARACTERISTIC WgC_VolEff_M /end REF_CHARACTERISTIC /begin REF_MEASUREMENT WgC_VolEff /end REF_MEASUREMENT /end GROUP
/begin GROUP S896_BoostPressurePID "EcuIntgdSwGend/ControlSoftware/WgtCtl/Wastegate Control/BoostPressurePID" /begin SUB_GROUP S908_PID_Controller /end SUB_GROUP
 /begin REF_CHARACTERISTIC WgC_CoeffDForWgCCtl_M WgC_CoeffFiltForWgCCtl_M WgC_CoeffIForWgCCtl_M WgC_CoeffPForWgCCtl_M WgC_DutySatPIDMax_P WgC_DutySatPIDMin_P WgC_FacSclPIDCoeff_P WgC_PIDCoeffDOvs_P WgC_PIDCoeffDOvv_P WgC_PIDCoeffFiltOvs_P WgC_PIDCoeffFiltOvv_P WgC_PIDCoeffIOvs_P WgC_PIDCoeffIOvv_P WgC_PIDCoeffPOvs_P WgC_PIDCoeffPOvv_P /end REF_CHARACTERISTIC
 /begin REF_MEASUREMENT WgC_CoeffDForWgCCtlMapOut WgC_CoeffFiltForWgCCtlMapOut WgC_CoeffIForWgCCtlMapOut WgC_CoeffPForWgCCtlMapOut WgC_ErrPAirBoost WgC_PIDCoeffD WgC_PIDCoeffFilt WgC_PIDCoeffI WgC_PIDCoeffP /end REF_MEASUREMENT
/end GROUP
/begin GROUP S896_BoostPressureRefSelector "EcuIntgdSwGend/ControlSoftware/WgtCtl/Wastegate Control/BoostPressureRefSelector"
 /begin REF_CHARACTERISTIC WgC_PAirBoostRefMain_M WgC_PAirBoostRefPAmbAirCorr_M WgC_PAirBoostRefSurgeCorr_M WgC_PAirBoostRefTAmbAirCorr_M WgC_PAirBoostRefTCooltCorr_M WgC_PAirBoostRefTOilCorr_M /end REF_CHARACTERISTIC
 /begin REF_MEASUREMENT WgC_PAirBoostRef WgC_PAirBoostRefMain WgC_PAirBoostRefPAmbAirCorr WgC_PAirBoostRefSurgeCorr WgC_PAirBoostRefTAmbAirCorr WgC_PAirBoostRefTCooltCorr WgC_PAirBoostRefTOilCorr /end REF_MEASUREMENT
/end GROUP
/begin GROUP S24_PID_Controller "EcuIntgdSwGend/ControlSoftware/CrsCtrl/CruiseControl/CruiseControlPIDController/PID_Controller" /begin SUB_GROUP S26_clamping_unit /end SUB_GROUP /begin REF_CHARACTERISTIC EG_NmrSng0_C /end REF_CHARACTERISTIC
 /begin REF_MEASUREMENT CrsCtrl_CoeffKdFbOut CrsCtrl_CoeffKdOut CrsCtrl_CoeffKiClampOut CrsCtrl_CoeffKiClampPreSatOut CrsCtrl_CoeffKpOut CrsCtrl_PIDOutCrsCtrlTq /end REF_MEASUREMENT
/end GROUP
/begin GROUP S29_Engine_Brake_Level_1_Activation_Condition "EcuIntgdSwGend/ControlSoftware/CrsCtrl/Engine Brake Activation via Cruise Control/Engine Brake Level Activation Condition/Engine Brake Level 1 Activation Condition" /begin SUB_GROUP S31_Debouncer2 S31_SetRstLtch /end SUB_GROUP
 /begin REF_CHARACTERISTIC CrsCtrl_EngBrkLvl1ActvnThd_P CrsCtrl_EngBrkLvl1DeactvnThd_P CrsCtrl_TiEngBrkLvl1ActvnDeb_P EG_NmrSng0_C EG_TsSw_C /end REF_CHARACTERISTIC
/end GROUP
/begin GROUP S29_Engine_Brake_Level_2_Activation_Condition "EcuIntgdSwGend/ControlSoftware/CrsCtrl/Engine Brake Activation via Cruise Control/Engine Brake Level Activation Condition/Engine Brake Level 2 Activation Condition" /begin SUB_GROUP S32_Debouncer S32_SetRstLtch3 /end SUB_GROUP
 /begin REF_CHARACTERISTIC CrsCtrl_EngBrkLvl2ActvnThd_P CrsCtrl_EngBrkLvl2DeactvnThd_P CrsCtrl_TiEngBrkLvl2ActvnDeb_P EG_NmrSng0_C EG_TsSw_C /end REF_CHARACTERISTIC
/end GROUP
/begin GROUP S47_saturation "EcuIntgdSwGend/ControlSoftware/DesTqClcn/Desired Torque Calculation CAN Signals/EC1 - Engine Configuration 1/saturation" /begin REF_MEASUREMENT DTqC_DrvrDmdPercTq /end REF_MEASUREMENT /end GROUP
/begin GROUP S52_N_Map_Interpolation_for_Brake_Torque "EcuIntgdSwGend/ControlSoftware/DesTqClcn/Running Mode/Driver Demand Torque Calculation/N-Map Interpolation for Brake Torque"
 /begin SUB_GROUP S56_Anti_Jerk_Algorithm S56_avoidzerodivision_single S56_avoidzerodivision_single1 /end SUB_GROUP
 /begin REF_CHARACTERISTIC DTqC_TCooltMap1Thd_P DTqC_TCooltMap2Thd_P DTqC_TCooltMap3Thd_P DTqC_TqBrkMap1_M DTqC_TqBrkMap2_M DTqC_TqBrkMap3_M DTqC_TqLimdBrk1Ovs_P DTqC_TqLimdBrk1Ovv_P DTqC_TqLimdBrk2Ovs_P DTqC_TqLimdBrk2Ovv_P DTqC_TqLimdBrk3Ovs_P DTqC_TqLimdBrk3Ovv_P /end REF_CHARACTERISTIC
 /begin REF_MEASUREMENT DTqC_TqBrkMap1 DTqC_TqBrkMap2 DTqC_TqBrkMap3 DTqC_TqLimdBrk DTqC_TqLimdBrk1to2Intp DTqC_TqLimdBrk2To3Intp /end REF_MEASUREMENT
/end GROUP
/begin GROUP S53_EndSpeed_Soft_Limit_Governor "EcuIntgdSwGend/ControlSoftware/DesTqClcn/Running Mode/EndSpeed Governor/EndSpeed Soft Limit Governor" /begin SUB_GROUP S64_PID_Controller /end SUB_GROUP
 /begin REF_CHARACTERISTIC DTqC_CoeffDForEndSpdCtl_M DTqC_CoeffFiltForEndSpdCtl_M DTqC_CoeffFiltKdEndSpdCtlOvs_P DTqC_CoeffFiltKdEndSpdCtlOvv_P DTqC_CoeffIForEndSpdCtl_M DTqC_CoeffPForEndSpdCtl_M DTqC_FacSclPIDCoeffEndSpd_P DTqC_KdEndSpdCtlOvs_P DTqC_KdEndSpdCtlOvv_P DTqC_KiEndSpdCtlOvs_P DTqC_KiEndSpdCtlOvv_P DTqC_KpEndSpdCtlOvs_P DTqC_KpEndSpdCtlOvv_P DTqC_TqDesSatPIDMaxEndSpd_P DTqC_TqDesSatPIDMinEndSpd_P /end REF_CHARACTERISTIC
 /begin REF_MEASUREMENT DTqC_CoeffDForEndSpdCtlMapOut DTqC_CoeffDForSpdCtlEndSpd DTqC_CoeffFiltForEndSpdCtlMapOut DTqC_CoeffFiltForSpdCtlEndSpd DTqC_CoeffIForEndSpdCtlMapOut DTqC_CoeffIForSpdCtlEndSpd DTqC_CoeffPForEndSpdCtlMapOut DTqC_CoeffPForSpdCtlEndSpd DTqC_NEngDelta /end REF_MEASUREMENT
/end GROUP
/begin GROUP S53_Engine_Speed_Hysteresis_for_Hard_Limitation "EcuIntgdSwGend/ControlSoftware/DesTqClcn/Running Mode/EndSpeed Governor/Engine Speed Hysteresis for Hard Limitation" /begin SUB_GROUP S65_Hard_Limit_Latching /end SUB_GROUP /begin REF_CHARACTERISTIC DTqC_HardLimEnaSwt_P EG_bFlgFalse_C EG_bFlgTrue_C /end REF_CHARACTERISTIC /begin REF_MEASUREMENT DTqC_AcvHardLim /end REF_MEASUREMENT /end GROUP
/begin GROUP S53_Engine_Speed_Hysteresis_for_Soft_Limitation "EcuIntgdSwGend/ControlSoftware/DesTqClcn/Running Mode/EndSpeed Governor/Engine Speed Hysteresis for Soft Limitation" /begin REF_CHARACTERISTIC DTqC_SoftLimEnaSwt_P EG_bFlgFalse_C EG_bFlgTrue_C /end REF_CHARACTERISTIC /begin REF_MEASUREMENT DTqC_AcvSoftLim /end REF_MEASUREMENT /end GROUP
/begin GROUP S54_PID_Controller "EcuIntgdSwGend/ControlSoftware/DesTqClcn/Running Mode/Idle Speed Controller/PID_Controller" /begin SUB_GROUP S75_Integrator_Reset S75_clamping_unit /end SUB_GROUP /begin REF_CHARACTERISTIC EG_NmrSng0_C /end REF_CHARACTERISTIC
 /begin REF_MEASUREMENT DTqC_CoeffKdFbOut DTqC_CoeffKdOut DTqC_CoeffKiClampOut DTqC_CoeffKiClampPreSatOut DTqC_CoeffKiClampSwtchOut DTqC_CoeffKiOut DTqC_CoeffKpOut DTqC_IdleSpdCtlPIDOut /end REF_MEASUREMENT
/end GROUP
/begin GROUP S55_TSC1_Request_for_Speed_Control "EcuIntgdSwGend/ControlSoftware/DesTqClcn/Running Mode/TSC1 Control Purpose/TSC1 Request for Speed Control" /begin SUB_GROUP S79_PID_Controller1 /end SUB_GROUP
 /begin REF_CHARACTERISTIC DTqC_CoeffDForTSC1SpdCtl_M DTqC_CoeffFiltForTSC1SpdCtl_M DTqC_CoeffFiltTSC1SpdCtlOvs_P DTqC_CoeffFiltTSC1SpdCtlOvv_P DTqC_CoeffIForTSC1SpdCtl_M DTqC_CoeffPForTSC1SpdCtl_M DTqC_KdTSC1SpdCtlOvs_P DTqC_KdTSC1SpdCtlOvv_P DTqC_KiTSC1SpdCtlOvs_P DTqC_KiTSC1SpdCtlOvv_P DTqC_KpTSC1SpdCtlOvs_P DTqC_KpTSC1SpdCtlOvv_P DTqC_TqDesTSC1ReqPIDMax_P DTqC_TqDesTSC1ReqPIDMin_P /end REF_CHARACTERISTIC
 /begin REF_MEASUREMENT DTqC_CoeffDForTSC1ReqSpdCtl DTqC_CoeffDForTSC1ReqSpdCtlMapOut DTqC_CoeffFiltForTSC1ReqSpdCtl DTqC_CoeffFiltForTSC1ReqSpdCtlMapOut DTqC_CoeffIForTSC1ReqSpdCtl DTqC_CoeffIForTSC1ReqSpdCtlMapOut DTqC_CoeffPForTSC1ReqSpdCtl DTqC_CoeffPForTSC1ReqSpdCtlMapOut DTqC_ErrNSpdReq /end REF_MEASUREMENT
/end GROUP
/begin GROUP S101_Debouncer4 "EcuIntgdSwGend/ControlSoftware/EcuInpPrcsg/Actuator Defect Signals/Shutdown For Injector Error/Debouncer4" /begin REF_MEASUREMENT EIP_TiElpdErrInjrShtdwn /end REF_MEASUREMENT /end GROUP
/begin GROUP S103_Cylinder_1_Speed_Error_Calculation "EcuIntgdSwGend/ControlSoftware/EcuInpPrcsg/Additionals/Cylinder Balancing/Cylinder 1 Speed Error Calculation" /begin SUB_GROUP S106_LowPassFilter1 S106_LowPassFilter2 /end SUB_GROUP
 /begin REF_CHARACTERISTIC EG_NmrSng0_C EG_TsSw_C EIP_NCyl1ErrOvs_P EIP_NCyl1ErrOvv_P EIP_NCylMaxThd_P EIP_NCylMinThd_P EIP_TcNCyl1MinFil_P EIP_TcNMeaCylMin_P /end REF_CHARACTERISTIC
 /begin REF_MEASUREMENT EIP_ErrNCyl1 EIP_NCyl1Dif /end REF_MEASUREMENT
/end GROUP
/begin GROUP S103_Cylinder_2_Speed_Error_Calculation "EcuIntgdSwGend/ControlSoftware/EcuInpPrcsg/Additionals/Cylinder Balancing/Cylinder 2 Speed Error Calculation" /begin SUB_GROUP S107_LowPassFilter3 /end SUB_GROUP
 /begin REF_CHARACTERISTIC EG_NmrSng0_C EG_TsSw_C EIP_NCyl2ErrOvs_P EIP_NCyl2ErrOvv_P EIP_NCylMaxThd_P EIP_NCylMinThd_P EIP_TcNCyl2MinFil_P /end REF_CHARACTERISTIC
 /begin REF_MEASUREMENT EIP_ErrNCyl2 EIP_NCyl2Dif /end REF_MEASUREMENT
/end GROUP
/begin GROUP S103_Cylinder_3_Speed_Error_Calculation "EcuIntgdSwGend/ControlSoftware/EcuInpPrcsg/Additionals/Cylinder Balancing/Cylinder 3 Speed Error Calculation" /begin SUB_GROUP S108_LowPassFilter4 /end SUB_GROUP
 /begin REF_CHARACTERISTIC EG_NmrSng0_C EG_TsSw_C EIP_NCyl3ErrOvs_P EIP_NCyl3ErrOvv_P EIP_NCylMaxThd_P EIP_NCylMinThd_P EIP_TcNCyl3MinFil_P /end REF_CHARACTERISTIC
 /begin REF_MEASUREMENT EIP_ErrNCyl3 EIP_NCyl3Dif /end REF_MEASUREMENT
/end GROUP
/begin GROUP S103_Cylinder_4_Speed_Error_Calculation "EcuIntgdSwGend/ControlSoftware/EcuInpPrcsg/Additionals/Cylinder Balancing/Cylinder 4 Speed Error Calculation" /begin SUB_GROUP S109_LowPassFilter5 /end SUB_GROUP
 /begin REF_CHARACTERISTIC EG_NmrSng0_C EG_TsSw_C EIP_NCyl4ErrOvs_P EIP_NCyl4ErrOvv_P EIP_NCylMaxThd_P EIP_NCylMinThd_P EIP_TcNCyl4MinFil_P /end REF_CHARACTERISTIC
 /begin REF_MEASUREMENT EIP_ErrNCyl4 EIP_NCyl4Dif /end REF_MEASUREMENT
/end GROUP
/begin GROUP S103_Cylinder_5_Speed_Error_Calculation "EcuIntgdSwGend/ControlSoftware/EcuInpPrcsg/Additionals/Cylinder Balancing/Cylinder 5 Speed Error Calculation" /begin SUB_GROUP S110_LowPassFilter6 /end SUB_GROUP
 /begin REF_CHARACTERISTIC EG_NmrSng0_C EG_TsSw_C EIP_NCyl5ErrOvs_P EIP_NCyl5ErrOvv_P EIP_NCylMaxThd_P EIP_NCylMinThd_P EIP_TcNCyl5MinFil_P /end REF_CHARACTERISTIC
 /begin REF_MEASUREMENT EIP_ErrNCyl5 EIP_NCyl5Dif /end REF_MEASUREMENT
/end GROUP
/begin GROUP S103_Cylinder_6_Speed_Error_Calculation "EcuIntgdSwGend/ControlSoftware/EcuInpPrcsg/Additionals/Cylinder Balancing/Cylinder 6 Speed Error Calculation" /begin SUB_GROUP S111_LowPassFilter7 /end SUB_GROUP
 /begin REF_CHARACTERISTIC EG_NmrSng0_C EG_TsSw_C EIP_NCyl6ErrOvs_P EIP_NCyl6ErrOvv_P EIP_NCylMaxThd_P EIP_NCylMinThd_P EIP_TcNCyl6MinFil_P /end REF_CHARACTERISTIC
 /begin REF_MEASUREMENT EIP_ErrNCyl6 EIP_NCyl6Dif /end REF_MEASUREMENT
/end GROUP
/begin GROUP S103_Debouncer6 "EcuIntgdSwGend/ControlSoftware/EcuInpPrcsg/Additionals/Cylinder Balancing/Debouncer6" /begin REF_MEASUREMENT EIP_TiElpdIdleMod EIP_bAcvIdleModDebOut /end REF_MEASUREMENT /end GROUP
/begin GROUP S104_Injector_1_Misfire "EcuIntgdSwGend/ControlSoftware/EcuInpPrcsg/Additionals/Misfire Detection/Injector 1 Misfire" /begin REF_CHARACTERISTIC EIP_NCyl1MinThd_P /end REF_CHARACTERISTIC /end GROUP
/begin GROUP S104_Injector_2_Misfire "EcuIntgdSwGend/ControlSoftware/EcuInpPrcsg/Additionals/Misfire Detection/Injector 2 Misfire" /begin REF_CHARACTERISTIC EIP_NCyl2MinThd_P /end REF_CHARACTERISTIC /end GROUP
/begin GROUP S104_Injector_3_Misfire "EcuIntgdSwGend/ControlSoftware/EcuInpPrcsg/Additionals/Misfire Detection/Injector 3 Misfire" /begin REF_CHARACTERISTIC EIP_NCyl3MinThd_P /end REF_CHARACTERISTIC /end GROUP
/begin GROUP S104_Injector_4_Misfire "EcuIntgdSwGend/ControlSoftware/EcuInpPrcsg/Additionals/Misfire Detection/Injector 4 Misfire" /begin REF_CHARACTERISTIC EIP_NCyl4MinThd_P /end REF_CHARACTERISTIC /end GROUP
/begin GROUP S104_Injector_5_Misfire "EcuIntgdSwGend/ControlSoftware/EcuInpPrcsg/Additionals/Misfire Detection/Injector 5 Misfire" /begin REF_CHARACTERISTIC EIP_NCyl5MinThd_P /end REF_CHARACTERISTIC /end GROUP
/end MODULE
/end PROJECT
