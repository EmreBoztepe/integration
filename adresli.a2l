ASAP2_VERSION 1 6
/begin PROJECT ECEMTAG_CR8 ""
/begin MODULE DIM ""
/begin MOD_COMMON "Mod Common Comment Here" DEPOSIT ABSOLUTE BYTE_ORDER MSB_FIRST /end MOD_COMMON
/begin COMPU_METHOD Current_mA_CM "Scale 1" RAT_FUNC "%20.0" "mA" COEFFS 0 1 0 0 0 1 /end COMPU_METHOD
/begin RECORD_LAYOUT FLOAT32_IEEE FNC_VALUES 1 FLOAT32_IEEE ROW_DIR DIRECT /end RECORD_LAYOUT
/begin RECORD_LAYOUT ULONG FNC_VALUES 1 ULONG ROW_DIR DIRECT /end RECORD_LAYOUT
/begin RECORD_LAYOUT UWORD FNC_VALUES 1 UWORD ROW_DIR DIRECT /end RECORD_LAYOUT
/begin RECORD_LAYOUT SWORD FNC_VALUES 1 SWORD ROW_DIR DIRECT /end RECORD_LAYOUT
/begin RECORD_LAYOUT UBYTE FNC_VALUES 1 UBYTE ROW_DIR DIRECT /end RECORD_LAYOUT
/begin RECORD_LAYOUT SBYTE FNC_VALUES 1 SBYTE ROW_DIR DIRECT /end RECORD_LAYOUT
/begin RECORD_LAYOUT RL_X_ULONG AXIS_PTS_X 1 ULONG INDEX_INCR DIRECT /end RECORD_LAYOUT
/begin RECORD_LAYOUT RL_X_UWORD AXIS_PTS_X 1 UWORD INDEX_INCR DIRECT /end RECORD_LAYOUT
/begin RECORD_LAYOUT RL_X_UBYTE AXIS_PTS_X 1 UBYTE INDEX_INCR DIRECT /end RECORD_LAYOUT
/******************************* From MATLAB ***************************************/ /* MATLAB_SECTION_START_1 */
/begin RECORD_LAYOUT Scalar_BOOLEAN FNC_VALUES 1 UBYTE ROW_DIR DIRECT /end RECORD_LAYOUT
/begin RECORD_LAYOUT Scalar_UBYTE FNC_VALUES 1 UBYTE ROW_DIR DIRECT /end RECORD_LAYOUT
/begin RECORD_LAYOUT Scalar_BYTE FNC_VALUES 1 SBYTE ROW_DIR DIRECT /end RECORD_LAYOUT
/begin RECORD_LAYOUT Scalar_SWORD FNC_VALUES 1 SWORD ROW_DIR DIRECT /end RECORD_LAYOUT
/begin RECORD_LAYOUT Scalar_FLOAT32_IEEE FNC_VALUES 1 FLOAT32_IEEE ROW_DIR DIRECT /end RECORD_LAYOUT
/begin RECORD_LAYOUT Lookup1D_X_WORD AXIS_PTS_X 1 SWORD INDEX_INCR DIRECT /end RECORD_LAYOUT
/begin RECORD_LAYOUT Lookup1D_FLOAT32_IEEE FNC_VALUES 1 FLOAT32_IEEE ROW_DIR DIRECT /end RECORD_LAYOUT
/begin RECORD_LAYOUT Lookup1D_X_FLOAT32_IEEE AXIS_PTS_X 1 FLOAT32_IEEE INDEX_INCR DIRECT /end RECORD_LAYOUT
/begin RECORD_LAYOUT Lookup2D_X_WORD AXIS_PTS_X 1 SWORD INDEX_INCR DIRECT /end RECORD_LAYOUT
/begin RECORD_LAYOUT Lookup2D_FLOAT32_IEEE FNC_VALUES 1 FLOAT32_IEEE ROW_DIR DIRECT /end RECORD_LAYOUT
/begin RECORD_LAYOUT Lookup2D_X_FLOAT32_IEEE AXIS_PTS_X 1 FLOAT32_IEEE INDEX_INCR DIRECT /end RECORD_LAYOUT
/begin CHARACTERISTIC TrC_MMaiFuQnty1_M "Main Quantity Value Interpolation Between Map 1 and 2" MAP 0x4004CF1C /* @ECU_Address@TrC_MMaiFuQnty1_M@ */ Lookup2D_FLOAT32_IEEE 0 EcuIntgdSwGend_CM_single_mm_3_stk 0.0 1000.0
 /begin AXIS_DESCR COM_AXIS TL_TqIndcdLimd EcuIntgdSwGend_CM_single_N_m 25 0.0 10000.0 AXIS_PTS_REF TrC_TqIndcdLimdMMaiFu_A /end AXIS_DESCR
 /begin AXIS_DESCR COM_AXIS EIP_NEng EcuIntgdSwGend_CM_single_rpm 25 0.0 5000.0 AXIS_PTS_REF TrC_NEngMMaiFu_A /end AXIS_DESCR
/end CHARACTERISTIC
/begin AXIS_PTS TrC_TqIndcdLimdMMaiFu_A "Axis of Indicated Torque for Main Fuel Map" 0x40050B44 /* @ECU_Address@TrC_TqIndcdLimdMMaiFu_A@ */ TL_TqIndcdLimd Lookup2D_X_FLOAT32_IEEE 0 EcuIntgdSwGend_CM_single_N_m 25 0.0 10000.0 /end AXIS_PTS
/begin AXIS_PTS TrC_NEngMMaiFu_A "Axis Values of Engine Speed for Main Fuel Quantity Map" 0x40050884 /* @ECU_Address@TrC_NEngMMaiFu_A@ */ EIP_NEng Lookup2D_X_FLOAT32_IEEE 0 EcuIntgdSwGend_CM_single_rpm 25 0.0 5000.0 /end AXIS_PTS
/begin CHARACTERISTIC TrC_MMaiFuQnty2_M "Main Quantity Value Interpolation Between Map 2 and 3" MAP 0x4004D8E0 /* @ECU_Address@TrC_MMaiFuQnty2_M@ */ Lookup2D_FLOAT32_IEEE 0 EcuIntgdSwGend_CM_single_mm_3_stk 0.0 1000.0
 /begin AXIS_DESCR COM_AXIS TL_TqIndcdLimd EcuIntgdSwGend_CM_single_N_m 25 0.0 10000.0 AXIS_PTS_REF TrC_TqIndcdLimdMMaiFu_A /end AXIS_DESCR
 /begin AXIS_DESCR COM_AXIS EIP_NEng EcuIntgdSwGend_CM_single_rpm 25 0.0 5000.0 AXIS_PTS_REF TrC_NEngMMaiFu_A /end AXIS_DESCR
/end CHARACTERISTIC
/begin CHARACTERISTIC TrC_MMaiFuQnty3_M "Main Quantity Map 2" MAP 0x4004E2A4 /* @ECU_Address@TrC_MMaiFuQnty3_M@ */ Lookup2D_FLOAT32_IEEE 0 EcuIntgdSwGend_CM_single_mm_3_stk 0.0 1000.0
 /begin AXIS_DESCR COM_AXIS TL_TqIndcdLimd EcuIntgdSwGend_CM_single_N_m 25 0.0 10000.0 AXIS_PTS_REF TrC_TqIndcdLimdMMaiFu_A /end AXIS_DESCR
 /begin AXIS_DESCR COM_AXIS EIP_NEng EcuIntgdSwGend_CM_single_rpm 25 0.0 5000.0 AXIS_PTS_REF TrC_NEngMMaiFu_A /end AXIS_DESCR
/end CHARACTERISTIC
/begin CHARACTERISTIC TrC_MPltFuQnty1_M "Pilot Quantity Map 1" MAP 0x4004EE28 /* @ECU_Address@TrC_MPltFuQnty1_M@ */ Lookup2D_FLOAT32_IEEE 0 EcuIntgdSwGend_CM_single_mm_3_stk 0.0 1000.0
 /begin AXIS_DESCR COM_AXIS TL_TqIndcdLimd EcuIntgdSwGend_CM_single_N_m 10 0.0 10000.0 AXIS_PTS_REF TrC_TqIndcdLimdMPreFu_A /end AXIS_DESCR
 /begin AXIS_DESCR COM_AXIS EIP_NEng EcuIntgdSwGend_CM_single_rpm 15 0.0 5000.0 AXIS_PTS_REF TrC_NEngMPreFu_A /end AXIS_DESCR
/end CHARACTERISTIC
/begin AXIS_PTS TrC_TqIndcdLimdMPreFu_A "Axis of Indicated Torque for Pilot Fuel Map" 0x40050BA8 /* @ECU_Address@TrC_TqIndcdLimdMPreFu_A@ */ TL_TqIndcdLimd Lookup2D_X_FLOAT32_IEEE 0 EcuIntgdSwGend_CM_single_N_m 10 0.0 10000.0 /end AXIS_PTS
/begin AXIS_PTS TrC_NEngMPreFu_A "Axis Values of Engine Speed for Pilot Fuel Quantity Map" 0x400508E8 /* @ECU_Address@TrC_NEngMPreFu_A@ */ EIP_NEng Lookup2D_X_FLOAT32_IEEE 0 EcuIntgdSwGend_CM_single_rpm 15 0.0 5000.0 /end AXIS_PTS
/begin CHARACTERISTIC TrC_MPltFuQnty2_M "Pilot Quantity Map 2" MAP 0x4004F080 /* @ECU_Address@TrC_MPltFuQnty2_M@ */ Lookup2D_FLOAT32_IEEE 0 EcuIntgdSwGend_CM_single_mm_3_stk 0.0 1000.0
 /begin AXIS_DESCR COM_AXIS TL_TqIndcdLimd EcuIntgdSwGend_CM_single_N_m 10 0.0 10000.0 AXIS_PTS_REF TrC_TqIndcdLimdMPreFu_A /end AXIS_DESCR
 /begin AXIS_DESCR COM_AXIS EIP_NEng EcuIntgdSwGend_CM_single_rpm 15 0.0 5000.0 AXIS_PTS_REF TrC_NEngMPreFu_A /end AXIS_DESCR
/end CHARACTERISTIC
/begin CHARACTERISTIC TrC_MPltFuQnty3_M "Pilot Quantity Map 3" MAP 0x4004F2D8 /* @ECU_Address@TrC_MPltFuQnty3_M@ */ Lookup2D_FLOAT32_IEEE 0 EcuIntgdSwGend_CM_single_mm_3_stk 0.0 1000.0
 /begin AXIS_DESCR COM_AXIS TL_TqIndcdLimd EcuIntgdSwGend_CM_single_N_m 10 0.0 10000.0 AXIS_PTS_REF TrC_TqIndcdLimdMPreFu_A /end AXIS_DESCR
 /begin AXIS_DESCR COM_AXIS EIP_NEng EcuIntgdSwGend_CM_single_rpm 15 0.0 5000.0 AXIS_PTS_REF TrC_NEngMPreFu_A /end AXIS_DESCR
/end CHARACTERISTIC
/begin CHARACTERISTIC TrC_MPltFuPAmbAirCorr_M "Pilot Fuel Quantity - Ambient Air Pressure Correction" MAP 0x4004EC98 /* @ECU_Address@TrC_MPltFuPAmbAirCorr_M@ */ Lookup2D_FLOAT32_IEEE 0 EcuIntgdSwGend_CM_single_mm_3_stk -500.0 500.0
 /begin AXIS_DESCR COM_AXIS TL_TqIndcdLimd EcuIntgdSwGend_CM_single_N_m 10 0.0 4000.0 AXIS_PTS_REF TrC_TqIndcdLimdForPltFuCorr_A /end AXIS_DESCR
 /begin AXIS_DESCR COM_AXIS EIP_PAmbAir EcuIntgdSwGend_CM_single_mbar 10 0.0 10000.0 AXIS_PTS_REF TrC_MPltFuPAmbAirCorr_A /end AXIS_DESCR
/end CHARACTERISTIC
/begin AXIS_PTS TrC_TqIndcdLimdForPltFuCorr_A "Indicated Torque for Pilot Fuel Quantity Correction" 0x40050B1C /* @ECU_Address@TrC_TqIndcdLimdForPltFuCorr_A@ */ TL_TqIndcdLimd Lookup2D_X_FLOAT32_IEEE 0 EcuIntgdSwGend_CM_single_N_m 10 0.0 4000.0 /end AXIS_PTS
/begin AXIS_PTS TrC_MPltFuPAmbAirCorr_A "Pilot Fuel Quantity - Axis of Ambient Air Pressure Correction" 0x4004EC70 /* @ECU_Address@TrC_MPltFuPAmbAirCorr_A@ */ EIP_PAmbAir Lookup2D_X_FLOAT32_IEEE 0 EcuIntgdSwGend_CM_single_mbar 10 0.0 10000.0 /end AXIS_PTS
/begin CHARACTERISTIC TrC_MPltFuTAirBoostCorr_M "Pilot Fuel Quantity - Airboost Temperature Correction" MAP 0x4004F560 /* @ECU_Address@TrC_MPltFuTAirBoostCorr_M@ */ Lookup2D_FLOAT32_IEEE 0 EcuIntgdSwGend_CM_single_mm_3_stk -500.0 500.0
 /begin AXIS_DESCR COM_AXIS TL_TqIndcdLimd EcuIntgdSwGend_CM_single_N_m 10 0.0 4000.0 AXIS_PTS_REF TrC_TqIndcdLimdForPltFuCorr_A /end AXIS_DESCR
 /begin AXIS_DESCR COM_AXIS EIP_TAirBoost EcuIntgdSwGend_CM_single_degC 10 -50.0 250.0 AXIS_PTS_REF TrC_MPltFuTAirBoostCorr_A /end AXIS_DESCR
/end CHARACTERISTIC
/begin AXIS_PTS TrC_MPltFuTAirBoostCorr_A "Pilot Fuel Quantity - Axis of Airboost Temperature Correction" 0x4004F538 /* @ECU_Address@TrC_MPltFuTAirBoostCorr_A@ */ EIP_TAirBoost Lookup2D_X_FLOAT32_IEEE 0 EcuIntgdSwGend_CM_single_degC 10 -50.0 250.0 /end AXIS_PTS
/begin CHARACTERISTIC TrC_MPltFuTAmbAirCorr_M "Pilot Fuel Quantity - Ambient Air Temperature Correction" MAP 0x4004F718 /* @ECU_Address@TrC_MPltFuTAmbAirCorr_M@ */ Lookup2D_FLOAT32_IEEE 0 EcuIntgdSwGend_CM_single_mm_3_stk -500.0 500.0
 /begin AXIS_DESCR COM_AXIS TL_TqIndcdLimd EcuIntgdSwGend_CM_single_N_m 10 0.0 4000.0 AXIS_PTS_REF TrC_TqIndcdLimdForPltFuCorr_A /end AXIS_DESCR
 /begin AXIS_DESCR COM_AXIS EIP_TAmbAir EcuIntgdSwGend_CM_single_degC 10 -50.0 250.0 AXIS_PTS_REF TrC_MPltFuTAmbAirCorr_A /end AXIS_DESCR
/end CHARACTERISTIC
/begin AXIS_PTS TrC_MPltFuTAmbAirCorr_A "Pilot Fuel Quantity - Axis of Ambient Air Temperature Correction" 0x4004F6F0 /* @ECU_Address@TrC_MPltFuTAmbAirCorr_A@ */ EIP_TAmbAir Lookup2D_X_FLOAT32_IEEE 0 EcuIntgdSwGend_CM_single_degC 10 -50.0 250.0 /end AXIS_PTS
/begin CHARACTERISTIC TrC_MPltFuTCooltCorr_M "Pilot Fuel Quantity - Coolant Temperature Correction" MAP 0x4004F8D0 /* @ECU_Address@TrC_MPltFuTCooltCorr_M@ */ Lookup2D_FLOAT32_IEEE 0 EcuIntgdSwGend_CM_single_mm_3_stk -500.0 500.0
 /begin AXIS_DESCR COM_AXIS TL_TqIndcdLimd EcuIntgdSwGend_CM_single_N_m 10 0.0 4000.0 AXIS_PTS_REF TrC_TqIndcdLimdForPltFuCorr_A /end AXIS_DESCR
 /begin AXIS_DESCR COM_AXIS EIP_TCoolt EcuIntgdSwGend_CM_single_degC 10 -50.0 250.0 AXIS_PTS_REF TrC_MPltFuTCooltCorr_A /end AXIS_DESCR
/end CHARACTERISTIC
/begin AXIS_PTS TrC_MPltFuTCooltCorr_A "Pilot Fuel Quantity - Axis of Coolant Temperature Correction" 0x4004F8A8 /* @ECU_Address@TrC_MPltFuTCooltCorr_A@ */ EIP_TCoolt Lookup2D_X_FLOAT32_IEEE 0 EcuIntgdSwGend_CM_single_degC 10 -50.0 250.0 /end AXIS_PTS
/begin CHARACTERISTIC TrC_MPltFuTOilCorr_M "Pilot Fuel Quantity - Oil Temperature Correction" MAP 0x4004FA88 /* @ECU_Address@TrC_MPltFuTOilCorr_M@ */ Lookup2D_FLOAT32_IEEE 0 EcuIntgdSwGend_CM_single_mm_3_stk -500.0 500.0
 /begin AXIS_DESCR COM_AXIS TL_TqIndcdLimd EcuIntgdSwGend_CM_single_N_m 10 0.0 4000.0 AXIS_PTS_REF TrC_TqIndcdLimdForPltFuCorr_A /end AXIS_DESCR
 /begin AXIS_DESCR COM_AXIS EIP_TOil EcuIntgdSwGend_CM_single_degC 10 -50.0 250.0 AXIS_PTS_REF TrC_MPltFuTOilCorr_A /end AXIS_DESCR
/end CHARACTERISTIC
/begin AXIS_PTS TrC_MPltFuTOilCorr_A "Pilot Fuel Quantity - Axis of Oil Temperature Correction" 0x4004FA60 /* @ECU_Address@TrC_MPltFuTOilCorr_A@ */ EIP_TOil Lookup2D_X_FLOAT32_IEEE 0 EcuIntgdSwGend_CM_single_degC 10 -50.0 250.0 /end AXIS_PTS
/begin CHARACTERISTIC TrC_MPltFuUClmp30Corr_M "Pilot Fuel Quantity - Battery Voltage Correction" MAP 0x4004FC40 /* @ECU_Address@TrC_MPltFuUClmp30Corr_M@ */ Lookup2D_FLOAT32_IEEE 0 EcuIntgdSwGend_CM_single_mm_3_stk -500.0 500.0
 /begin AXIS_DESCR COM_AXIS TL_TqIndcdLimd EcuIntgdSwGend_CM_single_N_m 10 0.0 4000.0 AXIS_PTS_REF TrC_TqIndcdLimdForPltFuCorr_A /end AXIS_DESCR
 /begin AXIS_DESCR COM_AXIS EIP_UClmp30 EcuIntgdSwGend_CM_single_V 10 0.0 50.0 AXIS_PTS_REF TrC_MPltFuUClmp30Corr_A /end AXIS_DESCR
/end CHARACTERISTIC
/begin AXIS_PTS TrC_MPltFuUClmp30Corr_A "Pilot Fuel Quantity - Axis of Battery Voltage Correction" 0x4004FC18 /* @ECU_Address@TrC_MPltFuUClmp30Corr_A@ */ EIP_UClmp30 Lookup2D_X_FLOAT32_IEEE 0 EcuIntgdSwGend_CM_single_V 10 0.0 50.0 /end AXIS_PTS
/begin CHARACTERISTIC TrC_RatAirFuSmokLim_M "Air Fuel Rate Smoke Limitation Map" MAP 0x40050954 /* @ECU_Address@TrC_RatAirFuSmokLim_M@ */ Lookup2D_FLOAT32_IEEE 0 EcuIntgdSwGend_CM_single 0.0 100.0
 /begin AXIS_DESCR COM_AXIS TL_TqIndcdLimd EcuIntgdSwGend_CM_single_N_m 10 0.0 30000.0 AXIS_PTS_REF TrC_TqIndcdLimdRatAirFu_A /end AXIS_DESCR
 /begin AXIS_DESCR COM_AXIS EIP_NEng EcuIntgdSwGend_CM_single_rpm 10 0.0 5000.0 AXIS_PTS_REF TrC_NEngRatAirFu_A /end AXIS_DESCR
/end CHARACTERISTIC
/begin AXIS_PTS TrC_TqIndcdLimdRatAirFu_A "Axis of Indicated Torque for Pilot Air Fuel Rate Map" 0x40050BD0 /* @ECU_Address@TrC_TqIndcdLimdRatAirFu_A@ */ TL_TqIndcdLimd Lookup2D_X_FLOAT32_IEEE 0 EcuIntgdSwGend_CM_single_N_m 10 0.0 30000.0 /end AXIS_PTS
/begin AXIS_PTS TrC_NEngRatAirFu_A "Axis Values of Engine Speed for Air Fuel Rate Map" 0x40050924 /* @ECU_Address@TrC_NEngRatAirFu_A@ */ EIP_NEng Lookup2D_X_FLOAT32_IEEE 0 EcuIntgdSwGend_CM_single_rpm 10 0.0 5000.0 /end AXIS_PTS
/begin CHARACTERISTIC TL_TqLimp_M "Limp Mode Map" CURVE 0x4004C658 /* @ECU_Address@TL_TqLimp_M@ */ Lookup1D_FLOAT32_IEEE 0 EcuIntgdSwGend_CM_single_N_m 0.0 10000.0
 /begin AXIS_DESCR COM_AXIS EIP_NEng EcuIntgdSwGend_CM_single_rpm 24 0.0 5000.0 AXIS_PTS_REF TL_NEngLimp_A /end AXIS_DESCR
/end CHARACTERISTIC
/begin AXIS_PTS TL_NEngLimp_A "Axis Values of Engine Speed for Limp Mode Curve" 0x4004B6B4 /* @ECU_Address@TL_NEngLimp_A@ */ EIP_NEng Lookup1D_X_FLOAT32_IEEE 0 EcuIntgdSwGend_CM_single_rpm 24 0.0 5000.0 /end AXIS_PTS
/begin CHARACTERISTIC TL_TqPtoProtn_M "Pto Protection Torque Limitation Curve" CURVE 0x4004C6C0 /* @ECU_Address@TL_TqPtoProtn_M@ */ Lookup1D_FLOAT32_IEEE 0 EcuIntgdSwGend_CM_single_N_m 0.0 5000.0
 /begin AXIS_DESCR COM_AXIS EIP_NEng EcuIntgdSwGend_CM_single_rpm 7 0.0 3000.0 AXIS_PTS_REF TL_NEngPtoProtn_A /end AXIS_DESCR
/end CHARACTERISTIC
/begin AXIS_PTS TL_NEngPtoProtn_A "Engine Speed Axis For Pto Protection Curve" 0x4004B714 /* @ECU_Address@TL_NEngPtoProtn_A@ */ EIP_NEng Lookup1D_X_FLOAT32_IEEE 0 EcuIntgdSwGend_CM_single_rpm 7 0.0 3000.0 /end AXIS_PTS
/begin CHARACTERISTIC TL_TqLimnForTrsmProtn_M "Transmission Protection Torque Limitation Map" MAP 0x4004C4C8 /* @ECU_Address@TL_TqLimnForTrsmProtn_M@ */ Lookup2D_FLOAT32_IEEE 0 EcuIntgdSwGend_CM_single_N_m 0.0 5000.0
 /begin AXIS_DESCR COM_AXIS EIP_CanTrsmCurrentGear EcuIntgdSwGend_CM_int16 10 -125.0 251.0 AXIS_PTS_REF TL_TrsmCurrentGear_A /end AXIS_DESCR
 /begin AXIS_DESCR COM_AXIS EIP_NEng EcuIntgdSwGend_CM_single_rpm 10 0.0 3000.0 AXIS_PTS_REF TL_NEngForTrsmProtn_A /end AXIS_DESCR
/end CHARACTERISTIC
/begin AXIS_PTS TL_TrsmCurrentGear_A "Transmission Current Gear Axis For Transmissin Protection" 0x4004C6E4 /* @ECU_Address@TL_TrsmCurrentGear_A@ */ EIP_CanTrsmCurrentGear Lookup2D_X_WORD 0 EcuIntgdSwGend_CM_int16 10 -125.0 251.0 /end AXIS_PTS
/begin AXIS_PTS TL_NEngForTrsmProtn_A "Engine Speed Axis For Transmission Protection Map" 0x4004B68C /* @ECU_Address@TL_NEngForTrsmProtn_A@ */ EIP_NEng Lookup2D_X_FLOAT32_IEEE 0 EcuIntgdSwGend_CM_single_rpm 10 0.0 3000.0 /end AXIS_PTS
/begin CHARACTERISTIC WgC_DutyWgtVlvFF_M "Feedforward Wastegate Duty Valve Map" MAP 0x4005187C /* @ECU_Address@WgC_DutyWgtVlvFF_M@ */ Lookup2D_FLOAT32_IEEE 0 EcuIntgdSwGend_CM_single__ 0.0 100.0
 /begin AXIS_DESCR COM_AXIS NO_INPUT_QUANTITY EcuIntgdSwGend_CM_single_N_m 15 0.0 1000.0 AXIS_PTS_REF WgC_TqIndcdLimdForPAirBoostFF_A /end AXIS_DESCR
 /begin AXIS_DESCR COM_AXIS EIP_NEng EcuIntgdSwGend_CM_single_rpm 15 0.0 3200.0 AXIS_PTS_REF WgC_NEngForPAirBoostFF_A /end AXIS_DESCR
/end CHARACTERISTIC
/begin AXIS_PTS WgC_TqIndcdLimdForPAirBoostFF_A "Limited Indicated Torque for Air Boost Pressure Feedforward Map Axis" 0x40052AC0 /* @ECU_Address@WgC_TqIndcdLimdForPAirBoostFF_A@ */ NO_INPUT_QUANTITY Lookup2D_X_FLOAT32_IEEE 0 EcuIntgdSwGend_CM_single_N_m 15 0.0 1000.0 /end AXIS_PTS
/begin AXIS_PTS WgC_NEngForPAirBoostFF_A "Engine Speed for Air Boost Pressure Feedforward Map Axis" 0x4005217C /* @ECU_Address@WgC_NEngForPAirBoostFF_A@ */ EIP_NEng Lookup2D_X_FLOAT32_IEEE 0 EcuIntgdSwGend_CM_single_rpm 15 0.0 3200.0 /end AXIS_PTS
/begin CHARACTERISTIC WgC_LimSigLo_M "Duty Valve Saturation Low Limit Signal Map" MAP 0x40051F9C /* @ECU_Address@WgC_LimSigLo_M@ */ Lookup2D_FLOAT32_IEEE 0 EcuIntgdSwGend_CM_single__ 0.0 100.0
 /begin AXIS_DESCR COM_AXIS NO_INPUT_QUANTITY EcuIntgdSwGend_CM_single_N_m 5 0.0 1000.0 AXIS_PTS_REF WgC_TqIndcdLimdForPAirBoostFFLimSigLo_A /end AXIS_DESCR
 /begin AXIS_DESCR COM_AXIS EIP_NEng EcuIntgdSwGend_CM_single_rpm 5 0.0 3200.0 AXIS_PTS_REF WgC_NEngForPAirBoostFFLimSigLo_A /end AXIS_DESCR
/end CHARACTERISTIC
/begin AXIS_PTS WgC_TqIndcdLimdForPAirBoostFFLimSigLo_A "Limited Indicated Torque for Air Boost Pressure Feedforward Limit Signal Low Map Axis" 0x40052A98 /* @ECU_Address@WgC_TqIndcdLimdForPAirBoostFFLimSigLo_A@ */ NO_INPUT_QUANTITY Lookup2D_X_FLOAT32_IEEE 0 EcuIntgdSwGend_CM_single_N_m 5 0.0 1000.0 /end AXIS_PTS
/begin AXIS_PTS WgC_NEngForPAirBoostFFLimSigLo_A "Engine Speed for Air Boost Pressure Feedforward Saturation Low Limit Map Axis" 0x40052154 /* @ECU_Address@WgC_NEngForPAirBoostFFLimSigLo_A@ */ EIP_NEng Lookup2D_X_FLOAT32_IEEE 0 EcuIntgdSwGend_CM_single_rpm 5 0.0 3200.0 /end AXIS_PTS
/begin CHARACTERISTIC WgC_LimSigUp_M "Duty Valve Saturation Up Limit Signal Map" MAP 0x40052000 /* @ECU_Address@WgC_LimSigUp_M@ */ Lookup2D_FLOAT32_IEEE 0 EcuIntgdSwGend_CM_single__ 0.0 100.0
 /begin AXIS_DESCR COM_AXIS NO_INPUT_QUANTITY EcuIntgdSwGend_CM_single_N_m 5 0.0 1000.0 AXIS_PTS_REF WgC_TqIndcdLimdForPAirBoostFFLimSigUp_A /end AXIS_DESCR
 /begin AXIS_DESCR COM_AXIS EIP_NEng EcuIntgdSwGend_CM_single_rpm 5 0.0 3200.0 AXIS_PTS_REF WgC_NEngForPAirBoostFFLimSigUp_A /end AXIS_DESCR
/end CHARACTERISTIC
/begin AXIS_PTS WgC_TqIndcdLimdForPAirBoostFFLimSigUp_A "Limited Indicated Torque for Air Boost Pressure Feedforward Limit Signal Up Map Axis" 0x40052AAC /* @ECU_Address@WgC_TqIndcdLimdForPAirBoostFFLimSigUp_A@ */ NO_INPUT_QUANTITY Lookup2D_X_FLOAT32_IEEE 0 EcuIntgdSwGend_CM_single_N_m 5 0.0 1000.0 /end AXIS_PTS
/begin AXIS_PTS WgC_NEngForPAirBoostFFLimSigUp_A "Engine Speed for Air Boost Pressure Feedforward Saturation Up Limit Map Axis" 0x40052168 /* @ECU_Address@WgC_NEngForPAirBoostFFLimSigUp_A@ */ EIP_NEng Lookup2D_X_FLOAT32_IEEE 0 EcuIntgdSwGend_CM_single_rpm 5 0.0 3200.0 /end AXIS_PTS
/begin CHARACTERISTIC WgC_StWgtVlvCtrl_M "Wastegate Valve Control State Map" CURVE 0x40052A00 /* @ECU_Address@WgC_StWgtVlvCtrl_M@ */ Lookup1D_FLOAT32_IEEE 0 EcuIntgdSwGend_CM_single 0.0 1.0
 /begin AXIS_DESCR COM_AXIS EIP_PAirBoost EcuIntgdSwGend_CM_single_mbar 8 -1000.0 3000.0 AXIS_PTS_REF WgC_PAirBoostForWgtVlvFF_A /end AXIS_DESCR
/end CHARACTERISTIC
/begin AXIS_PTS WgC_PAirBoostForWgtVlvFF_A "Air Boost Pressure for  Feedforward Wastegate Valve Map Axis" 0x40052618 /* @ECU_Address@WgC_PAirBoostForWgtVlvFF_A@ */ EIP_PAirBoost Lookup1D_X_FLOAT32_IEEE 0 EcuIntgdSwGend_CM_single_mbar 8 -1000.0 3000.0 /end AXIS_PTS
/begin CHARACTERISTIC CrsCtrl_CoeffDForVVehCtl_M "Coefficient Derrivate For Vehicle Velocity Control Map" CURVE 0x400403F4 /* @ECU_Address@CrsCtrl_CoeffDForVVehCtl_M@ */ Lookup1D_FLOAT32_IEEE 0 EcuIntgdSwGend_CM_single 0.0 10000.0
 /begin AXIS_DESCR COM_AXIS CrsCtrl_ErrVehVRef EcuIntgdSwGend_CM_single_km_h 20 -300.0 300.0 AXIS_PTS_REF CrsCtrl_ErrVVeh_A /end AXIS_DESCR
/end CHARACTERISTIC
/begin AXIS_PTS CrsCtrl_ErrVVeh_A "Error Vehicle Velocity Reference Map Axis" 0x40040544 /* @ECU_Address@CrsCtrl_ErrVVeh_A@ */ CrsCtrl_ErrVehVRef Lookup1D_X_FLOAT32_IEEE 0 EcuIntgdSwGend_CM_single_km_h 20 -300.0 300.0 /end AXIS_PTS
/begin CHARACTERISTIC CrsCtrl_CoeffFiltForVVehCtl_M "Coefficient Filter for Vehicle Velocity Control Map" CURVE 0x40040444 /* @ECU_Address@CrsCtrl_CoeffFiltForVVehCtl_M@ */ Lookup1D_FLOAT32_IEEE 0 EcuIntgdSwGend_CM_single 0.0 10000.0
 /begin AXIS_DESCR COM_AXIS CrsCtrl_ErrVehVRef EcuIntgdSwGend_CM_single_km_h 20 -300.0 300.0 AXIS_PTS_REF CrsCtrl_ErrVVeh_A /end AXIS_DESCR
/end CHARACTERISTIC
/begin CHARACTERISTIC CrsCtrl_CoeffIForVVehCtl_M "Coefficient Integral for Vehicle Velocity Control Map" CURVE 0x40040494 /* @ECU_Address@CrsCtrl_CoeffIForVVehCtl_M@ */ Lookup1D_FLOAT32_IEEE 0 EcuIntgdSwGend_CM_single 0.0 10000.0
 /begin AXIS_DESCR COM_AXIS CrsCtrl_ErrVehVRef EcuIntgdSwGend_CM_single_km_h 20 -300.0 300.0 AXIS_PTS_REF CrsCtrl_ErrVVeh_A /end AXIS_DESCR
/end CHARACTERISTIC
/begin CHARACTERISTIC CrsCtrl_CoeffPForVVehCtl_M "Derivative Coefficient Map Out Signal for Vehicle Velocity" CURVE 0x400404E4 /* @ECU_Address@CrsCtrl_CoeffPForVVehCtl_M@ */ Lookup1D_FLOAT32_IEEE 0 EcuIntgdSwGend_CM_single 0.0 10000.0
 /begin AXIS_DESCR COM_AXIS CrsCtrl_ErrVehVRef EcuIntgdSwGend_CM_single_km_h 20 -300.0 300.0 AXIS_PTS_REF CrsCtrl_ErrVVeh_A /end AXIS_DESCR
/end CHARACTERISTIC
/begin CHARACTERISTIC CrsCtrl_SatPIDMax_M "PID Maximum Saturation Map" MAP 0x400405DC /* @ECU_Address@CrsCtrl_SatPIDMax_M@ */ Lookup2D_FLOAT32_IEEE 0 EcuIntgdSwGend_CM_single_N_m 0.0 10000.0
 /begin AXIS_DESCR COM_AXIS EIP_CanTrsmCurrentGear EcuIntgdSwGend_CM_int16 6 -125.0 251.0 AXIS_PTS_REF CrsCtrl_CanTrsmCurrentGear_A /end AXIS_DESCR
 /begin AXIS_DESCR COM_AXIS EIP_NEng EcuIntgdSwGend_CM_single_rpm 6 0.0 3000.0 AXIS_PTS_REF CrsCtrl_NEngForPIDMax_A /end AXIS_DESCR
/end CHARACTERISTIC
/begin AXIS_PTS CrsCtrl_CanTrsmCurrentGear_A "Transmission Current Gear Map Axis" 0x400403E6 /* @ECU_Address@CrsCtrl_CanTrsmCurrentGear_A@ */ EIP_CanTrsmCurrentGear Lookup2D_X_WORD 0 EcuIntgdSwGend_CM_int16 6 -125.0 251.0 /end AXIS_PTS
/begin AXIS_PTS CrsCtrl_NEngForPIDMax_A "Engine Speed for PID Max Map Axis" 0x400405A0 /* @ECU_Address@CrsCtrl_NEngForPIDMax_A@ */ EIP_NEng Lookup2D_X_FLOAT32_IEEE 0 EcuIntgdSwGend_CM_single_rpm 6 0.0 3000.0 /end AXIS_PTS
/begin CHARACTERISTIC CrsCtrl_TrfCaseStsFac_M "Transfer Case Status Factor Map" CURVE 0x400406A0 /* @ECU_Address@CrsCtrl_TrfCaseStsFac_M@ */ Lookup1D_FLOAT32_IEEE 0 EcuIntgdSwGend_CM_single 0.0 100.0
 /begin AXIS_DESCR COM_AXIS EIP_CanTrfCaseSts EcuIntgdSwGend_CM_single 8 0.0 100.0 AXIS_PTS_REF CrsCtrl_TrfCaseStsFacForFF_A /end AXIS_DESCR
/end CHARACTERISTIC
/begin AXIS_PTS CrsCtrl_TrfCaseStsFacForFF_A "Transfer Case Status Factor for FeedForward Maps Axis" 0x40040680 /* @ECU_Address@CrsCtrl_TrfCaseStsFacForFF_A@ */ EIP_CanTrfCaseSts Lookup1D_X_FLOAT32_IEEE 0 EcuIntgdSwGend_CM_single 8 0.0 100.0 /end AXIS_PTS
/begin CHARACTERISTIC CrsCtrl_TrsmTqCnvrRatFac_M "Transmission Torque Convertor Ratio Factor Map" CURVE 0x400406C0 /* @ECU_Address@CrsCtrl_TrsmTqCnvrRatFac_M@ */ Lookup1D_FLOAT32_IEEE 0 EcuIntgdSwGend_CM_single 0.0 100.0
 /begin AXIS_DESCR COM_AXIS EIP_CanTrsmTqCnvrRat EcuIntgdSwGend_CM_single 8 0.0 100.0 AXIS_PTS_REF CrsCtrl_TrsmTqCnvrRatForFF_A /end AXIS_DESCR
/end CHARACTERISTIC
/begin AXIS_PTS CrsCtrl_TrsmTqCnvrRatForFF_A "Transmission Torque Convertor Ratio for FeedForward Map Axis" 0x400406E0 /* @ECU_Address@CrsCtrl_TrsmTqCnvrRatForFF_A@ */ EIP_CanTrsmTqCnvrRat Lookup1D_X_FLOAT32_IEEE 0 EcuIntgdSwGend_CM_single 8 0.0 100.0 /end AXIS_PTS
/begin CHARACTERISTIC DTqC_NEngIdleGearRef_M "Idle Reference Map According to Gear Index" CURVE 0x40041D80 /* @ECU_Address@DTqC_NEngIdleGearRef_M@ */ Lookup1D_FLOAT32_IEEE 0 EcuIntgdSwGend_CM_single_rpm 0.0 5000.0
 /begin AXIS_DESCR COM_AXIS EIP_CanTrsmCurrentGear EcuIntgdSwGend_CM_int16 5 -3.0 10.0 AXIS_PTS_REF DTqC_IdxGearIdleRef_A /end AXIS_DESCR
/end CHARACTERISTIC
/begin AXIS_PTS DTqC_IdxGearIdleRef_A "Active Index Gear Axis for Reference Idle Engine Speed Map" 0x40041C20 /* @ECU_Address@DTqC_IdxGearIdleRef_A@ */ EIP_CanTrsmCurrentGear Lookup1D_X_WORD 0 EcuIntgdSwGend_CM_int16 5 -3.0 10.0 /end AXIS_PTS
/begin CHARACTERISTIC DTqC_PAmbAirNEngIdleRef_M "Amibent Air Pressure for Reference Engine Idle Speed Map" CURVE 0x40041E2C /* @ECU_Address@DTqC_PAmbAirNEngIdleRef_M@ */ Lookup1D_FLOAT32_IEEE 0 EcuIntgdSwGend_CM_single -1000.0 1000.0
 /begin AXIS_DESCR COM_AXIS EIP_PAmbAir EcuIntgdSwGend_CM_single_mbar 10 0.0 1600.0 AXIS_PTS_REF DTqC_PAmbAirIdleRef_A /end AXIS_DESCR
/end CHARACTERISTIC
/begin AXIS_PTS DTqC_PAmbAirIdleRef_A "Amibent Air Pressure Map Axis for Reference Engine Idle Speed Map" 0x40041E04 /* @ECU_Address@DTqC_PAmbAirIdleRef_A@ */ EIP_PAmbAir Lookup1D_X_FLOAT32_IEEE 0 EcuIntgdSwGend_CM_single_mbar 10 0.0 1600.0 /end AXIS_PTS
/begin CHARACTERISTIC DTqC_TCooltNEngIdleRef_M "Coolant Temperature for Reference Engine Idle Speed Map Out" CURVE 0x40041FB4 /* @ECU_Address@DTqC_TCooltNEngIdleRef_M@ */ Lookup1D_FLOAT32_IEEE 0 EcuIntgdSwGend_CM_single_degC -1000.0 1000.0
 /begin AXIS_DESCR COM_AXIS EIP_TCoolt EcuIntgdSwGend_CM_single_degC 10 -40.0 150.0 AXIS_PTS_REF DTqC_TCooltIdleRef_A /end AXIS_DESCR
/end CHARACTERISTIC
/begin AXIS_PTS DTqC_TCooltIdleRef_A "Coolant Temperature Map Axis for Reference Engine Idle Speed Map" 0x40041F80 /* @ECU_Address@DTqC_TCooltIdleRef_A@ */ EIP_TCoolt Lookup1D_X_FLOAT32_IEEE 0 EcuIntgdSwGend_CM_single_degC 10 -40.0 150.0 /end AXIS_PTS
/begin CHARACTERISTIC DTqC_TOilNEngIdleRef_M "Oil Temperature for Reference Engine Idle Speed Map" CURVE 0x40042004 /* @ECU_Address@DTqC_TOilNEngIdleRef_M@ */ Lookup1D_FLOAT32_IEEE 0 EcuIntgdSwGend_CM_single -1000.0 1000.0
 /begin AXIS_DESCR COM_AXIS EIP_TOil EcuIntgdSwGend_CM_single_degC 10 -40.0 150.0 AXIS_PTS_REF DTqC_TOilIdleRef_A /end AXIS_DESCR
/end CHARACTERISTIC
/begin AXIS_PTS DTqC_TOilIdleRef_A "Oil Temperature Map Axis for Reference Engine Idle Speed Map" 0x40041FDC /* @ECU_Address@DTqC_TOilIdleRef_A@ */ EIP_TOil Lookup1D_X_FLOAT32_IEEE 0 EcuIntgdSwGend_CM_single_degC 10 -40.0 150.0 /end AXIS_PTS
/begin CHARACTERISTIC DTqC_CoeffDForSpdCtl_M "Derivative Coefficient Map for Speed Controller" MAP 0x400408D0 /* @ECU_Address@DTqC_CoeffDForSpdCtl_M@ */ Lookup2D_FLOAT32_IEEE 0 EcuIntgdSwGend_CM_single -100000.0 100000.0
 /begin AXIS_DESCR COM_AXIS DTqC_ErrNIdle EcuIntgdSwGend_CM_single_rpm 10 -500.0 500.0 AXIS_PTS_REF DTqC_ErrNEng_A /end AXIS_DESCR
 /begin AXIS_DESCR COM_AXIS EIP_TCoolt EcuIntgdSwGend_CM_single_degC 10 -40.0 150.0 AXIS_PTS_REF DTqC_TCooltForSpdCtl_A /end AXIS_DESCR
/end CHARACTERISTIC
/begin AXIS_PTS DTqC_ErrNEng_A "Axis Values of Error Engine Speed for PID Coefficient Maps" 0x40041A58 /* @ECU_Address@DTqC_ErrNEng_A@ */ DTqC_ErrNIdle Lookup2D_X_FLOAT32_IEEE 0 EcuIntgdSwGend_CM_single_rpm 10 -500.0 500.0 /end AXIS_PTS
/begin AXIS_PTS DTqC_TCooltForSpdCtl_A "Axis Values of Coolant High Temperature for Start Control Torque Map" 0x40041F30 /* @ECU_Address@DTqC_TCooltForSpdCtl_A@ */ EIP_TCoolt Lookup2D_X_FLOAT32_IEEE 0 EcuIntgdSwGend_CM_single_degC 10 -40.0 150.0 /end AXIS_PTS
/begin CHARACTERISTIC DTqC_CoeffFiltForSpdCtl_M "Filter Coefficient Map for Speed Controller" MAP 0x40040D80 /* @ECU_Address@DTqC_CoeffFiltForSpdCtl_M@ */ Lookup2D_FLOAT32_IEEE 0 EcuIntgdSwGend_CM_single -100000.0 100000.0
 /begin AXIS_DESCR COM_AXIS DTqC_ErrNIdle EcuIntgdSwGend_CM_single_rpm 10 -500.0 500.0 AXIS_PTS_REF DTqC_ErrNEng_A /end AXIS_DESCR
 /begin AXIS_DESCR COM_AXIS EIP_TCoolt EcuIntgdSwGend_CM_single_degC 10 -40.0 150.0 AXIS_PTS_REF DTqC_TCooltForSpdCtl_A /end AXIS_DESCR
/end CHARACTERISTIC
/begin CHARACTERISTIC DTqC_CoeffIForSpdCtl_M "Integrator Coefficient Map for Speed Controller" MAP 0x40041248 /* @ECU_Address@DTqC_CoeffIForSpdCtl_M@ */ Lookup2D_FLOAT32_IEEE 0 EcuIntgdSwGend_CM_single -100000.0 100000.0
 /begin AXIS_DESCR COM_AXIS DTqC_ErrNIdle EcuIntgdSwGend_CM_single_rpm 10 -500.0 500.0 AXIS_PTS_REF DTqC_ErrNEng_A /end AXIS_DESCR
 /begin AXIS_DESCR COM_AXIS EIP_TCoolt EcuIntgdSwGend_CM_single_degC 10 -40.0 150.0 AXIS_PTS_REF DTqC_TCooltForSpdCtl_A /end AXIS_DESCR
/end CHARACTERISTIC
/begin CHARACTERISTIC DTqC_CoeffPForSpdCtl_M "Proportional Coefficient Map for Speed Controller" MAP 0x400416F8 /* @ECU_Address@DTqC_CoeffPForSpdCtl_M@ */ Lookup2D_FLOAT32_IEEE 0 EcuIntgdSwGend_CM_single -100000.0 100000.0
 /begin AXIS_DESCR COM_AXIS DTqC_ErrNIdle EcuIntgdSwGend_CM_single_rpm 10 -500.0 500.0 AXIS_PTS_REF DTqC_ErrNEng_A /end AXIS_DESCR
 /begin AXIS_DESCR COM_AXIS EIP_TCoolt EcuIntgdSwGend_CM_single_degC 10 -40.0 150.0 AXIS_PTS_REF DTqC_TCooltForSpdCtl_A /end AXIS_DESCR
/end CHARACTERISTIC
/begin CHARACTERISTIC DTqC_IdleSpdCtrlFF_M "Idle Speed Controller Feed Forward Map" MAP 0x40041A90 /* @ECU_Address@DTqC_IdleSpdCtrlFF_M@ */ Lookup2D_FLOAT32_IEEE 0 EcuIntgdSwGend_CM_single_N_m -10000.0 10000.0
 /begin AXIS_DESCR COM_AXIS EIP_TCoolt EcuIntgdSwGend_CM_single_degC 10 -50.0 250.0 AXIS_PTS_REF DTqC_TCooltForIdleSpdFF_A /end AXIS_DESCR
 /begin AXIS_DESCR COM_AXIS EIP_NEng EcuIntgdSwGend_CM_single_rpm 10 0.0 5000.0 AXIS_PTS_REF DTqC_NEngForIdleSpdFF_A /end AXIS_DESCR
/end CHARACTERISTIC
/begin AXIS_PTS DTqC_TCooltForIdleSpdFF_A "Idle Speed Controller Feed Forward Coolant Temperature Axis" 0x40041F08 /* @ECU_Address@DTqC_TCooltForIdleSpdFF_A@ */ EIP_TCoolt Lookup2D_X_FLOAT32_IEEE 0 EcuIntgdSwGend_CM_single_degC 10 -50.0 250.0 /end AXIS_PTS
/begin AXIS_PTS DTqC_NEngForIdleSpdFF_A "Idle Speed Controller Feed Forward Engine Speed Axis" 0x40041CE4 /* @ECU_Address@DTqC_NEngForIdleSpdFF_A@ */ EIP_NEng Lookup2D_X_FLOAT32_IEEE 0 EcuIntgdSwGend_CM_single_rpm 10 0.0 5000.0 /end AXIS_PTS
/begin CHARACTERISTIC DTqC_TqDesSatMax_M "Idle Engine Speed PID Controlller Max Saturation Map" CURVE 0x40043374 /* @ECU_Address@DTqC_TqDesSatMax_M@ */ Lookup1D_FLOAT32_IEEE 0 EcuIntgdSwGend_CM_single_N_m -1000.0 10000.0
 /begin AXIS_DESCR COM_AXIS EIP_NEng EcuIntgdSwGend_CM_single_rpm 7 0.0 6000.0 AXIS_PTS_REF DTqC_NEngForTqDesSatMax_A /end AXIS_DESCR
/end CHARACTERISTIC
/begin AXIS_PTS DTqC_NEngForTqDesSatMax_A "Engine Speed Axis for Idle Speed PID Controller PID Max Saturation Map " 0x40041D5C /* @ECU_Address@DTqC_NEngForTqDesSatMax_A@ */ EIP_NEng Lookup1D_X_FLOAT32_IEEE 0 EcuIntgdSwGend_CM_single_rpm 7 0.0 6000.0 /end AXIS_PTS
/begin CHARACTERISTIC CrsCtrl_PIDCoeffDOvv_P "PID Derivative Coefficient for Cruise Control - Override Value" VALUE 0x400405BC /* @ECU_Address@CrsCtrl_PIDCoeffDOvv_P@ */ Scalar_FLOAT32_IEEE 0 EcuIntgdSwGend_CM_single 0.0 10000.0 /end CHARACTERISTIC
/begin CHARACTERISTIC CrsCtrl_PIDCoeffFiltOvv_P "PID Filter Coefficient for Cruise Control - Override Value" VALUE 0x400405C4 /* @ECU_Address@CrsCtrl_PIDCoeffFiltOvv_P@ */ Scalar_FLOAT32_IEEE 0 EcuIntgdSwGend_CM_single 0.0 10000.0 /end CHARACTERISTIC
/begin CHARACTERISTIC CrsCtrl_PIDCoeffIOvv_P "PID Integrator Coefficient for Cruise Control - Override Value" VALUE 0x400405CC /* @ECU_Address@CrsCtrl_PIDCoeffIOvv_P@ */ Scalar_FLOAT32_IEEE 0 EcuIntgdSwGend_CM_single 0.0 10000.0 /end CHARACTERISTIC
/begin CHARACTERISTIC CrsCtrl_PIDCoeffPOvv_P "PID Proportional Coefficient for Cruise Control - Override Value" VALUE 0x400405D4 /* @ECU_Address@CrsCtrl_PIDCoeffPOvv_P@ */ Scalar_FLOAT32_IEEE 0 EcuIntgdSwGend_CM_single 0.0 10000.0 /end CHARACTERISTIC
/begin CHARACTERISTIC CrsCtrl_PIDMin_P "PID Minimum Parameter" VALUE 0x400405D8 /* @ECU_Address@CrsCtrl_PIDMin_P@ */ Scalar_FLOAT32_IEEE 0 EcuIntgdSwGend_CM_single_N_m -5000.0 0.0 /end CHARACTERISTIC
/begin CHARACTERISTIC DTqC_CoeffFiltKdSpdCtlOvv_P "Filter Coefficient Parameter for Speed Controller - Override Value" VALUE 0x400410AC /* @ECU_Address@DTqC_CoeffFiltKdSpdCtlOvv_P@ */ Scalar_FLOAT32_IEEE 0 EcuIntgdSwGend_CM_single 0.0 1000.0 /end CHARACTERISTIC
/begin CHARACTERISTIC DTqC_DrvrDmdPercTqSatMax_P "Driver Demand Percent Torque Max Saturation" VALUE 0x40041A18 /* @ECU_Address@DTqC_DrvrDmdPercTqSatMax_P@ */ Scalar_FLOAT32_IEEE 0 EcuIntgdSwGend_CM_single__ 0.0 150.0 /end CHARACTERISTIC
/begin CHARACTERISTIC DTqC_DrvrDmdPercTqSatMin_P "Driver Demand Percent Torque Min Saturation" VALUE 0x40041A1C /* @ECU_Address@DTqC_DrvrDmdPercTqSatMin_P@ */ Scalar_FLOAT32_IEEE 0 EcuIntgdSwGend_CM_single__ 0.0 150.0 /end CHARACTERISTIC
/begin CHARACTERISTIC DTqC_EngSpdPoint1_P "Engine Speed Point 1 Value" VALUE 0x40041A28 /* @ECU_Address@DTqC_EngSpdPoint1_P@ */ Scalar_FLOAT32_IEEE 0 EcuIntgdSwGend_CM_single_rpm 0.0 8031.0 /end CHARACTERISTIC
/begin CHARACTERISTIC DTqC_EngSpdPoint2_P "Engine Speed Point 2 Value" VALUE 0x40041A2C /* @ECU_Address@DTqC_EngSpdPoint2_P@ */ Scalar_FLOAT32_IEEE 0 EcuIntgdSwGend_CM_single_rpm 0.0 8031.0 /end CHARACTERISTIC
/begin CHARACTERISTIC DTqC_EngSpdPoint3_P "Engine Speed Point 3 Value" VALUE 0x40041A30 /* @ECU_Address@DTqC_EngSpdPoint3_P@ */ Scalar_FLOAT32_IEEE 0 EcuIntgdSwGend_CM_single_rpm 0.0 8031.0 /end CHARACTERISTIC
/begin CHARACTERISTIC DTqC_EngSpdPoint4_P "Engine Speed Point 4 Value" VALUE 0x40041A34 /* @ECU_Address@DTqC_EngSpdPoint4_P@ */ Scalar_FLOAT32_IEEE 0 EcuIntgdSwGend_CM_single_rpm 0.0 8031.0 /end CHARACTERISTIC
/begin CHARACTERISTIC DTqC_EngSpdPoint5_P "Engine Speed Point 5 Value" VALUE 0x40041A38 /* @ECU_Address@DTqC_EngSpdPoint5_P@ */ Scalar_FLOAT32_IEEE 0 EcuIntgdSwGend_CM_single_rpm 0.0 8031.0 /end CHARACTERISTIC
/begin CHARACTERISTIC DTqC_EngSpdPoint6_P "Engine Speed Point 6 Value" VALUE 0x40041A3C /* @ECU_Address@DTqC_EngSpdPoint6_P@ */ Scalar_FLOAT32_IEEE 0 EcuIntgdSwGend_CM_single_rpm 0.0 8031.0 /end CHARACTERISTIC
/begin CHARACTERISTIC DTqC_EngSpdPoint7_P "Engine Speed Point 7 Value" VALUE 0x40041A40 /* @ECU_Address@DTqC_EngSpdPoint7_P@ */ Scalar_FLOAT32_IEEE 0 EcuIntgdSwGend_CM_single_rpm 0.0 3000.0 /end CHARACTERISTIC
/begin CHARACTERISTIC DTqC_EngTqPoint1_P "Engine Torque Point 1" VALUE 0x40041A44 /* @ECU_Address@DTqC_EngTqPoint1_P@ */ Scalar_FLOAT32_IEEE 0 EcuIntgdSwGend_CM_single_N_m 0.0 3000.0 /end CHARACTERISTIC
/begin CHARACTERISTIC DTqC_EngTqPoint2_P "Engine Torque Point 2" VALUE 0x40041A48 /* @ECU_Address@DTqC_EngTqPoint2_P@ */ Scalar_FLOAT32_IEEE 0 EcuIntgdSwGend_CM_single_N_m 0.0 3000.0 /end CHARACTERISTIC
/begin CHARACTERISTIC DTqC_EngTqPoint3_P "Engine Torque Point 3" VALUE 0x40041A4C /* @ECU_Address@DTqC_EngTqPoint3_P@ */ Scalar_FLOAT32_IEEE 0 EcuIntgdSwGend_CM_single_N_m 0.0 3000.0 /end CHARACTERISTIC
/begin CHARACTERISTIC DTqC_EngTqPoint4_P "Engine Torque Point 4" VALUE 0x40041A50 /* @ECU_Address@DTqC_EngTqPoint4_P@ */ Scalar_FLOAT32_IEEE 0 EcuIntgdSwGend_CM_single_N_m 0.0 3000.0 /end CHARACTERISTIC
/begin CHARACTERISTIC DTqC_EngTqPoint5_P "Engine Torque Point 5" VALUE 0x40041A54 /* @ECU_Address@DTqC_EngTqPoint5_P@ */ Scalar_FLOAT32_IEEE 0 EcuIntgdSwGend_CM_single_N_m 0.0 3000.0 /end CHARACTERISTIC
/begin CHARACTERISTIC DTqC_FacSclPIDCoeff_P "Factor Scaling Parameter for PID" VALUE 0x40041A84 /* @ECU_Address@DTqC_FacSclPIDCoeff_P@ */ Scalar_FLOAT32_IEEE 0 EcuIntgdSwGend_CM_single 1.0 10000.0 /end CHARACTERISTIC
/begin CHARACTERISTIC DTqC_KdSpdCtlOvv_P "Derivative Coefficient Parameter for Speed Controller - Override Value" VALUE 0x40041C40 /* @ECU_Address@DTqC_KdSpdCtlOvv_P@ */ Scalar_FLOAT32_IEEE 0 EcuIntgdSwGend_CM_single 0.0 1000.0 /end CHARACTERISTIC
/begin CHARACTERISTIC DTqC_KiSpdCtlOvv_P "Integrator Coefficient Parameter for Speed Controller - Override Value" VALUE 0x40041C58 /* @ECU_Address@DTqC_KiSpdCtlOvv_P@ */ Scalar_FLOAT32_IEEE 0 EcuIntgdSwGend_CM_single 0.0 1000.0 /end CHARACTERISTIC
/begin CHARACTERISTIC DTqC_KpSpdCtlOvv_P "Proportional Coefficient Parameter for Speed Controller - Override Value" VALUE 0x40041C70 /* @ECU_Address@DTqC_KpSpdCtlOvv_P@ */ Scalar_FLOAT32_IEEE 0 EcuIntgdSwGend_CM_single 0.0 1000.0 /end CHARACTERISTIC
/begin CHARACTERISTIC DTqC_NEngHardLimActvnThdOffs_P "Hard Limit Activation Threshold Offset" VALUE 0x40041D78 /* @ECU_Address@DTqC_NEngHardLimActvnThdOffs_P@ */ Scalar_FLOAT32_IEEE 0 EcuIntgdSwGend_CM_single_rpm -3000.0 3000.0 /end CHARACTERISTIC
/begin CHARACTERISTIC DTqC_NEngHardLimDeacThdOffs_P "" VALUE 0x40041D7C /* @ECU_Address@DTqC_NEngHardLimDeacThdOffs_P@ */ Scalar_FLOAT32_IEEE 0 EcuIntgdSwGend_CM_single_rpm -3000.0 3000.0 /end CHARACTERISTIC
/begin CHARACTERISTIC DTqC_NEngSoftLimActvnThdOffs_P "Soft Limit Activation Threshold Offset" VALUE 0x40041DA4 /* @ECU_Address@DTqC_NEngSoftLimActvnThdOffs_P@ */ Scalar_FLOAT32_IEEE 0 EcuIntgdSwGend_CM_single_rpm -3000.0 3000.0 /end CHARACTERISTIC
/begin CHARACTERISTIC DTqC_NEngSoftLimAcvThd_P "" VALUE 0x40041DA8 /* @ECU_Address@DTqC_NEngSoftLimAcvThd_P@ */ Scalar_FLOAT32_IEEE 0 EcuIntgdSwGend_CM_single_rpm 0.0 3000.0 /end CHARACTERISTIC
/begin CHARACTERISTIC DTqC_NEngSoftLimDeacThdOffs_P "" VALUE 0x40041DAC /* @ECU_Address@DTqC_NEngSoftLimDeacThdOffs_P@ */ Scalar_FLOAT32_IEEE 0 EcuIntgdSwGend_CM_single_rpm -3000.0 3000.0 /end CHARACTERISTIC
/begin CHARACTERISTIC DTqC_PtoCtrlNEngMaxSpdHys_P "High Speed Governor PTO Engine Max Engine Speed Hysteresis" VALUE 0x40041EA4 /* @ECU_Address@DTqC_PtoCtrlNEngMaxSpdHys_P@ */ Scalar_FLOAT32_IEEE 0 EcuIntgdSwGend_CM_single_rpm -3000.0 3000.0 /end CHARACTERISTIC
/begin CHARACTERISTIC DTqC_RateLoLimForPTOAccrOvrd_P "Rate Limiter Lower Limit for PTO Accelerator Override" VALUE 0x40041EA8 /* @ECU_Address@DTqC_RateLoLimForPTOAccrOvrd_P@ */ Scalar_FLOAT32_IEEE 0 EcuIntgdSwGend_CM_single_N_m -10000.0 0.0 /end CHARACTERISTIC
/begin CHARACTERISTIC DTqC_RateUpLimForPTOAccrOvrd_P "Rate Limiter Upper Limit for PTO Accelerator Override" VALUE 0x40041EAC /* @ECU_Address@DTqC_RateUpLimForPTOAccrOvrd_P@ */ Scalar_FLOAT32_IEEE 0 EcuIntgdSwGend_CM_single_N_m 0.0 10000.0 /end CHARACTERISTIC
/begin CHARACTERISTIC DTqC_TiTrbChrgOilLeakgIdleRef_P "Time Threshold Parameter for Turbo Oil Leakage" VALUE 0x400420A8 /* @ECU_Address@DTqC_TiTrbChrgOilLeakgIdleRef_P@ */ Scalar_FLOAT32_IEEE 0 EcuIntgdSwGend_CM_single_ms 0.0 1.0E+6 /end CHARACTERISTIC
/begin CHARACTERISTIC DTqC_TqDesSatPIDMin_P "Idle PID Controller Saturation Min Value" VALUE 0x40043398 /* @ECU_Address@DTqC_TqDesSatPIDMin_P@ */ Scalar_FLOAT32_IEEE 0 EcuIntgdSwGend_CM_single_N_m -1000.0 10000.0 /end CHARACTERISTIC
/begin CHARACTERISTIC DTqC_VehVAcvnTrbChrgOilLeakg_P "Turbo Charger Oil Leakage Activation Threshold According to Vehicle Speed" VALUE 0x40044050 /* @ECU_Address@DTqC_VehVAcvnTrbChrgOilLeakg_P@ */ Scalar_FLOAT32_IEEE 0 EcuIntgdSwGend_CM_single_km_h 0.0 200.0 /end CHARACTERISTIC
/begin CHARACTERISTIC EIP_CanEngReqTqHiReslFromTcuOvv_P "Engine Requested Torque - High Resolution From Tcu- Override Value" VALUE 0x400440DC /* @ECU_Address@EIP_CanEngReqTqHiReslFromTcuOvv_P@ */ Scalar_FLOAT32_IEEE 0 EcuIntgdSwGend_CM_single__ 0.0 0.875 /end CHARACTERISTIC
/begin CHARACTERISTIC EIP_CanEngRtdrSelnOvv_P "SPN 973 - Engine Retarder Selection - Override Value" VALUE 0x400440E4 /* @ECU_Address@EIP_CanEngRtdrSelnOvv_P@ */ Scalar_FLOAT32_IEEE 0 EcuIntgdSwGend_CM_single__ 0.0 100.0 /end CHARACTERISTIC
/begin CHARACTERISTIC EIP_CanEngSpdReqFromTcuOvv_P "Engine Requested Speed/Speed Limit - Override Value" VALUE 0x400440EC /* @ECU_Address@EIP_CanEngSpdReqFromTcuOvv_P@ */ Scalar_FLOAT32_IEEE 0 EcuIntgdSwGend_CM_single_rpm 0.0 8100.0 /end CHARACTERISTIC
/begin CHARACTERISTIC EIP_CanFuLvl1Ovv_P "Fuel Level 1 - Override Value" VALUE 0x4004410C /* @ECU_Address@EIP_CanFuLvl1Ovv_P@ */ Scalar_FLOAT32_IEEE 0 EcuIntgdSwGend_CM_single__ 0.0 100.0 /end CHARACTERISTIC
/begin CHARACTERISTIC EIP_CanTrsmActGearRatOvv_P "Transmission Actual Gear Ratio - Override Value" VALUE 0x40044130 /* @ECU_Address@EIP_CanTrsmActGearRatOvv_P@ */ Scalar_FLOAT32_IEEE 0 EcuIntgdSwGend_CM_single 0.0 64255.0 /end CHARACTERISTIC
/begin CHARACTERISTIC EIP_CanTrsmOutpShaftSpdOvv_P "Transmission Output Shaft Speed - Override Value" VALUE 0x4004414C /* @ECU_Address@EIP_CanTrsmOutpShaftSpdOvv_P@ */ Scalar_FLOAT32_IEEE 0 EcuIntgdSwGend_CM_single_rpm 0.0 8100.0 /end CHARACTERISTIC
/begin CHARACTERISTIC EIP_CanTrsmTqCnvrRatOvv_P "Transmission Torque Converter Ratio - Override Value" VALUE 0x40044160 /* @ECU_Address@EIP_CanTrsmTqCnvrRatOvv_P@ */ Scalar_FLOAT32_IEEE 0 EcuIntgdSwGend_CM_single 0.0 64255.0 /end CHARACTERISTIC
/begin CHARACTERISTIC EIP_CanTrsmTqLimOvv_P "Engine Input Processing - SPN 1845 - Transmission Torque Limit - Override Value" VALUE 0x40044168 /* @ECU_Address@EIP_CanTrsmTqLimOvv_P@ */ Scalar_FLOAT32_IEEE 0 EcuIntgdSwGend_CM_single_N_m 0.0 64255.0 /end CHARACTERISTIC
/begin CHARACTERISTIC EIP_NrErrCylMisfRedn_P "Cylinder Misfire Error Count Number for Torque Reduction Parameter" VALUE 0x400442D4 /* @ECU_Address@EIP_NrErrCylMisfRedn_P@ */ Scalar_FLOAT32_IEEE 0 EcuIntgdSwGend_CM_single 0.0 15.0 /end CHARACTERISTIC
/begin CHARACTERISTIC EIP_NrErrCylMisfShtdwn_P "Cylinder Misfire Error Count Number for Shutdown Parameter" VALUE 0x400442D8 /* @ECU_Address@EIP_NrErrCylMisfShtdwn_P@ */ Scalar_FLOAT32_IEEE 0 EcuIntgdSwGend_CM_single 0.0 15.0 /end CHARACTERISTIC
/begin CHARACTERISTIC EIP_NrErrCylMisfWarn_P "Cylinder Misfire Error Count Number for Warning Parameter" VALUE 0x400442DC /* @ECU_Address@EIP_NrErrCylMisfWarn_P@ */ Scalar_FLOAT32_IEEE 0 EcuIntgdSwGend_CM_single 0.0 15.0 /end CHARACTERISTIC
/begin CHARACTERISTIC EIP_NrErrInjrShtdwn_P "Injection Error Count Number for Shutdown Parameter" VALUE 0x400442E0 /* @ECU_Address@EIP_NrErrInjrShtdwn_P@ */ Scalar_FLOAT32_IEEE 0 EcuIntgdSwGend_CM_single 0.0 8.0 /end CHARACTERISTIC
/begin CHARACTERISTIC EIP_TiAcvErrCylMisfRednDeb_P "Debouncer Time for Error Cylinder Misfire Reduction Active Parameter" VALUE 0x4004469C /* @ECU_Address@EIP_TiAcvErrCylMisfRednDeb_P@ */ Scalar_FLOAT32_IEEE 0 EcuIntgdSwGend_CM_single_ms 0.0 250000.0 /end CHARACTERISTIC
/begin CHARACTERISTIC EIP_TiAcvErrCylMisfShtdwnDeb_P "Debouncer Time for Error Cylinder Misfire Shutdown Active Parameter" VALUE 0x400446A0 /* @ECU_Address@EIP_TiAcvErrCylMisfShtdwnDeb_P@ */ Scalar_FLOAT32_IEEE 0 EcuIntgdSwGend_CM_single_ms 0.0 250000.0 /end CHARACTERISTIC
/begin CHARACTERISTIC EIP_TiAcvErrCylMisfWarnDeb_P "Debouncer Time for Error Cylinder Misfire Warning Active Parameter" VALUE 0x400446A4 /* @ECU_Address@EIP_TiAcvErrCylMisfWarnDeb_P@ */ Scalar_FLOAT32_IEEE 0 EcuIntgdSwGend_CM_single_ms 0.0 250000.0 /end CHARACTERISTIC
/begin CHARACTERISTIC EIP_TiAcvErrInjrShtdwnDeb_P "Debouncer Time for Error Injection Shutdown Active Parameter" VALUE 0x400446A8 /* @ECU_Address@EIP_TiAcvErrInjrShtdwnDeb_P@ */ Scalar_FLOAT32_IEEE 0 EcuIntgdSwGend_CM_single_ms 0.0 250000.0 /end CHARACTERISTIC
/begin CHARACTERISTIC EIP_TiIdleModDeb_P "Debouncer Time for Idle Mode Parameter" VALUE 0x400446CC /* @ECU_Address@EIP_TiIdleModDeb_P@ */ Scalar_FLOAT32_IEEE 0 EcuIntgdSwGend_CM_single_ms 0.0 5000.0 /end CHARACTERISTIC
/begin CHARACTERISTIC TL_DynRateLoLim_P "Dynamic Rate Limiter Low Limit Parameter" VALUE 0x4004B634 /* @ECU_Address@TL_DynRateLoLim_P@ */ Scalar_FLOAT32_IEEE 0 EcuIntgdSwGend_CM_single -10000.0 0.0 /end CHARACTERISTIC
/begin CHARACTERISTIC TL_DynRateUpLim_P "Dynamic Rate Limiter Up Limit Parameter" VALUE 0x4004B638 /* @ECU_Address@TL_DynRateUpLim_P@ */ Scalar_FLOAT32_IEEE 0 EcuIntgdSwGend_CM_single 0.0 10000.0 /end CHARACTERISTIC
/begin CHARACTERISTIC TL_TqLimdForNExhTrbChrgOvv_P "Limited Torque Value of Turbo Charger Speed - Override Value" VALUE 0x4004C48C /* @ECU_Address@TL_TqLimdForNExhTrbChrgOvv_P@ */ Scalar_FLOAT32_IEEE 0 EcuIntgdSwGend_CM_single_N_m 0.0 5000.0 /end CHARACTERISTIC
/begin CHARACTERISTIC TL_TqLimdForPAirAmbOvv_P "Limited Torque Value of Ambient Air Pressure - Override Value" VALUE 0x4004C494 /* @ECU_Address@TL_TqLimdForPAirAmbOvv_P@ */ Scalar_FLOAT32_IEEE 0 EcuIntgdSwGend_CM_single_N_m 0.0 5000.0 /end CHARACTERISTIC
/begin CHARACTERISTIC TL_TqLimdForPAirBoostOvv_P "Limited Torque Value of Air Boost Pressure - Override Value" VALUE 0x4004C49C /* @ECU_Address@TL_TqLimdForPAirBoostOvv_P@ */ Scalar_FLOAT32_IEEE 0 EcuIntgdSwGend_CM_single_N_m 0.0 5000.0 /end CHARACTERISTIC
/begin CHARACTERISTIC TL_TqLimdForSurgeOvv_P "Limited Torque Value of Surge Protection - Override Value" VALUE 0x4004C4A4 /* @ECU_Address@TL_TqLimdForSurgeOvv_P@ */ Scalar_FLOAT32_IEEE 0 EcuIntgdSwGend_CM_single_N_m 0.0 10000.0 /end CHARACTERISTIC
/begin CHARACTERISTIC TL_TqLimdForTAirOvv_P "Limited Torque Value of Air Boost Temperature - Override Value" VALUE 0x4004C4AC /* @ECU_Address@TL_TqLimdForTAirOvv_P@ */ Scalar_FLOAT32_IEEE 0 EcuIntgdSwGend_CM_single_N_m 0.0 5000.0 /end CHARACTERISTIC
/begin CHARACTERISTIC TL_TqLimdForTCooltOvv_P "Limited Torque Value of Coolant High Temperature - Override Value" VALUE 0x4004C4B4 /* @ECU_Address@TL_TqLimdForTCooltOvv_P@ */ Scalar_FLOAT32_IEEE 0 EcuIntgdSwGend_CM_single_N_m 0.0 5000.0 /end CHARACTERISTIC
/begin CHARACTERISTIC TL_TqLimdForTFuOvv_P "Limited Torque Value of Fuel Temperature - Override Value" VALUE 0x4004C4BC /* @ECU_Address@TL_TqLimdForTFuOvv_P@ */ Scalar_FLOAT32_IEEE 0 EcuIntgdSwGend_CM_single_N_m 0.0 5000.0 /end CHARACTERISTIC
/begin CHARACTERISTIC TL_TqLimdForTOilOvv_P "Limited Torque Value of Oil Temperature - Override Value" VALUE 0x4004C4C4 /* @ECU_Address@TL_TqLimdForTOilOvv_P@ */ Scalar_FLOAT32_IEEE 0 EcuIntgdSwGend_CM_single_N_m 0.0 5000.0 /end CHARACTERISTIC
/begin CHARACTERISTIC TL_TqMapLimdEngProtnOvv_P "Map Based Torque Limitation - Override Value" VALUE 0x4004C6BC /* @ECU_Address@TL_TqMapLimdEngProtnOvv_P@ */ Scalar_FLOAT32_IEEE 0 EcuIntgdSwGend_CM_single_N_m 0.0 5000.0 /end CHARACTERISTIC
/begin CHARACTERISTIC TL_TqRednLvL1_P "Reduction Factor For Level 1 " VALUE 0x4004C6DC /* @ECU_Address@TL_TqRednLvL1_P@ */ Scalar_FLOAT32_IEEE 0 EcuIntgdSwGend_CM_single 0.0 1.0 /end CHARACTERISTIC
/begin CHARACTERISTIC TL_TqRednLvl2_P "Reduction Factor For Level 2" VALUE 0x4004C6E0 /* @ECU_Address@TL_TqRednLvl2_P@ */ Scalar_FLOAT32_IEEE 0 EcuIntgdSwGend_CM_single 0.0 1.0 /end CHARACTERISTIC
/begin CHARACTERISTIC TrC_MMaiFuQntyOvv_P "Main Fuel Quantity - Override Value" VALUE 0x4004EC6C /* @ECU_Address@TrC_MMaiFuQntyOvv_P@ */ Scalar_FLOAT32_IEEE 0 EcuIntgdSwGend_CM_single_mm_3_stk 0.0 1000.0 /end CHARACTERISTIC
/begin CHARACTERISTIC TrC_MPltFuQntyOvv_P "Pilot Fuel Quantity - Override Value" VALUE 0x4004F534 /* @ECU_Address@TrC_MPltFuQntyOvv_P@ */ Scalar_FLOAT32_IEEE 0 EcuIntgdSwGend_CM_single_mm_3_stk 0.0 1000.0 /end CHARACTERISTIC
/begin CHARACTERISTIC TrC_RatAirFuMax_P "Air Fuel Rate Max Threshold" VALUE 0x4005094C /* @ECU_Address@TrC_RatAirFuMax_P@ */ Scalar_FLOAT32_IEEE 0 EcuIntgdSwGend_CM_single 0.0 100.0 /end CHARACTERISTIC
/begin CHARACTERISTIC TrC_RatAirFuMin_P "Air Fuel Rate Min Threshold" VALUE 0x40050950 /* @ECU_Address@TrC_RatAirFuMin_P@ */ Scalar_FLOAT32_IEEE 0 EcuIntgdSwGend_CM_single 0.0 100.0 /end CHARACTERISTIC
/begin CHARACTERISTIC TrC_TCooltMap1Thd_P "Coolant High Temperature Threshold for Quantity Map 1" VALUE 0x40050AE8 /* @ECU_Address@TrC_TCooltMap1Thd_P@ */ Scalar_FLOAT32_IEEE 0 EcuIntgdSwGend_CM_single_degC -40.0 250.0 /end CHARACTERISTIC
/begin CHARACTERISTIC TrC_TCooltMap2Thd_P "Coolant High Temperature Threshold for Quantity Map 2" VALUE 0x40050AEC /* @ECU_Address@TrC_TCooltMap2Thd_P@ */ Scalar_FLOAT32_IEEE 0 EcuIntgdSwGend_CM_single_degC -40.0 250.0 /end CHARACTERISTIC
/begin CHARACTERISTIC TrC_TCooltMap3Thd_P "Coolant High Temperature Threshold for Quantity Map 3" VALUE 0x40050AF0 /* @ECU_Address@TrC_TCooltMap3Thd_P@ */ Scalar_FLOAT32_IEEE 0 EcuIntgdSwGend_CM_single_degC -40.0 250.0 /end CHARACTERISTIC
/begin CHARACTERISTIC WgC_DutyVlvOvv_P "Duty Valve - Override Value Parameter" VALUE 0x40051878 /* @ECU_Address@WgC_DutyVlvOvv_P@ */ Scalar_FLOAT32_IEEE 0 EcuIntgdSwGend_CM_single__ 0.0 100.0 /end CHARACTERISTIC
/begin CHARACTERISTIC EIP_CanEngTqReqFromAbsAscOvv_P "Engine Requested Torque/Torque Limit From Abs Asc - Override Value" VALUE 0x400440FA /* @ECU_Address@EIP_CanEngTqReqFromAbsAscOvv_P@ */ Scalar_SWORD 0 EcuIntgdSwGend_CM_int16 -125.0 125.0 /end CHARACTERISTIC
/begin CHARACTERISTIC EIP_CanEngTqReqFromTcuOvv_P "Engine Requested Torque/Torque Limit From Tcu - Override Value" VALUE 0x400440FE /* @ECU_Address@EIP_CanEngTqReqFromTcuOvv_P@ */ Scalar_SWORD 0 EcuIntgdSwGend_CM_int16__ -125.0 125.0 /end CHARACTERISTIC
/begin CHARACTERISTIC EIP_CanTachographVehSpdOvv_P "Tachograph Vehicle Speed - Override Value" VALUE 0x40044122 /* @ECU_Address@EIP_CanTachographVehSpdOvv_P@ */ Scalar_SWORD 0 EcuIntgdSwGend_CM_int16_km_h 0.0 251.0 /end CHARACTERISTIC
/begin CHARACTERISTIC EIP_CanTrsmCurrentGearOvv_P "Transmission Current Gear - Override Value" VALUE 0x40044136 /* @ECU_Address@EIP_CanTrsmCurrentGearOvv_P@ */ Scalar_SWORD 0 EcuIntgdSwGend_CM_int16 -125.0 251.0 /end CHARACTERISTIC
/begin CHARACTERISTIC EIP_CanTrsmSeldGearOvv_P "Transmission Selected Gear - Override Value" VALUE 0x40044152 /* @ECU_Address@EIP_CanTrsmSeldGearOvv_P@ */ Scalar_SWORD 0 EcuIntgdSwGend_CM_int16 -125.0 251.0 /end CHARACTERISTIC
/begin CHARACTERISTIC EIP_CanWhlBasVehSpdOvv_P "Wheel Based Vehicle Speed - Override Value" VALUE 0x40044186 /* @ECU_Address@EIP_CanWhlBasVehSpdOvv_P@ */ Scalar_SWORD 0 EcuIntgdSwGend_CM_int16_km_h 0.0 251.0 /end CHARACTERISTIC
/begin CHARACTERISTIC CrsCtrl_PIDCoeffDOvs_P "PID Derivative Coefficient for Cruise Control - Override Switch" VALUE 0x400405B8 /* @ECU_Address@CrsCtrl_PIDCoeffDOvs_P@ */ Scalar_BOOLEAN 0 EcuIntgdSwGend_CM_boolean 0.0 1.0 /end CHARACTERISTIC
/begin CHARACTERISTIC CrsCtrl_PIDCoeffFiltOvs_P "PID Filter Coefficient for Cruise Control - Override Switch" VALUE 0x400405C0 /* @ECU_Address@CrsCtrl_PIDCoeffFiltOvs_P@ */ Scalar_BOOLEAN 0 EcuIntgdSwGend_CM_boolean 0.0 1.0 /end CHARACTERISTIC
/begin CHARACTERISTIC CrsCtrl_PIDCoeffIOvs_P "PID Integrator Coefficient for Cruise Control - Override Switch" VALUE 0x400405C8 /* @ECU_Address@CrsCtrl_PIDCoeffIOvs_P@ */ Scalar_BOOLEAN 0 EcuIntgdSwGend_CM_boolean 0.0 1.0 /end CHARACTERISTIC
/begin CHARACTERISTIC CrsCtrl_PIDCoeffPOvs_P "PID Proportional Coefficient for Cruise Control - Override Switch" VALUE 0x400405D0 /* @ECU_Address@CrsCtrl_PIDCoeffPOvs_P@ */ Scalar_BOOLEAN 0 EcuIntgdSwGend_CM_boolean 0.0 1.0 /end CHARACTERISTIC
/begin CHARACTERISTIC DTqC_AccrPedlOvrdForCrsCtrl_P "Accelerator Pedal Override Parameter For Cruise Control" VALUE 0x40040730 /* @ECU_Address@DTqC_AccrPedlOvrdForCrsCtrl_P@ */ Scalar_BOOLEAN 0 EcuIntgdSwGend_CM_boolean 0.0 1.0 /end CHARACTERISTIC
/begin CHARACTERISTIC DTqC_AccrPedlOvrdForPto_P "Accelerator Pedal Override Parameter For Pto Control" VALUE 0x40040734 /* @ECU_Address@DTqC_AccrPedlOvrdForPto_P@ */ Scalar_BOOLEAN 0 EcuIntgdSwGend_CM_boolean 0.0 1.0 /end CHARACTERISTIC
/begin CHARACTERISTIC DTqC_CoeffFiltKdSpdCtlOvs_P "Filter Coefficient Parameter for Speed Controller - Override Switch" VALUE 0x400410A8 /* @ECU_Address@DTqC_CoeffFiltKdSpdCtlOvs_P@ */ Scalar_BOOLEAN 0 EcuIntgdSwGend_CM_boolean 0.0 1.0 /end CHARACTERISTIC
/begin CHARACTERISTIC DTqC_KdSpdCtlOvs_P "Derivative Coefficient Parameter for Speed Controller - Override Switch" VALUE 0x40041C3C /* @ECU_Address@DTqC_KdSpdCtlOvs_P@ */ Scalar_BOOLEAN 0 EcuIntgdSwGend_CM_boolean 0.0 1.0 /end CHARACTERISTIC
/begin CHARACTERISTIC DTqC_KiSpdCtlOvs_P "Integrator Coefficient Parameter for Speed Controller - Override Switch" VALUE 0x40041C54 /* @ECU_Address@DTqC_KiSpdCtlOvs_P@ */ Scalar_BOOLEAN 0 EcuIntgdSwGend_CM_boolean 0.0 1.0 /end CHARACTERISTIC
/begin CHARACTERISTIC DTqC_KpSpdCtlOvs_P "Proportional Coefficient Parameter for Speed Controller - Override Switch" VALUE 0x40041C6C /* @ECU_Address@DTqC_KpSpdCtlOvs_P@ */ Scalar_BOOLEAN 0 EcuIntgdSwGend_CM_boolean 0.0 1.0 /end CHARACTERISTIC
/begin CHARACTERISTIC EIP_CanABSActvOvs_P "Anti-Lock Braking (ABS) Active - Override Switch" VALUE 0x40044060 /* @ECU_Address@EIP_CanABSActvOvs_P@ */ Scalar_BOOLEAN 0 EcuIntgdSwGend_CM_boolean 0.0 1.0 /end CHARACTERISTIC
/begin CHARACTERISTIC EIP_CanASRBrkCtrlActvOvs_P "ASR Brake Control Active - Override Switch" VALUE 0x40044068 /* @ECU_Address@EIP_CanASRBrkCtrlActvOvs_P@ */ Scalar_BOOLEAN 0 EcuIntgdSwGend_CM_boolean 0.0 1.0 /end CHARACTERISTIC
/begin CHARACTERISTIC EIP_CanASREngCtrlActvOvs_P "ASR Engine Control Active - Override Switch" VALUE 0x40044070 /* @ECU_Address@EIP_CanASREngCtrlActvOvs_P@ */ Scalar_BOOLEAN 0 EcuIntgdSwGend_CM_boolean 0.0 1.0 /end CHARACTERISTIC
/begin CHARACTERISTIC EIP_CanCrsCtrlEnaSwtOvs_P "Cruise Control Enable Switch Override Switch Parameter" VALUE 0x40044078 /* @ECU_Address@EIP_CanCrsCtrlEnaSwtOvs_P@ */ Scalar_BOOLEAN 0 EcuIntgdSwGend_CM_boolean 0.0 1.0 /end CHARACTERISTIC
/begin CHARACTERISTIC EIP_CanCrsCtrlResuSwtOvs_P "Cruise Control Resume Switch From CAN Override Switch Parameter" VALUE 0x40044080 /* @ECU_Address@EIP_CanCrsCtrlResuSwtOvs_P@ */ Scalar_BOOLEAN 0 EcuIntgdSwGend_CM_boolean 0.0 1.0 /end CHARACTERISTIC
/begin CHARACTERISTIC EIP_CanCrsCtrlSetSwtOvs_P "Cruise Control Set Switch From CAN Override Switch Parameter" VALUE 0x40044088 /* @ECU_Address@EIP_CanCrsCtrlSetSwtOvs_P@ */ Scalar_BOOLEAN 0 EcuIntgdSwGend_CM_boolean 0.0 1.0 /end CHARACTERISTIC
/begin CHARACTERISTIC EIP_CanEngAuxShtdwnSwtOvs_P "Engine Auxiliary Shutdown Switch - Override Switch" VALUE 0x40044090 /* @ECU_Address@EIP_CanEngAuxShtdwnSwtOvs_P@ */ Scalar_BOOLEAN 0 EcuIntgdSwGend_CM_boolean 0.0 1.0 /end CHARACTERISTIC
/begin CHARACTERISTIC EIP_CanEngOvrdCtrlModFromAbsAscOvs_P "Engine Override Control Mode From Abs Asc - Override Switch Parameter" VALUE 0x40044098 /* @ECU_Address@EIP_CanEngOvrdCtrlModFromAbsAscOvs_P@ */ Scalar_BOOLEAN 0 EcuIntgdSwGend_CM_boolean 0.0 1.0 /end CHARACTERISTIC
/begin CHARACTERISTIC EIP_CanEngOvrdCtrlModFromTcuOvs_P "Engine Override Control Mode From Tcu - Override Switch Parameter" VALUE 0x400440A0 /* @ECU_Address@EIP_CanEngOvrdCtrlModFromTcuOvs_P@ */ Scalar_BOOLEAN 0 EcuIntgdSwGend_CM_boolean 0.0 1.0 /end CHARACTERISTIC
/begin CHARACTERISTIC EIP_CanEngPtoGovrEnaSwtOvs_P "CAN Pto Governor - Enable Switch - Override Switch Parameter" VALUE 0x400440B8 /* @ECU_Address@EIP_CanEngPtoGovrEnaSwtOvs_P@ */ Scalar_BOOLEAN 0 EcuIntgdSwGend_CM_boolean 0.0 1.0 /end CHARACTERISTIC
/begin CHARACTERISTIC EIP_CanEngRemPtoGovrProgdSpdCtrlSwtOvs_P "CAN Pto Governor - Programmed Speed Control Switch - Override Switch Parameter" VALUE 0x400440D0 /* @ECU_Address@EIP_CanEngRemPtoGovrProgdSpdCtrlSwtOvs_P@ */ Scalar_BOOLEAN 0 EcuIntgdSwGend_CM_boolean 0.0 1.0 /end CHARACTERISTIC
/begin CHARACTERISTIC EIP_CanEngReqTqHiReslFromTcuOvs_P "Engine Requested Torque - High Resolution From Tcu- Override Switch" VALUE 0x400440D8 /* @ECU_Address@EIP_CanEngReqTqHiReslFromTcuOvs_P@ */ Scalar_BOOLEAN 0 EcuIntgdSwGend_CM_boolean 0.0 1.0 /end CHARACTERISTIC
/begin CHARACTERISTIC EIP_CanEngRtdrSelnOvs_P "SPN 973 - Engine Retarder Selection - Override Switch" VALUE 0x400440E0 /* @ECU_Address@EIP_CanEngRtdrSelnOvs_P@ */ Scalar_BOOLEAN 0 EcuIntgdSwGend_CM_boolean 0.0 1.0 /end CHARACTERISTIC
/begin CHARACTERISTIC EIP_CanEngSpdReqFromTcuOvs_P "Engine Requested Speed/Speed Limit - Override Switch" VALUE 0x400440E8 /* @ECU_Address@EIP_CanEngSpdReqFromTcuOvs_P@ */ Scalar_BOOLEAN 0 EcuIntgdSwGend_CM_boolean 0.0 1.0 /end CHARACTERISTIC
/begin CHARACTERISTIC EIP_CanEngTqLimReqMaxCntnsOvs_P "Engine Torque Limit Request - Maximum Continuous - Override Switch" VALUE 0x400440F0 /* @ECU_Address@EIP_CanEngTqLimReqMaxCntnsOvs_P@ */ Scalar_BOOLEAN 0 EcuIntgdSwGend_CM_boolean 0.0 1.0 /end CHARACTERISTIC
/begin CHARACTERISTIC EIP_CanEngTqReqFromAbsAscOvs_P "Engine Requested Torque/Torque Limit From Abs Asc - Override Switch" VALUE 0x400440F8 /* @ECU_Address@EIP_CanEngTqReqFromAbsAscOvs_P@ */ Scalar_BOOLEAN 0 EcuIntgdSwGend_CM_boolean 0.0 1.0 /end CHARACTERISTIC
/begin CHARACTERISTIC EIP_CanEngTqReqFromTcuOvs_P "Engine Requested Torque/Torque Limit From Tcu - Override Switch" VALUE 0x400440FC /* @ECU_Address@EIP_CanEngTqReqFromTcuOvs_P@ */ Scalar_BOOLEAN 0 EcuIntgdSwGend_CM_boolean 0.0 1.0 /end CHARACTERISTIC
/begin CHARACTERISTIC EIP_CanEstimdEngParasiticTqOvs_P "Estimated Engine Parasitic Losses - Override Switch" VALUE 0x40044100 /* @ECU_Address@EIP_CanEstimdEngParasiticTqOvs_P@ */ Scalar_BOOLEAN 0 EcuIntgdSwGend_CM_boolean 0.0 1.0 /end CHARACTERISTIC
/begin CHARACTERISTIC EIP_CanFuLvl1Ovs_P "Fuel Level 1 - Override Switch" VALUE 0x40044108 /* @ECU_Address@EIP_CanFuLvl1Ovs_P@ */ Scalar_BOOLEAN 0 EcuIntgdSwGend_CM_boolean 0.0 1.0 /end CHARACTERISTIC
/begin CHARACTERISTIC EIP_CanOvrdCtrlModPrioFromAbsAscOvs_P "Override Control Mode Priority From Abs Asc - Override Switch" VALUE 0x40044110 /* @ECU_Address@EIP_CanOvrdCtrlModPrioFromAbsAscOvs_P@ */ Scalar_BOOLEAN 0 EcuIntgdSwGend_CM_boolean 0.0 1.0 /end CHARACTERISTIC
/begin CHARACTERISTIC EIP_CanOvrdCtrlModPrioFromTcuOvs_P "Override Control Mode Priority From Tcu - Override Switch" VALUE 0x40044118 /* @ECU_Address@EIP_CanOvrdCtrlModPrioFromTcuOvs_P@ */ Scalar_BOOLEAN 0 EcuIntgdSwGend_CM_boolean 0.0 1.0 /end CHARACTERISTIC
/begin CHARACTERISTIC EIP_CanTachographVehSpdOvs_P "Tachograph Vehicle Speed - Override Switch" VALUE 0x40044120 /* @ECU_Address@EIP_CanTachographVehSpdOvs_P@ */ Scalar_BOOLEAN 0 EcuIntgdSwGend_CM_boolean 0.0 1.0 /end CHARACTERISTIC
/begin CHARACTERISTIC EIP_CanTrfCaseStsOvs_P "Transfer case status - Override Switch" VALUE 0x40044124 /* @ECU_Address@EIP_CanTrfCaseStsOvs_P@ */ Scalar_BOOLEAN 0 EcuIntgdSwGend_CM_boolean 0.0 1.0 /end CHARACTERISTIC
/begin CHARACTERISTIC EIP_CanTrsmActGearRatOvs_P "Transmission Actual Gear Ratio - Override Switch" VALUE 0x4004412C /* @ECU_Address@EIP_CanTrsmActGearRatOvs_P@ */ Scalar_BOOLEAN 0 EcuIntgdSwGend_CM_boolean 0.0 1.0 /end CHARACTERISTIC
/begin CHARACTERISTIC EIP_CanTrsmCurrentGearOvs_P "Transmission Current Gear - Override Switch" VALUE 0x40044134 /* @ECU_Address@EIP_CanTrsmCurrentGearOvs_P@ */ Scalar_BOOLEAN 0 EcuIntgdSwGend_CM_boolean 0.0 1.0 /end CHARACTERISTIC
/begin CHARACTERISTIC EIP_CanTrsmEngCrkEnaOvs_P "Transmission Engine Crank Enable - Override Switch" VALUE 0x40044138 /* @ECU_Address@EIP_CanTrsmEngCrkEnaOvs_P@ */ Scalar_BOOLEAN 0 EcuIntgdSwGend_CM_boolean 0.0 1.0 /end CHARACTERISTIC
/begin CHARACTERISTIC EIP_CanTrsmOilLvlReqOvs_P "Transmission Oil Level Request - Override Switch" VALUE 0x40044140 /* @ECU_Address@EIP_CanTrsmOilLvlReqOvs_P@ */ Scalar_BOOLEAN 0 EcuIntgdSwGend_CM_boolean 0.0 1.0 /end CHARACTERISTIC
/begin CHARACTERISTIC EIP_CanTrsmOutpShaftSpdOvs_P "Transmission Output Shaft Speed - Override Switch" VALUE 0x40044148 /* @ECU_Address@EIP_CanTrsmOutpShaftSpdOvs_P@ */ Scalar_BOOLEAN 0 EcuIntgdSwGend_CM_boolean 0.0 1.0 /end CHARACTERISTIC
/begin CHARACTERISTIC EIP_CanTrsmSeldGearOvs_P "Transmission Selected Gear - Override Switch" VALUE 0x40044150 /* @ECU_Address@EIP_CanTrsmSeldGearOvs_P@ */ Scalar_BOOLEAN 0 EcuIntgdSwGend_CM_boolean 0.0 1.0 /end CHARACTERISTIC
/begin CHARACTERISTIC EIP_CanTrsmTqCnvLockUpEngdOvs_P "Transmission Torque Converter Lockup Engaged - Override Switch" VALUE 0x40044154 /* @ECU_Address@EIP_CanTrsmTqCnvLockUpEngdOvs_P@ */ Scalar_BOOLEAN 0 EcuIntgdSwGend_CM_boolean 0.0 1.0 /end CHARACTERISTIC
/begin CHARACTERISTIC EIP_CanTrsmTqCnvrRatOvs_P "Transmission Torque Converter Ratio - Override Switch" VALUE 0x4004415C /* @ECU_Address@EIP_CanTrsmTqCnvrRatOvs_P@ */ Scalar_BOOLEAN 0 EcuIntgdSwGend_CM_boolean 0.0 1.0 /end CHARACTERISTIC
/begin CHARACTERISTIC EIP_CanTrsmTqLimOvs_P "Engine Input Processing - SPN 1845 - Transmission Torque Limit - Override Switch" VALUE 0x40044164 /* @ECU_Address@EIP_CanTrsmTqLimOvs_P@ */ Scalar_BOOLEAN 0 EcuIntgdSwGend_CM_boolean 0.0 1.0 /end CHARACTERISTIC
/begin CHARACTERISTIC EIP_CanVehLimSpdGovrDecSwtOvs_P "Vehicle Limiting Speed Governor Increment Switch Override Switch Parameter" VALUE 0x4004416C /* @ECU_Address@EIP_CanVehLimSpdGovrDecSwtOvs_P@ */ Scalar_BOOLEAN 0 EcuIntgdSwGend_CM_boolean 0.0 1.0 /end CHARACTERISTIC
/begin CHARACTERISTIC EIP_CanVehLimSpdGovrEnaSwtOvs_P "Vehicle Limiting Speed Governor Enable Switch Override Switch Parameter" VALUE 0x40044174 /* @ECU_Address@EIP_CanVehLimSpdGovrEnaSwtOvs_P@ */ Scalar_BOOLEAN 0 EcuIntgdSwGend_CM_boolean 0.0 1.0 /end CHARACTERISTIC
/begin CHARACTERISTIC EIP_CanVehLimSpdGovrInctSwtOvs_P "Vehicle Limiting Speed Governor Decrement Switch Override Switch Parameter" VALUE 0x4004417C /* @ECU_Address@EIP_CanVehLimSpdGovrInctSwtOvs_P@ */ Scalar_BOOLEAN 0 EcuIntgdSwGend_CM_boolean 0.0 1.0 /end CHARACTERISTIC
/begin CHARACTERISTIC EIP_CanWhlBasVehSpdOvs_P "Wheel Based Vehicle Speed - Override Switch" VALUE 0x40044184 /* @ECU_Address@EIP_CanWhlBasVehSpdOvs_P@ */ Scalar_BOOLEAN 0 EcuIntgdSwGend_CM_boolean 0.0 1.0 /end CHARACTERISTIC
/begin CHARACTERISTIC EIP_StOfCanABSActvOvs_P "Engine Input Processing State Of Anti-Lock Braking (ABS) Active Override Switch Parameter" VALUE 0x400443B4 /* @ECU_Address@EIP_StOfCanABSActvOvs_P@ */ Scalar_BOOLEAN 0 EcuIntgdSwGend_CM_boolean 0.0 1.0 /end CHARACTERISTIC
/begin CHARACTERISTIC EIP_StOfCanABSActvOvv_P "Engine Input Processing State Of Anti-Lock Braking (ABS) Active Override Value Parameter" VALUE 0x400443B8 /* @ECU_Address@EIP_StOfCanABSActvOvv_P@ */ Scalar_BOOLEAN 0 EcuIntgdSwGend_CM_boolean 0.0 1.0 /end CHARACTERISTIC
/begin CHARACTERISTIC EIP_StOfCanASRBrkCtrlActvOvs_P "State Of Can Acceleration Slip Regulation (ASR) Brake Control Active Override Switch Parameter" VALUE 0x400443BC /* @ECU_Address@EIP_StOfCanASRBrkCtrlActvOvs_P@ */ Scalar_BOOLEAN 0 EcuIntgdSwGend_CM_boolean 0.0 1.0 /end CHARACTERISTIC
/begin CHARACTERISTIC EIP_StOfCanASRBrkCtrlActvOvv_P "State Of Can Acceleration Slip Regulation (ASR) Brake Control Active Override Value Parameter" VALUE 0x400443C0 /* @ECU_Address@EIP_StOfCanASRBrkCtrlActvOvv_P@ */ Scalar_BOOLEAN 0 EcuIntgdSwGend_CM_boolean 0.0 1.0 /end CHARACTERISTIC
/begin CHARACTERISTIC EIP_StOfCanASREngCtrlActvOvs_P "State Of Can Acceleration Slip Regulation (ASR) Engine Control Active Override Switch Parameter" VALUE 0x400443C4 /* @ECU_Address@EIP_StOfCanASREngCtrlActvOvs_P@ */ Scalar_BOOLEAN 0 EcuIntgdSwGend_CM_boolean 0.0 1.0 /end CHARACTERISTIC
/begin CHARACTERISTIC EIP_StOfCanASREngCtrlActvOvv_P "State Of Can Acceleration Slip Regulation (ASR) Engine Control Active Override Value Parameter" VALUE 0x400443C8 /* @ECU_Address@EIP_StOfCanASREngCtrlActvOvv_P@ */ Scalar_BOOLEAN 0 EcuIntgdSwGend_CM_boolean 0.0 1.0 /end CHARACTERISTIC
/begin CHARACTERISTIC EIP_StOfCanCrsCtrlEnaSwtOvs_P "State Of Can Cruise Control Enable Switch Override Switch Parameter" VALUE 0x400443CC /* @ECU_Address@EIP_StOfCanCrsCtrlEnaSwtOvs_P@ */ Scalar_BOOLEAN 0 EcuIntgdSwGend_CM_boolean 0.0 1.0 /end CHARACTERISTIC
/begin CHARACTERISTIC EIP_StOfCanCrsCtrlEnaSwtOvv_P "State Of Can Cruise Control Enable Switch Override Value Parameter" VALUE 0x400443D0 /* @ECU_Address@EIP_StOfCanCrsCtrlEnaSwtOvv_P@ */ Scalar_BOOLEAN 0 EcuIntgdSwGend_CM_boolean 0.0 1.0 /end CHARACTERISTIC
/begin CHARACTERISTIC EIP_StOfCanCrsCtrlResuSwtOvs_P "State Of Can Cruise Control Resume Switch Override Switch Parameter" VALUE 0x400443D4 /* @ECU_Address@EIP_StOfCanCrsCtrlResuSwtOvs_P@ */ Scalar_BOOLEAN 0 EcuIntgdSwGend_CM_boolean 0.0 1.0 /end CHARACTERISTIC
/begin CHARACTERISTIC EIP_StOfCanCrsCtrlResuSwtOvv_P "State Of Can Cruise Control Resume Switch Override Value Parameter" VALUE 0x400443D8 /* @ECU_Address@EIP_StOfCanCrsCtrlResuSwtOvv_P@ */ Scalar_BOOLEAN 0 EcuIntgdSwGend_CM_boolean 0.0 1.0 /end CHARACTERISTIC
/begin CHARACTERISTIC EIP_StOfCanCrsCtrlSetSwtOvs_P "State Of Can Cruise Control Set Switch Override Switch Parameter" VALUE 0x400443DC /* @ECU_Address@EIP_StOfCanCrsCtrlSetSwtOvs_P@ */ Scalar_BOOLEAN 0 EcuIntgdSwGend_CM_boolean 0.0 1.0 /end CHARACTERISTIC
/begin CHARACTERISTIC EIP_StOfCanCrsCtrlSetSwtOvv_P "State Of Can Cruise Control Set Switch Override Value Parameter" VALUE 0x400443E0 /* @ECU_Address@EIP_StOfCanCrsCtrlSetSwtOvv_P@ */ Scalar_BOOLEAN 0 EcuIntgdSwGend_CM_boolean 0.0 1.0 /end CHARACTERISTIC
/begin CHARACTERISTIC EIP_StOfCanEngAuxShtdwnSwtOvs_P "State Of Can Engine Auxiliary Shutdown Switch Override Switch Parameter" VALUE 0x400443E4 /* @ECU_Address@EIP_StOfCanEngAuxShtdwnSwtOvs_P@ */ Scalar_BOOLEAN 0 EcuIntgdSwGend_CM_boolean 0.0 1.0 /end CHARACTERISTIC
/begin CHARACTERISTIC EIP_StOfCanEngAuxShtdwnSwtOvv_P "State Of Can Engine Auxiliary Shutdown Switch Override Value Parameter" VALUE 0x400443E8 /* @ECU_Address@EIP_StOfCanEngAuxShtdwnSwtOvv_P@ */ Scalar_BOOLEAN 0 EcuIntgdSwGend_CM_boolean 0.0 1.0 /end CHARACTERISTIC
/begin CHARACTERISTIC EIP_StOfCanEngOvrdCtrlModFromAbsAscOvs_P "State Of Engine Override Control Mode From Abs Asc - Override Switch" VALUE 0x400443EC /* @ECU_Address@EIP_StOfCanEngOvrdCtrlModFromAbsAscOvs_P@ */ Scalar_BOOLEAN 0 EcuIntgdSwGend_CM_boolean 0.0 1.0 /end CHARACTERISTIC
/begin CHARACTERISTIC EIP_StOfCanEngOvrdCtrlModFromAbsAscOvv_P "State Of Engine Override Control Mode From Abs Asc - Override Value" VALUE 0x400443F0 /* @ECU_Address@EIP_StOfCanEngOvrdCtrlModFromAbsAscOvv_P@ */ Scalar_BOOLEAN 0 EcuIntgdSwGend_CM_boolean 0.0 1.0 /end CHARACTERISTIC
/begin CHARACTERISTIC EIP_StOfCanEngOvrdCtrlModFromTcuOvs_P "State Of Engine Override Control Mode From Tcu - Override Switch" VALUE 0x400443F4 /* @ECU_Address@EIP_StOfCanEngOvrdCtrlModFromTcuOvs_P@ */ Scalar_BOOLEAN 0 EcuIntgdSwGend_CM_boolean 0.0 1.0 /end CHARACTERISTIC
/begin CHARACTERISTIC EIP_StOfCanEngOvrdCtrlModFromTcuOvv_P "State Of Engine Override Control Mode From Tcu - Override Value" VALUE 0x400443F8 /* @ECU_Address@EIP_StOfCanEngOvrdCtrlModFromTcuOvv_P@ */ Scalar_BOOLEAN 0 EcuIntgdSwGend_CM_boolean 0.0 1.0 /end CHARACTERISTIC
/begin CHARACTERISTIC EIP_StOfCanEngPtoGovrEnaSwtOvs_P "Engine Input Processing State Of Can Engine Pto Governor Enable Switch Override Switch Parameter" VALUE 0x4004440C /* @ECU_Address@EIP_StOfCanEngPtoGovrEnaSwtOvs_P@ */ Scalar_BOOLEAN 0 EcuIntgdSwGend_CM_boolean 0.0 1.0 /end CHARACTERISTIC
/begin CHARACTERISTIC EIP_StOfCanEngPtoGovrEnaSwtOvv_P "Engine Input Processing State Of Can Engine Pto Governor Enable Switch Override Value Parameter" VALUE 0x40044410 /* @ECU_Address@EIP_StOfCanEngPtoGovrEnaSwtOvv_P@ */ Scalar_BOOLEAN 0 EcuIntgdSwGend_CM_boolean 0.0 1.0 /end CHARACTERISTIC
/begin CHARACTERISTIC EIP_StOfCanEngRemPtoGovrSpdCtrlSwtOvs_P "Engine Input Processing State Of Can Engine Remote Pto Governor Speed Control Switch Override Switch Parameter" VALUE 0x40044424 /* @ECU_Address@EIP_StOfCanEngRemPtoGovrSpdCtrlSwtOvs_P@ */ Scalar_BOOLEAN 0 EcuIntgdSwGend_CM_boolean 0.0 1.0 /end CHARACTERISTIC
/begin CHARACTERISTIC EIP_StOfCanEngRemPtoGovrSpdCtrlSwtOvv_P "Engine Input Processing State Of Can Engine Remote Pto Governor Speed Control Switch Override Value Parameter" VALUE 0x40044428 /* @ECU_Address@EIP_StOfCanEngRemPtoGovrSpdCtrlSwtOvv_P@ */ Scalar_BOOLEAN 0 EcuIntgdSwGend_CM_boolean 0.0 1.0 /end CHARACTERISTIC
/begin CHARACTERISTIC EIP_StOfCanEngReqTqHiReslFromTcuOvs_P "State Of Can Engine Request Torque High Resolution Override Switch Parameter" VALUE 0x4004442C /* @ECU_Address@EIP_StOfCanEngReqTqHiReslFromTcuOvs_P@ */ Scalar_BOOLEAN 0 EcuIntgdSwGend_CM_boolean 0.0 1.0 /end CHARACTERISTIC
/begin CHARACTERISTIC EIP_StOfCanEngReqTqHiReslFromTcuOvv_P "State Of Can Engine Request Torque High Resolution Override Value Parameter" VALUE 0x40044430 /* @ECU_Address@EIP_StOfCanEngReqTqHiReslFromTcuOvv_P@ */ Scalar_BOOLEAN 0 EcuIntgdSwGend_CM_boolean 0.0 1.0 /end CHARACTERISTIC
/begin CHARACTERISTIC EIP_StOfCanEngRtdrSelnOvs_P "SPN 973 - Engine Retarder Selection  State Of Can - Override Switch" VALUE 0x40044434 /* @ECU_Address@EIP_StOfCanEngRtdrSelnOvs_P@ */ Scalar_BOOLEAN 0 EcuIntgdSwGend_CM_boolean 0.0 1.0 /end CHARACTERISTIC
/begin CHARACTERISTIC EIP_StOfCanEngRtdrSelnOvv_P "SPN 973 - Engine Retarder Selection  State Of Can - Override Value" VALUE 0x40044438 /* @ECU_Address@EIP_StOfCanEngRtdrSelnOvv_P@ */ Scalar_BOOLEAN 0 EcuIntgdSwGend_CM_boolean 0.0 1.0 /end CHARACTERISTIC
/begin CHARACTERISTIC EIP_StOfCanEngSpdReqFromTcuOvs_P "State Of Can Engine Speed Request Override Switch Parameter" VALUE 0x4004443C /* @ECU_Address@EIP_StOfCanEngSpdReqFromTcuOvs_P@ */ Scalar_BOOLEAN 0 EcuIntgdSwGend_CM_boolean 0.0 1.0 /end CHARACTERISTIC
/begin CHARACTERISTIC EIP_StOfCanEngSpdReqFromTcuOvv_P "State Of Can Engine Speed Request Override Value Parameter" VALUE 0x40044440 /* @ECU_Address@EIP_StOfCanEngSpdReqFromTcuOvv_P@ */ Scalar_BOOLEAN 0 EcuIntgdSwGend_CM_boolean 0.0 1.0 /end CHARACTERISTIC
/begin CHARACTERISTIC EIP_StOfCanEngTqLimReqMaxCntnsOvs_P "State Of Can Engine Torque Limit Request - Maximum Continuous Override Switch Parameter" VALUE 0x40044444 /* @ECU_Address@EIP_StOfCanEngTqLimReqMaxCntnsOvs_P@ */ Scalar_BOOLEAN 0 EcuIntgdSwGend_CM_boolean 0.0 1.0 /end CHARACTERISTIC
/begin CHARACTERISTIC EIP_StOfCanEngTqLimReqMaxCntnsOvv_P "State Of Can Engine Torque Limit Request - Maximum Continuous Override Value Parameter" VALUE 0x40044448 /* @ECU_Address@EIP_StOfCanEngTqLimReqMaxCntnsOvv_P@ */ Scalar_BOOLEAN 0 EcuIntgdSwGend_CM_boolean 0.0 1.0 /end CHARACTERISTIC
/begin CHARACTERISTIC EIP_StOfCanEngTqReqFromAbsAscOvs_P "State Of Can Engine Torque Request Override Switch Parameter From Abs Asc" VALUE 0x4004444C /* @ECU_Address@EIP_StOfCanEngTqReqFromAbsAscOvs_P@ */ Scalar_BOOLEAN 0 EcuIntgdSwGend_CM_boolean 0.0 1.0 /end CHARACTERISTIC
/begin CHARACTERISTIC EIP_StOfCanEngTqReqFromAbsAscOvv_P "State Of Can Engine Torque Request Override Switch Parameter From Abs Asc" VALUE 0x40044450 /* @ECU_Address@EIP_StOfCanEngTqReqFromAbsAscOvv_P@ */ Scalar_BOOLEAN 0 EcuIntgdSwGend_CM_boolean 0.0 1.0 /end CHARACTERISTIC
/begin CHARACTERISTIC EIP_StOfCanEngTqReqFromTcuOvs_P "State Of Can Engine Torque Request Override Switch Parameter From Tcu" VALUE 0x40044454 /* @ECU_Address@EIP_StOfCanEngTqReqFromTcuOvs_P@ */ Scalar_BOOLEAN 0 EcuIntgdSwGend_CM_boolean 0.0 1.0 /end CHARACTERISTIC
/begin CHARACTERISTIC EIP_StOfCanEngTqReqFromTcuOvv_P "State Of Can Engine Torque Request Override Value Parameter From Tcu" VALUE 0x40044458 /* @ECU_Address@EIP_StOfCanEngTqReqFromTcuOvv_P@ */ Scalar_BOOLEAN 0 EcuIntgdSwGend_CM_boolean 0.0 1.0 /end CHARACTERISTIC
/begin CHARACTERISTIC EIP_StOfCanEstimdEngParasiticTqOvs_P "State Of Can Estimated Engine Parasitic Torque Override Switch Parameter" VALUE 0x4004445C /* @ECU_Address@EIP_StOfCanEstimdEngParasiticTqOvs_P@ */ Scalar_BOOLEAN 0 EcuIntgdSwGend_CM_boolean 0.0 1.0 /end CHARACTERISTIC
/begin CHARACTERISTIC EIP_StOfCanEstimdEngParasiticTqOvv_P "State Of Can Estimated Engine Parasitic Torque Override Value Parameter" VALUE 0x40044460 /* @ECU_Address@EIP_StOfCanEstimdEngParasiticTqOvv_P@ */ Scalar_BOOLEAN 0 EcuIntgdSwGend_CM_boolean 0.0 1.0 /end CHARACTERISTIC
/begin CHARACTERISTIC EIP_StOfCanFuLvl1Ovs_P "State Of Fuel Level 1 - Override Switch" VALUE 0x40044464 /* @ECU_Address@EIP_StOfCanFuLvl1Ovs_P@ */ Scalar_BOOLEAN 0 EcuIntgdSwGend_CM_boolean 0.0 1.0 /end CHARACTERISTIC
/begin CHARACTERISTIC EIP_StOfCanFuLvl1Ovv_P "State Of Fuel Level 1 - Override Value" VALUE 0x40044468 /* @ECU_Address@EIP_StOfCanFuLvl1Ovv_P@ */ Scalar_BOOLEAN 0 EcuIntgdSwGend_CM_boolean 0.0 1.0 /end CHARACTERISTIC
/begin CHARACTERISTIC EIP_StOfCanOvrdCtrlModPrioFromAbsAscOvs_P "State Of Can Override Control Mode Priority Override Switch Parameter From Abs Asc" VALUE 0x4004446C /* @ECU_Address@EIP_StOfCanOvrdCtrlModPrioFromAbsAscOvs_P@ */ Scalar_BOOLEAN 0 EcuIntgdSwGend_CM_boolean 0.0 1.0 /end CHARACTERISTIC
/begin CHARACTERISTIC EIP_StOfCanOvrdCtrlModPrioFromAbsAscOvv_P "State Of Can Override Control Mode Priority Override Value Parameter From Abs Asc" VALUE 0x40044470 /* @ECU_Address@EIP_StOfCanOvrdCtrlModPrioFromAbsAscOvv_P@ */ Scalar_BOOLEAN 0 EcuIntgdSwGend_CM_boolean 0.0 1.0 /end CHARACTERISTIC
/begin CHARACTERISTIC EIP_StOfCanOvrdCtrlModPrioFromTcuOvs_P "State Of Can Override Control Mode Priority Override Switch Parameter From Tcu" VALUE 0x40044474 /* @ECU_Address@EIP_StOfCanOvrdCtrlModPrioFromTcuOvs_P@ */ Scalar_BOOLEAN 0 EcuIntgdSwGend_CM_boolean 0.0 1.0 /end CHARACTERISTIC
/begin CHARACTERISTIC EIP_StOfCanOvrdCtrlModPrioFromTcuOvv_P "State Of Can Override Control Mode Priority Override Value Parameter From Tcu" VALUE 0x40044478 /* @ECU_Address@EIP_StOfCanOvrdCtrlModPrioFromTcuOvv_P@ */ Scalar_BOOLEAN 0 EcuIntgdSwGend_CM_boolean 0.0 1.0 /end CHARACTERISTIC
/begin CHARACTERISTIC EIP_StOfCanTachographVehSpdOvs_P "State of Tachograph Vehicle Speed - Override Switch" VALUE 0x4004447C /* @ECU_Address@EIP_StOfCanTachographVehSpdOvs_P@ */ Scalar_BOOLEAN 0 EcuIntgdSwGend_CM_boolean 0.0 1.0 /end CHARACTERISTIC
/begin CHARACTERISTIC EIP_StOfCanTachographVehSpdOvv_P "State of Tachograph Vehicle Speed - Override Value" VALUE 0x40044480 /* @ECU_Address@EIP_StOfCanTachographVehSpdOvv_P@ */ Scalar_BOOLEAN 0 EcuIntgdSwGend_CM_boolean 0.0 1.0 /end CHARACTERISTIC
/begin CHARACTERISTIC EIP_StOfCanTrfCaseStsOvs_P "Ecu Input Processing State Of Can Transfer Case Status Override Switch Parameter" VALUE 0x40044484 /* @ECU_Address@EIP_StOfCanTrfCaseStsOvs_P@ */ Scalar_BOOLEAN 0 EcuIntgdSwGend_CM_boolean 0.0 1.0 /end CHARACTERISTIC
/begin CHARACTERISTIC EIP_StOfCanTrfCaseStsOvv_P "Ecu Input Processing State Of Can Transfer Case Status Override Value Parameter" VALUE 0x40044488 /* @ECU_Address@EIP_StOfCanTrfCaseStsOvv_P@ */ Scalar_BOOLEAN 0 EcuIntgdSwGend_CM_boolean 0.0 1.0 /end CHARACTERISTIC
/begin CHARACTERISTIC EIP_StOfCanTrsmActGearRatOvs_P "State Of Can Transmission Actual Gear Ratio Override Switch Parameter" VALUE 0x4004448C /* @ECU_Address@EIP_StOfCanTrsmActGearRatOvs_P@ */ Scalar_BOOLEAN 0 EcuIntgdSwGend_CM_boolean 0.0 1.0 /end CHARACTERISTIC
/begin CHARACTERISTIC EIP_StOfCanTrsmActGearRatOvv_P "State Of Can Transmission Actual Gear Ratio Override Value Parameter" VALUE 0x40044490 /* @ECU_Address@EIP_StOfCanTrsmActGearRatOvv_P@ */ Scalar_BOOLEAN 0 EcuIntgdSwGend_CM_boolean 0.0 1.0 /end CHARACTERISTIC
/begin CHARACTERISTIC EIP_StOfCanTrsmCurrentGearOvs_P "Engine Input Processing State Of Can Transmission Current Gear Override Switch Parameter" VALUE 0x40044494 /* @ECU_Address@EIP_StOfCanTrsmCurrentGearOvs_P@ */ Scalar_BOOLEAN 0 EcuIntgdSwGend_CM_boolean 0.0 1.0 /end CHARACTERISTIC
/begin CHARACTERISTIC EIP_StOfCanTrsmCurrentGearOvv_P "Engine Input Processing State Of Can Transmission Current Gear Override Value Parameter" VALUE 0x40044498 /* @ECU_Address@EIP_StOfCanTrsmCurrentGearOvv_P@ */ Scalar_BOOLEAN 0 EcuIntgdSwGend_CM_boolean 0.0 1.0 /end CHARACTERISTIC
/begin CHARACTERISTIC EIP_StOfCanTrsmEngCrkEnaOvs_P "Ecu Input Processing State Of Can Transmission Engine Crank Enable Override Switch Parameter" VALUE 0x4004449C /* @ECU_Address@EIP_StOfCanTrsmEngCrkEnaOvs_P@ */ Scalar_BOOLEAN 0 EcuIntgdSwGend_CM_boolean 0.0 1.0 /end CHARACTERISTIC
/begin CHARACTERISTIC EIP_StOfCanTrsmEngCrkEnaOvv_P "Ecu Input Processing State Of Can Transmission Engine Crank Enable Override Value Parameter" VALUE 0x400444A0 /* @ECU_Address@EIP_StOfCanTrsmEngCrkEnaOvv_P@ */ Scalar_BOOLEAN 0 EcuIntgdSwGend_CM_boolean 0.0 1.0 /end CHARACTERISTIC
/begin CHARACTERISTIC EIP_StOfCanTrsmOilLvlReqOvs_P "State Of Can Transmission Oil Level Request Override Switch Parameter" VALUE 0x400444A4 /* @ECU_Address@EIP_StOfCanTrsmOilLvlReqOvs_P@ */ Scalar_BOOLEAN 0 EcuIntgdSwGend_CM_boolean 0.0 1.0 /end CHARACTERISTIC
/begin CHARACTERISTIC EIP_StOfCanTrsmOilLvlReqOvv_P "State Of Can Transmission Oil Level Request Override Value Parameter" VALUE 0x400444A8 /* @ECU_Address@EIP_StOfCanTrsmOilLvlReqOvv_P@ */ Scalar_BOOLEAN 0 EcuIntgdSwGend_CM_boolean 0.0 1.0 /end CHARACTERISTIC
/begin CHARACTERISTIC EIP_StOfCanTrsmOutpShaftSpdOvs_P "State of Transmission Outputshaft Speed - Override Switch Parameter" VALUE 0x400444AC /* @ECU_Address@EIP_StOfCanTrsmOutpShaftSpdOvs_P@ */ Scalar_BOOLEAN 0 EcuIntgdSwGend_CM_boolean 0.0 1.0 /end CHARACTERISTIC
/begin CHARACTERISTIC EIP_StOfCanTrsmOutpShaftSpdOvv_P "State of Transmission Outputshaft Speed - Override Value Parameter" VALUE 0x400444B0 /* @ECU_Address@EIP_StOfCanTrsmOutpShaftSpdOvv_P@ */ Scalar_BOOLEAN 0 EcuIntgdSwGend_CM_boolean 0.0 1.0 /end CHARACTERISTIC
/begin CHARACTERISTIC EIP_StOfCanTrsmSeldGearOvs_P "State Of Can Transmission Selected Gear Override Switch Parameter" VALUE 0x400444B4 /* @ECU_Address@EIP_StOfCanTrsmSeldGearOvs_P@ */ Scalar_BOOLEAN 0 EcuIntgdSwGend_CM_boolean 0.0 1.0 /end CHARACTERISTIC
/begin CHARACTERISTIC EIP_StOfCanTrsmSeldGearOvv_P "State Of Can Transmission Selected Gear Override Value Parameter" VALUE 0x400444B8 /* @ECU_Address@EIP_StOfCanTrsmSeldGearOvv_P@ */ Scalar_BOOLEAN 0 EcuIntgdSwGend_CM_boolean 0.0 1.0 /end CHARACTERISTIC
/begin CHARACTERISTIC EIP_StOfCanTrsmTqCnvLockUpEngdOvs_P "Engine Input Processing State Of Can Transmission Torque Convertor Lock Up Engaged Override Switch Parameter" VALUE 0x400444BC /* @ECU_Address@EIP_StOfCanTrsmTqCnvLockUpEngdOvs_P@ */ Scalar_BOOLEAN 0 EcuIntgdSwGend_CM_boolean 0.0 1.0 /end CHARACTERISTIC
/begin CHARACTERISTIC EIP_StOfCanTrsmTqCnvLockUpEngdOvv_P "Engine Input Processing State Of Can Transmission Torque Convertor Lock Up Engaged Override Value Parameter" VALUE 0x400444C0 /* @ECU_Address@EIP_StOfCanTrsmTqCnvLockUpEngdOvv_P@ */ Scalar_BOOLEAN 0 EcuIntgdSwGend_CM_boolean 0.0 1.0 /end CHARACTERISTIC
/begin CHARACTERISTIC EIP_StOfCanTrsmTqCnvrRatOvs_P "Ecu Input Processing State Of Can Transmission Torque Converter Ratio Override Switch Parameter" VALUE 0x400444C4 /* @ECU_Address@EIP_StOfCanTrsmTqCnvrRatOvs_P@ */ Scalar_BOOLEAN 0 EcuIntgdSwGend_CM_boolean 0.0 1.0 /end CHARACTERISTIC
/begin CHARACTERISTIC EIP_StOfCanTrsmTqCnvrRatOvv_P "Ecu Input Processing State Of Can Transmission Torque Converter Ratio Override Value Parameter" VALUE 0x400444C8 /* @ECU_Address@EIP_StOfCanTrsmTqCnvrRatOvv_P@ */ Scalar_BOOLEAN 0 EcuIntgdSwGend_CM_boolean 0.0 1.0 /end CHARACTERISTIC
/begin CHARACTERISTIC EIP_StOfCanTrsmTqLimOvs_P "Status Of Transmission Torque Limit - Override Switch" VALUE 0x400444CC /* @ECU_Address@EIP_StOfCanTrsmTqLimOvs_P@ */ Scalar_BOOLEAN 0 EcuIntgdSwGend_CM_boolean 0.0 1.0 /end CHARACTERISTIC
/begin CHARACTERISTIC EIP_StOfCanTrsmTqLimOvv_P "Status Of Transmission Torque Limit - Override Value" VALUE 0x400444D0 /* @ECU_Address@EIP_StOfCanTrsmTqLimOvv_P@ */ Scalar_BOOLEAN 0 EcuIntgdSwGend_CM_boolean 0.0 1.0 /end CHARACTERISTIC
/begin CHARACTERISTIC EIP_StOfCanVehLimSpdGovrDecSwtOvs_P "State of Can Vehicle Limiting Speed Governor Decrement Swich Override Switch Parameter" VALUE 0x400444D4 /* @ECU_Address@EIP_StOfCanVehLimSpdGovrDecSwtOvs_P@ */ Scalar_BOOLEAN 0 EcuIntgdSwGend_CM_boolean 0.0 1.0 /end CHARACTERISTIC
/begin CHARACTERISTIC EIP_StOfCanVehLimSpdGovrDecSwtOvv_P "State of Can Vehicle Limiting Speed Governor Decrement Swich Override Value Parameter" VALUE 0x400444D8 /* @ECU_Address@EIP_StOfCanVehLimSpdGovrDecSwtOvv_P@ */ Scalar_BOOLEAN 0 EcuIntgdSwGend_CM_boolean 0.0 1.0 /end CHARACTERISTIC
/begin CHARACTERISTIC EIP_StOfCanVehLimSpdGovrEnaSwtOvs_P "State of Vehicle Limiting Speed Governor Enable Switch Override Switch Parameter" VALUE 0x400444DC /* @ECU_Address@EIP_StOfCanVehLimSpdGovrEnaSwtOvs_P@ */ Scalar_BOOLEAN 0 EcuIntgdSwGend_CM_boolean 0.0 1.0 /end CHARACTERISTIC
/begin CHARACTERISTIC EIP_StOfCanVehLimSpdGovrEnaSwtOvv_P "State of Vehicle Limiting Speed Governor Enable Switch Override Value Parameter" VALUE 0x400444E0 /* @ECU_Address@EIP_StOfCanVehLimSpdGovrEnaSwtOvv_P@ */ Scalar_BOOLEAN 0 EcuIntgdSwGend_CM_boolean 0.0 1.0 /end CHARACTERISTIC
/begin CHARACTERISTIC EIP_StOfCanVehLimSpdGovrInctSwtOvs_P "State of Can Vehicle Limiting Speed Governor Increment Switch Override Switch Parameter" VALUE 0x400444E4 /* @ECU_Address@EIP_StOfCanVehLimSpdGovrInctSwtOvs_P@ */ Scalar_BOOLEAN 0 EcuIntgdSwGend_CM_boolean 0.0 1.0 /end CHARACTERISTIC
/begin CHARACTERISTIC EIP_StOfCanVehLimSpdGovrInctSwtOvv_P "State of Can Vehicle Limiting Speed Governor Increment Switch Override Value Parameter" VALUE 0x400444E8 /* @ECU_Address@EIP_StOfCanVehLimSpdGovrInctSwtOvv_P@ */ Scalar_BOOLEAN 0 EcuIntgdSwGend_CM_boolean 0.0 1.0 /end CHARACTERISTIC
/begin CHARACTERISTIC EIP_StOfCanWhlBasVehSpdOvs_P "State of Wheel Based Vehicle Speed - Override Switch Parameter" VALUE 0x400444EC /* @ECU_Address@EIP_StOfCanWhlBasVehSpdOvs_P@ */ Scalar_BOOLEAN 0 EcuIntgdSwGend_CM_boolean 0.0 1.0 /end CHARACTERISTIC
/begin CHARACTERISTIC EIP_StOfCanWhlBasVehSpdOvv_P "State of Wheel Based Vehicle Speed - Override Value Parameter" VALUE 0x400444F0 /* @ECU_Address@EIP_StOfCanWhlBasVehSpdOvv_P@ */ Scalar_BOOLEAN 0 EcuIntgdSwGend_CM_boolean 0.0 1.0 /end CHARACTERISTIC
/begin CHARACTERISTIC EIP_SteadyFlgEnaForMisfire_P "Steady State Flag Enable For Misfire Detection" VALUE 0x400444F4 /* @ECU_Address@EIP_SteadyFlgEnaForMisfire_P@ */ Scalar_BOOLEAN 0 EcuIntgdSwGend_CM_boolean 0.0 1.0 /end CHARACTERISTIC
/begin CHARACTERISTIC EIP_bAcvCylBalnOvs_P "Cylinder Balance Active - Override Switch Parameter" VALUE 0x40044750 /* @ECU_Address@EIP_bAcvCylBalnOvs_P@ */ Scalar_BOOLEAN 0 EcuIntgdSwGend_CM_boolean 0.0 1.0 /end CHARACTERISTIC
/begin CHARACTERISTIC EIP_bAcvCylBalnOvv_P "Cylinder Balance Active - Override Value Parameter" VALUE 0x40044754 /* @ECU_Address@EIP_bAcvCylBalnOvv_P@ */ Scalar_BOOLEAN 0 EcuIntgdSwGend_CM_boolean 0.0 1.0 /end CHARACTERISTIC
/begin CHARACTERISTIC EIP_bAcvErrCylMisfRednOvs_P "Error Cylinder Misfire Reduction Active - Override Switch Parameter" VALUE 0x40044760 /* @ECU_Address@EIP_bAcvErrCylMisfRednOvs_P@ */ Scalar_BOOLEAN 0 EcuIntgdSwGend_CM_boolean 0.0 1.0 /end CHARACTERISTIC
/begin CHARACTERISTIC EIP_bAcvErrCylMisfRednOvv_P "Error Cylinder Misfire Reduction Active - Override Value Parameter" VALUE 0x40044764 /* @ECU_Address@EIP_bAcvErrCylMisfRednOvv_P@ */ Scalar_BOOLEAN 0 EcuIntgdSwGend_CM_boolean 0.0 1.0 /end CHARACTERISTIC
/begin CHARACTERISTIC EIP_bAcvErrCylMisfShtdwnOvs_P "Error Cylinder Misfire Shutdown Active - Override Switch Parameter" VALUE 0x40044768 /* @ECU_Address@EIP_bAcvErrCylMisfShtdwnOvs_P@ */ Scalar_BOOLEAN 0 EcuIntgdSwGend_CM_boolean 0.0 1.0 /end CHARACTERISTIC
/begin CHARACTERISTIC EIP_bAcvErrCylMisfShtdwnOvv_P "Error Cylinder Misfire Shutdown Active - Override Value Parameter" VALUE 0x4004476C /* @ECU_Address@EIP_bAcvErrCylMisfShtdwnOvv_P@ */ Scalar_BOOLEAN 0 EcuIntgdSwGend_CM_boolean 0.0 1.0 /end CHARACTERISTIC
/begin CHARACTERISTIC EIP_bAcvErrCylMisfWarnOvs_P "Error Cylinder Misfire Warning Active - Override Switch Parameter" VALUE 0x40044770 /* @ECU_Address@EIP_bAcvErrCylMisfWarnOvs_P@ */ Scalar_BOOLEAN 0 EcuIntgdSwGend_CM_boolean 0.0 1.0 /end CHARACTERISTIC
/begin CHARACTERISTIC EIP_bAcvErrCylMisfWarnOvv_P "Error Cylinder Misfire Warning Active - Override Value Parameter" VALUE 0x40044774 /* @ECU_Address@EIP_bAcvErrCylMisfWarnOvv_P@ */ Scalar_BOOLEAN 0 EcuIntgdSwGend_CM_boolean 0.0 1.0 /end CHARACTERISTIC
/begin CHARACTERISTIC EIP_bAcvErrInjrShtdwnOvs_P "Error Injection Shutdown Active - Override Switch Parameter" VALUE 0x40044778 /* @ECU_Address@EIP_bAcvErrInjrShtdwnOvs_P@ */ Scalar_BOOLEAN 0 EcuIntgdSwGend_CM_boolean 0.0 1.0 /end CHARACTERISTIC
/begin CHARACTERISTIC EIP_bAcvErrInjrShtdwnOvv_P "Error Injection Shutdown Active - Override Value Parameter" VALUE 0x4004477C /* @ECU_Address@EIP_bAcvErrInjrShtdwnOvv_P@ */ Scalar_BOOLEAN 0 EcuIntgdSwGend_CM_boolean 0.0 1.0 /end CHARACTERISTIC
/begin CHARACTERISTIC TL_FricForAbsAscLimnEna_P "Friction For Abs Asc Limitation Enable" VALUE 0x4004B63C /* @ECU_Address@TL_FricForAbsAscLimnEna_P@ */ Scalar_BOOLEAN 0 EcuIntgdSwGend_CM_boolean 0.0 1.0 /end CHARACTERISTIC
/begin CHARACTERISTIC TL_FricForDftTqLimEna_P "Friction For Default Torque Limit Enable" VALUE 0x4004B640 /* @ECU_Address@TL_FricForDftTqLimEna_P@ */ Scalar_BOOLEAN 0 EcuIntgdSwGend_CM_boolean 0.0 1.0 /end CHARACTERISTIC
/begin CHARACTERISTIC TL_FricForGbxProtnEna_P "Friction For Gearbox Protection Enable" VALUE 0x4004B644 /* @ECU_Address@TL_FricForGbxProtnEna_P@ */ Scalar_BOOLEAN 0 EcuIntgdSwGend_CM_boolean 0.0 1.0 /end CHARACTERISTIC
/begin CHARACTERISTIC TL_FricForPtoProtnEna_P "Friction For Pto Protection Enable" VALUE 0x4004B648 /* @ECU_Address@TL_FricForPtoProtnEna_P@ */ Scalar_BOOLEAN 0 EcuIntgdSwGend_CM_boolean 0.0 1.0 /end CHARACTERISTIC
/begin CHARACTERISTIC TL_FricForTrsmProtnEna_P "Friction For Transmission Protection Enable" VALUE 0x4004B64C /* @ECU_Address@TL_FricForTrsmProtnEna_P@ */ Scalar_BOOLEAN 0 EcuIntgdSwGend_CM_boolean 0.0 1.0 /end CHARACTERISTIC
/begin CHARACTERISTIC TL_TqLimdForNExhTrbChrgOvs_P "Limited Torque Value of Turbo Charger Speed - Override Switch" VALUE 0x4004C488 /* @ECU_Address@TL_TqLimdForNExhTrbChrgOvs_P@ */ Scalar_BOOLEAN 0 EcuIntgdSwGend_CM_boolean 0.0 1.0 /end CHARACTERISTIC
/begin CHARACTERISTIC TL_TqLimdForPAirAmbOvs_P "Limited Torque Value of Ambient Air Pressure - Override Switch" VALUE 0x4004C490 /* @ECU_Address@TL_TqLimdForPAirAmbOvs_P@ */ Scalar_BOOLEAN 0 EcuIntgdSwGend_CM_boolean 0.0 1.0 /end CHARACTERISTIC
/begin CHARACTERISTIC TL_TqLimdForPAirBoostOvs_P "Limited Torque Value of Air Boost Pressure - Override Switch" VALUE 0x4004C498 /* @ECU_Address@TL_TqLimdForPAirBoostOvs_P@ */ Scalar_BOOLEAN 0 EcuIntgdSwGend_CM_boolean 0.0 1.0 /end CHARACTERISTIC
/begin CHARACTERISTIC TL_TqLimdForSurgeOvs_P "Limited Torque Value of Surge Protection - Override Switch" VALUE 0x4004C4A0 /* @ECU_Address@TL_TqLimdForSurgeOvs_P@ */ Scalar_BOOLEAN 0 EcuIntgdSwGend_CM_boolean 0.0 1.0 /end CHARACTERISTIC
/begin CHARACTERISTIC TL_TqLimdForTAirOvs_P "Limited Torque Value of Air Boost Temperature - Override Switch" VALUE 0x4004C4A8 /* @ECU_Address@TL_TqLimdForTAirOvs_P@ */ Scalar_BOOLEAN 0 EcuIntgdSwGend_CM_boolean 0.0 1.0 /end CHARACTERISTIC
/begin CHARACTERISTIC TL_TqLimdForTCooltOvs_P "Limited Torque Value of Coolant High Temperature - Override Switch" VALUE 0x4004C4B0 /* @ECU_Address@TL_TqLimdForTCooltOvs_P@ */ Scalar_BOOLEAN 0 EcuIntgdSwGend_CM_boolean 0.0 1.0 /end CHARACTERISTIC
/begin CHARACTERISTIC TL_TqLimdForTFuOvs_P "Limited Torque Value of Fuel Temperature - Override Switch" VALUE 0x4004C4B8 /* @ECU_Address@TL_TqLimdForTFuOvs_P@ */ Scalar_BOOLEAN 0 EcuIntgdSwGend_CM_boolean 0.0 1.0 /end CHARACTERISTIC
/begin CHARACTERISTIC TL_TqLimdForTOilOvs_P "Limited Torque Value of Oil Temperature - Override Switch" VALUE 0x4004C4C0 /* @ECU_Address@TL_TqLimdForTOilOvs_P@ */ Scalar_BOOLEAN 0 EcuIntgdSwGend_CM_boolean 0.0 1.0 /end CHARACTERISTIC
/begin CHARACTERISTIC TL_TqMapLimdEngProtnOvs_P "Map Based Torque Limitation - Override Switch" VALUE 0x4004C6B8 /* @ECU_Address@TL_TqMapLimdEngProtnOvs_P@ */ Scalar_BOOLEAN 0 EcuIntgdSwGend_CM_boolean 0.0 1.0 /end CHARACTERISTIC
/begin CHARACTERISTIC TL_bDeacvRateLimOvs_P "Dynamic Rate Limiter Activation - Override Switch" VALUE 0x4004C6F8 /* @ECU_Address@TL_bDeacvRateLimOvs_P@ */ Scalar_BOOLEAN 0 EcuIntgdSwGend_CM_boolean 0.0 1.0 /end CHARACTERISTIC
/begin CHARACTERISTIC TrC_MMaiFuQntyOvs_P "Main Fuel Quantity - Override Switch" VALUE 0x4004EC68 /* @ECU_Address@TrC_MMaiFuQntyOvs_P@ */ Scalar_BOOLEAN 0 EcuIntgdSwGend_CM_boolean 0.0 1.0 /end CHARACTERISTIC
/begin CHARACTERISTIC TrC_MPltFuQntyOvs_P "Pilot Fuel Quantity - Override Switch" VALUE 0x4004F530 /* @ECU_Address@TrC_MPltFuQntyOvs_P@ */ Scalar_BOOLEAN 0 EcuIntgdSwGend_CM_boolean 0.0 1.0 /end CHARACTERISTIC
/begin CHARACTERISTIC TrC_SmokeLimOvs_P "Smoke Limitation Activation - Override Switch" VALUE 0x40050AE4 /* @ECU_Address@TrC_SmokeLimOvs_P@ */ Scalar_BOOLEAN 0 EcuIntgdSwGend_CM_boolean 0.0 1.0 /end CHARACTERISTIC
/begin CHARACTERISTIC WgC_DutyVlvOvs_P "Duty Valve - Override Switch Parameter" VALUE 0x40051874 /* @ECU_Address@WgC_DutyVlvOvs_P@ */ Scalar_BOOLEAN 0 EcuIntgdSwGend_CM_boolean 0.0 1.0 /end CHARACTERISTIC
/begin CHARACTERISTIC EIP_CanEngAuxShtdwnSwtOvv_P "Engine Auxiliary Shutdown Switch - Override Value" VALUE 0x40044094 /* @ECU_Address@EIP_CanEngAuxShtdwnSwtOvv_P@ */ Scalar_BYTE 0 EcuIntgdSwGend_CM_int8 0.0 3.0 /end CHARACTERISTIC
/begin CHARACTERISTIC EIP_CanEngTqLimReqMaxCntnsOvv_P "Engine Torque Limit Request - Maximum Continuous - Override Value" VALUE 0x400440F4 /* @ECU_Address@EIP_CanEngTqLimReqMaxCntnsOvv_P@ */ Scalar_BYTE 0 EcuIntgdSwGend_CM_int8__ -125.0 125.0 /end CHARACTERISTIC
/begin CHARACTERISTIC EIP_CanEstimdEngParasiticTqOvv_P "Estimated Engine Parasitic Losses - Override Value" VALUE 0x40044104 /* @ECU_Address@EIP_CanEstimdEngParasiticTqOvv_P@ */ Scalar_BYTE 0 EcuIntgdSwGend_CM_int8__ -125.0 125.0 /end CHARACTERISTIC
/begin CHARACTERISTIC EIP_CanABSActvOvv_P "Anti-Lock Braking (ABS) Active - Override Value" VALUE 0x40044064 /* @ECU_Address@EIP_CanABSActvOvv_P@ */ Scalar_UBYTE 0 EcuIntgdSwGend_CM_uint8 0.0 3.0 /end CHARACTERISTIC
/begin CHARACTERISTIC EIP_CanASRBrkCtrlActvOvv_P "ASR Brake Control Active - Override Value" VALUE 0x4004406C /* @ECU_Address@EIP_CanASRBrkCtrlActvOvv_P@ */ Scalar_UBYTE 0 EcuIntgdSwGend_CM_uint8 0.0 3.0 /end CHARACTERISTIC
/begin CHARACTERISTIC EIP_CanASREngCtrlActvOvv_P "ASR Engine Control Active - Override Value" VALUE 0x40044074 /* @ECU_Address@EIP_CanASREngCtrlActvOvv_P@ */ Scalar_UBYTE 0 EcuIntgdSwGend_CM_uint8 0.0 3.0 /end CHARACTERISTIC
/begin CHARACTERISTIC EIP_CanCrsCtrlEnaSwtOvv_P "Cruise Control Enable Switch Override Value Parameter" VALUE 0x4004407C /* @ECU_Address@EIP_CanCrsCtrlEnaSwtOvv_P@ */ Scalar_UBYTE 0 EcuIntgdSwGend_CM_uint8 0.0 3.0 /end CHARACTERISTIC
/begin CHARACTERISTIC EIP_CanCrsCtrlResuSwtOvv_P "Cruise Control Resume Switch From CAN Override Value Parameter" VALUE 0x40044084 /* @ECU_Address@EIP_CanCrsCtrlResuSwtOvv_P@ */ Scalar_UBYTE 0 EcuIntgdSwGend_CM_uint8 0.0 3.0 /end CHARACTERISTIC
/begin CHARACTERISTIC EIP_CanCrsCtrlSetSwtOvv_P "Cruise Control Set Switch From CAN Override Value Parameter" VALUE 0x4004408C /* @ECU_Address@EIP_CanCrsCtrlSetSwtOvv_P@ */ Scalar_UBYTE 0 EcuIntgdSwGend_CM_uint8 0.0 3.0 /end CHARACTERISTIC
/begin CHARACTERISTIC EIP_CanEngOvrdCtrlModFromAbsAscOvv_P "Engine Override Control Mode From Abs Asc- Override Value Parameter" VALUE 0x4004409C /* @ECU_Address@EIP_CanEngOvrdCtrlModFromAbsAscOvv_P@ */ Scalar_UBYTE 0 EcuIntgdSwGend_CM_uint8 0.0 3.0 /end CHARACTERISTIC
/begin CHARACTERISTIC EIP_CanEngOvrdCtrlModFromTcuOvv_P "Engine Override Control Mode From Tcu - Override Value Parameter" VALUE 0x400440A4 /* @ECU_Address@EIP_CanEngOvrdCtrlModFromTcuOvv_P@ */ Scalar_UBYTE 0 EcuIntgdSwGend_CM_uint8 0.0 3.0 /end CHARACTERISTIC
/begin CHARACTERISTIC EIP_CanEngPtoGovrEnaSwtOvv_P "CAN Pto Governor - Enable Switch - Override Value Parameter" VALUE 0x400440BC /* @ECU_Address@EIP_CanEngPtoGovrEnaSwtOvv_P@ */ Scalar_UBYTE 0 EcuIntgdSwGend_CM_uint8 0.0 3.0 /end CHARACTERISTIC
/begin CHARACTERISTIC EIP_CanEngRemPtoGovrProgdSpdCtrlSwtOvv_P "CAN Pto Governor - Programmed Speed Control Switch - Override Value Parameter" VALUE 0x400440D4 /* @ECU_Address@EIP_CanEngRemPtoGovrProgdSpdCtrlSwtOvv_P@ */ Scalar_UBYTE 0 EcuIntgdSwGend_CM_uint8 0.0 3.0 /end CHARACTERISTIC
/begin CHARACTERISTIC EIP_CanOvrdCtrlModPrioFromAbsAscOvv_P "Override Control Mode Priority From Abs Asc - Override Value" VALUE 0x40044114 /* @ECU_Address@EIP_CanOvrdCtrlModPrioFromAbsAscOvv_P@ */ Scalar_UBYTE 0 EcuIntgdSwGend_CM_uint8 0.0 3.0 /end CHARACTERISTIC
/begin CHARACTERISTIC EIP_CanOvrdCtrlModPrioFromTcuOvv_P "Override Control Mode Priority From Tcu - Override Value" VALUE 0x4004411C /* @ECU_Address@EIP_CanOvrdCtrlModPrioFromTcuOvv_P@ */ Scalar_UBYTE 0 EcuIntgdSwGend_CM_uint8 0.0 3.0 /end CHARACTERISTIC
/begin CHARACTERISTIC EIP_CanTrfCaseStsOvv_P "Transfer case status - Override Value" VALUE 0x40044128 /* @ECU_Address@EIP_CanTrfCaseStsOvv_P@ */ Scalar_UBYTE 0 EcuIntgdSwGend_CM_uint8 0.0 7.0 /end CHARACTERISTIC
/begin CHARACTERISTIC EIP_CanTrsmEngCrkEnaOvv_P "Transmission Engine Crank Enable - Override Value" VALUE 0x4004413C /* @ECU_Address@EIP_CanTrsmEngCrkEnaOvv_P@ */ Scalar_UBYTE 0 EcuIntgdSwGend_CM_uint8 0.0 3.0 /end CHARACTERISTIC
/begin CHARACTERISTIC EIP_CanTrsmOilLvlReqOvv_P "Transmission Oil Level Request - Override Value" VALUE 0x40044144 /* @ECU_Address@EIP_CanTrsmOilLvlReqOvv_P@ */ Scalar_UBYTE 0 EcuIntgdSwGend_CM_uint8__ 0.0 3.0 /end CHARACTERISTIC
/begin CHARACTERISTIC EIP_CanTrsmTqCnvLockUpEngdOvv_P "Transmission Torque Converter Lockup Engaged - Override Value" VALUE 0x40044158 /* @ECU_Address@EIP_CanTrsmTqCnvLockUpEngdOvv_P@ */ Scalar_UBYTE 0 EcuIntgdSwGend_CM_uint8 0.0 3.0 /end CHARACTERISTIC
/begin CHARACTERISTIC EIP_CanVehLimSpdGovrDecSwtOvv_P "Vehicle Limiting Speed Governor Increment Switch Override Value Parameter" VALUE 0x40044170 /* @ECU_Address@EIP_CanVehLimSpdGovrDecSwtOvv_P@ */ Scalar_UBYTE 0 EcuIntgdSwGend_CM_uint8 0.0 3.0 /end CHARACTERISTIC
/begin CHARACTERISTIC EIP_CanVehLimSpdGovrEnaSwtOvv_P "Vehicle Limiting Speed Governor Enable Switch Override Value Parameter" VALUE 0x40044178 /* @ECU_Address@EIP_CanVehLimSpdGovrEnaSwtOvv_P@ */ Scalar_UBYTE 0 EcuIntgdSwGend_CM_uint8 0.0 3.0 /end CHARACTERISTIC
/begin CHARACTERISTIC EIP_CanVehLimSpdGovrInctSwtOvv_P "Vehicle Limiting Speed Governor Decrement Switch Override Value Parameter" VALUE 0x40044180 /* @ECU_Address@EIP_CanVehLimSpdGovrInctSwtOvv_P@ */ Scalar_UBYTE 0 EcuIntgdSwGend_CM_uint8 0.0 3.0 /end CHARACTERISTIC
/begin MEASUREMENT WgC_DutyWgtVlvFF "Feedforward Wastegate Duty Valve" FLOAT32_IEEE EcuIntgdSwGend_CM_single__ 0 0 0.0 100.0 ECU_ADDRESS 0x4000E600 /* @ECU_Address@WgC_DutyWgtVlvFF@ */ /end MEASUREMENT
/begin MEASUREMENT WgC_DutyWgtVlv "Wastegate Duty Valve" FLOAT32_IEEE EcuIntgdSwGend_CM_single__ 0 0 0.0 100.0 ECU_ADDRESS 0x4000DE58 /* @ECU_Address@WgC_DutyWgtVlv@ */ /end MEASUREMENT
/begin MEASUREMENT WgC_DutyWgtVlvBefSat "Wastegate Duty Valve Before Saturation" FLOAT32_IEEE EcuIntgdSwGend_CM_single__ 0 0 0.0 100.0 ECU_ADDRESS 0x4000E674 /* @ECU_Address@WgC_DutyWgtVlvBefSat@ */ /end MEASUREMENT
/begin MEASUREMENT WgC_LimSigUp "Duty Valve Saturation Up Limit Signal" FLOAT32_IEEE EcuIntgdSwGend_CM_single__ 0 0 0.0 100.0 ECU_ADDRESS 0x4000DA44 /* @ECU_Address@WgC_LimSigUp@ */ /end MEASUREMENT
/begin MEASUREMENT WgC_LimSigLo "Duty Valve Saturation Low Limit Signal" FLOAT32_IEEE EcuIntgdSwGend_CM_single__ 0 0 0.0 100.0 ECU_ADDRESS 0x4000DA00 /* @ECU_Address@WgC_LimSigLo@ */ /end MEASUREMENT
/begin MEASUREMENT WgC_DutyVlvReq "Duty Valve Request" FLOAT32_IEEE EcuIntgdSwGend_CM_single__ 0 0 0.0 100.0 ECU_ADDRESS 0x4000E204 /* @ECU_Address@WgC_DutyVlvReq@ */ /end MEASUREMENT
/begin MEASUREMENT TL_CanEngTqReqNmFromAbsAsc "Engine Torque Request Nm From Abs Asc" FLOAT32_IEEE EcuIntgdSwGend_CM_single_N_m 0 0 -1000.0 10000.0 ECU_ADDRESS 0x4000DC3C /* @ECU_Address@TL_CanEngTqReqNmFromAbsAsc@ */ /end MEASUREMENT
/begin MEASUREMENT TL_MaxTqFromAbsAsc "Max Torque From Abs Asc" FLOAT32_IEEE EcuIntgdSwGend_CM_single_N_m 0 0 -1000.0 10000.0 ECU_ADDRESS 0x4000E474 /* @ECU_Address@TL_MaxTqFromAbsAsc@ */ /end MEASUREMENT
/begin MEASUREMENT TL_TqLimnForEngBrk "Engine Brake Torque Limitation" FLOAT32_IEEE EcuIntgdSwGend_CM_single_N_m 0 0 -1000.0 10000.0 ECU_ADDRESS 0x4000E814 /* @ECU_Address@TL_TqLimnForEngBrk@ */ /end MEASUREMENT
/begin MEASUREMENT TL_DftTqLimFromTcu "Default Torque Limititation From Tcu" FLOAT32_IEEE EcuIntgdSwGend_CM_single_N_m 0 0 0.0 64255.0 ECU_ADDRESS 0x4000E4E4 /* @ECU_Address@TL_DftTqLimFromTcu@ */ /end MEASUREMENT
/begin MEASUREMENT TL_TqLimdForTCoolt "Limited Torque Value of Coolant High Temperature" FLOAT32_IEEE EcuIntgdSwGend_CM_single_N_m 0 0 0.0 10000.0 ECU_ADDRESS 0x4000DFB0 /* @ECU_Address@TL_TqLimdForTCoolt@ */ /end MEASUREMENT
/begin MEASUREMENT TL_TqLimdForTFu "Limited Torque Value of Fuel Temperature" FLOAT32_IEEE EcuIntgdSwGend_CM_single_N_m 0 0 0.0 10000.0 ECU_ADDRESS 0x4000E5D4 /* @ECU_Address@TL_TqLimdForTFu@ */ /end MEASUREMENT
/begin MEASUREMENT TL_TqLimdForNExhTrbChrg "Limited Torque Value of Turbo Charger Speed" FLOAT32_IEEE EcuIntgdSwGend_CM_single_N_m 0 0 0.0 10000.0 ECU_ADDRESS 0x4000DE0C /* @ECU_Address@TL_TqLimdForNExhTrbChrg@ */ /end MEASUREMENT
/begin MEASUREMENT TL_TqLimdForPAirBoost "Limited Torque Value of Air Boost Pressure" FLOAT32_IEEE EcuIntgdSwGend_CM_single_N_m 0 0 0.0 10000.0 ECU_ADDRESS 0x4000E880 /* @ECU_Address@TL_TqLimdForPAirBoost@ */ /end MEASUREMENT
/begin MEASUREMENT TL_TqLimdForTAir "Limited Torque Value of Air Boost Temperature" FLOAT32_IEEE EcuIntgdSwGend_CM_single_N_m 0 0 0.0 10000.0 ECU_ADDRESS 0x4000E084 /* @ECU_Address@TL_TqLimdForTAir@ */ /end MEASUREMENT
/begin MEASUREMENT TL_TqLimdForPAirAmb "Limited Torque Value of Ambient Air Pressure" FLOAT32_IEEE EcuIntgdSwGend_CM_single_N_m 0 0 0.0 10000.0 ECU_ADDRESS 0x4000DBA4 /* @ECU_Address@TL_TqLimdForPAirAmb@ */ /end MEASUREMENT
/begin MEASUREMENT TL_TqLimdForTOil "Limited Torque Value of Oil Temperature" FLOAT32_IEEE EcuIntgdSwGend_CM_single_N_m 0 0 0.0 10000.0 ECU_ADDRESS 0x4000E930 /* @ECU_Address@TL_TqLimdForTOil@ */ /end MEASUREMENT
/begin MEASUREMENT TL_TqLimdForSurge "Limited Torque Value of Surge Protection" FLOAT32_IEEE EcuIntgdSwGend_CM_single_N_m 0 0 0.0 10000.0 ECU_ADDRESS 0x4000DFC0 /* @ECU_Address@TL_TqLimdForSurge@ */ /end MEASUREMENT
/begin MEASUREMENT TL_TqMapLimdEngProtn "Map Based Torque Limitation Value" FLOAT32_IEEE EcuIntgdSwGend_CM_single_N_m 0 0 0.0 10000.0 ECU_ADDRESS 0x4000DD70 /* @ECU_Address@TL_TqMapLimdEngProtn@ */ /end MEASUREMENT
/begin MEASUREMENT TL_TqLimpMapOut "Limited Torque According to Limp Mode" FLOAT32_IEEE EcuIntgdSwGend_CM_single_N_m 0 0 0.0 10000.0 ECU_ADDRESS 0x4000DE2C /* @ECU_Address@TL_TqLimpMapOut@ */ /end MEASUREMENT
/begin MEASUREMENT TL_TqLimnLimp "Limp Mode Torque Limitation" FLOAT32_IEEE EcuIntgdSwGend_CM_single_N_m 0 0 0.0 10000.0 ECU_ADDRESS 0x4000D8F4 /* @ECU_Address@TL_TqLimnLimp@ */ /end MEASUREMENT
/begin MEASUREMENT TL_TqLimnRednLvl1 "Torque Limitation Reduction Level 1 " FLOAT32_IEEE EcuIntgdSwGend_CM_single_N_m 0 0 0.0 10000.0 ECU_ADDRESS 0x4000E740 /* @ECU_Address@TL_TqLimnRednLvl1@ */ /end MEASUREMENT
/begin MEASUREMENT TL_TqLimnRednLvl2 "Torque Limitation Reduction Level 2" FLOAT32_IEEE EcuIntgdSwGend_CM_single_N_m 0 0 0.0 10000.0 ECU_ADDRESS 0x4000E748 /* @ECU_Address@TL_TqLimnRednLvl2@ */ /end MEASUREMENT
/begin MEASUREMENT TL_DynRateLimr "Dynamic Rate Limiter Out Signal" FLOAT32_IEEE EcuIntgdSwGend_CM_single_N_m 0 0 0.0 10000.0 ECU_ADDRESS 0x4000DDA0 /* @ECU_Address@TL_DynRateLimr@ */ /end MEASUREMENT
/begin MEASUREMENT TL_TqIndcdLimdPre "Indicated Pre Limited Torque Value" FLOAT32_IEEE EcuIntgdSwGend_CM_single_N_m 0 0 0.0 10000.0 ECU_ADDRESS 0x4000E234 /* @ECU_Address@TL_TqIndcdLimdPre@ */ /end MEASUREMENT
/begin MEASUREMENT TL_TqLimnForPtoProtn "Pto Protection Torque Limitation" FLOAT32_IEEE EcuIntgdSwGend_CM_single_N_m 0 0 -1000.0 10000.0 ECU_ADDRESS 0x4000DB8C /* @ECU_Address@TL_TqLimnForPtoProtn@ */ /end MEASUREMENT
/begin MEASUREMENT TL_TqLimnForTrsmProtn "Transmission Protection Torque Limitation" FLOAT32_IEEE EcuIntgdSwGend_CM_single_N_m 0 0 -1000.0 10000.0 ECU_ADDRESS 0x4000DBC8 /* @ECU_Address@TL_TqLimnForTrsmProtn@ */ /end MEASUREMENT
/begin MEASUREMENT TL_CanEngTqReqNmFromTcu "Engine Torque Request Nm From Tcu" FLOAT32_IEEE EcuIntgdSwGend_CM_single_N_m 0 0 -1000.0 10000.0 ECU_ADDRESS 0x4000DC78 /* @ECU_Address@TL_CanEngTqReqNmFromTcu@ */ /end MEASUREMENT
/begin MEASUREMENT TL_MaxTqFromTcu "Max Torque From Tcu" FLOAT32_IEEE EcuIntgdSwGend_CM_single_N_m 0 0 -1000.0 10000.0 ECU_ADDRESS 0x4000DE00 /* @ECU_Address@TL_MaxTqFromTcu@ */ /end MEASUREMENT
/begin MEASUREMENT TL_TqIndcdLimdSwtOut "Indicated Torque Limitation Switch Out" FLOAT32_IEEE EcuIntgdSwGend_CM_single_N_m 0 0 0.0 10000.0 ECU_ADDRESS 0x4000DCC0 /* @ECU_Address@TL_TqIndcdLimdSwtOut@ */ /end MEASUREMENT
/begin MEASUREMENT TL_TqIndcdLimd "Indicated Limited Torque Value" FLOAT32_IEEE EcuIntgdSwGend_CM_single_N_m 0 0 0.0 100000.0 ECU_ADDRESS 0x4000DEF0 /* @ECU_Address@TL_TqIndcdLimd@ */ /end MEASUREMENT
/begin MEASUREMENT TrC_MMaiFuQntyFromMap1 "Main Quantity Map 1 Out" FLOAT32_IEEE EcuIntgdSwGend_CM_single_mm_3_stk 0 0 0.0 1000.0 ECU_ADDRESS 0x4000E918 /* @ECU_Address@TrC_MMaiFuQntyFromMap1@ */ /end MEASUREMENT
/begin MEASUREMENT TrC_MMaiFuQntyFromMap2 "Main Quantity Map 2 Out" FLOAT32_IEEE EcuIntgdSwGend_CM_single_mm_3_stk 0 0 0.0 1000.0 ECU_ADDRESS 0x4000E91C /* @ECU_Address@TrC_MMaiFuQntyFromMap2@ */ /end MEASUREMENT
/begin MEASUREMENT TrC_MMaiFuQnty1To2Intp "Main Fuel Quantity Value" FLOAT32_IEEE EcuIntgdSwGend_CM_single_mm_3_stk 0 0 0.0 10000.0 ECU_ADDRESS 0x4000D8A0 /* @ECU_Address@TrC_MMaiFuQnty1To2Intp@ */ /end MEASUREMENT
/begin MEASUREMENT TrC_MMaiFuQntyFromMap3 "Main Quantity Map 3 Out" FLOAT32_IEEE EcuIntgdSwGend_CM_single_mm_3_stk 0 0 0.0 1000.0 ECU_ADDRESS 0x4000DD28 /* @ECU_Address@TrC_MMaiFuQntyFromMap3@ */ /end MEASUREMENT
/begin MEASUREMENT TrC_MMaiFuQnty2To3Intp "Main Quantity Map 1" FLOAT32_IEEE EcuIntgdSwGend_CM_single_mm_3_stk 0 0 0.0 10000.0 ECU_ADDRESS 0x4000E290 /* @ECU_Address@TrC_MMaiFuQnty2To3Intp@ */ /end MEASUREMENT
/begin MEASUREMENT TrC_MMaiFuQntyPre "Pre Main Fuel Quantity " FLOAT32_IEEE EcuIntgdSwGend_CM_single_mm_3_stk 0 0 0.0 1000.0 ECU_ADDRESS 0x4000E484 /* @ECU_Address@TrC_MMaiFuQntyPre@ */ /end MEASUREMENT
/begin MEASUREMENT TrC_MAirPerStr "Limited Main Quantity Activation - Override Switch" FLOAT32_IEEE EcuIntgdSwGend_CM_single_mg_stk 0 0 0.0 1000.0 ECU_ADDRESS 0x4000E5D8 /* @ECU_Address@TrC_MAirPerStr@ */ /end MEASUREMENT
/begin MEASUREMENT TrC_MPltFuQntyFromMap1 "Pilot Quantity Map 1 Out" FLOAT32_IEEE EcuIntgdSwGend_CM_single_mm_3_stk 0 0 0.0 1000.0 ECU_ADDRESS 0x4000E6F0 /* @ECU_Address@TrC_MPltFuQntyFromMap1@ */ /end MEASUREMENT
/begin MEASUREMENT TrC_MPltFuQntyFromMap2 "Pilot Quantity Map 2 Out" FLOAT32_IEEE EcuIntgdSwGend_CM_single_mm_3_stk 0 0 0.0 1000.0 ECU_ADDRESS 0x4000DC48 /* @ECU_Address@TrC_MPltFuQntyFromMap2@ */ /end MEASUREMENT
/begin MEASUREMENT TrC_MPltFuQnty1To2Intp "Pilot Quantity Value Interpolation Between Map 1 and 2" FLOAT32_IEEE EcuIntgdSwGend_CM_single_mm_3_stk 0 0 0.0 10000.0 ECU_ADDRESS 0x4000DD3C /* @ECU_Address@TrC_MPltFuQnty1To2Intp@ */ /end MEASUREMENT
/begin MEASUREMENT TrC_MPltFuQntyFromMap3 "Pilot Quantity Map 3 Out" FLOAT32_IEEE EcuIntgdSwGend_CM_single_mm_3_stk 0 0 0.0 1000.0 ECU_ADDRESS 0x4000E6F8 /* @ECU_Address@TrC_MPltFuQntyFromMap3@ */ /end MEASUREMENT
/begin MEASUREMENT TrC_MPltFuQnty2To3Intp "Pilot Quantity Value Interpolation Between Map 2 and 3" FLOAT32_IEEE EcuIntgdSwGend_CM_single_mm_3_stk 0 0 0.0 10000.0 ECU_ADDRESS 0x4000E540 /* @ECU_Address@TrC_MPltFuQnty2To3Intp@ */ /end MEASUREMENT
/begin MEASUREMENT TrC_MPltFuQnty "Pilot Fuel Quantity" FLOAT32_IEEE EcuIntgdSwGend_CM_single_mm_3_stk 0 0 0.0 1000.0 ECU_ADDRESS 0x4000E288 /* @ECU_Address@TrC_MPltFuQnty@ */ /end MEASUREMENT
/begin MEASUREMENT TrC_MPltFuQntyCorrTCoolt "" FLOAT32_IEEE EcuIntgdSwGend_CM_single_mm_3_stk 0 0 -500.0 1000.0 ECU_ADDRESS 0x4000E6EC /* @ECU_Address@TrC_MPltFuQntyCorrTCoolt@ */ /end MEASUREMENT
/begin MEASUREMENT TrC_MPltFuQntyCorrPAmbAir "Pilot Fuel Quantity Mass Correction wrt Ambient Air Pressure" FLOAT32_IEEE EcuIntgdSwGend_CM_single_mm_3_stk 0 0 0.0 1000.0 ECU_ADDRESS 0x4000E80C /* @ECU_Address@TrC_MPltFuQntyCorrPAmbAir@ */ /end MEASUREMENT
/begin MEASUREMENT TrC_MPltFuQntyCorrTAmbAir "" FLOAT32_IEEE EcuIntgdSwGend_CM_single_mm_3_stk 0 0 -500.0 1000.0 ECU_ADDRESS 0x4000E24C /* @ECU_Address@TrC_MPltFuQntyCorrTAmbAir@ */ /end MEASUREMENT
/begin MEASUREMENT TrC_MPltFuQntyCorrTOil "" FLOAT32_IEEE EcuIntgdSwGend_CM_single_mm_3_stk 0 0 -500.0 1000.0 ECU_ADDRESS 0x4000E54C /* @ECU_Address@TrC_MPltFuQntyCorrTOil@ */ /end MEASUREMENT
/begin MEASUREMENT TrC_MPltFuQntyCorrTAirBoost "" FLOAT32_IEEE EcuIntgdSwGend_CM_single_mm_3_stk 0 0 -500.0 1000.0 ECU_ADDRESS 0x4000E1C0 /* @ECU_Address@TrC_MPltFuQntyCorrTAirBoost@ */ /end MEASUREMENT
/begin MEASUREMENT TrC_MPltFuQntyCorrUClmp30 "" FLOAT32_IEEE EcuIntgdSwGend_CM_single_mm_3_stk 0 0 -500.0 1000.0 ECU_ADDRESS 0x4000DF88 /* @ECU_Address@TrC_MPltFuQntyCorrUClmp30@ */ /end MEASUREMENT
/begin MEASUREMENT TrC_MPltFuQntyCorr "Pilot Fuel Quantity Correction Signal" FLOAT32_IEEE EcuIntgdSwGend_CM_single_mm_3_stk 0 0 0.0 1000.0 ECU_ADDRESS 0x4000D900 /* @ECU_Address@TrC_MPltFuQntyCorr@ */ /end MEASUREMENT
/begin MEASUREMENT TrC_RatAirFuSmokLim "Air Fuel Rate Smoke Limitation" FLOAT32_IEEE EcuIntgdSwGend_CM_single 0 0 0.0 100.0 ECU_ADDRESS 0x4000DECC /* @ECU_Address@TrC_RatAirFuSmokLim@ */ /end MEASUREMENT
/begin MEASUREMENT TrC_MMaiFuQntySmokLimd "Smoke Limited Main Fuel Quantity" FLOAT32_IEEE EcuIntgdSwGend_CM_single_mm_3_stk 0 0 0.0 1000.0 ECU_ADDRESS 0x4000DEF4 /* @ECU_Address@TrC_MMaiFuQntySmokLimd@ */ /end MEASUREMENT
/begin MEASUREMENT TrC_MMaiFuQntyLimd "Limited Main Fuel Quantity" FLOAT32_IEEE EcuIntgdSwGend_CM_single_mm_3_stk 0 0 0.0 1000.0 ECU_ADDRESS 0x4000E604 /* @ECU_Address@TrC_MMaiFuQntyLimd@ */ /end MEASUREMENT
/begin MEASUREMENT TrC_MTotFuQntyCorrForEngDmdTq "Total Fuel Quantity Correction For Endine Demand Torque Message" FLOAT32_IEEE EcuIntgdSwGend_CM_single_mm_3_stk 0 0 0.0 1000.0 ECU_ADDRESS 0x4000E408 /* @ECU_Address@TrC_MTotFuQntyCorrForEngDmdTq@ */ /end MEASUREMENT
/begin MEASUREMENT TrC_MMaiFuQntyCorrForEngDmdTq "" FLOAT32_IEEE EcuIntgdSwGend_CM_single_mm_3_stk 0 0 0.0 1000.0 ECU_ADDRESS 0x4000E50C /* @ECU_Address@TrC_MMaiFuQntyCorrForEngDmdTq@ */ /end MEASUREMENT
/begin MEASUREMENT EIP_CanTrsmOutpShaftSpd "Engine Input Processing Transmission Output Shaft Speed" FLOAT32_IEEE EcuIntgdSwGend_CM_single_rpm 0 0 0.0 8100.0 ECU_ADDRESS 0x4000E058 /* @ECU_Address@EIP_CanTrsmOutpShaftSpd@ */ /end MEASUREMENT
/begin MEASUREMENT EIP_CanTrsmActGearRat "Engine Input Processing Transmission Actual Gear Ratio" FLOAT32_IEEE EcuIntgdSwGend_CM_single 0 0 0.0 64255.0 ECU_ADDRESS 0x4000E168 /* @ECU_Address@EIP_CanTrsmActGearRat@ */ /end MEASUREMENT
/begin MEASUREMENT EIP_CanTrsmTqCnvrRat "Engine Input Processing Transmission Torque Converter Ratio" FLOAT32_IEEE EcuIntgdSwGend_CM_single 0 0 0.0 64255.0 ECU_ADDRESS 0x4000E334 /* @ECU_Address@EIP_CanTrsmTqCnvrRat@ */ /end MEASUREMENT
/begin MEASUREMENT EIP_CanEngReqTqHiReslFromTcu "Engine Requested Torque - High Resolution From Tcu" FLOAT32_IEEE EcuIntgdSwGend_CM_single__ 0 0 0.0 0.875 ECU_ADDRESS 0x4000E1CC /* @ECU_Address@EIP_CanEngReqTqHiReslFromTcu@ */ /end MEASUREMENT
/begin MEASUREMENT EIP_CanEngTqReqFromTcu "Engine Input Processing Engine Requested Torque/Torque Limit From Tcu" FLOAT32_IEEE EcuIntgdSwGend_CM_single__ 0 0 -125.0 125.0 ECU_ADDRESS 0x4000DDFC /* @ECU_Address@EIP_CanEngTqReqFromTcu@ */ /end MEASUREMENT
/begin MEASUREMENT EIP_CanEngSpdReqFromTcu "Engine Input Processing Engine Requested Speed/Speed Limit" FLOAT32_IEEE EcuIntgdSwGend_CM_single_rpm 0 0 0.0 8100.0 ECU_ADDRESS 0x4000E798 /* @ECU_Address@EIP_CanEngSpdReqFromTcu@ */ /end MEASUREMENT
/begin MEASUREMENT EIP_CanFuLvl1 "Engine Input Processing - Fuel Level 1" FLOAT32_IEEE EcuIntgdSwGend_CM_single__ 0 0 0.0 100.0 ECU_ADDRESS 0x4000E960 /* @ECU_Address@EIP_CanFuLvl1@ */ /end MEASUREMENT
/begin MEASUREMENT EIP_CanEngTqReqFromAbsAsc "Engine Input Processing Engine Requested Torque/Torque Limit From Abs Asc" FLOAT32_IEEE EcuIntgdSwGend_CM_single 0 0 -125.0 125.0 ECU_ADDRESS 0x4000E33C /* @ECU_Address@EIP_CanEngTqReqFromAbsAsc@ */ /end MEASUREMENT
/begin MEASUREMENT EIP_CanTrsmTqLim "Engine Input Processing - SPN 1845 - Transmission Torque Limit" FLOAT32_IEEE EcuIntgdSwGend_CM_single_N_m 0 0 0.0 64255.0 ECU_ADDRESS 0x4000DAB0 /* @ECU_Address@EIP_CanTrsmTqLim@ */ /end MEASUREMENT
/begin MEASUREMENT EIP_CanEngRtdrSeln "Engine Input Processing - SPN 973 - Engine Retarder Selection" FLOAT32_IEEE EcuIntgdSwGend_CM_single__ 0 0 0.0 100.0 ECU_ADDRESS 0x4000DCEC /* @ECU_Address@EIP_CanEngRtdrSeln@ */ /end MEASUREMENT
/begin MEASUREMENT EIP_NrErrCylMisfCount "Cylinder Misfire Error Count Number" FLOAT32_IEEE EcuIntgdSwGend_CM_single 0 0 0.0 15.0 ECU_ADDRESS 0x4000E04C /* @ECU_Address@EIP_NrErrCylMisfCount@ */ /end MEASUREMENT
/begin MEASUREMENT EIP_NrErrInjrCount "Injection Error Count Number" FLOAT32_IEEE EcuIntgdSwGend_CM_single 0 0 0.0 8.0 ECU_ADDRESS 0x4000DEA8 /* @ECU_Address@EIP_NrErrInjrCount@ */ /end MEASUREMENT
/begin MEASUREMENT DTqC_TiTrbChrgOilLeakgIdle "Elapsed Time Signal of Turbo Oil Leakage" FLOAT32_IEEE EcuIntgdSwGend_CM_single_ms 0 0 0.0 250000.0 ECU_ADDRESS 0x4000DEE8 /* @ECU_Address@DTqC_TiTrbChrgOilLeakgIdle@ */ /end MEASUREMENT
/begin MEASUREMENT DTqC_NEngIdleGearRef "Reference Idle Speed for Active Index Gear Map Out" FLOAT32_IEEE EcuIntgdSwGend_CM_single 0 0 0.0 6000.0 ECU_ADDRESS 0x4000E558 /* @ECU_Address@DTqC_NEngIdleGearRef@ */ /end MEASUREMENT
/begin MEASUREMENT DTqC_TCooltNEngIdleRef "Coolant Temperature for Reference Engine Idle Speed Map" FLOAT32_IEEE EcuIntgdSwGend_CM_single 0 0 -1000.0 1000.0 ECU_ADDRESS 0x4000E870 /* @ECU_Address@DTqC_TCooltNEngIdleRef@ */ /end MEASUREMENT
/begin MEASUREMENT DTqC_TOilNEngIdleRef "Oil Temperature for Reference Engine Idle Speed Map Out" FLOAT32_IEEE EcuIntgdSwGend_CM_single 0 0 -1000.0 1000.0 ECU_ADDRESS 0x4000E528 /* @ECU_Address@DTqC_TOilNEngIdleRef@ */ /end MEASUREMENT
/begin MEASUREMENT DTqC_PAmbAirNEngIdleRef "Amibent Air Pressure for Reference Engine Idle Speed Map Out" FLOAT32_IEEE EcuIntgdSwGend_CM_single 0 0 0.0 2000.0 ECU_ADDRESS 0x4000E434 /* @ECU_Address@DTqC_PAmbAirNEngIdleRef@ */ /end MEASUREMENT
/begin MEASUREMENT DTqC_EngPercTqPoint1 "Engine Percent Torque Point 1 " FLOAT32_IEEE EcuIntgdSwGend_CM_single__ 0 0 0.0 125.0 ECU_ADDRESS 0x4000E82C /* @ECU_Address@DTqC_EngPercTqPoint1@ */ /end MEASUREMENT
/begin MEASUREMENT DTqC_EngPercTqPoint2 "Engine Percent Torque Point 2" FLOAT32_IEEE EcuIntgdSwGend_CM_single__ 0 0 0.0 125.0 ECU_ADDRESS 0x4000E10C /* @ECU_Address@DTqC_EngPercTqPoint2@ */ /end MEASUREMENT
/begin MEASUREMENT DTqC_EngPercTqPoint3 "Engine Percent Torque Point 3" FLOAT32_IEEE EcuIntgdSwGend_CM_single__ 0 0 0.0 125.0 ECU_ADDRESS 0x4000E834 /* @ECU_Address@DTqC_EngPercTqPoint3@ */ /end MEASUREMENT
/begin MEASUREMENT DTqC_EngPercTqPoint4 "Engine Percent Torque Point 4" FLOAT32_IEEE EcuIntgdSwGend_CM_single__ 0 0 0.0 125.0 ECU_ADDRESS 0x4000E838 /* @ECU_Address@DTqC_EngPercTqPoint4@ */ /end MEASUREMENT
/begin MEASUREMENT DTqC_EngPercTqPoint5 "Engine Percent Torque Point 5" FLOAT32_IEEE EcuIntgdSwGend_CM_single__ 0 0 0.0 125.0 ECU_ADDRESS 0x4000E83C /* @ECU_Address@DTqC_EngPercTqPoint5@ */ /end MEASUREMENT
/begin MEASUREMENT DTqC_CanEngDftTqLim "Engine Default Torque Limit" FLOAT32_IEEE EcuIntgdSwGend_CM_single_N_m 0 0 0.0 64255.0 ECU_ADDRESS 0x4000E828 /* @ECU_Address@DTqC_CanEngDftTqLim@ */ /end MEASUREMENT
/begin MEASUREMENT DTqC_ErrNIdle "Idle Speed Reference and Engine Speed Differences" FLOAT32_IEEE EcuIntgdSwGend_CM_single_rpm 0 0 -3300.0 3300.0 ECU_ADDRESS 0x4000DE3C /* @ECU_Address@DTqC_ErrNIdle@ */ /end MEASUREMENT
/begin MEASUREMENT DTqC_CoeffPForSpdCtlMapOut "Proportional Coefficient Map Out Signal for Speed Controller" FLOAT32_IEEE EcuIntgdSwGend_CM_single 0 0 -100000.0 100000.0 ECU_ADDRESS 0x4000DF1C /* @ECU_Address@DTqC_CoeffPForSpdCtlMapOut@ */ /end MEASUREMENT
/begin MEASUREMENT DTqC_FacSclForPIDKpCoeff "Factor Scaling for PID Proportional Coefficient Signal" FLOAT32_IEEE EcuIntgdSwGend_CM_single 0 0 -100.0 100.0 ECU_ADDRESS 0x4000D840 /* @ECU_Address@DTqC_FacSclForPIDKpCoeff@ */ /end MEASUREMENT
/begin MEASUREMENT DTqC_CoeffPForSpdCtl "Proportional Coefficient Signal for Speed Controller" FLOAT32_IEEE EcuIntgdSwGend_CM_single 0 0 -100.0 100.0 ECU_ADDRESS 0x4000DF08 /* @ECU_Address@DTqC_CoeffPForSpdCtl@ */ /end MEASUREMENT
/begin MEASUREMENT DTqC_CoeffDForSpdCtlMapOut "Derivative Coefficient Map Out Signal for Speed Controller" FLOAT32_IEEE EcuIntgdSwGend_CM_single 0 0 -100000.0 100000.0 ECU_ADDRESS 0x4000DF18 /* @ECU_Address@DTqC_CoeffDForSpdCtlMapOut@ */ /end MEASUREMENT
/begin MEASUREMENT DTqC_FacSclForPIDKdCoeff "Factor Scaling for PID Derivative Coefficient Signal" FLOAT32_IEEE EcuIntgdSwGend_CM_single 0 0 -100.0 100.0 ECU_ADDRESS 0x4000DE34 /* @ECU_Address@DTqC_FacSclForPIDKdCoeff@ */ /end MEASUREMENT
/begin MEASUREMENT DTqC_CoeffDForSpdCtl "Derivative Coefficient Signal for Speed Controller" FLOAT32_IEEE EcuIntgdSwGend_CM_single 0 0 -100.0 100.0 ECU_ADDRESS 0x4000DC8C /* @ECU_Address@DTqC_CoeffDForSpdCtl@ */ /end MEASUREMENT
/begin MEASUREMENT DTqC_CoeffFiltForSpdCtlMapOut "Filter Coefficient Map Out Signal for Speed Controller" FLOAT32_IEEE EcuIntgdSwGend_CM_single 0 0 -100000.0 100000.0 ECU_ADDRESS 0x4000E308 /* @ECU_Address@DTqC_CoeffFiltForSpdCtlMapOut@ */ /end MEASUREMENT
/begin MEASUREMENT DTqC_FacSclForPIDFiltKdCoeff "Factor Scaling for PID Derivative Filter Coefficient Signal" FLOAT32_IEEE EcuIntgdSwGend_CM_single 0 0 -100.0 100.0 ECU_ADDRESS 0x4000D8F0 /* @ECU_Address@DTqC_FacSclForPIDFiltKdCoeff@ */ /end MEASUREMENT
/begin MEASUREMENT DTqC_CoeffFiltForSpdCtl "Filter Coefficient Signal for Speed Controller" FLOAT32_IEEE EcuIntgdSwGend_CM_single 0 0 -100.0 100.0 ECU_ADDRESS 0x4000DEBC /* @ECU_Address@DTqC_CoeffFiltForSpdCtl@ */ /end MEASUREMENT
/begin MEASUREMENT DTqC_TqDesSatPIDMax "Idle Engine Speed PID Controlller Max Saturation Parameter" FLOAT32_IEEE EcuIntgdSwGend_CM_single_N_m 0 0 -1000.0 10000.0 ECU_ADDRESS 0x4000E450 /* @ECU_Address@DTqC_TqDesSatPIDMax@ */ /end MEASUREMENT
/begin MEASUREMENT DTqC_IdleSpdCtrlFF "Idle Speed Controller FeedForward Out" FLOAT32_IEEE EcuIntgdSwGend_CM_single_N_m 0 0 -10000.0 10000.0 ECU_ADDRESS 0x4000D998 /* @ECU_Address@DTqC_IdleSpdCtrlFF@ */ /end MEASUREMENT
/begin MEASUREMENT DTqC_IdleSpdCtlTqBrk "Idle Speed Controller Brake Torque" FLOAT32_IEEE EcuIntgdSwGend_CM_single_N_m 0 0 -10000.0 10000.0 ECU_ADDRESS 0x4000E28C /* @ECU_Address@DTqC_IdleSpdCtlTqBrk@ */ /end MEASUREMENT
/begin MEASUREMENT DTqC_CabPtoTq "Desired Torque Calculation - Cabin Pto Torque" FLOAT32_IEEE EcuIntgdSwGend_CM_single_N_m 0 0 -10000.0 3000.0 ECU_ADDRESS 0x4000DCF0 /* @ECU_Address@DTqC_CabPtoTq@ */ /end MEASUREMENT
/begin MEASUREMENT DTqC_CrsCtrlTq "Desired Torque Calculation - Cruise Control Torque" FLOAT32_IEEE EcuIntgdSwGend_CM_single_N_m 0 0 -10000.0 3000.0 ECU_ADDRESS 0x4000DD0C /* @ECU_Address@DTqC_CrsCtrlTq@ */ /end MEASUREMENT
/begin MEASUREMENT DTqC_DrvrDmdTq "Driver Demand Torque" FLOAT32_IEEE EcuIntgdSwGend_CM_single_N_m 0 0 -10000.0 10000.0 ECU_ADDRESS 0x4000E4AC /* @ECU_Address@DTqC_DrvrDmdTq@ */ /end MEASUREMENT
/begin MEASUREMENT DTqC_TSC1SpdModTqReq "TSC1 Speed Mode Torque Request" FLOAT32_IEEE EcuIntgdSwGend_CM_single_N_m 0 0 -10000.0 10000.0 ECU_ADDRESS 0x4000E840 /* @ECU_Address@DTqC_TSC1SpdModTqReq@ */ /end MEASUREMENT
/begin MEASUREMENT DTqC_CanEngTqReqNmFromTcu "Engine Torque Request Nm" FLOAT32_IEEE EcuIntgdSwGend_CM_single_N_m 0 0 -10000.0 10000.0 ECU_ADDRESS 0x4000E47C /* @ECU_Address@DTqC_CanEngTqReqNmFromTcu@ */ /end MEASUREMENT
/begin MEASUREMENT DTqC_TSC1TqModTqReq "TSC1 Torque Mode Torque Request" FLOAT32_IEEE EcuIntgdSwGend_CM_single_N_m 0 0 -10000.0 10000.0 ECU_ADDRESS 0x4000E638 /* @ECU_Address@DTqC_TSC1TqModTqReq@ */ /end MEASUREMENT
/begin MEASUREMENT DTqC_TSC1MaxEngSpd "TSC1 Message Max Engine Speed Request" FLOAT32_IEEE EcuIntgdSwGend_CM_single_rpm 0 0 0.0 5000.0 ECU_ADDRESS 0x4000DDE0 /* @ECU_Address@DTqC_TSC1MaxEngSpd@ */ /end MEASUREMENT
/begin MEASUREMENT DTqC_NEngSoftLim "" FLOAT32_IEEE EcuIntgdSwGend_CM_single_rpm 0 0 0.0 3000.0 ECU_ADDRESS 0x4000DA34 /* @ECU_Address@DTqC_NEngSoftLim@ */ /end MEASUREMENT
/begin MEASUREMENT DTqC_TqEngSpdSoftLim "" FLOAT32_IEEE EcuIntgdSwGend_CM_single_N_m 0 0 -10000.0 10000.0 ECU_ADDRESS 0x4000E5BC /* @ECU_Address@DTqC_TqEngSpdSoftLim@ */ /end MEASUREMENT
/begin MEASUREMENT DTqC_CoeffIForSpdCtlMapOut "Integrator Coefficient Map Out Signal for Speed Controller" FLOAT32_IEEE EcuIntgdSwGend_CM_single 0 0 -100000.0 100000.0 ECU_ADDRESS 0x4000DA9C /* @ECU_Address@DTqC_CoeffIForSpdCtlMapOut@ */ /end MEASUREMENT
/begin MEASUREMENT DTqC_FacSclForPIDKiCoeff "Factor Scaling for PID Integrator Coefficient Signal" FLOAT32_IEEE EcuIntgdSwGend_CM_single 0 0 -100.0 100.0 ECU_ADDRESS 0x4000D908 /* @ECU_Address@DTqC_FacSclForPIDKiCoeff@ */ /end MEASUREMENT
/begin MEASUREMENT DTqC_CoeffIForSpdCtl "Integrator Coefficient Signal for Speed Controller" FLOAT32_IEEE EcuIntgdSwGend_CM_single 0 0 -100.0 100.0 ECU_ADDRESS 0x4000DE6C /* @ECU_Address@DTqC_CoeffIForSpdCtl@ */ /end MEASUREMENT
/begin MEASUREMENT CrsCtrl_EngBrkLvl "Engine Brake Level via Cruise Control" FLOAT32_IEEE EcuIntgdSwGend_CM_single 0 0 0.0 2.0 ECU_ADDRESS 0x4000E12C /* @ECU_Address@CrsCtrl_EngBrkLvl@ */ /end MEASUREMENT
/begin MEASUREMENT CrsCtrl_CoeffDForVVehCtl "Coefficient Derrivate For Vehicle Velocity Control" FLOAT32_IEEE EcuIntgdSwGend_CM_single 0 0 0.0 10000.0 ECU_ADDRESS 0x4000DDAC /* @ECU_Address@CrsCtrl_CoeffDForVVehCtl@ */ /end MEASUREMENT
/begin MEASUREMENT CrsCtrl_CoeffFiltForVVehCtl "Coefficient Filter for Vehicle Velocity Control" FLOAT32_IEEE EcuIntgdSwGend_CM_single 0 0 0.0 10000.0 ECU_ADDRESS 0x4000E55C /* @ECU_Address@CrsCtrl_CoeffFiltForVVehCtl@ */ /end MEASUREMENT
/begin MEASUREMENT CrsCtrl_CoeffPForVVehCtl "Derivative Coefficient Map for Vehicle Velocity" FLOAT32_IEEE EcuIntgdSwGend_CM_single 0 0 0.0 10000.0 ECU_ADDRESS 0x4000DCE8 /* @ECU_Address@CrsCtrl_CoeffPForVVehCtl@ */ /end MEASUREMENT
/begin MEASUREMENT CrsCtrl_SatPIDMax "PID Maximum Saturation" FLOAT32_IEEE EcuIntgdSwGend_CM_single_N_m 0 0 0.0 10000.0 ECU_ADDRESS 0x4000D974 /* @ECU_Address@CrsCtrl_SatPIDMax@ */ /end MEASUREMENT
/begin MEASUREMENT CrsCtrl_TrfCaseStsFac "Transfer Case Status Factor" FLOAT32_IEEE EcuIntgdSwGend_CM_single 0 0 0.0 100.0 ECU_ADDRESS 0x4000D960 /* @ECU_Address@CrsCtrl_TrfCaseStsFac@ */ /end MEASUREMENT
/begin MEASUREMENT CrsCtrl_TrsmTqCnvrRatFac "Transmission Torque Convertor Ratio Factor" FLOAT32_IEEE EcuIntgdSwGend_CM_single 0 0 0.0 100.0 ECU_ADDRESS 0x4000E0F4 /* @ECU_Address@CrsCtrl_TrsmTqCnvrRatFac@ */ /end MEASUREMENT
/begin MEASUREMENT CrsCtrl_CoeffIForVVehCtl "Coefficient Integral for Vehicle Velocity Control" FLOAT32_IEEE EcuIntgdSwGend_CM_single 0 0 0.0 10000.0 ECU_ADDRESS 0x4000E534 /* @ECU_Address@CrsCtrl_CoeffIForVVehCtl@ */ /end MEASUREMENT
/begin MEASUREMENT EIP_CanTrsmCurrentGear "Engine Input Processing Transmission Current Gear" SWORD EcuIntgdSwGend_CM_int16 0 0 -125.0 251.0 ECU_ADDRESS 0x4000E73E /* @ECU_Address@EIP_CanTrsmCurrentGear@ */ /end MEASUREMENT
/begin MEASUREMENT EIP_CanTrsmSeldGear "Engine Input Processing Transmission Selected Gear" SWORD EcuIntgdSwGend_CM_int16 0 0 -125.0 251.0 ECU_ADDRESS 0x4000E2D8 /* @ECU_Address@EIP_CanTrsmSeldGear@ */ /end MEASUREMENT
/begin MEASUREMENT EIP_CanWhlBasVehSpd "Engine Input Processing - Wheel Based Vehicle Speed" SWORD EcuIntgdSwGend_CM_int16_km_h 0 0 0.0 251.0 ECU_ADDRESS 0x4000D8DE /* @ECU_Address@EIP_CanWhlBasVehSpd@ */ /end MEASUREMENT
/begin MEASUREMENT EIP_CanTachographVehSpd "Engine Input Processing - Tachograph Vehicle Speed" SWORD EcuIntgdSwGend_CM_int16_km_h 0 0 0.0 251.0 ECU_ADDRESS 0x4000E1A0 /* @ECU_Address@EIP_CanTachographVehSpd@ */ /end MEASUREMENT
/begin MEASUREMENT EIP_CanTrsmOilLvlReq "Engine Input Processing Transmission Oil Level Request" UBYTE EcuIntgdSwGend_CM_uint8__ 0 0 0.0 3.0 ECU_ADDRESS 0x4000E16C /* @ECU_Address@EIP_CanTrsmOilLvlReq@ */ /end MEASUREMENT
/begin MEASUREMENT EIP_CanASREngCtrlActv "Engine Input Processing ASR Engine Control Active" UBYTE EcuIntgdSwGend_CM_uint8 0 0 0.0 3.0 ECU_ADDRESS 0x4000E481 /* @ECU_Address@EIP_CanASREngCtrlActv@ */ /end MEASUREMENT
/begin MEASUREMENT EIP_CanASRBrkCtrlActv "Engine Input Processing ASR Brake Control Active" UBYTE EcuIntgdSwGend_CM_uint8 0 0 0.0 3.0 ECU_ADDRESS 0x4000E2D4 /* @ECU_Address@EIP_CanASRBrkCtrlActv@ */ /end MEASUREMENT
/begin MEASUREMENT EIP_CanABSActv "Engine Input Processing Anti-Lock Braking (ABS) Active" UBYTE EcuIntgdSwGend_CM_uint8 0 0 0.0 3.0 ECU_ADDRESS 0x4000E094 /* @ECU_Address@EIP_CanABSActv@ */ /end MEASUREMENT
/begin MEASUREMENT EIP_CanTrsmEngCrkEna "Engine Input Processing Transmission Engine Crank Enable" UBYTE EcuIntgdSwGend_CM_uint8 0 0 0.0 3.0 ECU_ADDRESS 0x4000E148 /* @ECU_Address@EIP_CanTrsmEngCrkEna@ */ /end MEASUREMENT
/begin MEASUREMENT EIP_CanTrsmTqCnvLockUpEngd "Engine Input Processing Transmission Torque Converter Lockup Engaged" UBYTE EcuIntgdSwGend_CM_uint8 0 0 0.0 3.0 ECU_ADDRESS 0x4000D99D /* @ECU_Address@EIP_CanTrsmTqCnvLockUpEngd@ */ /end MEASUREMENT
/begin MEASUREMENT EIP_CanTrfCaseSts "Engine Input Processing Transfer case status" UBYTE EcuIntgdSwGend_CM_uint8 0 0 0.0 7.0 ECU_ADDRESS 0x4000E367 /* @ECU_Address@EIP_CanTrfCaseSts@ */ /end MEASUREMENT
/begin MEASUREMENT EIP_CanEngOvrdCtrlModFromTcu "Engine Input Processing Engine Override Control Mode From Tcu" UBYTE EcuIntgdSwGend_CM_uint8 0 0 0.0 3.0 ECU_ADDRESS 0x4000DB72 /* @ECU_Address@EIP_CanEngOvrdCtrlModFromTcu@ */ /end MEASUREMENT
/begin MEASUREMENT EIP_CanOvrdCtrlModPrioFromTcu "Engine Input Processing Override Control Mode Priority From Tcu" UBYTE EcuIntgdSwGend_CM_uint8 0 0 0.0 3.0 ECU_ADDRESS 0x4000E4E0 /* @ECU_Address@EIP_CanOvrdCtrlModPrioFromTcu@ */ /end MEASUREMENT
/begin MEASUREMENT EIP_CanEngPtoGovrEnaSwt "CAN Pto Governor - Enable Switch" UBYTE EcuIntgdSwGend_CM_uint8 0 0 0.0 3.0 ECU_ADDRESS 0x4000E0FF /* @ECU_Address@EIP_CanEngPtoGovrEnaSwt@ */ /end MEASUREMENT
/begin MEASUREMENT EIP_CanEngRemPtoGovrProgdSpdCtrlSwt "CAN Pto Governor - Programmed Speed Control Switch" UBYTE EcuIntgdSwGend_CM_uint8 0 0 0.0 3.0 ECU_ADDRESS 0x4000DFCC /* @ECU_Address@EIP_CanEngRemPtoGovrProgdSpdCtrlSwt@ */ /end MEASUREMENT
/begin MEASUREMENT EIP_CanCrsCtrlSetSwt "Cruise Control Set Switch From CAN" UBYTE EcuIntgdSwGend_CM_uint8 0 0 0.0 3.0 ECU_ADDRESS 0x4000E3F8 /* @ECU_Address@EIP_CanCrsCtrlSetSwt@ */ /end MEASUREMENT
/begin MEASUREMENT EIP_CanCrsCtrlResuSwt "Cruise Control Resume Switch From CAN" UBYTE EcuIntgdSwGend_CM_uint8 0 0 0.0 3.0 ECU_ADDRESS 0x4000E908 /* @ECU_Address@EIP_CanCrsCtrlResuSwt@ */ /end MEASUREMENT
/begin MEASUREMENT EIP_CanCrsCtrlEnaSwt "Cruise Control Enable Switch" UBYTE EcuIntgdSwGend_CM_uint8 0 0 0.0 3.0 ECU_ADDRESS 0x4000E5B8 /* @ECU_Address@EIP_CanCrsCtrlEnaSwt@ */ /end MEASUREMENT
/begin MEASUREMENT EIP_CanVehLimSpdGovrEnaSwt "Vehicle Limiting Speed Governor Enable Switch" UBYTE EcuIntgdSwGend_CM_uint8 0 0 0.0 3.0 ECU_ADDRESS 0x4000E448 /* @ECU_Address@EIP_CanVehLimSpdGovrEnaSwt@ */ /end MEASUREMENT
/begin MEASUREMENT EIP_CanVehLimSpdGovrInctSwt "Vehicle Limiting Speed Governor Decrement Switch" UBYTE EcuIntgdSwGend_CM_uint8 0 0 0.0 3.0 ECU_ADDRESS 0x4000DF24 /* @ECU_Address@EIP_CanVehLimSpdGovrInctSwt@ */ /end MEASUREMENT
/begin MEASUREMENT EIP_CanVehLimSpdGovrDecSwt "Vehicle Limiting Speed Governor Increment Switch" UBYTE EcuIntgdSwGend_CM_uint8 0 0 0.0 3.0 ECU_ADDRESS 0x4000E0F0 /* @ECU_Address@EIP_CanVehLimSpdGovrDecSwt@ */ /end MEASUREMENT
/begin MEASUREMENT EIP_CanEngOvrdCtrlModFromAbsAsc "Engine Input Processing Engine Override Control Mode From Abs Asc" UBYTE EcuIntgdSwGend_CM_uint8 0 0 0.0 3.0 ECU_ADDRESS 0x4000E183 /* @ECU_Address@EIP_CanEngOvrdCtrlModFromAbsAsc@ */ /end MEASUREMENT
/begin MEASUREMENT EIP_CanOvrdCtrlModPrioFromAbsAsc "Engine Input Processing Override Control Mode Priority From Abs Asc" UBYTE EcuIntgdSwGend_CM_uint8 0 0 0.0 3.0 ECU_ADDRESS 0x4000E25C /* @ECU_Address@EIP_CanOvrdCtrlModPrioFromAbsAsc@ */ /end MEASUREMENT
/begin MEASUREMENT EIP_CanEngTqLimReqMaxCntns "Engine Input Processing Engine Torque Limit Request - Maximum Continuous" SBYTE EcuIntgdSwGend_CM_int8__ 0 0 -125.0 125.0 ECU_ADDRESS 0x4000DA09 /* @ECU_Address@EIP_CanEngTqLimReqMaxCntns@ */ /end MEASUREMENT
/begin MEASUREMENT EIP_CanEngAuxShtdwnSwt "Engine Input Processing Engine Auxiliary Shutdown Switch" SBYTE EcuIntgdSwGend_CM_int8 0 0 0.0 3.0 ECU_ADDRESS 0x4000E16D /* @ECU_Address@EIP_CanEngAuxShtdwnSwt@ */ /end MEASUREMENT
/begin MEASUREMENT EIP_CanEstimdEngParasiticTq "Engine Input Processing Estimated Engine Parasitic Losses" SBYTE EcuIntgdSwGend_CM_int8__ 0 0 -125.0 125.0 ECU_ADDRESS 0x4000E11D /* @ECU_Address@EIP_CanEstimdEngParasiticTq@ */ /end MEASUREMENT
/begin MEASUREMENT WgC_WgtClsLoopEna "Wastegate Open Loop Enable" UBYTE EcuIntgdSwGend_CM_boolean 0 0 0.0 1.0 ECU_ADDRESS 0x4000E11E /* @ECU_Address@WgC_WgtClsLoopEna@ */ /end MEASUREMENT
/begin MEASUREMENT TrC_CdnSmokeLim "Smoke Limitation Condition Signal" UBYTE EcuIntgdSwGend_CM_boolean 0 0 0.0 1.0 ECU_ADDRESS 0x4000DC09 /* @ECU_Address@TrC_CdnSmokeLim@ */ /end MEASUREMENT
/begin MEASUREMENT EIP_StOfCanTrsmOilLvlReq "State Of Can Transmission Oil Level Request" UBYTE EcuIntgdSwGend_CM_boolean 0 0 0.0 1.0 ECU_ADDRESS 0x4000D880 /* @ECU_Address@EIP_StOfCanTrsmOilLvlReq@ */ /end MEASUREMENT
/begin MEASUREMENT EIP_StOfCanEngTqLimReqMaxCntns "State Of Can Engine Torque Limit Request - Maximum Continuous" UBYTE EcuIntgdSwGend_CM_boolean 0 0 0.0 1.0 ECU_ADDRESS 0x4000E489 /* @ECU_Address@EIP_StOfCanEngTqLimReqMaxCntns@ */ /end MEASUREMENT
/begin MEASUREMENT EIP_StOfCanASREngCtrlActv "State Of Can Acceleration Slip Regulation (ASR) Engine Control Active" UBYTE EcuIntgdSwGend_CM_boolean 0 0 0.0 1.0 ECU_ADDRESS 0x4000E274 /* @ECU_Address@EIP_StOfCanASREngCtrlActv@ */ /end MEASUREMENT
/begin MEASUREMENT EIP_StOfCanASRBrkCtrlActv "State Of Can Acceleration Slip Regulation (ASR) Brake Control Active" UBYTE EcuIntgdSwGend_CM_boolean 0 0 0.0 1.0 ECU_ADDRESS 0x4000E210 /* @ECU_Address@EIP_StOfCanASRBrkCtrlActv@ */ /end MEASUREMENT
/begin MEASUREMENT EIP_StOfCanABSActv "Engine Input Processing State Of Anti-Lock Braking (ABS) Active" UBYTE EcuIntgdSwGend_CM_boolean 0 0 0.0 1.0 ECU_ADDRESS 0x4000E56A /* @ECU_Address@EIP_StOfCanABSActv@ */ /end MEASUREMENT
/begin MEASUREMENT EIP_StOfCanEngAuxShtdwnSwt "State Of Can Engine Auxiliary Shutdown Switch" UBYTE EcuIntgdSwGend_CM_boolean 0 0 0.0 1.0 ECU_ADDRESS 0x4000E514 /* @ECU_Address@EIP_StOfCanEngAuxShtdwnSwt@ */ /end MEASUREMENT
/begin MEASUREMENT EIP_StOfCanTrsmEngCrkEna "Ecu Input Processing State Of Can Transmission Engine Crank Enable" UBYTE EcuIntgdSwGend_CM_boolean 0 0 0.0 1.0 ECU_ADDRESS 0x4000DE65 /* @ECU_Address@EIP_StOfCanTrsmEngCrkEna@ */ /end MEASUREMENT
/begin MEASUREMENT EIP_StOfCanEstimdEngParasiticTq "State Of Can Estimated Engine Parasitic Torque" UBYTE EcuIntgdSwGend_CM_boolean 0 0 0.0 1.0 ECU_ADDRESS 0x4000E076 /* @ECU_Address@EIP_StOfCanEstimdEngParasiticTq@ */ /end MEASUREMENT
/begin MEASUREMENT EIP_StOfCanTrsmTqCnvLockUpEngd "Engine Input Processing State Of Can Transmission Torque Convertor Lock Up Engaged" UBYTE EcuIntgdSwGend_CM_boolean 0 0 0.0 1.0 ECU_ADDRESS 0x4000E4B8 /* @ECU_Address@EIP_StOfCanTrsmTqCnvLockUpEngd@ */ /end MEASUREMENT
/begin MEASUREMENT EIP_StOfCanTrsmOutpShaftSpd "Engine Input Processing - State of Transmission Outputshaft Speed" UBYTE EcuIntgdSwGend_CM_boolean 0 0 0.0 1.0 ECU_ADDRESS 0x4000E551 /* @ECU_Address@EIP_StOfCanTrsmOutpShaftSpd@ */ /end MEASUREMENT
/begin MEASUREMENT EIP_StOfCanTrsmCurrentGear "Engine Input Processing State Of Can Transmission Current Gear" UBYTE EcuIntgdSwGend_CM_boolean 0 0 0.0 1.0 ECU_ADDRESS 0x4000E99C /* @ECU_Address@EIP_StOfCanTrsmCurrentGear@ */ /end MEASUREMENT
/begin MEASUREMENT EIP_StOfCanTrsmSeldGear "State Of Can Transmission Selected Gear" UBYTE EcuIntgdSwGend_CM_boolean 0 0 0.0 1.0 ECU_ADDRESS 0x4000E2DC /* @ECU_Address@EIP_StOfCanTrsmSeldGear@ */ /end MEASUREMENT
/begin MEASUREMENT EIP_StOfCanTrsmActGearRat "State Of Can Transmission Actual Gear Ratio" UBYTE EcuIntgdSwGend_CM_boolean 0 0 0.0 1.0 ECU_ADDRESS 0x4000DF74 /* @ECU_Address@EIP_StOfCanTrsmActGearRat@ */ /end MEASUREMENT
/begin MEASUREMENT EIP_StOfCanTrsmTqCnvrRat "Ecu Input Processing State Of Can Transmission Torque Converter Ratio" UBYTE EcuIntgdSwGend_CM_boolean 0 0 0.0 1.0 ECU_ADDRESS 0x4000E869 /* @ECU_Address@EIP_StOfCanTrsmTqCnvrRat@ */ /end MEASUREMENT
/begin MEASUREMENT EIP_StOfCanTrfCaseSts "Ecu Input Processing State Of Can Transfer Case Status" UBYTE EcuIntgdSwGend_CM_boolean 0 0 0.0 1.0 ECU_ADDRESS 0x4000DFB6 /* @ECU_Address@EIP_StOfCanTrfCaseSts@ */ /end MEASUREMENT
/begin MEASUREMENT EIP_StOfCanEngReqTqHiReslFromTcu "State Of Can Engine Request Torque High Resolution" UBYTE EcuIntgdSwGend_CM_boolean 0 0 0.0 1.0 ECU_ADDRESS 0x4000DE5C /* @ECU_Address@EIP_StOfCanEngReqTqHiReslFromTcu@ */ /end MEASUREMENT
/begin MEASUREMENT EIP_StOfCanEngTqReqFromTcu "State Of Can Engine Torque Request From Tcu" UBYTE EcuIntgdSwGend_CM_boolean 0 0 0.0 1.0 ECU_ADDRESS 0x4000E14D /* @ECU_Address@EIP_StOfCanEngTqReqFromTcu@ */ /end MEASUREMENT
/begin MEASUREMENT EIP_StOfCanEngOvrdCtrlModFromTcu "State Of Engine Override Control Mode From Tcu" UBYTE EcuIntgdSwGend_CM_boolean 0 0 0.0 1.0 ECU_ADDRESS 0x4000DEB7 /* @ECU_Address@EIP_StOfCanEngOvrdCtrlModFromTcu@ */ /end MEASUREMENT
/begin MEASUREMENT EIP_StOfCanOvrdCtrlModPrioFromTcu "State Of Can Override Control Mode Priority From Tcu" UBYTE EcuIntgdSwGend_CM_boolean 0 0 0.0 1.0 ECU_ADDRESS 0x4000DEAD /* @ECU_Address@EIP_StOfCanOvrdCtrlModPrioFromTcu@ */ /end MEASUREMENT
/begin MEASUREMENT EIP_StOfCanEngSpdReqFromTcu "State Of Can Engine Speed Request" UBYTE EcuIntgdSwGend_CM_boolean 0 0 0.0 1.0 ECU_ADDRESS 0x4000E4D5 /* @ECU_Address@EIP_StOfCanEngSpdReqFromTcu@ */ /end MEASUREMENT
/begin MEASUREMENT EIP_StOfCanWhlBasVehSpd "Engine Input Processing - State of Wheel Based Vehicle Speed" UBYTE EcuIntgdSwGend_CM_boolean 0 0 0.0 1.0 ECU_ADDRESS 0x4000D8E8 /* @ECU_Address@EIP_StOfCanWhlBasVehSpd@ */ /end MEASUREMENT
/begin MEASUREMENT EIP_StOfCanTachographVehSpd "Engine Input Processing State of Tachograph Vehicle Speed" UBYTE EcuIntgdSwGend_CM_boolean 0 0 0.0 1.0 ECU_ADDRESS 0x4000D8A4 /* @ECU_Address@EIP_StOfCanTachographVehSpd@ */ /end MEASUREMENT
/begin MEASUREMENT EIP_StOfCanEngPtoGovrEnaSwt "Engine Input Processing State Of Can Engine Pto Governor Enable Switch" UBYTE EcuIntgdSwGend_CM_boolean 0 0 0.0 1.0 ECU_ADDRESS 0x4000E650 /* @ECU_Address@EIP_StOfCanEngPtoGovrEnaSwt@ */ /end MEASUREMENT
/begin MEASUREMENT EIP_StOfCanEngRemPtoGovrSpdCtrlSwt "Engine Input Processing State Of Can Engine Remote Pto Governor Speed Control Switch" UBYTE EcuIntgdSwGend_CM_boolean 0 0 0.0 1.0 ECU_ADDRESS 0x4000E88C /* @ECU_Address@EIP_StOfCanEngRemPtoGovrSpdCtrlSwt@ */ /end MEASUREMENT
/begin MEASUREMENT EIP_StOfCanFuLvl1 "Engine Input Processing - State Of Fuel Level 1" UBYTE EcuIntgdSwGend_CM_boolean 0 0 0.0 1.0 ECU_ADDRESS 0x4000E041 /* @ECU_Address@EIP_StOfCanFuLvl1@ */ /end MEASUREMENT
/begin MEASUREMENT EIP_StOfCanCrsCtrlSetSwt "State Of Can Cruise Control Set Switch" UBYTE EcuIntgdSwGend_CM_boolean 0 0 0.0 1.0 ECU_ADDRESS 0x4000E0FC /* @ECU_Address@EIP_StOfCanCrsCtrlSetSwt@ */ /end MEASUREMENT
/begin MEASUREMENT EIP_StOfCanCrsCtrlResuSwt "State Of Can Cruise Control Resume Switch" UBYTE EcuIntgdSwGend_CM_boolean 0 0 0.0 1.0 ECU_ADDRESS 0x4000E6E0 /* @ECU_Address@EIP_StOfCanCrsCtrlResuSwt@ */ /end MEASUREMENT
/begin MEASUREMENT EIP_StOfCanCrsCtrlEnaSwt "State Of Can Cruise Control Enable Switch" UBYTE EcuIntgdSwGend_CM_boolean 0 0 0.0 1.0 ECU_ADDRESS 0x4000DD36 /* @ECU_Address@EIP_StOfCanCrsCtrlEnaSwt@ */ /end MEASUREMENT
/begin MEASUREMENT EIP_StOfCanVehLimSpdGovrEnaSwt "State of Vehicle Limiting Speed Governor Enable Switch" UBYTE EcuIntgdSwGend_CM_boolean 0 0 0.0 1.0 ECU_ADDRESS 0x4000DF6C /* @ECU_Address@EIP_StOfCanVehLimSpdGovrEnaSwt@ */ /end MEASUREMENT
/begin MEASUREMENT EIP_StOfCanVehLimSpdGovrInctSwt "State of Can Vehicle Limiting Speed Governor Increment Switch" UBYTE EcuIntgdSwGend_CM_boolean 0 0 0.0 1.0 ECU_ADDRESS 0x4000DA30 /* @ECU_Address@EIP_StOfCanVehLimSpdGovrInctSwt@ */ /end MEASUREMENT
/begin MEASUREMENT EIP_StOfCanVehLimSpdGovrDecSwt "State of Can Vehicle Limiting Speed Governor Decrement Swich" UBYTE EcuIntgdSwGend_CM_boolean 0 0 0.0 1.0 ECU_ADDRESS 0x4000E5EC /* @ECU_Address@EIP_StOfCanVehLimSpdGovrDecSwt@ */ /end MEASUREMENT
/begin MEASUREMENT EIP_StOfCanEngTqReqFromAbsAsc "State Of Can Engine Torque Request From Abs Asc" UBYTE EcuIntgdSwGend_CM_boolean 0 0 0.0 1.0 ECU_ADDRESS 0x4000E328 /* @ECU_Address@EIP_StOfCanEngTqReqFromAbsAsc@ */ /end MEASUREMENT
/begin MEASUREMENT EIP_StOfCanEngOvrdCtrlModFromAbsAsc "State Of Engine Override Control Mode From Abs Asc" UBYTE EcuIntgdSwGend_CM_boolean 0 0 0.0 1.0 ECU_ADDRESS 0x4000DA2B /* @ECU_Address@EIP_StOfCanEngOvrdCtrlModFromAbsAsc@ */ /end MEASUREMENT
/begin MEASUREMENT EIP_StOfCanOvrdCtrlModPrioFromAbsAsc "State Of Can Override Control Mode Priority From Abs Asc" UBYTE EcuIntgdSwGend_CM_boolean 0 0 0.0 1.0 ECU_ADDRESS 0x4000E025 /* @ECU_Address@EIP_StOfCanOvrdCtrlModPrioFromAbsAsc@ */ /end MEASUREMENT
/begin MEASUREMENT EIP_StOfCanTrsmTqLim "Status Of Transmission Torque Limit" UBYTE EcuIntgdSwGend_CM_boolean 0 0 0.0 1.0 ECU_ADDRESS 0x4000E0A5 /* @ECU_Address@EIP_StOfCanTrsmTqLim@ */ /end MEASUREMENT
/begin MEASUREMENT EIP_StOfCanEngRtdrSeln "Engine Input Processing - SPN 973 - Engine Retarder Selection  State Of Can" UBYTE EcuIntgdSwGend_CM_boolean 0 0 0.0 1.0 ECU_ADDRESS 0x4000D814 /* @ECU_Address@EIP_StOfCanEngRtdrSeln@ */ /end MEASUREMENT
/begin MEASUREMENT EIP_bAcvCylBaln "Cylinder Balance Active" UBYTE EcuIntgdSwGend_CM_boolean 0 0 0.0 1.0 ECU_ADDRESS 0x4000E98D /* @ECU_Address@EIP_bAcvCylBaln@ */ /end MEASUREMENT
/begin MEASUREMENT EIP_bErrCyl1Misf "Error Cylinder Misfire for Cylinder 1" UBYTE EcuIntgdSwGend_CM_boolean 0 0 0.0 1.0 ECU_ADDRESS 0x4000DF77 /* @ECU_Address@EIP_bErrCyl1Misf@ */ /end MEASUREMENT
/begin MEASUREMENT EIP_bErrCyl2Misf "Error Cylinder Misfire for Cylinder 2" UBYTE EcuIntgdSwGend_CM_boolean 0 0 0.0 1.0 ECU_ADDRESS 0x4000DCD3 /* @ECU_Address@EIP_bErrCyl2Misf@ */ /end MEASUREMENT
/begin MEASUREMENT EIP_bErrCyl3Misf "Error Cylinder Misfire for Cylinder 3" UBYTE EcuIntgdSwGend_CM_boolean 0 0 0.0 1.0 ECU_ADDRESS 0x4000D9F4 /* @ECU_Address@EIP_bErrCyl3Misf@ */ /end MEASUREMENT
/begin MEASUREMENT EIP_bErrCyl4Misf "Error Cylinder Misfire for Cylinder 4" UBYTE EcuIntgdSwGend_CM_boolean 0 0 0.0 1.0 ECU_ADDRESS 0x4000E8B8 /* @ECU_Address@EIP_bErrCyl4Misf@ */ /end MEASUREMENT
/begin MEASUREMENT EIP_bErrCyl5Misf "Error Cylinder Misfire for Cylinder 5" UBYTE EcuIntgdSwGend_CM_boolean 0 0 0.0 1.0 ECU_ADDRESS 0x4000E5DD /* @ECU_Address@EIP_bErrCyl5Misf@ */ /end MEASUREMENT
/begin MEASUREMENT EIP_bErrCyl6Misf "Error Cylinder Misfire for Cylinder 6" UBYTE EcuIntgdSwGend_CM_boolean 0 0 0.0 1.0 ECU_ADDRESS 0x4000E300 /* @ECU_Address@EIP_bErrCyl6Misf@ */ /end MEASUREMENT
/begin MEASUREMENT EIP_bErrCylMisfWarnBfrDeb "Error Cylinder Misfire Warning Before Debouncer" UBYTE EcuIntgdSwGend_CM_boolean 0 0 0.0 1.0 ECU_ADDRESS 0x4000DA0A /* @ECU_Address@EIP_bErrCylMisfWarnBfrDeb@ */ /end MEASUREMENT
/begin MEASUREMENT EIP_bAcvErrCylMisfWarn "Error Cylinder Misfire Warning Active" UBYTE EcuIntgdSwGend_CM_boolean 0 0 0.0 1.0 ECU_ADDRESS 0x4000E231 /* @ECU_Address@EIP_bAcvErrCylMisfWarn@ */ /end MEASUREMENT
/begin MEASUREMENT EIP_bErrCylMisfRednBfrDeb "Error Cylinder Misfire Reduction Before Debouncer" UBYTE EcuIntgdSwGend_CM_boolean 0 0 0.0 1.0 ECU_ADDRESS 0x4000E371 /* @ECU_Address@EIP_bErrCylMisfRednBfrDeb@ */ /end MEASUREMENT
/begin MEASUREMENT EIP_bAcvErrCylMisfRedn "Error Cylinder Misfire Reduction Active" UBYTE EcuIntgdSwGend_CM_boolean 0 0 0.0 1.0 ECU_ADDRESS 0x4000DF60 /* @ECU_Address@EIP_bAcvErrCylMisfRedn@ */ /end MEASUREMENT
/begin MEASUREMENT EIP_bErrCylMisfShtdwnBfrDeb "Error Cylinder Misfire Shutdown Before Debouncer" UBYTE EcuIntgdSwGend_CM_boolean 0 0 0.0 1.0 ECU_ADDRESS 0x4000DC41 /* @ECU_Address@EIP_bErrCylMisfShtdwnBfrDeb@ */ /end MEASUREMENT
/begin MEASUREMENT EIP_bAcvErrCylMisfShtdwn "Error Cylinder Misfire Shutdown Active" UBYTE EcuIntgdSwGend_CM_boolean 0 0 0.0 1.0 ECU_ADDRESS 0x4000E7D9 /* @ECU_Address@EIP_bAcvErrCylMisfShtdwn@ */ /end MEASUREMENT
/begin MEASUREMENT EIP_bErrInjrShtdwnBfrDeb "Error Injector Shutdown Before Debouncer" UBYTE EcuIntgdSwGend_CM_boolean 0 0 0.0 1.0 ECU_ADDRESS 0x4000E530 /* @ECU_Address@EIP_bErrInjrShtdwnBfrDeb@ */ /end MEASUREMENT
/begin MEASUREMENT EIP_bAcvErrInjrShtdwn "Error Injection Shutdown Active" UBYTE EcuIntgdSwGend_CM_boolean 0 0 0.0 1.0 ECU_ADDRESS 0x4000DB6B /* @ECU_Address@EIP_bAcvErrInjrShtdwn@ */ /end MEASUREMENT
/begin MEASUREMENT DTqC_IdxGearTrbChrgOil "Gear Position for Turbo Charger Oil Leakage Activation" UBYTE EcuIntgdSwGend_CM_boolean 0 0 0.0 1.0 ECU_ADDRESS 0x4000D8E9 /* @ECU_Address@DTqC_IdxGearTrbChrgOil@ */ /end MEASUREMENT
/begin MEASUREMENT DTqC_VehVAcvnTrbChrgOilLeakg "Turbo Charger Oil Leakage Activation According to Vehicle Speed" UBYTE EcuIntgdSwGend_CM_boolean 0 0 0.0 1.0 ECU_ADDRESS 0x4000E014 /* @ECU_Address@DTqC_VehVAcvnTrbChrgOilLeakg@ */ /end MEASUREMENT
/begin MEASUREMENT DTqC_bAcvGearChkForTrbChrgOilLeakg "Gear Check for Turbo Oil Leakage Protection" UBYTE EcuIntgdSwGend_CM_boolean 0 0 0.0 1.0 ECU_ADDRESS 0x4000E649 /* @ECU_Address@DTqC_bAcvGearChkForTrbChrgOilLeakg@ */ /end MEASUREMENT
/begin MEASUREMENT DTqC_bAcvTrbChrgOilLeakg "Turbo Oil Leakage Activation Signal" UBYTE EcuIntgdSwGend_CM_boolean 0 0 0.0 1.0 ECU_ADDRESS 0x4000E7BC /* @ECU_Address@DTqC_bAcvTrbChrgOilLeakg@ */ /end MEASUREMENT
/begin MEASUREMENT DTqC_PtoCtrlAccrPedlOvrd "PTO Control Accelerator Pedal Override" UBYTE EcuIntgdSwGend_CM_boolean 0 0 0.0 1.0 ECU_ADDRESS 0x4000E1BC /* @ECU_Address@DTqC_PtoCtrlAccrPedlOvrd@ */ /end MEASUREMENT
/begin MEASUREMENT DTqC_CrsCtrlAccrPedlOvrd "PTO Control Accelerator Pedal Override" UBYTE EcuIntgdSwGend_CM_boolean 0 0 0.0 1.0 ECU_ADDRESS 0x4000DF58 /* @ECU_Address@DTqC_CrsCtrlAccrPedlOvrd@ */ /end MEASUREMENT
/begin MEASUREMENT DTqC_EngOvspdModeActvn "Engine Overspeed Mode Activation Flag" UBYTE EcuIntgdSwGend_CM_boolean 0 0 0.0 1.0 ECU_ADDRESS 0x4000E5E1 /* @ECU_Address@DTqC_EngOvspdModeActvn@ */ /end MEASUREMENT
/begin MEASUREMENT CrsCtrl_ErrCanTrtCaseSts "Transfer Case Status Error Signal" UBYTE EcuIntgdSwGend_CM_boolean 0 0 0.0 1.0 ECU_ADDRESS 0x4000E54B /* @ECU_Address@CrsCtrl_ErrCanTrtCaseSts@ */ /end MEASUREMENT
/begin MEASUREMENT CrsCtrl_ErrCanTrsmTqCnvrRat "Transmission Torque Convertor Ratio Error Signal" UBYTE EcuIntgdSwGend_CM_boolean 0 0 0.0 1.0 ECU_ADDRESS 0x4000DEDA /* @ECU_Address@CrsCtrl_ErrCanTrsmTqCnvrRat@ */ /end MEASUREMENT
/begin COMPU_METHOD EcuIntgdSwGend_CM_single_N_m "Q = V" RAT_FUNC "%8.6" "N*m" COEFFS 0 1 0 0 0 1 /end COMPU_METHOD
/begin COMPU_METHOD EcuIntgdSwGend_CM_single_rpm "Q = V" RAT_FUNC "%8.6" "rpm" COEFFS 0 1 0 0 0 1 /end COMPU_METHOD
/begin COMPU_METHOD EcuIntgdSwGend_CM_single_degC "Q = V" RAT_FUNC "%8.6" "degC" COEFFS 0 1 0 0 0 1 /end COMPU_METHOD
/begin COMPU_METHOD EcuIntgdSwGend_CM_single__ "Q = V" RAT_FUNC "%8.6" "%" COEFFS 0 1 0 0 0 1 /end COMPU_METHOD
/begin COMPU_METHOD EcuIntgdSwGend_CM_single "Q = V" RAT_FUNC "%8.6" "" COEFFS 0 1 0 0 0 1 /end COMPU_METHOD
/begin COMPU_METHOD EcuIntgdSwGend_CM_single_ms "Q = V" RAT_FUNC "%8.6" "ms" COEFFS 0 1 0 0 0 1 /end COMPU_METHOD
/begin COMPU_METHOD EcuIntgdSwGend_CM_single_mbar "Q = V" RAT_FUNC "%8.6" "mbar" COEFFS 0 1 0 0 0 1 /end COMPU_METHOD
/begin COMPU_METHOD EcuIntgdSwGend_CM_single_mm_3_stk "Q = V" RAT_FUNC "%8.6" "mm^3/stk" COEFFS 0 1 0 0 0 1 /end COMPU_METHOD
/begin COMPU_METHOD EcuIntgdSwGend_CM_single_V "Q = V" RAT_FUNC "%8.6" "V" COEFFS 0 1 0 0 0 1 /end COMPU_METHOD
/begin COMPU_METHOD EcuIntgdSwGend_CM_int16 "Q = V" RAT_FUNC "%5.0" "" COEFFS 0 1 0 0 0 1 /end COMPU_METHOD
/begin COMPU_METHOD EcuIntgdSwGend_CM_single_km_h "Q = V" RAT_FUNC "%8.6" "km/h" COEFFS 0 1 0 0 0 1 /end COMPU_METHOD
/begin COMPU_METHOD EcuIntgdSwGend_CM_int16__ "Q = V" RAT_FUNC "%5.0" "%" COEFFS 0 1 0 0 0 1 /end COMPU_METHOD
/begin COMPU_METHOD EcuIntgdSwGend_CM_int16_km_h "Q = V" RAT_FUNC "%5.0" "km/h" COEFFS 0 1 0 0 0 1 /end COMPU_METHOD
/begin COMPU_METHOD EcuIntgdSwGend_CM_boolean "Q = V" RAT_FUNC "%1.0" "" COEFFS 0 1 0 0 0 1 /end COMPU_METHOD
/begin COMPU_METHOD EcuIntgdSwGend_CM_int8 "Q = V" RAT_FUNC "%3.0" "" COEFFS 0 1 0 0 0 1 /end COMPU_METHOD
/begin COMPU_METHOD EcuIntgdSwGend_CM_int8__ "Q = V" RAT_FUNC "%3.0" "%" COEFFS 0 1 0 0 0 1 /end COMPU_METHOD
/begin COMPU_METHOD EcuIntgdSwGend_CM_uint8 "Q = V" RAT_FUNC "%3.0" "" COEFFS 0 1 0 0 0 1 /end COMPU_METHOD
/begin COMPU_METHOD EcuIntgdSwGend_CM_uint8__ "Q = V" RAT_FUNC "%3.0" "%" COEFFS 0 1 0 0 0 1 /end COMPU_METHOD
/begin COMPU_METHOD EcuIntgdSwGend_CM_single_mg_stk "Q = V" RAT_FUNC "%8.6" "mg/stk" COEFFS 0 1 0 0 0 1 /end COMPU_METHOD
/begin GROUP S14_N_Map_Interpolation_for_Main_Quantity "EcuIntgdSwGend/ControlSoftware/TqCnvn/N-Map Interpolation for Main Quantity"
 /begin SUB_GROUP S675_avoidzerodivision_single S675_avoidzerodivision_single1 /end SUB_GROUP
 /begin REF_CHARACTERISTIC TrC_MMaiFuQnty1_M TrC_MMaiFuQnty2_M TrC_MMaiFuQnty3_M TrC_MMaiFuQntyOvs_P TrC_MMaiFuQntyOvv_P TrC_TCooltMap1Thd_P TrC_TCooltMap2Thd_P TrC_TCooltMap3Thd_P /end REF_CHARACTERISTIC
 /begin REF_MEASUREMENT TrC_MMaiFuQnty1To2Intp TrC_MMaiFuQnty2To3Intp TrC_MMaiFuQntyFromMap1 TrC_MMaiFuQntyFromMap2 TrC_MMaiFuQntyFromMap3 TrC_MMaiFuQntyPre /end REF_MEASUREMENT
/end GROUP
/begin GROUP S14_N_Map_Interpolation_for_Pre_Quantity "EcuIntgdSwGend/ControlSoftware/TqCnvn/N-Map Interpolation for Pre Quantity"
 /begin SUB_GROUP S676_avoidzerodivision_single S676_avoidzerodivision_single1 /end SUB_GROUP
 /begin REF_CHARACTERISTIC TrC_MPltFuQnty1_M TrC_MPltFuQnty2_M TrC_MPltFuQnty3_M TrC_MPltFuQntyOvs_P TrC_MPltFuQntyOvv_P TrC_TCooltMap1Thd_P TrC_TCooltMap2Thd_P TrC_TCooltMap3Thd_P /end REF_CHARACTERISTIC
 /begin REF_MEASUREMENT TrC_MPltFuQnty TrC_MPltFuQnty1To2Intp TrC_MPltFuQnty2To3Intp TrC_MPltFuQntyFromMap1 TrC_MPltFuQntyFromMap2 TrC_MPltFuQntyFromMap3 /end REF_MEASUREMENT
/end GROUP
/begin GROUP S14_Pilot_Quantity_Correction "EcuIntgdSwGend/ControlSoftware/TqCnvn/Pilot Quantity Correction"
 /begin REF_CHARACTERISTIC TrC_MPltFuPAmbAirCorr_M TrC_MPltFuTAirBoostCorr_M TrC_MPltFuTAmbAirCorr_M TrC_MPltFuTCooltCorr_M TrC_MPltFuTOilCorr_M TrC_MPltFuUClmp30Corr_M /end REF_CHARACTERISTIC
 /begin REF_MEASUREMENT TrC_MPltFuQntyCorr TrC_MPltFuQntyCorrPAmbAir TrC_MPltFuQntyCorrTAirBoost TrC_MPltFuQntyCorrTAmbAir TrC_MPltFuQntyCorrTCoolt TrC_MPltFuQntyCorrTOil TrC_MPltFuQntyCorrUClmp30 /end REF_MEASUREMENT
/end GROUP
/begin GROUP S14_Smoke_Limitation "EcuIntgdSwGend/ControlSoftware/TqCnvn/Smoke Limitation"
 /begin SUB_GROUP S678_avoidzerodivision_single S678_avoidzerodivision_single1 S678_avoidzerodivision_single2 S678_saturation /end SUB_GROUP
 /begin REF_CHARACTERISTIC EG_CnvnMm3ToMg_C EG_NmrSng2_C TrC_CnvnKgDivideSecToMgDivideMin_C TrC_InjrCfg4Cyl_C TrC_InjrCfg6Cyl_C TrC_RatAirFuMax_P TrC_RatAirFuMin_P TrC_RatAirFuSmokLim_M TrC_SmokeLimOvs_P /end REF_CHARACTERISTIC
 /begin REF_MEASUREMENT TrC_CdnSmokeLim TrC_MAirPerStr TrC_MMaiFuQntyLimd TrC_MMaiFuQntySmokLimd TrC_RatAirFuSmokLim /end REF_MEASUREMENT
/end GROUP
/begin GROUP S14_Torque_Conversion_For_SPN__2432___Engine_Demand_Torque "EcuIntgdSwGend/ControlSoftware/TqCnvn/Torque Conversion For SPN  2432 - Engine Demand Torque"
 /begin SUB_GROUP S679_Main_Quantity_Correction S679_N_Map_Interpolation_for_Main_Quantity S679_N_Map_Interpolation_for_Pre_Quantity S679_Pilot_Quantity_Correction S679_Smoke_Limitation /end SUB_GROUP
 /begin REF_CHARACTERISTIC EG_NmrSng0_C /end REF_CHARACTERISTIC
 /begin REF_MEASUREMENT TrC_MMaiFuQntyCorrForEngDmdTq TrC_MTotFuQntyCorrForEngDmdTq /end REF_MEASUREMENT
/end GROUP
/begin GROUP S15_Abs_Asc_Limitation "EcuIntgdSwGend/ControlSoftware/TqLim/Abs Asc Limitation"
 /begin REF_CHARACTERISTIC EG_NmrSng100_C EG_TSC1TqSpdLimMod_C TL_FricForAbsAscLimnEna_P /end REF_CHARACTERISTIC
 /begin REF_MEASUREMENT TL_CanEngTqReqNmFromAbsAsc TL_MaxTqFromAbsAsc /end REF_MEASUREMENT
/end GROUP
/begin GROUP S15_Engine_Brake_Limitation "EcuIntgdSwGend/ControlSoftware/TqLim/Engine Brake Limitation" /begin REF_CHARACTERISTIC TL_TqActvEngBrk_C /end REF_CHARACTERISTIC /begin REF_MEASUREMENT TL_TqLimnForEngBrk /end REF_MEASUREMENT /end GROUP
/begin GROUP S15_Engine_Default_Torque_Limit_From_Tcu "EcuIntgdSwGend/ControlSoftware/TqLim/Engine Default Torque Limit From Tcu" /begin REF_CHARACTERISTIC TL_FricForDftTqLimEna_P /end REF_CHARACTERISTIC /begin REF_MEASUREMENT TL_DftTqLimFromTcu /end REF_MEASUREMENT /end GROUP
/begin GROUP S15_Engine_Protection "EcuIntgdSwGend/ControlSoftware/TqLim/Engine Protection"
 /begin SUB_GROUP S704_Torque_Limitation_For_Fuel_Temperature S704_Torque_Limitation_for_Air_Temperature S704_Torque_Limitation_for_Ambient_Air_Pressure S704_Torque_Limitation_for_Coolant_Temperature S704_Torque_Limitation_for_Intake_Air_Pressure S704_Torque_Limitation_for_Oil_Temperature S704_Torque_Limitation_for_Surge_Protection S704_Torque_Limitation_for_Turbo_Charge_Speed /end SUB_GROUP
 /begin REF_CHARACTERISTIC TL_TqLimdForNExhTrbChrgOvs_P TL_TqLimdForNExhTrbChrgOvv_P TL_TqLimdForPAirAmbOvs_P TL_TqLimdForPAirAmbOvv_P TL_TqLimdForPAirBoostOvs_P TL_TqLimdForPAirBoostOvv_P TL_TqLimdForSurgeOvs_P TL_TqLimdForSurgeOvv_P TL_TqLimdForTAirOvs_P TL_TqLimdForTAirOvv_P TL_TqLimdForTCooltOvs_P TL_TqLimdForTCooltOvv_P TL_TqLimdForTFuOvs_P TL_TqLimdForTFuOvv_P TL_TqLimdForTOilOvs_P TL_TqLimdForTOilOvv_P TL_TqMapLimdEngProtnOvs_P TL_TqMapLimdEngProtnOvv_P /end REF_CHARACTERISTIC
 /begin REF_MEASUREMENT TL_TqLimdForNExhTrbChrg TL_TqLimdForPAirAmb TL_TqLimdForPAirBoost TL_TqLimdForSurge TL_TqLimdForTAir TL_TqLimdForTCoolt TL_TqLimdForTFu TL_TqLimdForTOil TL_TqMapLimdEngProtn /end REF_MEASUREMENT
/end GROUP
/begin GROUP S15_Gearbox_Limitation "EcuIntgdSwGend/ControlSoftware/TqLim/Gearbox Limitation"
 /begin REF_CHARACTERISTIC EG_NmrSng100_C EG_TSC1TqSpdLimMod_C TL_FricForGbxProtnEna_P /end REF_CHARACTERISTIC
 /begin REF_MEASUREMENT TL_CanEngTqReqNmFromTcu TL_MaxTqFromTcu /end REF_MEASUREMENT
/end GROUP
/begin GROUP S15_Limp_Mode_Limitation "EcuIntgdSwGend/ControlSoftware/TqLim/Limp Mode Limitation" /begin REF_CHARACTERISTIC TL_TqLimp_M /end REF_CHARACTERISTIC /begin REF_MEASUREMENT TL_TqLimnLimp TL_TqLimpMapOut /end REF_MEASUREMENT /end GROUP
/begin GROUP S15_PTO_Protection "EcuIntgdSwGend/ControlSoftware/TqLim/PTO Protection" /begin REF_CHARACTERISTIC TL_FricForPtoProtnEna_P TL_TqPtoProtn_M /end REF_CHARACTERISTIC /begin REF_MEASUREMENT TL_TqLimnForPtoProtn /end REF_MEASUREMENT /end GROUP
/begin GROUP S15_Rate_Limiter_for_Factor_Limitation "EcuIntgdSwGend/ControlSoftware/TqLim/Rate Limiter for Factor Limitation" /begin REF_CHARACTERISTIC TL_DynRateLoLim_P TL_DynRateUpLim_P TL_bDeacvRateLimOvs_P /end REF_CHARACTERISTIC /begin REF_MEASUREMENT TL_DynRateLimr TL_TqIndcdLimdPre /end REF_MEASUREMENT /end GROUP
/begin GROUP S15_Reduction_Limitation_Level_1 "EcuIntgdSwGend/ControlSoftware/TqLim/Reduction Limitation Level 1" /begin REF_CHARACTERISTIC TL_TqRednLvL1_P /end REF_CHARACTERISTIC /begin REF_MEASUREMENT TL_TqLimnRednLvl1 /end REF_MEASUREMENT /end GROUP
/begin GROUP S15_Reduction_Limitation_Level_2 "EcuIntgdSwGend/ControlSoftware/TqLim/Reduction Limitation Level 2" /begin REF_CHARACTERISTIC TL_TqRednLvl2_P /end REF_CHARACTERISTIC /begin REF_MEASUREMENT TL_TqLimnRednLvl2 /end REF_MEASUREMENT /end GROUP
/begin GROUP S15_Torque_Based_Limitation "EcuIntgdSwGend/ControlSoftware/TqLim/Torque Based Limitation" /begin REF_CHARACTERISTIC EG_ModEngCtlIdleSpd_C EG_ModEngCtlStrt_C TL_TqShtdwn_C /end REF_CHARACTERISTIC /begin REF_MEASUREMENT TL_TqIndcdLimd TL_TqIndcdLimdSwtOut /end REF_MEASUREMENT /end GROUP
/begin GROUP S15_Transsmission_Protection "EcuIntgdSwGend/ControlSoftware/TqLim/Transsmission Protection" /begin REF_CHARACTERISTIC TL_FricForTrsmProtnEna_P TL_TqLimnForTrsmProtn_M /end REF_CHARACTERISTIC /begin REF_MEASUREMENT TL_TqLimnForTrsmProtn /end REF_MEASUREMENT /end GROUP
/begin GROUP S16_Warning_Reduction_Shutdown_Functions "EcuIntgdSwGend/ControlSoftware/WarnMong/Warning-Reduction-Shutdown Functions"
 /begin SUB_GROUP S731_Global_Enable S731_Internal S731_Limp S731_Pressure S731_Reaction S731_Return_To_Normal S731_Temperature /end SUB_GROUP
/end GROUP
/begin GROUP S17_TurbochargerSpeedEstimation "EcuIntgdSwGend/ControlSoftware/WgtCtl/TurbochargerSpeedEstimation"
 /begin SUB_GROUP S895_AirMassFlowCalc S895_CalculatedCompressorInletPressure S895_CalculatedCompressorOutletPressure S895_CompressorEfficiency S895_CompressorPressureRatio S895_CorrectedAirMassFlow S895_SurgeCheck S895_TurbochargerSpeed S895_VolumetricEfficiency /end SUB_GROUP
/end GROUP
/begin GROUP S17_Wastegate_Control "EcuIntgdSwGend/ControlSoftware/WgtCtl/Wastegate Control" /begin SUB_GROUP S896_BoostPressurePID S896_BoostPressureRefSelector /end SUB_GROUP
 /begin REF_CHARACTERISTIC WgC_DutyVlvOvs_P WgC_DutyVlvOvv_P WgC_DutyWgtVlvFF_M WgC_LimSigLo_M WgC_LimSigUp_M WgC_StWgtVlvCtrl_M /end REF_CHARACTERISTIC
 /begin REF_MEASUREMENT WgC_DutyVlvReq WgC_DutyWgtVlv WgC_DutyWgtVlvBefSat WgC_DutyWgtVlvFF WgC_LimSigLo WgC_LimSigUp WgC_WgtClsLoopEna /end REF_MEASUREMENT
/end GROUP
/begin GROUP S20_CruiseControlPIDController "EcuIntgdSwGend/ControlSoftware/CrsCtrl/CruiseControl/CruiseControlPIDController" /begin SUB_GROUP S24_PID_Controller /end SUB_GROUP
 /begin REF_CHARACTERISTIC CrsCtrl_CoeffDForVVehCtl_M CrsCtrl_CoeffFiltForVVehCtl_M CrsCtrl_CoeffIForVVehCtl_M CrsCtrl_CoeffPForVVehCtl_M CrsCtrl_PIDCoeffDOvs_P CrsCtrl_PIDCoeffDOvv_P CrsCtrl_PIDCoeffFiltOvs_P CrsCtrl_PIDCoeffFiltOvv_P CrsCtrl_PIDCoeffIOvs_P CrsCtrl_PIDCoeffIOvv_P CrsCtrl_PIDCoeffPOvs_P CrsCtrl_PIDCoeffPOvv_P CrsCtrl_PIDMin_P CrsCtrl_SatPIDMax_M CrsCtrl_TrfCaseStsFac_M CrsCtrl_TrsmTqCnvrRatFac_M EG_NmrSng1_C EG_VldInpSt_C /end REF_CHARACTERISTIC
 /begin REF_MEASUREMENT CrsCtrl_CoeffDForVVehCtl CrsCtrl_CoeffFiltForVVehCtl CrsCtrl_CoeffIForVVehCtl CrsCtrl_CoeffPForVVehCtl CrsCtrl_ErrCanTrsmTqCnvrRat CrsCtrl_ErrCanTrtCaseSts CrsCtrl_SatPIDMax CrsCtrl_TrfCaseStsFac CrsCtrl_TrsmTqCnvrRatFac /end REF_MEASUREMENT
/end GROUP
/begin GROUP S21_Engine_Brake_Level_Activation_Condition "EcuIntgdSwGend/ControlSoftware/CrsCtrl/Engine Brake Activation via Cruise Control/Engine Brake Level Activation Condition"
 /begin SUB_GROUP S29_Engine_Brake_Level_1_Activation_Condition S29_Engine_Brake_Level_2_Activation_Condition /end SUB_GROUP
 /begin REF_CHARACTERISTIC CrsCtrl_EngBrkLvl1Cfg_C CrsCtrl_EngBrkLvl2Cfg_C /end REF_CHARACTERISTIC
/end GROUP
/begin GROUP S21_Engine_Brake_Level_Set "EcuIntgdSwGend/ControlSoftware/CrsCtrl/Engine Brake Activation via Cruise Control/Engine Brake Level Set"
 /begin REF_CHARACTERISTIC CrsCtrl_EngBrkLvl0_C CrsCtrl_EngBrkLvl1_C CrsCtrl_EngBrkLvl2_C /end REF_CHARACTERISTIC
 /begin REF_MEASUREMENT CrsCtrl_EngBrkLvl /end REF_MEASUREMENT
/end GROUP
/begin GROUP S37_Accelarator_Pedal_Override_Modes "EcuIntgdSwGend/ControlSoftware/DesTqClcn/Desired Torque Calculation CAN Signals/Accelarator Pedal Override Modes" /begin REF_CHARACTERISTIC EG_CrsCtrlActvd_C /end REF_CHARACTERISTIC /begin REF_MEASUREMENT DTqC_CrsCtrlAccrPedlOvrd DTqC_PtoCtrlAccrPedlOvrd /end REF_MEASUREMENT /end GROUP
/begin GROUP S37_EC1___Engine_Configuration_1 "EcuIntgdSwGend/ControlSoftware/DesTqClcn/Desired Torque Calculation CAN Signals/EC1 - Engine Configuration 1" /begin SUB_GROUP S47_saturation /end SUB_GROUP
 /begin REF_CHARACTERISTIC DTqC_DrvrDmdPercTqSatMax_P DTqC_DrvrDmdPercTqSatMin_P DTqC_EngSpdPoint1_P DTqC_EngSpdPoint2_P DTqC_EngSpdPoint3_P DTqC_EngSpdPoint4_P DTqC_EngSpdPoint5_P DTqC_EngSpdPoint6_P DTqC_EngSpdPoint7_P DTqC_EngTqPoint1_P DTqC_EngTqPoint2_P DTqC_EngTqPoint3_P DTqC_EngTqPoint4_P DTqC_EngTqPoint5_P EG_NmrSng0_C EG_NmrSng100_C EG_VldInpSt_C /end REF_CHARACTERISTIC
 /begin REF_MEASUREMENT DTqC_CanEngDftTqLim DTqC_EngPercTqPoint1 DTqC_EngPercTqPoint2 DTqC_EngPercTqPoint3 DTqC_EngPercTqPoint4 DTqC_EngPercTqPoint5 /end REF_MEASUREMENT
/end GROUP
/begin GROUP S39_Engine_Idle_Reference "EcuIntgdSwGend/ControlSoftware/DesTqClcn/Idle Speed Reference Selector/Engine Idle Reference"
 /begin REF_CHARACTERISTIC DTqC_NEngIdleGearRef_M DTqC_PAmbAirNEngIdleRef_M DTqC_TCooltNEngIdleRef_M DTqC_TOilNEngIdleRef_M /end REF_CHARACTERISTIC
 /begin REF_MEASUREMENT DTqC_NEngIdleGearRef DTqC_PAmbAirNEngIdleRef DTqC_TCooltNEngIdleRef DTqC_TOilNEngIdleRef /end REF_MEASUREMENT
/end GROUP
/begin GROUP S39_Turbo_Oil_Leakage_Protection "EcuIntgdSwGend/ControlSoftware/DesTqClcn/Idle Speed Reference Selector/Turbo Oil Leakage Protection"
 /begin REF_CHARACTERISTIC DTqC_TiTrbChrgOilLeakgIdleRef_P DTqC_VehVAcvnTrbChrgOilLeakg_P EG_ModEngCtlIdleSpd_C /end REF_CHARACTERISTIC
 /begin REF_MEASUREMENT DTqC_IdxGearTrbChrgOil DTqC_TiTrbChrgOilLeakgIdle DTqC_VehVAcvnTrbChrgOilLeakg DTqC_bAcvGearChkForTrbChrgOilLeakg DTqC_bAcvTrbChrgOilLeakg /end REF_MEASUREMENT
/end GROUP
/begin GROUP S41_Driver_Demand_Torque_Calculation "EcuIntgdSwGend/ControlSoftware/DesTqClcn/Running Mode/Driver Demand Torque Calculation" /begin SUB_GROUP S52_N_Map_Interpolation_for_Brake_Torque /end SUB_GROUP
 /begin REF_CHARACTERISTIC DTqC_AccrPedlOvrdForCrsCtrl_P DTqC_AccrPedlOvrdForPto_P DTqC_RateLoLimForPTOAccrOvrd_P DTqC_RateUpLimForPTOAccrOvrd_P EG_CrsCtrlActvd_C /end REF_CHARACTERISTIC
 /begin REF_MEASUREMENT DTqC_CabPtoTq DTqC_CrsCtrlTq DTqC_DrvrDmdTq /end REF_MEASUREMENT
/end GROUP
/begin GROUP S41_EndSpeed_Governor "EcuIntgdSwGend/ControlSoftware/DesTqClcn/Running Mode/EndSpeed Governor"
 /begin SUB_GROUP S53_EndSpeed_Soft_Limit_Governor S53_Engine_Speed_Hysteresis_for_Hard_Limitation S53_Engine_Speed_Hysteresis_for_Soft_Limitation /end SUB_GROUP
 /begin REF_CHARACTERISTIC DTqC_NEngHardLimActvnThdOffs_P DTqC_NEngHardLimDeacThdOffs_P DTqC_NEngHardLimTqOffs_C DTqC_NEngSoftLimActvnThdOffs_P DTqC_NEngSoftLimAcvThd_P DTqC_NEngSoftLimDeacThdOffs_P DTqC_PtoCtrlNEngMaxSpdHys_P /end REF_CHARACTERISTIC
 /begin REF_MEASUREMENT DTqC_EngOvspdModeActvn DTqC_NEngSoftLim DTqC_TqEngSpdSoftLim /end REF_MEASUREMENT
/end GROUP
/begin GROUP S41_Idle_Speed_Controller "EcuIntgdSwGend/ControlSoftware/DesTqClcn/Running Mode/Idle Speed Controller" /begin SUB_GROUP S54_PID_Controller /end SUB_GROUP
 /begin REF_CHARACTERISTIC DTqC_CoeffDForSpdCtl_M DTqC_CoeffFiltForSpdCtl_M DTqC_CoeffFiltKdSpdCtlOvs_P DTqC_CoeffFiltKdSpdCtlOvv_P DTqC_CoeffIForSpdCtl_M DTqC_CoeffPForSpdCtl_M DTqC_FacSclPIDCoeff_P DTqC_IdleSpdCtrlFF_M DTqC_KdSpdCtlOvs_P DTqC_KdSpdCtlOvv_P DTqC_KiSpdCtlOvs_P DTqC_KiSpdCtlOvv_P DTqC_KpSpdCtlOvs_P DTqC_KpSpdCtlOvv_P DTqC_TqDesSatMax_M DTqC_TqDesSatPIDMin_P /end REF_CHARACTERISTIC
 /begin REF_MEASUREMENT DTqC_CoeffDForSpdCtl DTqC_CoeffDForSpdCtlMapOut DTqC_CoeffFiltForSpdCtl DTqC_CoeffFiltForSpdCtlMapOut DTqC_CoeffIForSpdCtl DTqC_CoeffIForSpdCtlMapOut DTqC_CoeffPForSpdCtl DTqC_CoeffPForSpdCtlMapOut DTqC_ErrNIdle DTqC_FacSclForPIDFiltKdCoeff DTqC_FacSclForPIDKdCoeff DTqC_FacSclForPIDKiCoeff DTqC_FacSclForPIDKpCoeff DTqC_IdleSpdCtlTqBrk DTqC_IdleSpdCtrlFF DTqC_TqDesSatPIDMax /end REF_MEASUREMENT
/end GROUP
/begin GROUP S41_TSC1_Control_Purpose "EcuIntgdSwGend/ControlSoftware/DesTqClcn/Running Mode/TSC1 Control Purpose" /begin SUB_GROUP S55_TSC1_Request_for_Speed_Control /end SUB_GROUP
 /begin REF_CHARACTERISTIC EG_NmrSng100_C EG_TSC1SpdCtrlMod_C EG_TSC1TqCtrlMod_C EG_TSC1TqSpdLimMod_C /end REF_CHARACTERISTIC
 /begin REF_MEASUREMENT DTqC_CanEngTqReqNmFromTcu DTqC_TSC1MaxEngSpd DTqC_TSC1SpdModTqReq DTqC_TSC1TqModTqReq /end REF_MEASUREMENT
/end GROUP
/begin GROUP S83_Shutdown_For_Injector_Error "EcuIntgdSwGend/ControlSoftware/EcuInpPrcsg/Actuator Defect Signals/Shutdown For Injector Error" /begin SUB_GROUP S101_Debouncer4 /end SUB_GROUP
 /begin REF_CHARACTERISTIC EG_NmrSng0_C EG_TsSw_C EIP_NrErrInjrShtdwn_P EIP_TiAcvErrInjrShtdwnDeb_P EIP_bAcvErrInjrShtdwnOvs_P EIP_bAcvErrInjrShtdwnOvv_P /end REF_CHARACTERISTIC
 /begin REF_MEASUREMENT EIP_NrErrInjrCount EIP_bAcvErrInjrShtdwn EIP_bErrInjrShtdwnBfrDeb /end REF_MEASUREMENT
/end GROUP
/begin GROUP S84_Cylinder_Balancing "EcuIntgdSwGend/ControlSoftware/EcuInpPrcsg/Additionals/Cylinder Balancing"
 /begin SUB_GROUP S103_Cylinder_1_Speed_Error_Calculation S103_Cylinder_2_Speed_Error_Calculation S103_Cylinder_3_Speed_Error_Calculation S103_Cylinder_4_Speed_Error_Calculation S103_Cylinder_5_Speed_Error_Calculation S103_Cylinder_6_Speed_Error_Calculation S103_Debouncer6 /end SUB_GROUP
 /begin REF_CHARACTERISTIC EG_NmrSng0_C EG_TsSw_C EIP_NmrSgn0ForCylBaln_C EIP_TiIdleModDeb_P EIP_bAcvCylBalnOvs_P EIP_bAcvCylBalnOvv_P /end REF_CHARACTERISTIC
 /begin REF_MEASUREMENT EIP_bAcvCylBaln /end REF_MEASUREMENT
/end GROUP
/begin GROUP S84_Misfire_Detection "EcuIntgdSwGend/ControlSoftware/EcuInpPrcsg/Additionals/Misfire Detection"
 /begin SUB_GROUP S104_Injector_1_Misfire S104_Injector_2_Misfire S104_Injector_3_Misfire S104_Injector_4_Misfire S104_Injector_5_Misfire S104_Injector_6_Misfire /end SUB_GROUP
 /begin REF_CHARACTERISTIC EIP_SteadyFlgEnaForMisfire_P /end REF_CHARACTERISTIC
 /begin REF_MEASUREMENT EIP_bErrCyl1Misf EIP_bErrCyl2Misf EIP_bErrCyl3Misf EIP_bErrCyl4Misf /end REF_MEASUREMENT
/end GROUP
/begin GROUP S84_Shutdown_For_Cylinder_Misfire_Error "EcuIntgdSwGend/ControlSoftware/EcuInpPrcsg/Additionals/Shutdown For Cylinder Misfire Error" /begin SUB_GROUP S105_Debouncer S105_Debouncer1 S105_Debouncer2 /end SUB_GROUP
 /begin REF_CHARACTERISTIC EG_DiErrCyl_C EG_NmrSng0_C EG_TsSw_C EIP_NrErrCylMisfRedn_P EIP_NrErrCylMisfShtdwn_P EIP_NrErrCylMisfWarn_P EIP_TiAcvErrCylMisfRednDeb_P EIP_TiAcvErrCylMisfShtdwnDeb_P EIP_TiAcvErrCylMisfWarnDeb_P EIP_bAcvErrCylMisfRednOvs_P EIP_bAcvErrCylMisfRednOvv_P EIP_bAcvErrCylMisfShtdwnOvs_P EIP_bAcvErrCylMisfShtdwnOvv_P EIP_bAcvErrCylMisfWarnOvs_P EIP_bAcvErrCylMisfWarnOvv_P /end REF_CHARACTERISTIC
 /begin REF_MEASUREMENT EIP_NrErrCylMisfCount EIP_bAcvErrCylMisfRedn EIP_bAcvErrCylMisfShtdwn EIP_bAcvErrCylMisfWarn EIP_bErrCyl5Misf EIP_bErrCyl6Misf EIP_bErrCylMisfRednBfrDeb EIP_bErrCylMisfShtdwnBfrDeb EIP_bErrCylMisfWarnBfrDeb /end REF_MEASUREMENT
/end GROUP
/begin GROUP S85_SPN_1624___Tachograph_vehicle_speed "EcuIntgdSwGend/ControlSoftware/EcuInpPrcsg/CAN Signals/SPN 1624 - Tachograph vehicle speed"
 /begin REF_CHARACTERISTIC EIP_CanTachographVehSpdOvs_P EIP_CanTachographVehSpdOvv_P EIP_StOfCanTachographVehSpdOvs_P EIP_StOfCanTachographVehSpdOvv_P /end REF_CHARACTERISTIC
 /begin REF_MEASUREMENT EIP_CanTachographVehSpd EIP_StOfCanTachographVehSpd /end REF_MEASUREMENT
/end GROUP
/begin GROUP S85_SPN_1653___Vehicle_Limiting_Speed_Governor_Enable_Switch "EcuIntgdSwGend/ControlSoftware/EcuInpPrcsg/CAN Signals/SPN 1653 - Vehicle Limiting Speed Governor Enable Switch"
 /begin REF_CHARACTERISTIC EIP_CanVehLimSpdGovrEnaSwtOvs_P EIP_CanVehLimSpdGovrEnaSwtOvv_P EIP_StOfCanVehLimSpdGovrEnaSwtOvs_P EIP_StOfCanVehLimSpdGovrEnaSwtOvv_P /end REF_CHARACTERISTIC
 /begin REF_MEASUREMENT EIP_CanVehLimSpdGovrEnaSwt EIP_StOfCanVehLimSpdGovrEnaSwt /end REF_MEASUREMENT
/end GROUP
/begin GROUP S85_SPN_1654___Vehicle_Limiting_Speed_Governor_Increment_Switch "EcuIntgdSwGend/ControlSoftware/EcuInpPrcsg/CAN Signals/SPN 1654 - Vehicle Limiting Speed Governor Increment Switch"
 /begin REF_CHARACTERISTIC EIP_CanVehLimSpdGovrInctSwtOvs_P EIP_CanVehLimSpdGovrInctSwtOvv_P EIP_StOfCanVehLimSpdGovrInctSwtOvs_P EIP_StOfCanVehLimSpdGovrInctSwtOvv_P /end REF_CHARACTERISTIC
 /begin REF_MEASUREMENT EIP_CanVehLimSpdGovrInctSwt EIP_StOfCanVehLimSpdGovrInctSwt /end REF_MEASUREMENT
/end GROUP
/begin GROUP S85_SPN_1655___Vehicle_Limiting_Speed_Governor_Decrement_Switch "EcuIntgdSwGend/ControlSoftware/EcuInpPrcsg/CAN Signals/SPN 1655 - Vehicle Limiting Speed Governor Decrement Switch"
 /begin REF_CHARACTERISTIC EIP_CanVehLimSpdGovrDecSwtOvs_P EIP_CanVehLimSpdGovrDecSwtOvv_P EIP_StOfCanVehLimSpdGovrDecSwtOvs_P EIP_StOfCanVehLimSpdGovrDecSwtOvv_P /end REF_CHARACTERISTIC
 /begin REF_MEASUREMENT EIP_CanVehLimSpdGovrDecSwt EIP_StOfCanVehLimSpdGovrDecSwt /end REF_MEASUREMENT
/end GROUP
/begin GROUP S85_SPN_1787___Engine_Torque_Limit_Request___Maximum_Continuous "EcuIntgdSwGend/ControlSoftware/EcuInpPrcsg/CAN Signals/SPN 1787 - Engine Torque Limit Request - Maximum Continuous"
 /begin REF_CHARACTERISTIC EIP_CanEngTqLimReqMaxCntnsOvs_P EIP_CanEngTqLimReqMaxCntnsOvv_P EIP_StOfCanEngTqLimReqMaxCntnsOvs_P EIP_StOfCanEngTqLimReqMaxCntnsOvv_P /end REF_CHARACTERISTIC
 /begin REF_MEASUREMENT EIP_CanEngTqLimReqMaxCntns EIP_StOfCanEngTqLimReqMaxCntns /end REF_MEASUREMENT
/end GROUP
/begin GROUP S85_SPN_1845___Transmission_Torque_Limit "EcuIntgdSwGend/ControlSoftware/EcuInpPrcsg/CAN Signals/SPN 1845 - Transmission Torque Limit"
 /begin REF_CHARACTERISTIC EIP_CanTrsmTqLimOvs_P EIP_CanTrsmTqLimOvv_P EIP_StOfCanTrsmTqLimOvs_P EIP_StOfCanTrsmTqLimOvv_P /end REF_CHARACTERISTIC
 /begin REF_MEASUREMENT EIP_CanTrsmTqLim EIP_StOfCanTrsmTqLim /end REF_MEASUREMENT
/end GROUP
/begin GROUP S85_SPN_191___Transmission_Output_Shaft_Speed "EcuIntgdSwGend/ControlSoftware/EcuInpPrcsg/CAN Signals/SPN 191 - Transmission Output Shaft Speed"
 /begin REF_CHARACTERISTIC EIP_CanTrsmOutpShaftSpdOvs_P EIP_CanTrsmOutpShaftSpdOvv_P EIP_StOfCanTrsmOutpShaftSpdOvs_P EIP_StOfCanTrsmOutpShaftSpdOvv_P /end REF_CHARACTERISTIC
 /begin REF_MEASUREMENT EIP_CanTrsmOutpShaftSpd EIP_StOfCanTrsmOutpShaftSpd /end REF_MEASUREMENT
/end GROUP
/begin GROUP S85_SPN_2900___Transmission_Engine_Crank_Enable "EcuIntgdSwGend/ControlSoftware/EcuInpPrcsg/CAN Signals/SPN 2900 - Transmission Engine Crank Enable"
 /begin REF_CHARACTERISTIC EIP_CanTrsmEngCrkEnaOvs_P EIP_CanTrsmEngCrkEnaOvv_P EIP_StOfCanTrsmEngCrkEnaOvs_P EIP_StOfCanTrsmEngCrkEnaOvv_P /end REF_CHARACTERISTIC
 /begin REF_MEASUREMENT EIP_CanTrsmEngCrkEna EIP_StOfCanTrsmEngCrkEna /end REF_MEASUREMENT
/end GROUP
/begin GROUP S85_SPN_2978___Estimated_Engine_Parasitic_Losses___Percent_Torque "EcuIntgdSwGend/ControlSoftware/EcuInpPrcsg/CAN Signals/SPN 2978 - Estimated Engine Parasitic Losses - Percent Torque"
 /begin REF_CHARACTERISTIC EIP_CanEstimdEngParasiticTqOvs_P EIP_CanEstimdEngParasiticTqOvv_P EIP_StOfCanEstimdEngParasiticTqOvs_P EIP_StOfCanEstimdEngParasiticTqOvv_P /end REF_CHARACTERISTIC
 /begin REF_MEASUREMENT EIP_CanEstimdEngParasiticTq EIP_StOfCanEstimdEngParasiticTq /end REF_MEASUREMENT
/end GROUP
/begin GROUP S85_SPN_3030___Transmission_Torque_Converter_Ratio "EcuIntgdSwGend/ControlSoftware/EcuInpPrcsg/CAN Signals/SPN 3030 - Transmission Torque Converter Ratio"
 /begin REF_CHARACTERISTIC EIP_CanTrsmTqCnvrRatOvs_P EIP_CanTrsmTqCnvrRatOvv_P EIP_StOfCanTrsmTqCnvrRatOvs_P EIP_StOfCanTrsmTqCnvrRatOvv_P /end REF_CHARACTERISTIC
 /begin REF_MEASUREMENT EIP_CanTrsmTqCnvrRat EIP_StOfCanTrsmTqCnvrRat /end REF_MEASUREMENT
/end GROUP
/begin GROUP S85_SPN_3645___Transfer_Case_Status "EcuIntgdSwGend/ControlSoftware/EcuInpPrcsg/CAN Signals/SPN 3645 - Transfer Case Status"
 /begin REF_CHARACTERISTIC EIP_CanTrfCaseStsOvs_P EIP_CanTrfCaseStsOvv_P EIP_StOfCanTrfCaseStsOvs_P EIP_StOfCanTrfCaseStsOvv_P /end REF_CHARACTERISTIC
 /begin REF_MEASUREMENT EIP_CanTrfCaseSts EIP_StOfCanTrfCaseSts /end REF_MEASUREMENT
/end GROUP
/begin GROUP S85_SPN_3809___Transmission_Oil_Level_Request "EcuIntgdSwGend/ControlSoftware/EcuInpPrcsg/CAN Signals/SPN 3809 - Transmission Oil Level Request"
 /begin REF_CHARACTERISTIC EIP_CanTrsmOilLvlReqOvs_P EIP_CanTrsmOilLvlReqOvv_P EIP_StOfCanTrsmOilLvlReqOvs_P EIP_StOfCanTrsmOilLvlReqOvv_P /end REF_CHARACTERISTIC
 /begin REF_MEASUREMENT EIP_CanTrsmOilLvlReq EIP_StOfCanTrsmOilLvlReq /end REF_MEASUREMENT
/end GROUP
/begin GROUP S85_SPN_4191___Engine_Requested_Torque___High_Resolution_From_Tcu "EcuIntgdSwGend/ControlSoftware/EcuInpPrcsg/CAN Signals/SPN 4191 - Engine Requested Torque - High Resolution From Tcu"
 /begin REF_CHARACTERISTIC EIP_CanEngReqTqHiReslFromTcuOvs_P EIP_CanEngReqTqHiReslFromTcuOvv_P EIP_StOfCanEngReqTqHiReslFromTcuOvs_P EIP_StOfCanEngReqTqHiReslFromTcuOvv_P /end REF_CHARACTERISTIC
 /begin REF_MEASUREMENT EIP_CanEngReqTqHiReslFromTcu EIP_StOfCanEngReqTqHiReslFromTcu /end REF_MEASUREMENT
/end GROUP
/begin GROUP S85_SPN_518___Engine_Requested_Torque__Torque_Limit_From_Abs_Asc "EcuIntgdSwGend/ControlSoftware/EcuInpPrcsg/CAN Signals/SPN 518 - Engine Requested Torque//Torque Limit From Abs Asc"
 /begin REF_CHARACTERISTIC EIP_CanEngTqReqFromAbsAscOvs_P EIP_CanEngTqReqFromAbsAscOvv_P EIP_StOfCanEngTqReqFromAbsAscOvs_P EIP_StOfCanEngTqReqFromAbsAscOvv_P /end REF_CHARACTERISTIC
 /begin REF_MEASUREMENT EIP_CanEngTqReqFromAbsAsc EIP_StOfCanEngTqReqFromAbsAsc /end REF_MEASUREMENT
/end GROUP
/begin GROUP S85_SPN_518___Engine_Requested_Torque__Torque_Limit_From_Tcu "EcuIntgdSwGend/ControlSoftware/EcuInpPrcsg/CAN Signals/SPN 518 - Engine Requested Torque//Torque Limit From Tcu"
 /begin REF_CHARACTERISTIC EIP_CanEngTqReqFromTcuOvs_P EIP_CanEngTqReqFromTcuOvv_P EIP_StOfCanEngTqReqFromTcuOvs_P EIP_StOfCanEngTqReqFromTcuOvv_P /end REF_CHARACTERISTIC
 /begin REF_MEASUREMENT EIP_CanEngTqReqFromTcu EIP_StOfCanEngTqReqFromTcu /end REF_MEASUREMENT
/end GROUP
/begin GROUP S85_SPN_523___Transmission_Current_Gear "EcuIntgdSwGend/ControlSoftware/EcuInpPrcsg/CAN Signals/SPN 523 - Transmission Current Gear"
 /begin REF_CHARACTERISTIC EIP_CanTrsmCurrentGearOvs_P EIP_CanTrsmCurrentGearOvv_P EIP_StOfCanTrsmCurrentGearOvs_P EIP_StOfCanTrsmCurrentGearOvv_P /end REF_CHARACTERISTIC
 /begin REF_MEASUREMENT EIP_CanTrsmCurrentGear EIP_StOfCanTrsmCurrentGear /end REF_MEASUREMENT
/end GROUP
/begin GROUP S85_SPN_524___Transmission_Selected_Gear "EcuIntgdSwGend/ControlSoftware/EcuInpPrcsg/CAN Signals/SPN 524 - Transmission Selected Gear"
 /begin REF_CHARACTERISTIC EIP_CanTrsmSeldGearOvs_P EIP_CanTrsmSeldGearOvv_P EIP_StOfCanTrsmSeldGearOvs_P EIP_StOfCanTrsmSeldGearOvv_P /end REF_CHARACTERISTIC
 /begin REF_MEASUREMENT EIP_CanTrsmSeldGear EIP_StOfCanTrsmSeldGear /end REF_MEASUREMENT
/end GROUP
/begin GROUP S85_SPN_526___Transmission_Actual_Gear_Ratio "EcuIntgdSwGend/ControlSoftware/EcuInpPrcsg/CAN Signals/SPN 526 - Transmission Actual Gear Ratio"
 /begin REF_CHARACTERISTIC EIP_CanTrsmActGearRatOvs_P EIP_CanTrsmActGearRatOvv_P EIP_StOfCanTrsmActGearRatOvs_P EIP_StOfCanTrsmActGearRatOvv_P /end REF_CHARACTERISTIC
 /begin REF_MEASUREMENT EIP_CanTrsmActGearRat EIP_StOfCanTrsmActGearRat /end REF_MEASUREMENT
/end GROUP
/begin GROUP S85_SPN_561___ASR_Engine_Control_Active "EcuIntgdSwGend/ControlSoftware/EcuInpPrcsg/CAN Signals/SPN 561 - ASR Engine Control Active"
 /begin REF_CHARACTERISTIC EIP_CanASREngCtrlActvOvs_P EIP_CanASREngCtrlActvOvv_P EIP_StOfCanASREngCtrlActvOvs_P EIP_StOfCanASREngCtrlActvOvv_P /end REF_CHARACTERISTIC
 /begin REF_MEASUREMENT EIP_CanASREngCtrlActv EIP_StOfCanASREngCtrlActv /end REF_MEASUREMENT
/end GROUP
/begin GROUP S85_SPN_562___ASR_Brake_Control_Active "EcuIntgdSwGend/ControlSoftware/EcuInpPrcsg/CAN Signals/SPN 562 - ASR Brake Control Active"
 /begin REF_CHARACTERISTIC EIP_CanASRBrkCtrlActvOvs_P EIP_CanASRBrkCtrlActvOvv_P EIP_StOfCanASRBrkCtrlActvOvs_P EIP_StOfCanASRBrkCtrlActvOvv_P /end REF_CHARACTERISTIC
 /begin REF_MEASUREMENT EIP_CanASRBrkCtrlActv EIP_StOfCanASRBrkCtrlActv /end REF_MEASUREMENT
/end GROUP
/begin GROUP S85_SPN_563___Anti_Lock_Braking__ABS__Active "EcuIntgdSwGend/ControlSoftware/EcuInpPrcsg/CAN Signals/SPN 563 - Anti-Lock Braking (ABS) Active"
 /begin REF_CHARACTERISTIC EIP_CanABSActvOvs_P EIP_CanABSActvOvv_P EIP_StOfCanABSActvOvs_P EIP_StOfCanABSActvOvv_P /end REF_CHARACTERISTIC
 /begin REF_MEASUREMENT EIP_CanABSActv EIP_StOfCanABSActv /end REF_MEASUREMENT
/end GROUP
/begin GROUP S85_SPN_573___Transmission_Torque_Converter_Lockup_Engaged "EcuIntgdSwGend/ControlSoftware/EcuInpPrcsg/CAN Signals/SPN 573 - Transmission Torque Converter Lockup Engaged"
 /begin REF_CHARACTERISTIC EIP_CanTrsmTqCnvLockUpEngdOvs_P EIP_CanTrsmTqCnvLockUpEngdOvv_P EIP_StOfCanTrsmTqCnvLockUpEngdOvs_P EIP_StOfCanTrsmTqCnvLockUpEngdOvv_P /end REF_CHARACTERISTIC
 /begin REF_MEASUREMENT EIP_CanTrsmTqCnvLockUpEngd EIP_StOfCanTrsmTqCnvLockUpEngd /end REF_MEASUREMENT
/end GROUP
/begin GROUP S85_SPN_596___Cruise_Control_Enable_Switch "EcuIntgdSwGend/ControlSoftware/EcuInpPrcsg/CAN Signals/SPN 596 - Cruise Control Enable Switch"
 /begin REF_CHARACTERISTIC EIP_CanCrsCtrlEnaSwtOvs_P EIP_CanCrsCtrlEnaSwtOvv_P EIP_StOfCanCrsCtrlEnaSwtOvs_P EIP_StOfCanCrsCtrlEnaSwtOvv_P /end REF_CHARACTERISTIC
 /begin REF_MEASUREMENT EIP_CanCrsCtrlEnaSwt EIP_StOfCanCrsCtrlEnaSwt /end REF_MEASUREMENT
/end GROUP
/begin GROUP S85_SPN_599___Cruise_Control_Set_Switch "EcuIntgdSwGend/ControlSoftware/EcuInpPrcsg/CAN Signals/SPN 599 - Cruise Control Set Switch"
 /begin REF_CHARACTERISTIC EIP_CanCrsCtrlSetSwtOvs_P EIP_CanCrsCtrlSetSwtOvv_P EIP_StOfCanCrsCtrlSetSwtOvs_P EIP_StOfCanCrsCtrlSetSwtOvv_P /end REF_CHARACTERISTIC
 /begin REF_MEASUREMENT EIP_CanCrsCtrlSetSwt EIP_StOfCanCrsCtrlSetSwt /end REF_MEASUREMENT
/end GROUP
/begin GROUP S85_SPN_601___Cruise_Control_Resume_Switch "EcuIntgdSwGend/ControlSoftware/EcuInpPrcsg/CAN Signals/SPN 601 - Cruise Control Resume Switch"
 /begin REF_CHARACTERISTIC EIP_CanCrsCtrlResuSwtOvs_P EIP_CanCrsCtrlResuSwtOvv_P EIP_StOfCanCrsCtrlResuSwtOvs_P EIP_StOfCanCrsCtrlResuSwtOvv_P /end REF_CHARACTERISTIC
 /begin REF_MEASUREMENT EIP_CanCrsCtrlResuSwt EIP_StOfCanCrsCtrlResuSwt /end REF_MEASUREMENT
/end GROUP
/begin GROUP S85_SPN_695___Engine_Override_Control_Mode_From_Abs_Asc "EcuIntgdSwGend/ControlSoftware/EcuInpPrcsg/CAN Signals/SPN 695 - Engine Override Control Mode From Abs Asc"
 /begin REF_CHARACTERISTIC EIP_CanEngOvrdCtrlModFromAbsAscOvs_P EIP_CanEngOvrdCtrlModFromAbsAscOvv_P EIP_StOfCanEngOvrdCtrlModFromAbsAscOvs_P EIP_StOfCanEngOvrdCtrlModFromAbsAscOvv_P /end REF_CHARACTERISTIC
 /begin REF_MEASUREMENT EIP_CanEngOvrdCtrlModFromAbsAsc EIP_StOfCanEngOvrdCtrlModFromAbsAsc /end REF_MEASUREMENT
/end GROUP
/begin GROUP S85_SPN_695___Engine_Override_Control_Mode_From_Tcu "EcuIntgdSwGend/ControlSoftware/EcuInpPrcsg/CAN Signals/SPN 695 - Engine Override Control Mode From Tcu"
 /begin REF_CHARACTERISTIC EIP_CanEngOvrdCtrlModFromTcuOvs_P EIP_CanEngOvrdCtrlModFromTcuOvv_P EIP_StOfCanEngOvrdCtrlModFromTcuOvs_P EIP_StOfCanEngOvrdCtrlModFromTcuOvv_P /end REF_CHARACTERISTIC
 /begin REF_MEASUREMENT EIP_CanEngOvrdCtrlModFromTcu EIP_StOfCanEngOvrdCtrlModFromTcu /end REF_MEASUREMENT
/end GROUP
/begin GROUP S85_SPN_84___Wheel_Based_Vehicle_Speed "EcuIntgdSwGend/ControlSoftware/EcuInpPrcsg/CAN Signals/SPN 84 - Wheel-Based Vehicle Speed"
 /begin REF_CHARACTERISTIC EIP_CanWhlBasVehSpdOvs_P EIP_CanWhlBasVehSpdOvv_P EIP_StOfCanWhlBasVehSpdOvs_P EIP_StOfCanWhlBasVehSpdOvv_P /end REF_CHARACTERISTIC
 /begin REF_MEASUREMENT EIP_CanWhlBasVehSpd EIP_StOfCanWhlBasVehSpd /end REF_MEASUREMENT
/end GROUP
/begin GROUP S85_SPN_897___Override_Control_Mode_Priority_From_Abs_Asc "EcuIntgdSwGend/ControlSoftware/EcuInpPrcsg/CAN Signals/SPN 897 - Override Control Mode Priority From Abs Asc"
 /begin REF_CHARACTERISTIC EIP_CanOvrdCtrlModPrioFromAbsAscOvs_P EIP_CanOvrdCtrlModPrioFromAbsAscOvv_P EIP_StOfCanOvrdCtrlModPrioFromAbsAscOvs_P EIP_StOfCanOvrdCtrlModPrioFromAbsAscOvv_P /end REF_CHARACTERISTIC
 /begin REF_MEASUREMENT EIP_CanOvrdCtrlModPrioFromAbsAsc EIP_StOfCanOvrdCtrlModPrioFromAbsAsc /end REF_MEASUREMENT
/end GROUP
/begin GROUP S85_SPN_897___Override_Control_Mode_Priority_From_Tcu "EcuIntgdSwGend/ControlSoftware/EcuInpPrcsg/CAN Signals/SPN 897 - Override Control Mode Priority From Tcu"
 /begin REF_CHARACTERISTIC EIP_CanOvrdCtrlModPrioFromTcuOvs_P EIP_CanOvrdCtrlModPrioFromTcuOvv_P EIP_StOfCanOvrdCtrlModPrioFromTcuOvs_P EIP_StOfCanOvrdCtrlModPrioFromTcuOvv_P /end REF_CHARACTERISTIC
 /begin REF_MEASUREMENT EIP_CanOvrdCtrlModPrioFromTcu EIP_StOfCanOvrdCtrlModPrioFromTcu /end REF_MEASUREMENT
/end GROUP
/begin GROUP S85_SPN_898___Engine_Requested_Speed__Speed_Limit_From_Tcu "EcuIntgdSwGend/ControlSoftware/EcuInpPrcsg/CAN Signals/SPN 898 - Engine Requested Speed//Speed Limit From Tcu"
 /begin REF_CHARACTERISTIC EIP_CanEngSpdReqFromTcuOvs_P EIP_CanEngSpdReqFromTcuOvv_P EIP_StOfCanEngSpdReqFromTcuOvs_P EIP_StOfCanEngSpdReqFromTcuOvv_P /end REF_CHARACTERISTIC
 /begin REF_MEASUREMENT EIP_CanEngSpdReqFromTcu EIP_StOfCanEngSpdReqFromTcu /end REF_MEASUREMENT
/end GROUP
/begin GROUP S85_SPN_96___Fuel_Level_1 "EcuIntgdSwGend/ControlSoftware/EcuInpPrcsg/CAN Signals/SPN 96 - Fuel Level 1"
 /begin REF_CHARACTERISTIC EIP_CanFuLvl1Ovs_P EIP_CanFuLvl1Ovv_P EIP_StOfCanFuLvl1Ovs_P EIP_StOfCanFuLvl1Ovv_P /end REF_CHARACTERISTIC
 /begin REF_MEASUREMENT EIP_CanFuLvl1 EIP_StOfCanFuLvl1 /end REF_MEASUREMENT
/end GROUP
/begin GROUP S85_SPN_970___Engine_Auxiliary_Shutdown_Switch "EcuIntgdSwGend/ControlSoftware/EcuInpPrcsg/CAN Signals/SPN 970 - Engine Auxiliary Shutdown Switch"
 /begin REF_CHARACTERISTIC EIP_CanEngAuxShtdwnSwtOvs_P EIP_CanEngAuxShtdwnSwtOvv_P EIP_StOfCanEngAuxShtdwnSwtOvs_P EIP_StOfCanEngAuxShtdwnSwtOvv_P /end REF_CHARACTERISTIC
 /begin REF_MEASUREMENT EIP_CanEngAuxShtdwnSwt EIP_StOfCanEngAuxShtdwnSwt /end REF_MEASUREMENT
/end GROUP
/begin GROUP S85_SPN_973___Engine_Retarder_Selection "EcuIntgdSwGend/ControlSoftware/EcuInpPrcsg/CAN Signals/SPN 973 - Engine Retarder Selection"
 /begin REF_CHARACTERISTIC EIP_CanEngRtdrSelnOvs_P EIP_CanEngRtdrSelnOvv_P EIP_StOfCanEngRtdrSelnOvs_P EIP_StOfCanEngRtdrSelnOvv_P /end REF_CHARACTERISTIC
 /begin REF_MEASUREMENT EIP_CanEngRtdrSeln EIP_StOfCanEngRtdrSeln /end REF_MEASUREMENT
/end GROUP
/begin GROUP S85_SPN_979___Engine_Remote_PTO_Governor_Pregrogrammed_Speed_Control_Switch "EcuIntgdSwGend/ControlSoftware/EcuInpPrcsg/CAN Signals/SPN 979 - Engine Remote PTO Governor Pregrogrammed Speed Control Switch"
 /begin REF_CHARACTERISTIC EIP_CanEngRemPtoGovrProgdSpdCtrlSwtOvs_P EIP_CanEngRemPtoGovrProgdSpdCtrlSwtOvv_P EIP_StOfCanEngRemPtoGovrSpdCtrlSwtOvs_P EIP_StOfCanEngRemPtoGovrSpdCtrlSwtOvv_P /end REF_CHARACTERISTIC
 /begin REF_MEASUREMENT EIP_CanEngRemPtoGovrProgdSpdCtrlSwt EIP_StOfCanEngRemPtoGovrSpdCtrlSwt /end REF_MEASUREMENT
/end GROUP
/begin GROUP S85_SPN_980___Engine_PTO_Governor_Enable_Switch "EcuIntgdSwGend/ControlSoftware/EcuInpPrcsg/CAN Signals/SPN 980 - Engine PTO Governor Enable Switch"
 /begin REF_CHARACTERISTIC EIP_CanEngPtoGovrEnaSwtOvs_P EIP_CanEngPtoGovrEnaSwtOvv_P EIP_StOfCanEngPtoGovrEnaSwtOvs_P EIP_StOfCanEngPtoGovrEnaSwtOvv_P /end REF_CHARACTERISTIC
 /begin REF_MEASUREMENT EIP_CanEngPtoGovrEnaSwt EIP_StOfCanEngPtoGovrEnaSwt /end REF_MEASUREMENT
/end GROUP
/begin GROUP S679_N_Map_Interpolation_for_Main_Quantity "EcuIntgdSwGend/ControlSoftware/TqCnvn/Torque Conversion For SPN  2432 - Engine Demand Torque/N-Map Interpolation for Main Quantity"
 /begin REF_CHARACTERISTIC TrC_MMaiFuQnty1_M TrC_MMaiFuQnty2_M TrC_MMaiFuQnty3_M TrC_MMaiFuQntyOvs_P TrC_MMaiFuQntyOvv_P TrC_TCooltMap1Thd_P TrC_TCooltMap2Thd_P TrC_TCooltMap3Thd_P /end REF_CHARACTERISTIC
/end GROUP
/begin GROUP S679_N_Map_Interpolation_for_Pre_Quantity "EcuIntgdSwGend/ControlSoftware/TqCnvn/Torque Conversion For SPN  2432 - Engine Demand Torque/N-Map Interpolation for Pre Quantity"
 /begin REF_CHARACTERISTIC TrC_MPltFuQnty1_M TrC_MPltFuQnty2_M TrC_MPltFuQnty3_M TrC_MPltFuQntyOvs_P TrC_MPltFuQntyOvv_P TrC_TCooltMap1Thd_P TrC_TCooltMap2Thd_P TrC_TCooltMap3Thd_P /end REF_CHARACTERISTIC
/end GROUP
/begin GROUP S679_Pilot_Quantity_Correction "EcuIntgdSwGend/ControlSoftware/TqCnvn/Torque Conversion For SPN  2432 - Engine Demand Torque/Pilot Quantity Correction"
 /begin REF_CHARACTERISTIC TrC_MPltFuPAmbAirCorr_M TrC_MPltFuTAirBoostCorr_M TrC_MPltFuTAmbAirCorr_M TrC_MPltFuTCooltCorr_M TrC_MPltFuTOilCorr_M TrC_MPltFuUClmp30Corr_M /end REF_CHARACTERISTIC
/end GROUP
/begin GROUP S679_Smoke_Limitation "EcuIntgdSwGend/ControlSoftware/TqCnvn/Torque Conversion For SPN  2432 - Engine Demand Torque/Smoke Limitation"
 /begin REF_CHARACTERISTIC TrC_RatAirFuMax_P TrC_RatAirFuMin_P TrC_RatAirFuSmokLim_M TrC_SmokeLimOvs_P /end REF_CHARACTERISTIC
/end GROUP
/begin GROUP S55_TSC1_Request_for_Speed_Control "EcuIntgdSwGend/ControlSoftware/DesTqClcn/Running Mode/TSC1 Control Purpose/TSC1 Request for Speed Control" /begin REF_CHARACTERISTIC DTqC_FacSclPIDCoeff_P /end REF_CHARACTERISTIC /end GROUP
/end MODULE
/end PROJECT
