ASAP2_VERSION 1 6
/begin PROJECT ECEMTAG_CR8 ""
/begin MODULE DIM ""
/begin MOD_COMMON "Mod Common Comment Here" DEPOSIT ABSOLUTE BYTE_ORDER MSB_FIRST /end MOD_COMMON
/begin RECORD_LAYOUT FLOAT32_IEEE FNC_VALUES 1 FLOAT32_IEEE ROW_DIR DIRECT /end RECORD_LAYOUT
/begin RECORD_LAYOUT UWORD FNC_VALUES 1 UWORD ROW_DIR DIRECT /end RECORD_LAYOUT
/begin RECORD_LAYOUT SWORD FNC_VALUES 1 SWORD ROW_DIR DIRECT /end RECORD_LAYOUT
/begin RECORD_LAYOUT UBYTE FNC_VALUES 1 UBYTE ROW_DIR DIRECT /end RECORD_LAYOUT
/begin RECORD_LAYOUT SBYTE FNC_VALUES 1 SBYTE ROW_DIR DIRECT /end RECORD_LAYOUT
/begin RECORD_LAYOUT RL_X_SBYTE AXIS_PTS_X 1 SBYTE INDEX_INCR DIRECT /end RECORD_LAYOUT
/******************************* From MATLAB ***************************************/ /* MATLAB_SECTION_START_1 */
/begin RECORD_LAYOUT Scalar_BOOLEAN FNC_VALUES 1 UBYTE ROW_DIR DIRECT /end RECORD_LAYOUT
/begin RECORD_LAYOUT Scalar_UBYTE FNC_VALUES 1 UBYTE ROW_DIR DIRECT /end RECORD_LAYOUT
/begin RECORD_LAYOUT Scalar_BYTE FNC_VALUES 1 SBYTE ROW_DIR DIRECT /end RECORD_LAYOUT
/begin RECORD_LAYOUT Scalar_UWORD FNC_VALUES 1 UWORD ROW_DIR DIRECT /end RECORD_LAYOUT
/begin RECORD_LAYOUT Scalar_SWORD FNC_VALUES 1 SWORD ROW_DIR DIRECT /end RECORD_LAYOUT
/begin RECORD_LAYOUT Scalar_LONG FNC_VALUES 1 SLONG ROW_DIR DIRECT /end RECORD_LAYOUT
/begin RECORD_LAYOUT Scalar_FLOAT32_IEEE FNC_VALUES 1 FLOAT32_IEEE ROW_DIR DIRECT /end RECORD_LAYOUT
/begin RECORD_LAYOUT Scalar_FLOAT64_IEEE FNC_VALUES 1 FLOAT64_IEEE ROW_DIR DIRECT /end RECORD_LAYOUT
/begin RECORD_LAYOUT Lookup1D_BOOLEAN FNC_VALUES 1 UBYTE ROW_DIR DIRECT /end RECORD_LAYOUT
/begin RECORD_LAYOUT Lookup1D_X_BOOLEAN AXIS_PTS_X 1 UBYTE INDEX_INCR DIRECT /end RECORD_LAYOUT
/begin RECORD_LAYOUT Lookup1D_BYTE FNC_VALUES 1 SBYTE ROW_DIR DIRECT /end RECORD_LAYOUT
/begin RECORD_LAYOUT Lookup1D_X_BYTE AXIS_PTS_X 1 SBYTE INDEX_INCR DIRECT /end RECORD_LAYOUT
/begin RECORD_LAYOUT Lookup1D_FLOAT32_IEEE FNC_VALUES 1 FLOAT32_IEEE ROW_DIR DIRECT /end RECORD_LAYOUT
/begin RECORD_LAYOUT Lookup1D_X_FLOAT32_IEEE AXIS_PTS_X 1 FLOAT32_IEEE INDEX_INCR DIRECT /end RECORD_LAYOUT
/begin CHARACTERISTIC IC_DurMaiLimd_M "Limited Main Injection Duration Map" CURVE 0x40044FD0 /* @ECU_Address@IC_DurMaiLimd_M@ */ Lookup1D_FLOAT32_IEEE 0 EcuIntgdSwGend_CM_single_us 0.0 5000.0
 /begin AXIS_DESCR COM_AXIS EIP_PRail EcuIntgdSwGend_CM_single_bar 16 0.0 2500.0 AXIS_PTS_REF IC_PRailMaiLimd_A /end AXIS_DESCR
/end CHARACTERISTIC
/begin AXIS_PTS IC_PRailMaiLimd_A "Rail Pressure Limited Main Injection Duration Map Axis" 0x40045FA4 /* @ECU_Address@IC_PRailMaiLimd_A@ */ EIP_PRail Lookup1D_X_FLOAT32_IEEE 0 EcuIntgdSwGend_CM_single_bar 16 0.0 2500.0 /end AXIS_PTS
/begin CHARACTERISTIC EIP_GearSpdCnvnFacForTrsm_P "Gear Speed Conversion Factor for Transmission" VALUE 0x40044218 /* @ECU_Address@EIP_GearSpdCnvnFacForTrsm_P@ */ Scalar_FLOAT32_IEEE 0 EcuIntgdSwGend_CM_single 0.0 1.0 /end CHARACTERISTIC
/begin CHARACTERISTIC EIP_GrdtLvlOil_P "Oil Level Gradient Parameter" VALUE 0x4004421C /* @ECU_Address@EIP_GrdtLvlOil_P@ */ Scalar_FLOAT32_IEEE 0 EcuIntgdSwGend_CM_single -10000.0 20000.0 /end CHARACTERISTIC
/begin CHARACTERISTIC EIP_GrdtPAirBoost_P "Air Boost Pressure Gradient Parameter" VALUE 0x40044220 /* @ECU_Address@EIP_GrdtPAirBoost_P@ */ Scalar_FLOAT32_IEEE 0 EcuIntgdSwGend_CM_single_mbar_sec -10000.0 20000.0 /end CHARACTERISTIC
/begin CHARACTERISTIC EIP_GrdtPAmbAir_P "Ambient Air Pressure Gradient Parameter" VALUE 0x40044224 /* @ECU_Address@EIP_GrdtPAmbAir_P@ */ Scalar_FLOAT32_IEEE 0 EcuIntgdSwGend_CM_single_mbar_sec -10000.0 20000.0 /end CHARACTERISTIC
/begin CHARACTERISTIC EIP_GrdtPFu_P "Fuel Pressure Gradient Parameter" VALUE 0x40044228 /* @ECU_Address@EIP_GrdtPFu_P@ */ Scalar_FLOAT32_IEEE 0 EcuIntgdSwGend_CM_single_mbar_sec -10000.0 20000.0 /end CHARACTERISTIC
/begin CHARACTERISTIC EIP_GrdtPOil_P "Oil Pressure Gradient Parameter" VALUE 0x4004422C /* @ECU_Address@EIP_GrdtPOil_P@ */ Scalar_FLOAT32_IEEE 0 EcuIntgdSwGend_CM_single_mbar_sec -10000.0 20000.0 /end CHARACTERISTIC
/begin CHARACTERISTIC EIP_GrdtPRail_P "Rail Pressure Gradient Parameter" VALUE 0x40044230 /* @ECU_Address@EIP_GrdtPRail_P@ */ Scalar_FLOAT32_IEEE 0 EcuIntgdSwGend_CM_single_bar_sec -10000.0 20000.0 /end CHARACTERISTIC
/begin CHARACTERISTIC EIP_GrdtTAirBoost_P "Air Boost Temperature Gradient Parameter" VALUE 0x40044234 /* @ECU_Address@EIP_GrdtTAirBoost_P@ */ Scalar_FLOAT32_IEEE 0 EcuIntgdSwGend_CM_single_degC_sec -10000.0 20000.0 /end CHARACTERISTIC
/begin CHARACTERISTIC EIP_GrdtTAmbAir_P "Ambient Air Temperature Gradient Parameter" VALUE 0x40044238 /* @ECU_Address@EIP_GrdtTAmbAir_P@ */ Scalar_FLOAT32_IEEE 0 EcuIntgdSwGend_CM_single_degC_sec -10000.0 20000.0 /end CHARACTERISTIC
/begin CHARACTERISTIC EIP_GrdtTCoolt_P "Coolant Temperature Gradient Parameter" VALUE 0x4004423C /* @ECU_Address@EIP_GrdtTCoolt_P@ */ Scalar_FLOAT32_IEEE 0 EcuIntgdSwGend_CM_single_degC_sec -10000.0 20000.0 /end CHARACTERISTIC
/begin CHARACTERISTIC EIP_GrdtTEcu_P "ECU Temperature Gradient Parameter" VALUE 0x40044240 /* @ECU_Address@EIP_GrdtTEcu_P@ */ Scalar_FLOAT32_IEEE 0 EcuIntgdSwGend_CM_single_degC_sec -10000.0 20000.0 /end CHARACTERISTIC
/begin CHARACTERISTIC EIP_GrdtTFu_P "Fuel Temperature Gradient Parameter" VALUE 0x40044244 /* @ECU_Address@EIP_GrdtTFu_P@ */ Scalar_FLOAT32_IEEE 0 EcuIntgdSwGend_CM_single_degC_sec -10000.0 20000.0 /end CHARACTERISTIC
/begin CHARACTERISTIC EIP_GrdtTOil_P "Oil Temperature Gradient Parameter" VALUE 0x40044248 /* @ECU_Address@EIP_GrdtTOil_P@ */ Scalar_FLOAT32_IEEE 0 EcuIntgdSwGend_CM_single_degC_sec -10000.0 20000.0 /end CHARACTERISTIC
/begin CHARACTERISTIC EIP_LvlOilMax_P "Max Oil Level Parameter" VALUE 0x40044268 /* @ECU_Address@EIP_LvlOilMax_P@ */ Scalar_FLOAT32_IEEE 0 EcuIntgdSwGend_CM_single__ 0.0 100.0 /end CHARACTERISTIC
/begin CHARACTERISTIC EIP_LvlOilMin_P "Min Oil Level Parameter" VALUE 0x4004426C /* @ECU_Address@EIP_LvlOilMin_P@ */ Scalar_FLOAT32_IEEE 0 EcuIntgdSwGend_CM_single__ 0.0 100.0 /end CHARACTERISTIC
/begin CHARACTERISTIC EIP_NEngEmgcyShtdwnForOvspd_P "Engine Speed Parameter for Emergency Shutdown for Overspeed" VALUE 0x400442C8 /* @ECU_Address@EIP_NEngEmgcyShtdwnForOvspd_P@ */ Scalar_FLOAT32_IEEE 0 EcuIntgdSwGend_CM_single_rpm 0.0 5000.0 /end CHARACTERISTIC
/begin CHARACTERISTIC EIP_PAirBoostMax_P "Max Air Boost Pressure Parameter" VALUE 0x400442EC /* @ECU_Address@EIP_PAirBoostMax_P@ */ Scalar_FLOAT32_IEEE 0 EcuIntgdSwGend_CM_single_mbar 0.0 15000.0 /end CHARACTERISTIC
/begin CHARACTERISTIC EIP_PAirBoostMin_P "Min Air Boost Pressure Parameter" VALUE 0x400442F0 /* @ECU_Address@EIP_PAirBoostMin_P@ */ Scalar_FLOAT32_IEEE 0 EcuIntgdSwGend_CM_single_mbar 0.0 15000.0 /end CHARACTERISTIC
/begin CHARACTERISTIC EIP_PAmbAirMax_P "Max Ambient Air Pressure Parameter" VALUE 0x40044304 /* @ECU_Address@EIP_PAmbAirMax_P@ */ Scalar_FLOAT32_IEEE 0 EcuIntgdSwGend_CM_single_mbar -1000.0 1600.0 /end CHARACTERISTIC
/begin CHARACTERISTIC EIP_PAmbAirMin_P "Min Ambient Air Pressure Parameter" VALUE 0x40044308 /* @ECU_Address@EIP_PAmbAirMin_P@ */ Scalar_FLOAT32_IEEE 0 EcuIntgdSwGend_CM_single_mbar -1000.0 1600.0 /end CHARACTERISTIC
/begin CHARACTERISTIC EIP_PFuMax_P "Max Fuel Pressure Parameter" VALUE 0x40044318 /* @ECU_Address@EIP_PFuMax_P@ */ Scalar_FLOAT32_IEEE 0 EcuIntgdSwGend_CM_single_mbar 0.0 15000.0 /end CHARACTERISTIC
/begin CHARACTERISTIC EIP_PFuMin_P "Min Fuel Pressure Parameter" VALUE 0x4004431C /* @ECU_Address@EIP_PFuMin_P@ */ Scalar_FLOAT32_IEEE 0 EcuIntgdSwGend_CM_single_mbar 0.0 15000.0 /end CHARACTERISTIC
/begin CHARACTERISTIC EIP_POilMax_P "Max Oil Pressure Parameter" VALUE 0x4004432C /* @ECU_Address@EIP_POilMax_P@ */ Scalar_FLOAT32_IEEE 0 EcuIntgdSwGend_CM_single_mbar 0.0 15000.0 /end CHARACTERISTIC
/begin CHARACTERISTIC EIP_POilMin_P "Min Oil Pressure Parameter" VALUE 0x40044330 /* @ECU_Address@EIP_POilMin_P@ */ Scalar_FLOAT32_IEEE 0 EcuIntgdSwGend_CM_single_mbar 0.0 15000.0 /end CHARACTERISTIC
/begin CHARACTERISTIC EIP_PRailMax_P "Max Rail Pressure Parameter" VALUE 0x40044344 /* @ECU_Address@EIP_PRailMax_P@ */ Scalar_FLOAT32_IEEE 0 EcuIntgdSwGend_CM_single_bar 0.0 15000.0 /end CHARACTERISTIC
/begin CHARACTERISTIC EIP_PRailMin_P "Min Rail Pressure Parameter" VALUE 0x40044348 /* @ECU_Address@EIP_PRailMin_P@ */ Scalar_FLOAT32_IEEE 0 EcuIntgdSwGend_CM_single_bar 0.0 15000.0 /end CHARACTERISTIC
/begin CHARACTERISTIC EIP_PercgAccr1Max_P "Max First Acelerator Pedal Percentage Parameter" VALUE 0x40044358 /* @ECU_Address@EIP_PercgAccr1Max_P@ */ Scalar_FLOAT32_IEEE 0 EcuIntgdSwGend_CM_single__ 0.0 100.0 /end CHARACTERISTIC
/begin CHARACTERISTIC EIP_PercgAccr1Min_P "Min First Acelerator Pedal Percentage Parameter" VALUE 0x4004435C /* @ECU_Address@EIP_PercgAccr1Min_P@ */ Scalar_FLOAT32_IEEE 0 EcuIntgdSwGend_CM_single__ 0.0 100.0 /end CHARACTERISTIC
/begin CHARACTERISTIC EIP_PercgAccr2Max_P "Max Second Acelerator Pedal Percentage Parameter" VALUE 0x40044368 /* @ECU_Address@EIP_PercgAccr2Max_P@ */ Scalar_FLOAT32_IEEE 0 EcuIntgdSwGend_CM_single__ 0.0 100.0 /end CHARACTERISTIC
/begin CHARACTERISTIC EIP_PercgAccr2Min_P "Min Second Acelerator Pedal Percentage Parameter" VALUE 0x4004436C /* @ECU_Address@EIP_PercgAccr2Min_P@ */ Scalar_FLOAT32_IEEE 0 EcuIntgdSwGend_CM_single__ 0.0 100.0 /end CHARACTERISTIC
/begin CHARACTERISTIC EIP_PercgAccrDiffThd_P "Acelerator Pedal Percentage Difference Threshold Parameter" VALUE 0x4004437C /* @ECU_Address@EIP_PercgAccrDiffThd_P@ */ Scalar_FLOAT32_IEEE 0 EcuIntgdSwGend_CM_single__ 0.0 100.0 /end CHARACTERISTIC
/begin CHARACTERISTIC EIP_PercgAccrMaxHysThd_P "Acelerator Pedal Percentage Max Hysteresis Threshold Parameter" VALUE 0x4004438C /* @ECU_Address@EIP_PercgAccrMaxHysThd_P@ */ Scalar_FLOAT32_IEEE 0 EcuIntgdSwGend_CM_single__ 0.0 100.0 /end CHARACTERISTIC
/begin CHARACTERISTIC EIP_PercgAccrMaxThd_P "Acelerator Pedal Percentage Max Threshold Parameter" VALUE 0x40044390 /* @ECU_Address@EIP_PercgAccrMaxThd_P@ */ Scalar_FLOAT32_IEEE 0 EcuIntgdSwGend_CM_single__ 0.0 100.0 /end CHARACTERISTIC
/begin CHARACTERISTIC EIP_PercgAccrMax_P "Acelerator Pedal Percentage Max Parameter" VALUE 0x40044394 /* @ECU_Address@EIP_PercgAccrMax_P@ */ Scalar_FLOAT32_IEEE 0 EcuIntgdSwGend_CM_single__ 0.0 100.0 /end CHARACTERISTIC
/begin CHARACTERISTIC EIP_PercgAccrMinHysThd_P "Acelerator Pedal Percentage Min Hysteresis Threshold Parameter" VALUE 0x40044398 /* @ECU_Address@EIP_PercgAccrMinHysThd_P@ */ Scalar_FLOAT32_IEEE 0 EcuIntgdSwGend_CM_single__ 0.0 100.0 /end CHARACTERISTIC
/begin CHARACTERISTIC EIP_PercgAccrMinThd_P "Acelerator Pedal Percentage Min Threshold Parameter" VALUE 0x4004439C /* @ECU_Address@EIP_PercgAccrMinThd_P@ */ Scalar_FLOAT32_IEEE 0 EcuIntgdSwGend_CM_single__ 0.0 100.0 /end CHARACTERISTIC
/begin CHARACTERISTIC EIP_PercgAccrMin_P "Acelerator Pedal Percentage Min Parameter" VALUE 0x400443A0 /* @ECU_Address@EIP_PercgAccrMin_P@ */ Scalar_FLOAT32_IEEE 0 EcuIntgdSwGend_CM_single__ 0.0 100.0 /end CHARACTERISTIC
/begin CHARACTERISTIC EIP_TAirBoostMax_P "Max Air Boost Temperature Parameter" VALUE 0x400444FC /* @ECU_Address@EIP_TAirBoostMax_P@ */ Scalar_FLOAT32_IEEE 0 EcuIntgdSwGend_CM_single_degC -50.0 250.0 /end CHARACTERISTIC
/begin CHARACTERISTIC EIP_TAirBoostMin_P "Min Air Boost Temperature Parameter" VALUE 0x40044500 /* @ECU_Address@EIP_TAirBoostMin_P@ */ Scalar_FLOAT32_IEEE 0 EcuIntgdSwGend_CM_single_degC -50.0 250.0 /end CHARACTERISTIC
/begin CHARACTERISTIC EIP_TAmbAirMax_P "Max Ambient Air Temperature Parameter" VALUE 0x40044510 /* @ECU_Address@EIP_TAmbAirMax_P@ */ Scalar_FLOAT32_IEEE 0 EcuIntgdSwGend_CM_single_degC -50.0 250.0 /end CHARACTERISTIC
/begin CHARACTERISTIC EIP_TAmbAirMin_P "Min Ambient Air Temperature Parameter" VALUE 0x40044514 /* @ECU_Address@EIP_TAmbAirMin_P@ */ Scalar_FLOAT32_IEEE 0 EcuIntgdSwGend_CM_single_degC -50.0 250.0 /end CHARACTERISTIC
/begin CHARACTERISTIC EIP_TCooltMax_P "Max Coolant Temperature Parameter" VALUE 0x40044554 /* @ECU_Address@EIP_TCooltMax_P@ */ Scalar_FLOAT32_IEEE 0 EcuIntgdSwGend_CM_single_degC -50.0 250.0 /end CHARACTERISTIC
/begin CHARACTERISTIC EIP_TCooltMin_P "Min Coolant Temperature Parameter" VALUE 0x40044558 /* @ECU_Address@EIP_TCooltMin_P@ */ Scalar_FLOAT32_IEEE 0 EcuIntgdSwGend_CM_single_degC -50.0 250.0 /end CHARACTERISTIC
/begin CHARACTERISTIC EIP_TCooltTOilCohThd_P "Coolant Temperature Oil Temperature Cohenerence Threshold Parameter" VALUE 0x40044564 /* @ECU_Address@EIP_TCooltTOilCohThd_P@ */ Scalar_FLOAT32_IEEE 0 EcuIntgdSwGend_CM_single_degC -50.0 1000.0 /end CHARACTERISTIC
/begin CHARACTERISTIC EIP_TEcuMax_P "Max Ecu Temperature Parameter" VALUE 0x4004459C /* @ECU_Address@EIP_TEcuMax_P@ */ Scalar_FLOAT32_IEEE 0 EcuIntgdSwGend_CM_single_degC -50.0 250.0 /end CHARACTERISTIC
/begin CHARACTERISTIC EIP_TEcuMin_P "Min Ecu Temperature Parameter" VALUE 0x400445A0 /* @ECU_Address@EIP_TEcuMin_P@ */ Scalar_FLOAT32_IEEE 0 EcuIntgdSwGend_CM_single_degC -50.0 250.0 /end CHARACTERISTIC
/begin CHARACTERISTIC EIP_TFuMax_P "Max Fuel Temperature Parameter " VALUE 0x400445B0 /* @ECU_Address@EIP_TFuMax_P@ */ Scalar_FLOAT32_IEEE 0 EcuIntgdSwGend_CM_single_degC -50.0 250.0 /end CHARACTERISTIC
/begin CHARACTERISTIC EIP_TFuMin_P "Min Fuel Temperature Parameter" VALUE 0x400445B4 /* @ECU_Address@EIP_TFuMin_P@ */ Scalar_FLOAT32_IEEE 0 EcuIntgdSwGend_CM_single_degC -50.0 250.0 /end CHARACTERISTIC
/begin CHARACTERISTIC EIP_TOilMax_P "Max Oil Temperature Parameter" VALUE 0x400445F4 /* @ECU_Address@EIP_TOilMax_P@ */ Scalar_FLOAT32_IEEE 0 EcuIntgdSwGend_CM_single_degC -50.0 250.0 /end CHARACTERISTIC
/begin CHARACTERISTIC EIP_TOilMin_P "Min Oil Temperature Parameter" VALUE 0x400445F8 /* @ECU_Address@EIP_TOilMin_P@ */ Scalar_FLOAT32_IEEE 0 EcuIntgdSwGend_CM_single_degC -50.0 250.0 /end CHARACTERISTIC
/begin CHARACTERISTIC EIP_TcLvlOilFil_P "Low Pass Filter Time Constant for Oil Level" VALUE 0x40044644 /* @ECU_Address@EIP_TcLvlOilFil_P@ */ Scalar_FLOAT32_IEEE 0 EcuIntgdSwGend_CM_single_ms 0.0 5000.0 /end CHARACTERISTIC
/begin CHARACTERISTIC EIP_TcPAirBoostFil_P "Low Pass Filter Time Constant for Air Boost Pressure" VALUE 0x40044668 /* @ECU_Address@EIP_TcPAirBoostFil_P@ */ Scalar_FLOAT32_IEEE 0 EcuIntgdSwGend_CM_single_ms 0.0 5000.0 /end CHARACTERISTIC
/begin CHARACTERISTIC EIP_TcPAmbAirFil_P "Low Pass Filter Time Constant for Ambient Air Pressure" VALUE 0x4004466C /* @ECU_Address@EIP_TcPAmbAirFil_P@ */ Scalar_FLOAT32_IEEE 0 EcuIntgdSwGend_CM_single_ms 0.0 5000.0 /end CHARACTERISTIC
/begin CHARACTERISTIC EIP_TcPFuFil_P "Low Pass Filter Time Constant for Fuel Pressure" VALUE 0x40044670 /* @ECU_Address@EIP_TcPFuFil_P@ */ Scalar_FLOAT32_IEEE 0 EcuIntgdSwGend_CM_single_ms 0.0 5000.0 /end CHARACTERISTIC
/begin CHARACTERISTIC EIP_TcPOilFil_P "Low Pass Filter Time Constant for Oil Ressure" VALUE 0x40044674 /* @ECU_Address@EIP_TcPOilFil_P@ */ Scalar_FLOAT32_IEEE 0 EcuIntgdSwGend_CM_single_ms 0.0 5000.0 /end CHARACTERISTIC
/begin CHARACTERISTIC EIP_TcPRailFil_P "Low Pass Filter Time Constant for Rail Pressure" VALUE 0x40044678 /* @ECU_Address@EIP_TcPRailFil_P@ */ Scalar_FLOAT32_IEEE 0 EcuIntgdSwGend_CM_single_ms 0.0 5000.0 /end CHARACTERISTIC
/begin CHARACTERISTIC EIP_TcTAirBoostFil_P "Low Pass Filter Time Constant for Air Boost Temperature" VALUE 0x4004467C /* @ECU_Address@EIP_TcTAirBoostFil_P@ */ Scalar_FLOAT32_IEEE 0 EcuIntgdSwGend_CM_single_ms 0.0 5000.0 /end CHARACTERISTIC
/begin CHARACTERISTIC EIP_TcTAmbAirFil_P "Low Pass Filter Time Constant for Ambient Air Temperature" VALUE 0x40044680 /* @ECU_Address@EIP_TcTAmbAirFil_P@ */ Scalar_FLOAT32_IEEE 0 EcuIntgdSwGend_CM_single_ms 0.0 5000.0 /end CHARACTERISTIC
/begin CHARACTERISTIC EIP_TcTCooltFil_P "Low Pass Filter Time Constant for Coolant Temperature" VALUE 0x40044684 /* @ECU_Address@EIP_TcTCooltFil_P@ */ Scalar_FLOAT32_IEEE 0 EcuIntgdSwGend_CM_single_ms 0.0 5000.0 /end CHARACTERISTIC
/begin CHARACTERISTIC EIP_TcTEcuFil_P "Low Pass Filter Time Constant for ECU Temperature" VALUE 0x40044688 /* @ECU_Address@EIP_TcTEcuFil_P@ */ Scalar_FLOAT32_IEEE 0 EcuIntgdSwGend_CM_single_ms 0.0 5000.0 /end CHARACTERISTIC
/begin CHARACTERISTIC EIP_TcTFuFil_P "Low Pass Filter Time Constant for Fuel Temperature" VALUE 0x4004468C /* @ECU_Address@EIP_TcTFuFil_P@ */ Scalar_FLOAT32_IEEE 0 EcuIntgdSwGend_CM_single_ms 0.0 5000.0 /end CHARACTERISTIC
/begin CHARACTERISTIC EIP_TcTOilFil_P "Low Pass Filter Time Constant for Oil Temperature" VALUE 0x40044690 /* @ECU_Address@EIP_TcTOilFil_P@ */ Scalar_FLOAT32_IEEE 0 EcuIntgdSwGend_CM_single_ms 0.0 5000.0 /end CHARACTERISTIC
/begin CHARACTERISTIC EIP_TiAcvEmgcyShtdwnForOvspdDeb_P "Debouncer Time for Emergency Shutdown for Overspeed Active Parameter" VALUE 0x40044698 /* @ECU_Address@EIP_TiAcvEmgcyShtdwnForOvspdDeb_P@ */ Scalar_FLOAT32_IEEE 0 EcuIntgdSwGend_CM_single_ms 0.0 250000.0 /end CHARACTERISTIC
/begin CHARACTERISTIC EIP_TiDebAccrDervThd_P "Debouncer Time for Accelerator Derivation Threshold Parameter" VALUE 0x400446B8 /* @ECU_Address@EIP_TiDebAccrDervThd_P@ */ Scalar_FLOAT32_IEEE 0 EcuIntgdSwGend_CM_single_ms 0.0 250000.0 /end CHARACTERISTIC
/begin CHARACTERISTIC EIP_TiLvlOilSnsrDeb_P "Debouncer Time for Oil Level Sensor Parameter" VALUE 0x400446D8 /* @ECU_Address@EIP_TiLvlOilSnsrDeb_P@ */ Scalar_FLOAT32_IEEE 0 EcuIntgdSwGend_CM_single_ms 0.0 250000.0 /end CHARACTERISTIC
/begin CHARACTERISTIC EIP_TiPAirBoostSnsrDeb_P "Debouncer Time for Air Boost Pressure Sensor Parameter" VALUE 0x400446DC /* @ECU_Address@EIP_TiPAirBoostSnsrDeb_P@ */ Scalar_FLOAT32_IEEE 0 EcuIntgdSwGend_CM_single_ms 0.0 250000.0 /end CHARACTERISTIC
/begin CHARACTERISTIC EIP_TiPAmbAirSnsrDeb_P "Debouncer Time for Ambient Air Pressure Sensor Parameter" VALUE 0x400446E0 /* @ECU_Address@EIP_TiPAmbAirSnsrDeb_P@ */ Scalar_FLOAT32_IEEE 0 EcuIntgdSwGend_CM_single_ms 0.0 250000.0 /end CHARACTERISTIC
/begin CHARACTERISTIC EIP_TiPFuSnsrDeb_P "Debouncer Time for Fuel Pressure Sensor Parameter" VALUE 0x400446E4 /* @ECU_Address@EIP_TiPFuSnsrDeb_P@ */ Scalar_FLOAT32_IEEE 0 EcuIntgdSwGend_CM_single_ms 0.0 250000.0 /end CHARACTERISTIC
/begin CHARACTERISTIC EIP_TiPOilSnsrDeb_P "Debouncer Time for Oil Pressure Sensor Parameter" VALUE 0x400446E8 /* @ECU_Address@EIP_TiPOilSnsrDeb_P@ */ Scalar_FLOAT32_IEEE 0 EcuIntgdSwGend_CM_single_ms 0.0 250000.0 /end CHARACTERISTIC
/begin CHARACTERISTIC EIP_TiPRailSnsrDeb_P "Debouncer Time for Rail Pressure Sensor Parameter" VALUE 0x400446EC /* @ECU_Address@EIP_TiPRailSnsrDeb_P@ */ Scalar_FLOAT32_IEEE 0 EcuIntgdSwGend_CM_single_ms 0.0 250000.0 /end CHARACTERISTIC
/begin CHARACTERISTIC EIP_TiTAirBoostSnsrDeb_P "Debouncer Time for Air Boost Temperature Sensor Parameter" VALUE 0x400446F4 /* @ECU_Address@EIP_TiTAirBoostSnsrDeb_P@ */ Scalar_FLOAT32_IEEE 0 EcuIntgdSwGend_CM_single_ms 0.0 250000.0 /end CHARACTERISTIC
/begin CHARACTERISTIC EIP_TiTAmbAirSnsrDeb_P "Debouncer Time for Ambient Air Temperature Sensor Parameter" VALUE 0x400446F8 /* @ECU_Address@EIP_TiTAmbAirSnsrDeb_P@ */ Scalar_FLOAT32_IEEE 0 EcuIntgdSwGend_CM_single_ms 0.0 250000.0 /end CHARACTERISTIC
/begin CHARACTERISTIC EIP_TiTCooltSnsrDeb_P "Debouncer Time for Coolant Temperature Sensor Parameter" VALUE 0x400446FC /* @ECU_Address@EIP_TiTCooltSnsrDeb_P@ */ Scalar_FLOAT32_IEEE 0 EcuIntgdSwGend_CM_single_ms 0.0 250000.0 /end CHARACTERISTIC
/begin CHARACTERISTIC EIP_TiTEcuSnsrDeb_P "Debouncer Time for ECU Temperature Sensor Parameter" VALUE 0x40044700 /* @ECU_Address@EIP_TiTEcuSnsrDeb_P@ */ Scalar_FLOAT32_IEEE 0 EcuIntgdSwGend_CM_single_ms 0.0 250000.0 /end CHARACTERISTIC
/begin CHARACTERISTIC EIP_TiTFuSnsrDeb_P "Debouncer Time for Fuel Temperature Sensor Parameter" VALUE 0x40044704 /* @ECU_Address@EIP_TiTFuSnsrDeb_P@ */ Scalar_FLOAT32_IEEE 0 EcuIntgdSwGend_CM_single_ms 0.0 250000.0 /end CHARACTERISTIC
/begin CHARACTERISTIC EIP_TiTOilSnsrDeb_P "Debouncer Time for Oil Temperature Sensor Parameter" VALUE 0x40044708 /* @ECU_Address@EIP_TiTOilSnsrDeb_P@ */ Scalar_FLOAT32_IEEE 0 EcuIntgdSwGend_CM_single_ms 0.0 250000.0 /end CHARACTERISTIC
/begin CHARACTERISTIC EIP_TiVehVDevErrThd_P "Velocity Deviation Error Activation Timer Value" VALUE 0x40044710 /* @ECU_Address@EIP_TiVehVDevErrThd_P@ */ Scalar_FLOAT32_IEEE 0 EcuIntgdSwGend_CM_single_ms 0.0 50000.0 /end CHARACTERISTIC
/begin CHARACTERISTIC EOP_AccrPedl1IdleCndThd_P "Accelerator Pedal Idle Condition Threshold" VALUE 0x400449D0 /* @ECU_Address@EOP_AccrPedl1IdleCndThd_P@ */ Scalar_FLOAT32_IEEE 0 EcuIntgdSwGend_CM_single 0.0 100.0 /end CHARACTERISTIC
/begin CHARACTERISTIC EOP_CanAccrPedlPosn1Ovv_P "SPN 91 - Accelerator Pedal Position 1 - Override Value" VALUE 0x400449FC /* @ECU_Address@EOP_CanAccrPedlPosn1Ovv_P@ */ Scalar_FLOAT32_IEEE 0 EcuIntgdSwGend_CM_single__ 0.0 100.0 /end CHARACTERISTIC
/begin CHARACTERISTIC EOP_CanActEngBrkPercTqOvv_P "SPN 520 - Actual Retarder - Percent Torque - Override Value" VALUE 0x40044A04 /* @ECU_Address@EOP_CanActEngBrkPercTqOvv_P@ */ Scalar_FLOAT32_IEEE 0 EcuIntgdSwGend_CM_single__ -125.0 125.0 /end CHARACTERISTIC
/begin CHARACTERISTIC EOP_CanActEngPercTqOvv_P "SPN 513 - Actual Engine Percent Torque - Override Value" VALUE 0x40044A14 /* @ECU_Address@EOP_CanActEngPercTqOvv_P@ */ Scalar_FLOAT32_IEEE 0 EcuIntgdSwGend_CM_single__ 0.0 125.0 /end CHARACTERISTIC
/begin CHARACTERISTIC EOP_CanActMaxAvlEngBrkPercTqOvv_P "SPN 1717 - Actual Maximum Available Retarder - Percent Torque - Override Value" VALUE 0x40044A1C /* @ECU_Address@EOP_CanActMaxAvlEngBrkPercTqOvv_P@ */ Scalar_FLOAT32_IEEE 0 EcuIntgdSwGend_CM_single__ -125.0 125.0 /end CHARACTERISTIC
/begin CHARACTERISTIC EOP_CanBattVolt1Ovv_P "SPN 168 - Battery Potential - Power Input 1 - Override Value" VALUE 0x40044A2C /* @ECU_Address@EOP_CanBattVolt1Ovv_P@ */ Scalar_FLOAT32_IEEE 0 EcuIntgdSwGend_CM_single_V 0.0 3213.0 /end CHARACTERISTIC
/begin CHARACTERISTIC EOP_CanDrvrDmdEngBrkPercTqOvv_P "SPN 1715 - Drivers Demand Retarder - Percent Torque - Override Value" VALUE 0x40044A80 /* @ECU_Address@EOP_CanDrvrDmdEngBrkPercTqOvv_P@ */ Scalar_FLOAT32_IEEE 0 EcuIntgdSwGend_CM_single__ -125.0 125.0 /end CHARACTERISTIC
/begin CHARACTERISTIC EOP_CanDrvrDmdPercTqOvv_P "SPN 512 - Driver Demand Percent Torque - Override Value" VALUE 0x40044A88 /* @ECU_Address@EOP_CanDrvrDmdPercTqOvv_P@ */ Scalar_FLOAT32_IEEE 0 EcuIntgdSwGend_CM_single__ 0.0 125.0 /end CHARACTERISTIC
/begin CHARACTERISTIC EOP_CanEngDftTqLimOvv_P "SPN 1846 - Engine Default Torque Limit - Override Value" VALUE 0x40044AA0 /* @ECU_Address@EOP_CanEngDftTqLimOvv_P@ */ Scalar_FLOAT32_IEEE 0 EcuIntgdSwGend_CM_single_N_m 0.0 64255.0 /end CHARACTERISTIC
/begin CHARACTERISTIC EOP_CanEngDmdPercTqOvv_P "SPN 2432 - Engine Demand Percent Torque - Override Value" VALUE 0x40044AA8 /* @ECU_Address@EOP_CanEngDmdPercTqOvv_P@ */ Scalar_FLOAT32_IEEE 0 EcuIntgdSwGend_CM_single__ 0.0 125.0 /end CHARACTERISTIC
/begin CHARACTERISTIC EOP_CanEngFuRateOvv_P "SPN 183 - Engine Fuel Rate - Override Value" VALUE 0x40044AB0 /* @ECU_Address@EOP_CanEngFuRateOvv_P@ */ Scalar_FLOAT32_IEEE 0 EcuIntgdSwGend_CM_single_L_h 0.0 3213.0 /end CHARACTERISTIC
/begin CHARACTERISTIC EOP_CanEngHrOvv_P "SPN 247 - Engine Total Hours of Operation - Override Value" VALUE 0x40044AB8 /* @ECU_Address@EOP_CanEngHrOvv_P@ */ Scalar_FLOAT32_IEEE 0 EcuIntgdSwGend_CM_single_h 0.0 2.10554061E+8 /end CHARACTERISTIC
/begin CHARACTERISTIC EOP_CanEngParasiticLossOvv_P "SPN 2978 - Estimated Engine Parasitic Losses - Override Value" VALUE 0x40044AC0 /* @ECU_Address@EOP_CanEngParasiticLossOvv_P@ */ Scalar_FLOAT32_IEEE 0 EcuIntgdSwGend_CM_single__ 0.0 255.0 /end CHARACTERISTIC
/begin CHARACTERISTIC EOP_CanEngPercTqPoint1Ovv_P "SPN 539 - Engine Percent Torque Point 1 - Override Value" VALUE 0x40044AC8 /* @ECU_Address@EOP_CanEngPercTqPoint1Ovv_P@ */ Scalar_FLOAT32_IEEE 0 EcuIntgdSwGend_CM_single__ 0.0 125.0 /end CHARACTERISTIC
/begin CHARACTERISTIC EOP_CanEngPercTqPoint2Ovv_P "SPN 539 - Engine Percent Torque Point 2 - Override Value" VALUE 0x40044AD0 /* @ECU_Address@EOP_CanEngPercTqPoint2Ovv_P@ */ Scalar_FLOAT32_IEEE 0 EcuIntgdSwGend_CM_single__ 0.0 125.0 /end CHARACTERISTIC
/begin CHARACTERISTIC EOP_CanEngPercTqPoint3Ovv_P "SPN 539 - Engine Percent Torque Point 3 - Override Value" VALUE 0x40044AD8 /* @ECU_Address@EOP_CanEngPercTqPoint3Ovv_P@ */ Scalar_FLOAT32_IEEE 0 EcuIntgdSwGend_CM_single__ 0.0 125.0 /end CHARACTERISTIC
/begin CHARACTERISTIC EOP_CanEngPercTqPoint4Ovv_P "SPN 539 - Engine Percent Torque Point 4 - Override Value" VALUE 0x40044AE0 /* @ECU_Address@EOP_CanEngPercTqPoint4Ovv_P@ */ Scalar_FLOAT32_IEEE 0 EcuIntgdSwGend_CM_single__ 0.0 125.0 /end CHARACTERISTIC
/begin CHARACTERISTIC EOP_CanEngPercTqPoint5Ovv_P "SPN 539 - Engine Percent Torque Point 5 - Override Value" VALUE 0x40044AE8 /* @ECU_Address@EOP_CanEngPercTqPoint5Ovv_P@ */ Scalar_FLOAT32_IEEE 0 EcuIntgdSwGend_CM_single__ 0.0 125.0 /end CHARACTERISTIC
/begin CHARACTERISTIC EOP_CanEngRatedPwrOvv_P "SPN 166 - Engine Rated Power - Override Value" VALUE 0x40044AF0 /* @ECU_Address@EOP_CanEngRatedPwrOvv_P@ */ Scalar_FLOAT32_IEEE 0 EcuIntgdSwGend_CM_single_kW 0.0 32128.0 /end CHARACTERISTIC
/begin CHARACTERISTIC EOP_CanEngRatedSpdOvv_P "SPN 189 - Engine Rated Speed - Override Value" VALUE 0x40044AF8 /* @ECU_Address@EOP_CanEngRatedSpdOvv_P@ */ Scalar_FLOAT32_IEEE 0 EcuIntgdSwGend_CM_single_rpm 0.0 8032.0 /end CHARACTERISTIC
/begin CHARACTERISTIC EOP_CanEngRefTqOvv_P "SPN 544 - Engine Reference Torque - Override Value" VALUE 0x40044B08 /* @ECU_Address@EOP_CanEngRefTqOvv_P@ */ Scalar_FLOAT32_IEEE 0 EcuIntgdSwGend_CM_single_N_m 0.0 64255.0 /end CHARACTERISTIC
/begin CHARACTERISTIC EOP_CanEngSpdOvv_P "SPN 190 - Engine Speed - Override Value" VALUE 0x40044B18 /* @ECU_Address@EOP_CanEngSpdOvv_P@ */ Scalar_FLOAT32_IEEE 0 EcuIntgdSwGend_CM_single_rpm 0.0 8032.0 /end CHARACTERISTIC
/begin CHARACTERISTIC EOP_CanEngSpdPoint1Ovv_P "SPN 188 - Engine Speed Point 1 - Override Value" VALUE 0x40044B20 /* @ECU_Address@EOP_CanEngSpdPoint1Ovv_P@ */ Scalar_FLOAT32_IEEE 0 EcuIntgdSwGend_CM_single_rpm 0.0 8031.0 /end CHARACTERISTIC
/begin CHARACTERISTIC EOP_CanEngSpdPoint2Ovv_P "SPN 528 - Engine Speed Point 2 - Override Value" VALUE 0x40044B28 /* @ECU_Address@EOP_CanEngSpdPoint2Ovv_P@ */ Scalar_FLOAT32_IEEE 0 EcuIntgdSwGend_CM_single_rpm 0.0 8031.0 /end CHARACTERISTIC
/begin CHARACTERISTIC EOP_CanEngSpdPoint3Ovv_P "SPN 529 - Engine Speed Point 3 - Override Value" VALUE 0x40044B30 /* @ECU_Address@EOP_CanEngSpdPoint3Ovv_P@ */ Scalar_FLOAT32_IEEE 0 EcuIntgdSwGend_CM_single_rpm 0.0 8031.0 /end CHARACTERISTIC
/begin CHARACTERISTIC EOP_CanEngSpdPoint4Ovv_P "SPN 530 - Engine Speed Point 4 - Override Value" VALUE 0x40044B38 /* @ECU_Address@EOP_CanEngSpdPoint4Ovv_P@ */ Scalar_FLOAT32_IEEE 0 EcuIntgdSwGend_CM_single_rpm 0.0 8031.0 /end CHARACTERISTIC
/begin CHARACTERISTIC EOP_CanEngSpdPoint5Ovv_P "SPN 531 - Engine Speed Point 5 - Override Value" VALUE 0x40044B40 /* @ECU_Address@EOP_CanEngSpdPoint5Ovv_P@ */ Scalar_FLOAT32_IEEE 0 EcuIntgdSwGend_CM_single_rpm 0.0 8031.0 /end CHARACTERISTIC
/begin CHARACTERISTIC EOP_CanEngSpdPoint6Ovv_P "SPN 532 - Engine Speed Point 6 - Override Value" VALUE 0x40044B48 /* @ECU_Address@EOP_CanEngSpdPoint6Ovv_P@ */ Scalar_FLOAT32_IEEE 0 EcuIntgdSwGend_CM_single_rpm 0.0 8031.0 /end CHARACTERISTIC
/begin CHARACTERISTIC EOP_CanEngSpdPoint7Ovv_P "SPN 533 - Engine Speed Point 7 - Override Value" VALUE 0x40044B50 /* @ECU_Address@EOP_CanEngSpdPoint7Ovv_P@ */ Scalar_FLOAT32_IEEE 0 EcuIntgdSwGend_CM_single_rpm 0.0 8031.0 /end CHARACTERISTIC
/begin CHARACTERISTIC EOP_CanEngTotFuQntyOvv_P "SPN 250 - Engine Total Fuel Used - Override Value" VALUE 0x40044B68 /* @ECU_Address@EOP_CanEngTotFuQntyOvv_P@ */ Scalar_FLOAT32_IEEE 0 EcuIntgdSwGend_CM_single_L 0.0 2.105540608E+9 /end CHARACTERISTIC
/begin CHARACTERISTIC EOP_CanEngTqModOvv_P "SPN 899 - Engine Torque Mode - Override Value" VALUE 0x40044B70 /* @ECU_Address@EOP_CanEngTqModOvv_P@ */ Scalar_FLOAT32_IEEE 0 EcuIntgdSwGend_CM_single 0.0 15.0 /end CHARACTERISTIC
/begin CHARACTERISTIC EOP_CanLvlOilOvv_P "SPN 98 - Engine Oil Level - Override Value" VALUE 0x40044B80 /* @ECU_Address@EOP_CanLvlOilOvv_P@ */ Scalar_FLOAT32_IEEE 0 EcuIntgdSwGend_CM_single__ 0.0 100.0 /end CHARACTERISTIC
/begin CHARACTERISTIC EOP_CanNomFricPercTqOvv_P "SPN 514 - Nominal Friction - Percent Torque - Override Value" VALUE 0x40044B88 /* @ECU_Address@EOP_CanNomFricPercTqOvv_P@ */ Scalar_FLOAT32_IEEE 0 EcuIntgdSwGend_CM_single__ 0.0 100.0 /end CHARACTERISTIC
/begin CHARACTERISTIC EOP_CanPAirBoostOvv_P "SPN 102 - Engine Intake Manifold 1 Pressure - Override Value" VALUE 0x40044B90 /* @ECU_Address@EOP_CanPAirBoostOvv_P@ */ Scalar_FLOAT32_IEEE 0 EcuIntgdSwGend_CM_single_kPa 0.0 500.0 /end CHARACTERISTIC
/begin CHARACTERISTIC EOP_CanPBaroOvv_P "SPN 108 - Barometric Pressure - Override Value" VALUE 0x40044B98 /* @ECU_Address@EOP_CanPBaroOvv_P@ */ Scalar_FLOAT32_IEEE 0 EcuIntgdSwGend_CM_single_kPa 0.0 125.0 /end CHARACTERISTIC
/begin CHARACTERISTIC EOP_CanPFuOvv_P "SPN 94 - Engine Fuel Delivery Pressure - Override Value" VALUE 0x40044BA0 /* @ECU_Address@EOP_CanPFuOvv_P@ */ Scalar_FLOAT32_IEEE 0 EcuIntgdSwGend_CM_single_kPa 0.0 1000.0 /end CHARACTERISTIC
/begin CHARACTERISTIC EOP_CanPOilOvv_P "SPN 100 - Engine Oil Pressure - Override Value" VALUE 0x40044BA8 /* @ECU_Address@EOP_CanPOilOvv_P@ */ Scalar_FLOAT32_IEEE 0 EcuIntgdSwGend_CM_single_kPa 0.0 1000.0 /end CHARACTERISTIC
/begin CHARACTERISTIC EOP_CanPRailOvv_P "SPN 157 - Engine Injector Metering Rail 1 Pressure - Override Value" VALUE 0x40044BB0 /* @ECU_Address@EOP_CanPRailOvv_P@ */ Scalar_FLOAT32_IEEE 0 EcuIntgdSwGend_CM_single_MPa 0.0 251.0 /end CHARACTERISTIC
/begin CHARACTERISTIC EOP_CanPercLoadAtCurrentSpdOvv_P "SPN 92 - Engine Percent Load At Current Speed - Override Value" VALUE 0x40044BC0 /* @ECU_Address@EOP_CanPercLoadAtCurrentSpdOvv_P@ */ Scalar_FLOAT32_IEEE 0 EcuIntgdSwGend_CM_single__ 0.0 250.0 /end CHARACTERISTIC
/begin CHARACTERISTIC EOP_CanPosOfWg1Ovv_P "SPN 1188 - Engine Turbocharger Wastegate Actuator 1 Position - Override Value" VALUE 0x40044BC8 /* @ECU_Address@EOP_CanPosOfWg1Ovv_P@ */ Scalar_FLOAT32_IEEE 0 EcuIntgdSwGend_CM_single__ 0.0 100.0 /end CHARACTERISTIC
/begin CHARACTERISTIC EOP_CanRefEngBrkTqOvv_P "SPN 556 - Reference Retarder Torque - Override Value" VALUE 0x40044BD8 /* @ECU_Address@EOP_CanRefEngBrkTqOvv_P@ */ Scalar_FLOAT32_IEEE 0 EcuIntgdSwGend_CM_single_N_m 0.0 5000.0 /end CHARACTERISTIC
/begin CHARACTERISTIC EOP_CanSoiMaiInjOvv_P "SPN1436 - Engine Actual Ignition Timing - Override Value" VALUE 0x40044BE0 /* @ECU_Address@EOP_CanSoiMaiInjOvv_P@ */ Scalar_FLOAT32_IEEE 0 EcuIntgdSwGend_CM_single_deg -200.0 302.0 /end CHARACTERISTIC
/begin CHARACTERISTIC EOP_CanTAirBoostHiReslOvv_P "SPN 1636 - Engine Intake Manifold 1 Temperature (High Resolution) - Override Value" VALUE 0x40044BE8 /* @ECU_Address@EOP_CanTAirBoostHiReslOvv_P@ */ Scalar_FLOAT32_IEEE 0 EcuIntgdSwGend_CM_single_degC -273.0 1735.0 /end CHARACTERISTIC
/begin CHARACTERISTIC EOP_CanTAirBoostOvv_P "SPN 105 - Engine Intake Manifold 1 Temperature - Override Value" VALUE 0x40044BF0 /* @ECU_Address@EOP_CanTAirBoostOvv_P@ */ Scalar_FLOAT32_IEEE 0 EcuIntgdSwGend_CM_single_degC -40.0 210.0 /end CHARACTERISTIC
/begin CHARACTERISTIC EOP_CanTAmbAirOvv_P "SPN 171 - Ambient Air Temperature - Override Value" VALUE 0x40044BF8 /* @ECU_Address@EOP_CanTAmbAirOvv_P@ */ Scalar_FLOAT32_IEEE 0 EcuIntgdSwGend_CM_single -40.0 250.0 /end CHARACTERISTIC
/begin CHARACTERISTIC EOP_CanTCooltOvv_P "SPN 1637 - Engine Coolant Temperature (High Resolution) - Override Value" VALUE 0x40044C00 /* @ECU_Address@EOP_CanTCooltOvv_P@ */ Scalar_FLOAT32_IEEE 0 EcuIntgdSwGend_CM_single_degC -273.0 1735.0 /end CHARACTERISTIC
/begin CHARACTERISTIC EOP_CanTEcuOvv_P "SPN 1136 - Engine ECU Temperature - Override Value" VALUE 0x40044C08 /* @ECU_Address@EOP_CanTEcuOvv_P@ */ Scalar_FLOAT32_IEEE 0 EcuIntgdSwGend_CM_single_degC -273.0 1735.0 /end CHARACTERISTIC
/begin CHARACTERISTIC EOP_CanTFuOvv_P "SPN 174 - Engine Fuel Temperature - Override Value" VALUE 0x40044C10 /* @ECU_Address@EOP_CanTFuOvv_P@ */ Scalar_FLOAT32_IEEE 0 EcuIntgdSwGend_CM_single_degC -40.0 210.0 /end CHARACTERISTIC
/begin CHARACTERISTIC EOP_CanTOilOvv_P "SPN 175 - Engine Oil Temperature - Override Value" VALUE 0x40044C18 /* @ECU_Address@EOP_CanTOilOvv_P@ */ Scalar_FLOAT32_IEEE 0 EcuIntgdSwGend_CM_single_degC -273.0 1735.0 /end CHARACTERISTIC
/begin CHARACTERISTIC EOP_CanWhlBasVehSpdOvv_P "SPN 84 - Wheel-Based Vehicle Speed - Override Value" VALUE 0x40044C28 /* @ECU_Address@EOP_CanWhlBasVehSpdOvv_P@ */ Scalar_FLOAT32_IEEE 0 EcuIntgdSwGend_CM_single_km_h 0.0 250.0 /end CHARACTERISTIC
/begin CHARACTERISTIC EOP_EngRatedPwr_P "Engine Rated Power Parameter" VALUE 0x40044CE4 /* @ECU_Address@EOP_EngRatedPwr_P@ */ Scalar_FLOAT32_IEEE 0 EcuIntgdSwGend_CM_single_kW 0.0 32128.0 /end CHARACTERISTIC
/begin CHARACTERISTIC EOP_EngRatedSpd_P "Engine Rated Speed Parameter" VALUE 0x40044CE8 /* @ECU_Address@EOP_EngRatedSpd_P@ */ Scalar_FLOAT32_IEEE 0 EcuIntgdSwGend_CM_single_rpm 0.0 8032.0 /end CHARACTERISTIC
/begin CHARACTERISTIC EngBrk_DrvrBrkLvrPosn0_P "Driver Brake Lever Position 0" VALUE 0x40044EB0 /* @ECU_Address@EngBrk_DrvrBrkLvrPosn0_P@ */ Scalar_FLOAT32_IEEE 0 EcuIntgdSwGend_CM_single__ 0.0 100.0 /end CHARACTERISTIC
/begin CHARACTERISTIC EngBrk_DrvrBrkLvrPosn1_P "Driver Brake Lever Position 1" VALUE 0x40044EB4 /* @ECU_Address@EngBrk_DrvrBrkLvrPosn1_P@ */ Scalar_FLOAT32_IEEE 0 EcuIntgdSwGend_CM_single__ 0.0 100.0 /end CHARACTERISTIC
/begin CHARACTERISTIC EngBrk_DrvrBrkLvrPosn2_P "Driver Brake Lever Position 2" VALUE 0x40044EB8 /* @ECU_Address@EngBrk_DrvrBrkLvrPosn2_P@ */ Scalar_FLOAT32_IEEE 0 EcuIntgdSwGend_CM_single__ 0.0 100.0 /end CHARACTERISTIC
/begin CHARACTERISTIC IC_FacCyl1SatMax_P "Cylinder Balancing PID Controller Maximum Saturation Factor Parameter for Cylinder 1" VALUE 0x40045088 /* @ECU_Address@IC_FacCyl1SatMax_P@ */ Scalar_FLOAT32_IEEE 0 EcuIntgdSwGend_CM_single -0.15 0.15 /end CHARACTERISTIC
/begin CHARACTERISTIC IC_FacCyl1SatMin_P "Cylinder Balancing PID Controller Minimum Saturation Factor Parameter for Cylinder 1" VALUE 0x4004508C /* @ECU_Address@IC_FacCyl1SatMin_P@ */ Scalar_FLOAT32_IEEE 0 EcuIntgdSwGend_CM_single -0.15 0.15 /end CHARACTERISTIC
/begin CHARACTERISTIC IC_FacCyl2SatMax_P "Cylinder Balancing PID Controller Maximum Saturation Factor Parameter for Cylinder 2" VALUE 0x40045090 /* @ECU_Address@IC_FacCyl2SatMax_P@ */ Scalar_FLOAT32_IEEE 0 EcuIntgdSwGend_CM_single -0.15 0.15 /end CHARACTERISTIC
/begin CHARACTERISTIC IC_FacCyl2SatMin_P "Cylinder Balancing PID Controller Minimum Saturation Factor Parameter for Cylinder 2" VALUE 0x40045094 /* @ECU_Address@IC_FacCyl2SatMin_P@ */ Scalar_FLOAT32_IEEE 0 EcuIntgdSwGend_CM_single -0.15 0.15 /end CHARACTERISTIC
/begin CHARACTERISTIC IC_FacCyl3SatMax_P "Cylinder Balancing PID Controller Maximum Saturation Factor Parameter for Cylinder 3" VALUE 0x40045098 /* @ECU_Address@IC_FacCyl3SatMax_P@ */ Scalar_FLOAT32_IEEE 0 EcuIntgdSwGend_CM_single -0.15 0.15 /end CHARACTERISTIC
/begin CHARACTERISTIC IC_FacCyl3SatMin_P "Cylinder Balancing PID Controller Minimum Saturation Factor Parameter for Cylinder 3" VALUE 0x4004509C /* @ECU_Address@IC_FacCyl3SatMin_P@ */ Scalar_FLOAT32_IEEE 0 EcuIntgdSwGend_CM_single -0.15 0.15 /end CHARACTERISTIC
/begin CHARACTERISTIC IC_FacCyl4SatMax_P "Cylinder Balancing PID Controller Maximum Saturation Factor Parameter for Cylinder 4" VALUE 0x400450A0 /* @ECU_Address@IC_FacCyl4SatMax_P@ */ Scalar_FLOAT32_IEEE 0 EcuIntgdSwGend_CM_single -0.15 0.15 /end CHARACTERISTIC
/begin CHARACTERISTIC IC_FacCyl4SatMin_P "Cylinder Balancing PID Controller Minimum Saturation Factor Parameter for Cylinder 4" VALUE 0x400450A4 /* @ECU_Address@IC_FacCyl4SatMin_P@ */ Scalar_FLOAT32_IEEE 0 EcuIntgdSwGend_CM_single -0.15 0.15 /end CHARACTERISTIC
/begin CHARACTERISTIC IC_FacCyl5SatMax_P "Cylinder Balancing PID Controller Maximum Saturation Factor Parameter for Cylinder 5" VALUE 0x400450A8 /* @ECU_Address@IC_FacCyl5SatMax_P@ */ Scalar_FLOAT32_IEEE 0 EcuIntgdSwGend_CM_single -0.15 0.15 /end CHARACTERISTIC
/begin CHARACTERISTIC IC_FacCyl5SatMin_P "Cylinder Balancing PID Controller Minimum Saturation Factor Parameter for Cylinder 5" VALUE 0x400450AC /* @ECU_Address@IC_FacCyl5SatMin_P@ */ Scalar_FLOAT32_IEEE 0 EcuIntgdSwGend_CM_single -0.15 0.15 /end CHARACTERISTIC
/begin CHARACTERISTIC IC_FacCyl6SatMax_P "Cylinder Balancing PID Controller Maximum Saturation Factor Parameter for Cylinder 6" VALUE 0x400450B0 /* @ECU_Address@IC_FacCyl6SatMax_P@ */ Scalar_FLOAT32_IEEE 0 EcuIntgdSwGend_CM_single -0.15 0.15 /end CHARACTERISTIC
/begin CHARACTERISTIC IC_FacCyl6SatMin_P "Cylinder Balancing PID Controller Minimum Saturation Factor Parameter for Cylinder 6" VALUE 0x400450B4 /* @ECU_Address@IC_FacCyl6SatMin_P@ */ Scalar_FLOAT32_IEEE 0 EcuIntgdSwGend_CM_single -0.15 0.15 /end CHARACTERISTIC
/begin CHARACTERISTIC IC_KdCoeffCyl1_P "Cylinder Balancing PID Controller D Filter Coefficient for Cylinder 1 Parameter" VALUE 0x40045C9C /* @ECU_Address@IC_KdCoeffCyl1_P@ */ Scalar_FLOAT32_IEEE 0 EcuIntgdSwGend_CM_single -100.0 100.0 /end CHARACTERISTIC
/begin CHARACTERISTIC IC_KdCoeffCyl2_P "Cylinder Balancing PID Controller D Filter Coefficient for Cylinder 2 Parameter" VALUE 0x40045CA0 /* @ECU_Address@IC_KdCoeffCyl2_P@ */ Scalar_FLOAT32_IEEE 0 EcuIntgdSwGend_CM_single -100.0 100.0 /end CHARACTERISTIC
/begin CHARACTERISTIC IC_KdCoeffCyl3_P "Cylinder Balancing PID Controller D Filter Coefficient for Cylinder 3 Parameter" VALUE 0x40045CA4 /* @ECU_Address@IC_KdCoeffCyl3_P@ */ Scalar_FLOAT32_IEEE 0 EcuIntgdSwGend_CM_single -100.0 100.0 /end CHARACTERISTIC
/begin CHARACTERISTIC IC_KdCoeffCyl4_P "Cylinder Balancing PID Controller D Filter Coefficient for Cylinder 4 Parameter" VALUE 0x40045CA8 /* @ECU_Address@IC_KdCoeffCyl4_P@ */ Scalar_FLOAT32_IEEE 0 EcuIntgdSwGend_CM_single -100.0 100.0 /end CHARACTERISTIC
/begin CHARACTERISTIC IC_KdCoeffCyl5_P "Cylinder Balancing PID Controller D Filter Coefficient for Cylinder 5 Parameter" VALUE 0x40045CAC /* @ECU_Address@IC_KdCoeffCyl5_P@ */ Scalar_FLOAT32_IEEE 0 EcuIntgdSwGend_CM_single -100.0 100.0 /end CHARACTERISTIC
/begin CHARACTERISTIC IC_KdCoeffCyl6_P "Cylinder Balancing PID Controller D Filter Coefficient for Cylinder 6 Parameter" VALUE 0x40045CB0 /* @ECU_Address@IC_KdCoeffCyl6_P@ */ Scalar_FLOAT32_IEEE 0 EcuIntgdSwGend_CM_single -100.0 100.0 /end CHARACTERISTIC
/begin CHARACTERISTIC IC_KdCyl1_P "Cylinder Balancing PID Controller D Coefficient for Cylinder 1 Parameter" VALUE 0x40045CB4 /* @ECU_Address@IC_KdCyl1_P@ */ Scalar_FLOAT32_IEEE 0 EcuIntgdSwGend_CM_single -100.0 100.0 /end CHARACTERISTIC
/begin CHARACTERISTIC IC_KdCyl2_P "Cylinder Balancing PID Controller D Coefficient for Cylinder 2 Parameter" VALUE 0x40045CB8 /* @ECU_Address@IC_KdCyl2_P@ */ Scalar_FLOAT32_IEEE 0 EcuIntgdSwGend_CM_single -100.0 100.0 /end CHARACTERISTIC
/begin CHARACTERISTIC IC_KdCyl3_P "Cylinder Balancing PID Controller D Coefficient for Cylinder 3 Parameter" VALUE 0x40045CBC /* @ECU_Address@IC_KdCyl3_P@ */ Scalar_FLOAT32_IEEE 0 EcuIntgdSwGend_CM_single -100.0 100.0 /end CHARACTERISTIC
/begin CHARACTERISTIC IC_KdCyl4_P "Cylinder Balancing PID Controller D Coefficient for Cylinder 4 Parameter" VALUE 0x40045CC0 /* @ECU_Address@IC_KdCyl4_P@ */ Scalar_FLOAT32_IEEE 0 EcuIntgdSwGend_CM_single -100.0 100.0 /end CHARACTERISTIC
/begin CHARACTERISTIC IC_KdCyl5_P "Cylinder Balancing PID Controller D Coefficient for Cylinder 5 Parameter" VALUE 0x40045CC4 /* @ECU_Address@IC_KdCyl5_P@ */ Scalar_FLOAT32_IEEE 0 EcuIntgdSwGend_CM_single -100.0 100.0 /end CHARACTERISTIC
/begin CHARACTERISTIC IC_KdCyl6_P "Cylinder Balancing PID Controller D Coefficient for Cylinder 6 Parameter" VALUE 0x40045CC8 /* @ECU_Address@IC_KdCyl6_P@ */ Scalar_FLOAT32_IEEE 0 EcuIntgdSwGend_CM_single -100.0 100.0 /end CHARACTERISTIC
/begin CHARACTERISTIC IC_KiCyl1_P "Cylinder Balancing PID Controller I Coefficient for Cylinder 1 Parameter" VALUE 0x40045CCC /* @ECU_Address@IC_KiCyl1_P@ */ Scalar_FLOAT32_IEEE 0 EcuIntgdSwGend_CM_single -100.0 100.0 /end CHARACTERISTIC
/begin CHARACTERISTIC IC_KiCyl2_P "Cylinder Balancing PID Controller I Coefficient for Cylinder 2 Parameter" VALUE 0x40045CD0 /* @ECU_Address@IC_KiCyl2_P@ */ Scalar_FLOAT32_IEEE 0 EcuIntgdSwGend_CM_single -100.0 100.0 /end CHARACTERISTIC
/begin CHARACTERISTIC IC_KiCyl3_P "Cylinder Balancing PID Controller I Coefficient for Cylinder 3 Parameter" VALUE 0x40045CD4 /* @ECU_Address@IC_KiCyl3_P@ */ Scalar_FLOAT32_IEEE 0 EcuIntgdSwGend_CM_single -100.0 100.0 /end CHARACTERISTIC
/begin CHARACTERISTIC IC_KiCyl4_P "Cylinder Balancing PID Controller I Coefficient for Cylinder 4 Parameter" VALUE 0x40045CD8 /* @ECU_Address@IC_KiCyl4_P@ */ Scalar_FLOAT32_IEEE 0 EcuIntgdSwGend_CM_single -100.0 100.0 /end CHARACTERISTIC
/begin CHARACTERISTIC IC_KiCyl5_P "Cylinder Balancing PID Controller I Coefficient for Cylinder 5 Parameter" VALUE 0x40045CDC /* @ECU_Address@IC_KiCyl5_P@ */ Scalar_FLOAT32_IEEE 0 EcuIntgdSwGend_CM_single -100.0 100.0 /end CHARACTERISTIC
/begin CHARACTERISTIC IC_KiCyl6_P "Cylinder Balancing PID Controller I Coefficient for Cylinder 6 Parameter" VALUE 0x40045CE0 /* @ECU_Address@IC_KiCyl6_P@ */ Scalar_FLOAT32_IEEE 0 EcuIntgdSwGend_CM_single -100.0 100.0 /end CHARACTERISTIC
/begin CHARACTERISTIC IC_KpCyl1_P "Cylinder Balancing PID Controller P Coefficient for Cylinder 1 Parameter" VALUE 0x40045CE4 /* @ECU_Address@IC_KpCyl1_P@ */ Scalar_FLOAT32_IEEE 0 EcuIntgdSwGend_CM_single -100.0 100.0 /end CHARACTERISTIC
/begin CHARACTERISTIC IC_KpCyl2_P "Cylinder Balancing PID Controller P Coefficient for Cylinder 2 Parameter" VALUE 0x40045CE8 /* @ECU_Address@IC_KpCyl2_P@ */ Scalar_FLOAT32_IEEE 0 EcuIntgdSwGend_CM_single -100.0 100.0 /end CHARACTERISTIC
/begin CHARACTERISTIC IC_KpCyl3_P "Cylinder Balancing PID Controller P Coefficient for Cylinder 3 Parameter" VALUE 0x40045CEC /* @ECU_Address@IC_KpCyl3_P@ */ Scalar_FLOAT32_IEEE 0 EcuIntgdSwGend_CM_single -100.0 100.0 /end CHARACTERISTIC
/begin CHARACTERISTIC IC_KpCyl4_P "Cylinder Balancing PID Controller P Coefficient for Cylinder 4 Parameter" VALUE 0x40045CF0 /* @ECU_Address@IC_KpCyl4_P@ */ Scalar_FLOAT32_IEEE 0 EcuIntgdSwGend_CM_single -100.0 100.0 /end CHARACTERISTIC
/begin CHARACTERISTIC IC_KpCyl5_P "Cylinder Balancing PID Controller P Coefficient for Cylinder 5 Parameter" VALUE 0x40045CF4 /* @ECU_Address@IC_KpCyl5_P@ */ Scalar_FLOAT32_IEEE 0 EcuIntgdSwGend_CM_single -100.0 100.0 /end CHARACTERISTIC
/begin CHARACTERISTIC IC_KpCyl6_P "Cylinder Balancing PID Controller P Coefficient for Cylinder 6 Parameter" VALUE 0x40045CF8 /* @ECU_Address@IC_KpCyl6_P@ */ Scalar_FLOAT32_IEEE 0 EcuIntgdSwGend_CM_single -100.0 100.0 /end CHARACTERISTIC
/begin CHARACTERISTIC EIP_VehVDevErrThd_P "Vehicle Speed Deviation To High Detection Threshold" VALUE 0x40044736 /* @ECU_Address@EIP_VehVDevErrThd_P@ */ Scalar_SWORD 0 EcuIntgdSwGend_CM_int16_km_h 0.0 250.0 /end CHARACTERISTIC
/begin CHARACTERISTIC EOP_CanCrsCtrlSetSpdOvv_P "SPN 86 - Cruise Control Set Speed - Override Value" VALUE 0x40044A6A /* @ECU_Address@EOP_CanCrsCtrlSetSpdOvv_P@ */ Scalar_SWORD 0 EcuIntgdSwGend_CM_int16_km_h 0.0 250.0 /end CHARACTERISTIC
/begin CHARACTERISTIC EIP_CanEngPtoGovrAccrSwtOvs_P "CAN Pto Governor - Accelerator Switch - Override Switch Parameter" VALUE 0x400440A8 /* @ECU_Address@EIP_CanEngPtoGovrAccrSwtOvs_P@ */ Scalar_BOOLEAN 0 EcuIntgdSwGend_CM_boolean 0.0 1.0 /end CHARACTERISTIC
/begin CHARACTERISTIC EIP_CanEngPtoGovrCoastSwtOvs_P "CAN Pto Governor - Coast Switch - Override Switch Parameter" VALUE 0x400440B0 /* @ECU_Address@EIP_CanEngPtoGovrCoastSwtOvs_P@ */ Scalar_BOOLEAN 0 EcuIntgdSwGend_CM_boolean 0.0 1.0 /end CHARACTERISTIC
/begin CHARACTERISTIC EIP_CanEngPtoGovrResuSwtOvs_P "CAN Pto Governor - Resume Switch - Override Switch Parameter" VALUE 0x400440C0 /* @ECU_Address@EIP_CanEngPtoGovrResuSwtOvs_P@ */ Scalar_BOOLEAN 0 EcuIntgdSwGend_CM_boolean 0.0 1.0 /end CHARACTERISTIC
/begin CHARACTERISTIC EIP_CanEngPtoGovrSetSwtOvs_P "CAN Pto Governor - Set Switch - Override Switch Parameter" VALUE 0x400440C8 /* @ECU_Address@EIP_CanEngPtoGovrSetSwtOvs_P@ */ Scalar_BOOLEAN 0 EcuIntgdSwGend_CM_boolean 0.0 1.0 /end CHARACTERISTIC
/begin CHARACTERISTIC EIP_EngBrkCfg_P "Engine Brake Configuration Parameter" VALUE 0x400441A8 /* @ECU_Address@EIP_EngBrkCfg_P@ */ Scalar_BOOLEAN 0 EcuIntgdSwGend_CM_boolean 0.0 1.0 /end CHARACTERISTIC
/begin CHARACTERISTIC EIP_EngBrkLvlCfg_P "Engine Brake Level Configration Parameter" VALUE 0x400441AC /* @ECU_Address@EIP_EngBrkLvlCfg_P@ */ Scalar_BOOLEAN 0 EcuIntgdSwGend_CM_boolean 0.0 1.0 /end CHARACTERISTIC
/begin CHARACTERISTIC EIP_StOfCanEngPtoGovrAccrSwtOvs_P "Engine Input Processing State Of Can Engine Pto Governor Accelerate Switch Override Switch Parameter" VALUE 0x400443FC /* @ECU_Address@EIP_StOfCanEngPtoGovrAccrSwtOvs_P@ */ Scalar_BOOLEAN 0 EcuIntgdSwGend_CM_boolean 0.0 1.0 /end CHARACTERISTIC
/begin CHARACTERISTIC EIP_StOfCanEngPtoGovrAccrSwtOvv_P "Engine Input Processing State Of Can Engine Pto Governor Accelerate Switch Override Value Parameter" VALUE 0x40044400 /* @ECU_Address@EIP_StOfCanEngPtoGovrAccrSwtOvv_P@ */ Scalar_BOOLEAN 0 EcuIntgdSwGend_CM_boolean 0.0 1.0 /end CHARACTERISTIC
/begin CHARACTERISTIC EIP_StOfCanEngPtoGovrCoastSwtOvs_P "Engine Input Processing State Of Can Engine Pto Governor Coast Switch Override Switch Parameter" VALUE 0x40044404 /* @ECU_Address@EIP_StOfCanEngPtoGovrCoastSwtOvs_P@ */ Scalar_BOOLEAN 0 EcuIntgdSwGend_CM_boolean 0.0 1.0 /end CHARACTERISTIC
/begin CHARACTERISTIC EIP_StOfCanEngPtoGovrCoastSwtOvv_P "Engine Input Processing State Of Can Engine Pto Governor Coast Switch Override Value Parameter" VALUE 0x40044408 /* @ECU_Address@EIP_StOfCanEngPtoGovrCoastSwtOvv_P@ */ Scalar_BOOLEAN 0 EcuIntgdSwGend_CM_boolean 0.0 1.0 /end CHARACTERISTIC
/begin CHARACTERISTIC EIP_StOfCanEngPtoGovrResuSwtOvs_P "Engine Input Processing State Of Can Engine Pto Governor Resume Switch Override Switch Parameter" VALUE 0x40044414 /* @ECU_Address@EIP_StOfCanEngPtoGovrResuSwtOvs_P@ */ Scalar_BOOLEAN 0 EcuIntgdSwGend_CM_boolean 0.0 1.0 /end CHARACTERISTIC
/begin CHARACTERISTIC EIP_StOfCanEngPtoGovrResuSwtOvv_P "Engine Input Processing State Of Can Engine Pto Governor Resume Switch Override Value Parameter" VALUE 0x40044418 /* @ECU_Address@EIP_StOfCanEngPtoGovrResuSwtOvv_P@ */ Scalar_BOOLEAN 0 EcuIntgdSwGend_CM_boolean 0.0 1.0 /end CHARACTERISTIC
/begin CHARACTERISTIC EIP_StOfCanEngPtoGovrSetSwtOvs_P "Engine Input Processing State Of Can Engine Pto Governor Set Switch Override Switch Parameter" VALUE 0x4004441C /* @ECU_Address@EIP_StOfCanEngPtoGovrSetSwtOvs_P@ */ Scalar_BOOLEAN 0 EcuIntgdSwGend_CM_boolean 0.0 1.0 /end CHARACTERISTIC
/begin CHARACTERISTIC EIP_StOfCanEngPtoGovrSetSwtOvv_P "Engine Input Processing State Of Can Engine Pto Governor Set Switch Override Value Parameter" VALUE 0x40044420 /* @ECU_Address@EIP_StOfCanEngPtoGovrSetSwtOvv_P@ */ Scalar_BOOLEAN 0 EcuIntgdSwGend_CM_boolean 0.0 1.0 /end CHARACTERISTIC
/begin CHARACTERISTIC EIP_WgCfg_P "Wastegate Configuration Parameter" VALUE 0x40044740 /* @ECU_Address@EIP_WgCfg_P@ */ Scalar_BOOLEAN 0 EcuIntgdSwGend_CM_boolean 0.0 1.0 /end CHARACTERISTIC
/begin CHARACTERISTIC EIP_bAcvEmgcyShtdwnForOvspdOvs_P "Emergency Shutdown for Overspeed Active  - Override Switch Parameter" VALUE 0x40044758 /* @ECU_Address@EIP_bAcvEmgcyShtdwnForOvspdOvs_P@ */ Scalar_BOOLEAN 0 EcuIntgdSwGend_CM_boolean 0.0 1.0 /end CHARACTERISTIC
/begin CHARACTERISTIC EIP_bAcvEmgcyShtdwnForOvspdOvv_P "Emergency Shutdown for Overspeed Active - Override Value Parameter" VALUE 0x4004475C /* @ECU_Address@EIP_bAcvEmgcyShtdwnForOvspdOvv_P@ */ Scalar_BOOLEAN 0 EcuIntgdSwGend_CM_boolean 0.0 1.0 /end CHARACTERISTIC
/begin CHARACTERISTIC EIP_bErrAccr1And2OorOvs_P "Error Accelerator 1 and 2 Out of Range Total Loss - Override Switch Parameter" VALUE 0x400447C8 /* @ECU_Address@EIP_bErrAccr1And2OorOvs_P@ */ Scalar_BOOLEAN 0 EcuIntgdSwGend_CM_boolean 0.0 1.0 /end CHARACTERISTIC
/begin CHARACTERISTIC EIP_bErrAccr1And2OorOvv_P "Error Accelerator 1 and 2 Out of Range Total Loss - Override Value Parameter" VALUE 0x400447CC /* @ECU_Address@EIP_bErrAccr1And2OorOvv_P@ */ Scalar_BOOLEAN 0 EcuIntgdSwGend_CM_boolean 0.0 1.0 /end CHARACTERISTIC
/begin CHARACTERISTIC EIP_bErrAccrRedncyOvs_P "Error Accelerator Redundancy - Override Switch Parameter" VALUE 0x400447D0 /* @ECU_Address@EIP_bErrAccrRedncyOvs_P@ */ Scalar_BOOLEAN 0 EcuIntgdSwGend_CM_boolean 0.0 1.0 /end CHARACTERISTIC
/begin CHARACTERISTIC EIP_bErrAccrRedncyOvv_P "Error Accelerator Redundancy - Override Value Parameter" VALUE 0x400447D4 /* @ECU_Address@EIP_bErrAccrRedncyOvv_P@ */ Scalar_BOOLEAN 0 EcuIntgdSwGend_CM_boolean 0.0 1.0 /end CHARACTERISTIC
/begin CHARACTERISTIC EIP_bErrLvlOilSnsrOvs_P "Error Oil Level Sensor - Override Switch Parameter" VALUE 0x40044890 /* @ECU_Address@EIP_bErrLvlOilSnsrOvs_P@ */ Scalar_BOOLEAN 0 EcuIntgdSwGend_CM_boolean 0.0 1.0 /end CHARACTERISTIC
/begin CHARACTERISTIC EIP_bErrLvlOilSnsrOvv_P "Error Oil Level Sensor - Override Value Parameter" VALUE 0x40044894 /* @ECU_Address@EIP_bErrLvlOilSnsrOvv_P@ */ Scalar_BOOLEAN 0 EcuIntgdSwGend_CM_boolean 0.0 1.0 /end CHARACTERISTIC
/begin CHARACTERISTIC EIP_bErrPAirBoostSnsrOvs_P "Error Air Boost Pressure Sensor - Override Switch Parameter" VALUE 0x40044898 /* @ECU_Address@EIP_bErrPAirBoostSnsrOvs_P@ */ Scalar_BOOLEAN 0 EcuIntgdSwGend_CM_boolean 0.0 1.0 /end CHARACTERISTIC
/begin CHARACTERISTIC EIP_bErrPAirBoostSnsrOvv_P "Error Air Boost Pressure Sensor - Override Value Parameter" VALUE 0x4004489C /* @ECU_Address@EIP_bErrPAirBoostSnsrOvv_P@ */ Scalar_BOOLEAN 0 EcuIntgdSwGend_CM_boolean 0.0 1.0 /end CHARACTERISTIC
/begin CHARACTERISTIC EIP_bErrPAmbAirSnsrOvs_P "Error Ambient Air Pressure Sensor - Override Switch Parameter" VALUE 0x400448A0 /* @ECU_Address@EIP_bErrPAmbAirSnsrOvs_P@ */ Scalar_BOOLEAN 0 EcuIntgdSwGend_CM_boolean 0.0 1.0 /end CHARACTERISTIC
/begin CHARACTERISTIC EIP_bErrPAmbAirSnsrOvv_P "Error Ambient Air Pressure Sensor - Override Value Parameter" VALUE 0x400448A4 /* @ECU_Address@EIP_bErrPAmbAirSnsrOvv_P@ */ Scalar_BOOLEAN 0 EcuIntgdSwGend_CM_boolean 0.0 1.0 /end CHARACTERISTIC
/begin CHARACTERISTIC EIP_bErrPFuSnsrOvs_P "Error Fuel Pressure Sensor - Override Switch Parameter" VALUE 0x400448B0 /* @ECU_Address@EIP_bErrPFuSnsrOvs_P@ */ Scalar_BOOLEAN 0 EcuIntgdSwGend_CM_boolean 0.0 1.0 /end CHARACTERISTIC
/begin CHARACTERISTIC EIP_bErrPFuSnsrOvv_P "Error Fuel Pressure Sensor - Override Value Parameter" VALUE 0x400448B4 /* @ECU_Address@EIP_bErrPFuSnsrOvv_P@ */ Scalar_BOOLEAN 0 EcuIntgdSwGend_CM_boolean 0.0 1.0 /end CHARACTERISTIC
/begin CHARACTERISTIC EIP_bErrPOilSnsrOvs_P "Error Oil Pressure Sensor - Override Switch Parameter" VALUE 0x400448B8 /* @ECU_Address@EIP_bErrPOilSnsrOvs_P@ */ Scalar_BOOLEAN 0 EcuIntgdSwGend_CM_boolean 0.0 1.0 /end CHARACTERISTIC
/begin CHARACTERISTIC EIP_bErrPOilSnsrOvv_P "Error Oil Pressure Sensor - Override Value Parameter" VALUE 0x400448BC /* @ECU_Address@EIP_bErrPOilSnsrOvv_P@ */ Scalar_BOOLEAN 0 EcuIntgdSwGend_CM_boolean 0.0 1.0 /end CHARACTERISTIC
/begin CHARACTERISTIC EIP_bErrPRailSnsrOvs_P "Error Rail Pressure Sensor - Override Switch Parameter" VALUE 0x400448C0 /* @ECU_Address@EIP_bErrPRailSnsrOvs_P@ */ Scalar_BOOLEAN 0 EcuIntgdSwGend_CM_boolean 0.0 1.0 /end CHARACTERISTIC
/begin CHARACTERISTIC EIP_bErrPRailSnsrOvv_P "Error Rail Pressure Sensor - Override Value Parameter" VALUE 0x400448C4 /* @ECU_Address@EIP_bErrPRailSnsrOvv_P@ */ Scalar_BOOLEAN 0 EcuIntgdSwGend_CM_boolean 0.0 1.0 /end CHARACTERISTIC
/begin CHARACTERISTIC EIP_bErrTAirBoostSnsrOvs_P "Error Air Boost Temperature Sensor - Override Switch Parameter" VALUE 0x400448F0 /* @ECU_Address@EIP_bErrTAirBoostSnsrOvs_P@ */ Scalar_BOOLEAN 0 EcuIntgdSwGend_CM_boolean 0.0 1.0 /end CHARACTERISTIC
/begin CHARACTERISTIC EIP_bErrTAirBoostSnsrOvv_P "Error Air Boost Temperature Sensor - Override Value Parameter" VALUE 0x400448F4 /* @ECU_Address@EIP_bErrTAirBoostSnsrOvv_P@ */ Scalar_BOOLEAN 0 EcuIntgdSwGend_CM_boolean 0.0 1.0 /end CHARACTERISTIC
/begin CHARACTERISTIC EIP_bErrTAmbAirSnsrOvs_P "Error Ambient Air Temperature Sensor - Override Switch Parameter" VALUE 0x400448F8 /* @ECU_Address@EIP_bErrTAmbAirSnsrOvs_P@ */ Scalar_BOOLEAN 0 EcuIntgdSwGend_CM_boolean 0.0 1.0 /end CHARACTERISTIC
/begin CHARACTERISTIC EIP_bErrTAmbAirSnsrOvv_P "Error Ambient Air Temperature Sensor - Override Value Parameter" VALUE 0x400448FC /* @ECU_Address@EIP_bErrTAmbAirSnsrOvv_P@ */ Scalar_BOOLEAN 0 EcuIntgdSwGend_CM_boolean 0.0 1.0 /end CHARACTERISTIC
/begin CHARACTERISTIC EIP_bErrTCooltSnsrOvs_P "Error Coolant Temperature Sensor - Override Switch Parameter" VALUE 0x40044900 /* @ECU_Address@EIP_bErrTCooltSnsrOvs_P@ */ Scalar_BOOLEAN 0 EcuIntgdSwGend_CM_boolean 0.0 1.0 /end CHARACTERISTIC
/begin CHARACTERISTIC EIP_bErrTCooltSnsrOvv_P "Error Coolant Temperature Sensor - Override Value Parameter" VALUE 0x40044904 /* @ECU_Address@EIP_bErrTCooltSnsrOvv_P@ */ Scalar_BOOLEAN 0 EcuIntgdSwGend_CM_boolean 0.0 1.0 /end CHARACTERISTIC
/begin CHARACTERISTIC EIP_bErrTEcuSnsrOvs_P "Error ECU Temperature Sensor - Override Switch Parameter" VALUE 0x40044908 /* @ECU_Address@EIP_bErrTEcuSnsrOvs_P@ */ Scalar_BOOLEAN 0 EcuIntgdSwGend_CM_boolean 0.0 1.0 /end CHARACTERISTIC
/begin CHARACTERISTIC EIP_bErrTEcuSnsrOvv_P "Error ECU Temperature Sensor - Override Value Parameter" VALUE 0x4004490C /* @ECU_Address@EIP_bErrTEcuSnsrOvv_P@ */ Scalar_BOOLEAN 0 EcuIntgdSwGend_CM_boolean 0.0 1.0 /end CHARACTERISTIC
/begin CHARACTERISTIC EIP_bErrTFuSnsrOvs_P "Error Fuel Temperature Sensor - Override Switch Parameter" VALUE 0x40044910 /* @ECU_Address@EIP_bErrTFuSnsrOvs_P@ */ Scalar_BOOLEAN 0 EcuIntgdSwGend_CM_boolean 0.0 1.0 /end CHARACTERISTIC
/begin CHARACTERISTIC EIP_bErrTFuSnsrOvv_P "Error Fuel Temperature Sensor - Override Value Parameter" VALUE 0x40044914 /* @ECU_Address@EIP_bErrTFuSnsrOvv_P@ */ Scalar_BOOLEAN 0 EcuIntgdSwGend_CM_boolean 0.0 1.0 /end CHARACTERISTIC
/begin CHARACTERISTIC EIP_bErrTOilSnsrOvs_P "Error Oil Temperature Sensor - Override Switch Parameter" VALUE 0x40044918 /* @ECU_Address@EIP_bErrTOilSnsrOvs_P@ */ Scalar_BOOLEAN 0 EcuIntgdSwGend_CM_boolean 0.0 1.0 /end CHARACTERISTIC
/begin CHARACTERISTIC EIP_bErrTOilSnsrOvv_P "Error Oil Temperature Sensor - Override Value Parameter" VALUE 0x4004491C /* @ECU_Address@EIP_bErrTOilSnsrOvv_P@ */ Scalar_BOOLEAN 0 EcuIntgdSwGend_CM_boolean 0.0 1.0 /end CHARACTERISTIC
/begin CHARACTERISTIC EOP_BrkPedlNotAvl_P "Brake Pedal Not Available Parameter" VALUE 0x400449EC /* @ECU_Address@EOP_BrkPedlNotAvl_P@ */ Scalar_BOOLEAN 0 EcuIntgdSwGend_CM_boolean 0.0 1.0 /end CHARACTERISTIC
/begin CHARACTERISTIC EOP_CanAccrPedl1LoIdleSwtOvs_P "SPN 558 - Accelerator Pedal 1 Low Idle Switch - Override Switch" VALUE 0x400449F0 /* @ECU_Address@EOP_CanAccrPedl1LoIdleSwtOvs_P@ */ Scalar_BOOLEAN 0 EcuIntgdSwGend_CM_boolean 0.0 1.0 /end CHARACTERISTIC
/begin CHARACTERISTIC EOP_CanAccrPedlPosn1Ovs_P "SPN 91 - Accelerator Pedal Position 1 - Override Switch" VALUE 0x400449F8 /* @ECU_Address@EOP_CanAccrPedlPosn1Ovs_P@ */ Scalar_BOOLEAN 0 EcuIntgdSwGend_CM_boolean 0.0 1.0 /end CHARACTERISTIC
/begin CHARACTERISTIC EOP_CanActEngBrkPercTqOvs_P "SPN 520 - Actual Retarder - Percent Torque - Override Switch" VALUE 0x40044A00 /* @ECU_Address@EOP_CanActEngBrkPercTqOvs_P@ */ Scalar_BOOLEAN 0 EcuIntgdSwGend_CM_boolean 0.0 1.0 /end CHARACTERISTIC
/begin CHARACTERISTIC EOP_CanActEngPercTqHiReslOvs_P "SPN 4154 - Actual Engine Percent Torque High Resolution - Override Switch" VALUE 0x40044A08 /* @ECU_Address@EOP_CanActEngPercTqHiReslOvs_P@ */ Scalar_BOOLEAN 0 EcuIntgdSwGend_CM_boolean 0.0 1.0 /end CHARACTERISTIC
/begin CHARACTERISTIC EOP_CanActEngPercTqOvs_P "SPN 513 - Actual Engine Percent Torque - Override Switch" VALUE 0x40044A10 /* @ECU_Address@EOP_CanActEngPercTqOvs_P@ */ Scalar_BOOLEAN 0 EcuIntgdSwGend_CM_boolean 0.0 1.0 /end CHARACTERISTIC
/begin CHARACTERISTIC EOP_CanActMaxAvlEngBrkPercTqOvs_P "SPN 1717 - Actual Maximum Available Retarder - Percent Torque - Override Switch" VALUE 0x40044A18 /* @ECU_Address@EOP_CanActMaxAvlEngBrkPercTqOvs_P@ */ Scalar_BOOLEAN 0 EcuIntgdSwGend_CM_boolean 0.0 1.0 /end CHARACTERISTIC
/begin CHARACTERISTIC EOP_CanAmberWarnLampOvs_P "SPN 624 - Amber Warning Lamp - Override Switch" VALUE 0x40044A20 /* @ECU_Address@EOP_CanAmberWarnLampOvs_P@ */ Scalar_BOOLEAN 0 EcuIntgdSwGend_CM_boolean 0.0 1.0 /end CHARACTERISTIC
/begin CHARACTERISTIC EOP_CanAmberWarnLampOvv_P "SPN 624 - Amber Warning Lamp - Override Value" VALUE 0x40044A24 /* @ECU_Address@EOP_CanAmberWarnLampOvv_P@ */ Scalar_BOOLEAN 0 EcuIntgdSwGend_CM_boolean 0.0 1.0 /end CHARACTERISTIC
/begin CHARACTERISTIC EOP_CanBattVolt1Ovs_P "SPN 168 - Battery Potential - Power Input 1 - Override Switch" VALUE 0x40044A28 /* @ECU_Address@EOP_CanBattVolt1Ovs_P@ */ Scalar_BOOLEAN 0 EcuIntgdSwGend_CM_boolean 0.0 1.0 /end CHARACTERISTIC
/begin CHARACTERISTIC EOP_CanBrkSwtOvs_P "SPN 597 - Brake Switch - Override Switch" VALUE 0x40044A30 /* @ECU_Address@EOP_CanBrkSwtOvs_P@ */ Scalar_BOOLEAN 0 EcuIntgdSwGend_CM_boolean 0.0 1.0 /end CHARACTERISTIC
/begin CHARACTERISTIC EOP_CanColdStrtLampOvs_P "SPN 1081 - Engine Wait to Start Lamp - Override Switch" VALUE 0x40044A38 /* @ECU_Address@EOP_CanColdStrtLampOvs_P@ */ Scalar_BOOLEAN 0 EcuIntgdSwGend_CM_boolean 0.0 1.0 /end CHARACTERISTIC
/begin CHARACTERISTIC EOP_CanCrsCtrlActvOvs_P "SPN 595 - Cruise Control Active - Override Switch" VALUE 0x40044A40 /* @ECU_Address@EOP_CanCrsCtrlActvOvs_P@ */ Scalar_BOOLEAN 0 EcuIntgdSwGend_CM_boolean 0.0 1.0 /end CHARACTERISTIC
/begin CHARACTERISTIC EOP_CanCrsCtrlDecSwtOvs_P "SPN 600 - Cruise Control Coast (Decelerate) Switch - Override Switch" VALUE 0x40044A48 /* @ECU_Address@EOP_CanCrsCtrlDecSwtOvs_P@ */ Scalar_BOOLEAN 0 EcuIntgdSwGend_CM_boolean 0.0 1.0 /end CHARACTERISTIC
/begin CHARACTERISTIC EOP_CanCrsCtrlEnaSwtOvs_P "SPN 596 - Cruise Control Enable Switch - Override Switch" VALUE 0x40044A50 /* @ECU_Address@EOP_CanCrsCtrlEnaSwtOvs_P@ */ Scalar_BOOLEAN 0 EcuIntgdSwGend_CM_boolean 0.0 1.0 /end CHARACTERISTIC
/begin CHARACTERISTIC EOP_CanCrsCtrlIncSwtOvs_P "SPN 602 - Cruise Control Accelerate Switch - Override Switch" VALUE 0x40044A58 /* @ECU_Address@EOP_CanCrsCtrlIncSwtOvs_P@ */ Scalar_BOOLEAN 0 EcuIntgdSwGend_CM_boolean 0.0 1.0 /end CHARACTERISTIC
/begin CHARACTERISTIC EOP_CanCrsCtrlResSwtOvs_P "SPN 601 - Cruise Control Resume Switch - Override Switch" VALUE 0x40044A60 /* @ECU_Address@EOP_CanCrsCtrlResSwtOvs_P@ */ Scalar_BOOLEAN 0 EcuIntgdSwGend_CM_boolean 0.0 1.0 /end CHARACTERISTIC
/begin CHARACTERISTIC EOP_CanCrsCtrlSetSpdOvs_P "SPN 86 - Cruise Control Set Speed - Override Switch" VALUE 0x40044A68 /* @ECU_Address@EOP_CanCrsCtrlSetSpdOvs_P@ */ Scalar_BOOLEAN 0 EcuIntgdSwGend_CM_boolean 0.0 1.0 /end CHARACTERISTIC
/begin CHARACTERISTIC EOP_CanCrsCtrlSetSwtOvs_P "SPN 599 - Cruise Control Set Switch - Override Switch" VALUE 0x40044A6C /* @ECU_Address@EOP_CanCrsCtrlSetSwtOvs_P@ */ Scalar_BOOLEAN 0 EcuIntgdSwGend_CM_boolean 0.0 1.0 /end CHARACTERISTIC
/begin CHARACTERISTIC EOP_CanCrsCtrlStOvs_P "SPN 527 - Cruise Control State - Override Switch" VALUE 0x40044A74 /* @ECU_Address@EOP_CanCrsCtrlStOvs_P@ */ Scalar_BOOLEAN 0 EcuIntgdSwGend_CM_boolean 0.0 1.0 /end CHARACTERISTIC
/begin CHARACTERISTIC EOP_CanDrvrDmdEngBrkPercTqOvs_P "SPN 1715 - Drivers Demand Retarder - Percent Torque - Override Switch" VALUE 0x40044A7C /* @ECU_Address@EOP_CanDrvrDmdEngBrkPercTqOvs_P@ */ Scalar_BOOLEAN 0 EcuIntgdSwGend_CM_boolean 0.0 1.0 /end CHARACTERISTIC
/begin CHARACTERISTIC EOP_CanDrvrDmdPercTqOvs_P "SPN 512 - Driver Demand Percent Torque - Override Switch" VALUE 0x40044A84 /* @ECU_Address@EOP_CanDrvrDmdPercTqOvs_P@ */ Scalar_BOOLEAN 0 EcuIntgdSwGend_CM_boolean 0.0 1.0 /end CHARACTERISTIC
/begin CHARACTERISTIC EOP_CanEngAmberWarnLampCmdOvs_P "SPN 5078 - Engine Amber Warning Lamp Command - Override Switch" VALUE 0x40044A8C /* @ECU_Address@EOP_CanEngAmberWarnLampCmdOvs_P@ */ Scalar_BOOLEAN 0 EcuIntgdSwGend_CM_boolean 0.0 1.0 /end CHARACTERISTIC
/begin CHARACTERISTIC EOP_CanEngBrkActvdLampCmdOvs_P "SPN 5081 -  Engine Brake Active Lamp Command - Override Switch" VALUE 0x40044A94 /* @ECU_Address@EOP_CanEngBrkActvdLampCmdOvs_P@ */ Scalar_BOOLEAN 0 EcuIntgdSwGend_CM_boolean 0.0 1.0 /end CHARACTERISTIC
/begin CHARACTERISTIC EOP_CanEngDftTqLimOvs_P "SPN 1846 - Engine Default Torque Limit - Override Switch" VALUE 0x40044A9C /* @ECU_Address@EOP_CanEngDftTqLimOvs_P@ */ Scalar_BOOLEAN 0 EcuIntgdSwGend_CM_boolean 0.0 1.0 /end CHARACTERISTIC
/begin CHARACTERISTIC EOP_CanEngDmdPercTqOvs_P "SPN 2432 - Engine Demand Percent Torque - Override Switch" VALUE 0x40044AA4 /* @ECU_Address@EOP_CanEngDmdPercTqOvs_P@ */ Scalar_BOOLEAN 0 EcuIntgdSwGend_CM_boolean 0.0 1.0 /end CHARACTERISTIC
/begin CHARACTERISTIC EOP_CanEngFuRateOvs_P "SPN 183 - Engine Fuel Rate - Override Switch" VALUE 0x40044AAC /* @ECU_Address@EOP_CanEngFuRateOvs_P@ */ Scalar_BOOLEAN 0 EcuIntgdSwGend_CM_boolean 0.0 1.0 /end CHARACTERISTIC
/begin CHARACTERISTIC EOP_CanEngHrOvs_P "SPN 247 - Engine Total Hours of Operation - Override Switch" VALUE 0x40044AB4 /* @ECU_Address@EOP_CanEngHrOvs_P@ */ Scalar_BOOLEAN 0 EcuIntgdSwGend_CM_boolean 0.0 1.0 /end CHARACTERISTIC
/begin CHARACTERISTIC EOP_CanEngParasiticLossOvs_P "SPN 2978 - Estimated Engine Parasitic Losses - Override Switch" VALUE 0x40044ABC /* @ECU_Address@EOP_CanEngParasiticLossOvs_P@ */ Scalar_BOOLEAN 0 EcuIntgdSwGend_CM_boolean 0.0 1.0 /end CHARACTERISTIC
/begin CHARACTERISTIC EOP_CanEngPercTqPoint1Ovs_P "SPN 539 - Engine Percent Torque Point 1 - Override Switch" VALUE 0x40044AC4 /* @ECU_Address@EOP_CanEngPercTqPoint1Ovs_P@ */ Scalar_BOOLEAN 0 EcuIntgdSwGend_CM_boolean 0.0 1.0 /end CHARACTERISTIC
/begin CHARACTERISTIC EOP_CanEngPercTqPoint2Ovs_P "SPN 539 - Engine Percent Torque Point 2 - Override Switch" VALUE 0x40044ACC /* @ECU_Address@EOP_CanEngPercTqPoint2Ovs_P@ */ Scalar_BOOLEAN 0 EcuIntgdSwGend_CM_boolean 0.0 1.0 /end CHARACTERISTIC
/begin CHARACTERISTIC EOP_CanEngPercTqPoint3Ovs_P "SPN 539 - Engine Percent Torque Point 3 - Override Switch" VALUE 0x40044AD4 /* @ECU_Address@EOP_CanEngPercTqPoint3Ovs_P@ */ Scalar_BOOLEAN 0 EcuIntgdSwGend_CM_boolean 0.0 1.0 /end CHARACTERISTIC
/begin CHARACTERISTIC EOP_CanEngPercTqPoint4Ovs_P "SPN 539 - Engine Percent Torque Point 4 - Override Switch" VALUE 0x40044ADC /* @ECU_Address@EOP_CanEngPercTqPoint4Ovs_P@ */ Scalar_BOOLEAN 0 EcuIntgdSwGend_CM_boolean 0.0 1.0 /end CHARACTERISTIC
/begin CHARACTERISTIC EOP_CanEngPercTqPoint5Ovs_P "SPN 539 - Engine Percent Torque Point 5 - Override Switch" VALUE 0x40044AE4 /* @ECU_Address@EOP_CanEngPercTqPoint5Ovs_P@ */ Scalar_BOOLEAN 0 EcuIntgdSwGend_CM_boolean 0.0 1.0 /end CHARACTERISTIC
/begin CHARACTERISTIC EOP_CanEngRatedPwrOvs_P "SPN 166 - Engine Rated Power - Override Switch" VALUE 0x40044AEC /* @ECU_Address@EOP_CanEngRatedPwrOvs_P@ */ Scalar_BOOLEAN 0 EcuIntgdSwGend_CM_boolean 0.0 1.0 /end CHARACTERISTIC
/begin CHARACTERISTIC EOP_CanEngRatedSpdOvs_P "SPN 189 - Engine Rated Speed - Override Switch" VALUE 0x40044AF4 /* @ECU_Address@EOP_CanEngRatedSpdOvs_P@ */ Scalar_BOOLEAN 0 EcuIntgdSwGend_CM_boolean 0.0 1.0 /end CHARACTERISTIC
/begin CHARACTERISTIC EOP_CanEngRedStopLampCmdOvs_P "SPN 5079 - Engine Red Stop Lamp Command - Override Switch" VALUE 0x40044AFC /* @ECU_Address@EOP_CanEngRedStopLampCmdOvs_P@ */ Scalar_BOOLEAN 0 EcuIntgdSwGend_CM_boolean 0.0 1.0 /end CHARACTERISTIC
/begin CHARACTERISTIC EOP_CanEngRefTqOvs_P "SPN 544 - Engine Reference Torque - Override Switch" VALUE 0x40044B04 /* @ECU_Address@EOP_CanEngRefTqOvs_P@ */ Scalar_BOOLEAN 0 EcuIntgdSwGend_CM_boolean 0.0 1.0 /end CHARACTERISTIC
/begin CHARACTERISTIC EOP_CanEngShtdwnOvrdSwtOvs_P "SPN 1237 - Engine Shutdown Override Switch - Override Switch" VALUE 0x40044B0C /* @ECU_Address@EOP_CanEngShtdwnOvrdSwtOvs_P@ */ Scalar_BOOLEAN 0 EcuIntgdSwGend_CM_boolean 0.0 1.0 /end CHARACTERISTIC
/begin CHARACTERISTIC EOP_CanEngSpdOvs_P "SPN 190 - Engine Speed - Override Switch" VALUE 0x40044B14 /* @ECU_Address@EOP_CanEngSpdOvs_P@ */ Scalar_BOOLEAN 0 EcuIntgdSwGend_CM_boolean 0.0 1.0 /end CHARACTERISTIC
/begin CHARACTERISTIC EOP_CanEngSpdPoint1Ovs_P "SPN 188 - Engine Speed Point 1 - Override Switch" VALUE 0x40044B1C /* @ECU_Address@EOP_CanEngSpdPoint1Ovs_P@ */ Scalar_BOOLEAN 0 EcuIntgdSwGend_CM_boolean 0.0 1.0 /end CHARACTERISTIC
/begin CHARACTERISTIC EOP_CanEngSpdPoint2Ovs_P "SPN 528 - Engine Speed Point 2 - Override Switch" VALUE 0x40044B24 /* @ECU_Address@EOP_CanEngSpdPoint2Ovs_P@ */ Scalar_BOOLEAN 0 EcuIntgdSwGend_CM_boolean 0.0 1.0 /end CHARACTERISTIC
/begin CHARACTERISTIC EOP_CanEngSpdPoint3Ovs_P "SPN 529 - Engine Speed Point 3 - Override Switch" VALUE 0x40044B2C /* @ECU_Address@EOP_CanEngSpdPoint3Ovs_P@ */ Scalar_BOOLEAN 0 EcuIntgdSwGend_CM_boolean 0.0 1.0 /end CHARACTERISTIC
/begin CHARACTERISTIC EOP_CanEngSpdPoint4Ovs_P "SPN 530 - Engine Speed Point 4 - Override Switch" VALUE 0x40044B34 /* @ECU_Address@EOP_CanEngSpdPoint4Ovs_P@ */ Scalar_BOOLEAN 0 EcuIntgdSwGend_CM_boolean 0.0 1.0 /end CHARACTERISTIC
/begin CHARACTERISTIC EOP_CanEngSpdPoint5Ovs_P "SPN 531 - Engine Speed Point 5 - Override Switch" VALUE 0x40044B3C /* @ECU_Address@EOP_CanEngSpdPoint5Ovs_P@ */ Scalar_BOOLEAN 0 EcuIntgdSwGend_CM_boolean 0.0 1.0 /end CHARACTERISTIC
/begin CHARACTERISTIC EOP_CanEngSpdPoint6Ovs_P "SPN 532 - Engine Speed Point 6 - Override Switch" VALUE 0x40044B44 /* @ECU_Address@EOP_CanEngSpdPoint6Ovs_P@ */ Scalar_BOOLEAN 0 EcuIntgdSwGend_CM_boolean 0.0 1.0 /end CHARACTERISTIC
/begin CHARACTERISTIC EOP_CanEngSpdPoint7Ovs_P "SPN 533 - Engine Speed Point 7 - Override Switch" VALUE 0x40044B4C /* @ECU_Address@EOP_CanEngSpdPoint7Ovs_P@ */ Scalar_BOOLEAN 0 EcuIntgdSwGend_CM_boolean 0.0 1.0 /end CHARACTERISTIC
/begin CHARACTERISTIC EOP_CanEngStOvs_P "SPN 3543 - Engine Operating State - Override Switch" VALUE 0x40044B54 /* @ECU_Address@EOP_CanEngStOvs_P@ */ Scalar_BOOLEAN 0 EcuIntgdSwGend_CM_boolean 0.0 1.0 /end CHARACTERISTIC
/begin CHARACTERISTIC EOP_CanEngStrtrModOvs_P "SPN 1675 - Engine Starter Mode - Override Switch" VALUE 0x40044B5C /* @ECU_Address@EOP_CanEngStrtrModOvs_P@ */ Scalar_BOOLEAN 0 EcuIntgdSwGend_CM_boolean 0.0 1.0 /end CHARACTERISTIC
/begin CHARACTERISTIC EOP_CanEngTotFuQntyOvs_P "SPN 250 - Engine Total Fuel Used - Override Switch" VALUE 0x40044B64 /* @ECU_Address@EOP_CanEngTotFuQntyOvs_P@ */ Scalar_BOOLEAN 0 EcuIntgdSwGend_CM_boolean 0.0 1.0 /end CHARACTERISTIC
/begin CHARACTERISTIC EOP_CanEngTqModOvs_P "SPN 899 - Engine Torque Mode - Override Switch" VALUE 0x40044B6C /* @ECU_Address@EOP_CanEngTqModOvs_P@ */ Scalar_BOOLEAN 0 EcuIntgdSwGend_CM_boolean 0.0 1.0 /end CHARACTERISTIC
/begin CHARACTERISTIC EOP_CanHndBrkPrkgOvs_P "SPN 70 - Parking Brake Switch - Override Switch" VALUE 0x40044B74 /* @ECU_Address@EOP_CanHndBrkPrkgOvs_P@ */ Scalar_BOOLEAN 0 EcuIntgdSwGend_CM_boolean 0.0 1.0 /end CHARACTERISTIC
/begin CHARACTERISTIC EOP_CanLvlOilOvs_P "SPN 98 - Engine Oil Level - Override Switch" VALUE 0x40044B7C /* @ECU_Address@EOP_CanLvlOilOvs_P@ */ Scalar_BOOLEAN 0 EcuIntgdSwGend_CM_boolean 0.0 1.0 /end CHARACTERISTIC
/begin CHARACTERISTIC EOP_CanNomFricPercTqOvs_P "SPN 514 - Nominal Friction - Percent Torque - Override Switch" VALUE 0x40044B84 /* @ECU_Address@EOP_CanNomFricPercTqOvs_P@ */ Scalar_BOOLEAN 0 EcuIntgdSwGend_CM_boolean 0.0 1.0 /end CHARACTERISTIC
/begin CHARACTERISTIC EOP_CanPAirBoostOvs_P "SPN 102 - Engine Intake Manifold 1 Pressure - Override Switch" VALUE 0x40044B8C /* @ECU_Address@EOP_CanPAirBoostOvs_P@ */ Scalar_BOOLEAN 0 EcuIntgdSwGend_CM_boolean 0.0 1.0 /end CHARACTERISTIC
/begin CHARACTERISTIC EOP_CanPBaroOvs_P "SPN 108 - Barometric Pressure - Override Switch" VALUE 0x40044B94 /* @ECU_Address@EOP_CanPBaroOvs_P@ */ Scalar_BOOLEAN 0 EcuIntgdSwGend_CM_boolean 0.0 1.0 /end CHARACTERISTIC
/begin CHARACTERISTIC EOP_CanPFuOvs_P "SPN 94 - Engine Fuel Delivery Pressure - Override Switch" VALUE 0x40044B9C /* @ECU_Address@EOP_CanPFuOvs_P@ */ Scalar_BOOLEAN 0 EcuIntgdSwGend_CM_boolean 0.0 1.0 /end CHARACTERISTIC
/begin CHARACTERISTIC EOP_CanPOilOvs_P "SPN 100 - Engine Oil Pressure - Override Switch" VALUE 0x40044BA4 /* @ECU_Address@EOP_CanPOilOvs_P@ */ Scalar_BOOLEAN 0 EcuIntgdSwGend_CM_boolean 0.0 1.0 /end CHARACTERISTIC
/begin CHARACTERISTIC EOP_CanPRailOvs_P "SPN 157 - Engine Injector Metering Rail 1 Pressure - Override Switch" VALUE 0x40044BAC /* @ECU_Address@EOP_CanPRailOvs_P@ */ Scalar_BOOLEAN 0 EcuIntgdSwGend_CM_boolean 0.0 1.0 /end CHARACTERISTIC
/begin CHARACTERISTIC EOP_CanPTOGovrStOvs_P "SPN 976 - PTO Governor State - Override Switch" VALUE 0x40044BB4 /* @ECU_Address@EOP_CanPTOGovrStOvs_P@ */ Scalar_BOOLEAN 0 EcuIntgdSwGend_CM_boolean 0.0 1.0 /end CHARACTERISTIC
/begin CHARACTERISTIC EOP_CanPercLoadAtCurrentSpdOvs_P "SPN 92 - Engine Percent Load At Current Speed - Override Switch" VALUE 0x40044BBC /* @ECU_Address@EOP_CanPercLoadAtCurrentSpdOvs_P@ */ Scalar_BOOLEAN 0 EcuIntgdSwGend_CM_boolean 0.0 1.0 /end CHARACTERISTIC
/begin CHARACTERISTIC EOP_CanPosOfWg1Ovs_P "SPN 1188 - Engine Turbocharger Wastegate Actuator 1 Position - Override Switch" VALUE 0x40044BC4 /* @ECU_Address@EOP_CanPosOfWg1Ovs_P@ */ Scalar_BOOLEAN 0 EcuIntgdSwGend_CM_boolean 0.0 1.0 /end CHARACTERISTIC
/begin CHARACTERISTIC EOP_CanRedStopLampOvs_P "SPN 623 - Red Stop Lamp - Override Switch" VALUE 0x40044BCC /* @ECU_Address@EOP_CanRedStopLampOvs_P@ */ Scalar_BOOLEAN 0 EcuIntgdSwGend_CM_boolean 0.0 1.0 /end CHARACTERISTIC
/begin CHARACTERISTIC EOP_CanRedStopLampOvv_P "SPN 623 - Red Stop Lamp - Override Value" VALUE 0x40044BD0 /* @ECU_Address@EOP_CanRedStopLampOvv_P@ */ Scalar_BOOLEAN 0 EcuIntgdSwGend_CM_boolean 0.0 1.0 /end CHARACTERISTIC
/begin CHARACTERISTIC EOP_CanRefEngBrkTqOvs_P "SPN 556 - Reference Retarder Torque - Override Switch" VALUE 0x40044BD4 /* @ECU_Address@EOP_CanRefEngBrkTqOvs_P@ */ Scalar_BOOLEAN 0 EcuIntgdSwGend_CM_boolean 0.0 1.0 /end CHARACTERISTIC
/begin CHARACTERISTIC EOP_CanSoiMaiInjOvs_P "SPN1436 - Engine Actual Ignition Timing - Override Switch" VALUE 0x40044BDC /* @ECU_Address@EOP_CanSoiMaiInjOvs_P@ */ Scalar_BOOLEAN 0 EcuIntgdSwGend_CM_boolean_deg 0.0 1.0 /end CHARACTERISTIC
/begin CHARACTERISTIC EOP_CanTAirBoostHiReslOvs_P "SPN 1636 - Engine Intake Manifold 1 Temperature (High Resolution) - Override Switch" VALUE 0x40044BE4 /* @ECU_Address@EOP_CanTAirBoostHiReslOvs_P@ */ Scalar_BOOLEAN 0 EcuIntgdSwGend_CM_boolean 0.0 1.0 /end CHARACTERISTIC
/begin CHARACTERISTIC EOP_CanTAirBoostOvs_P "SPN 105 - Engine Intake Manifold 1 Temperature - Override Switch" VALUE 0x40044BEC /* @ECU_Address@EOP_CanTAirBoostOvs_P@ */ Scalar_BOOLEAN 0 EcuIntgdSwGend_CM_boolean 0.0 1.0 /end CHARACTERISTIC
/begin CHARACTERISTIC EOP_CanTAmbAirOvs_P "SPN 171 - Ambient Air Temperature - Override Switch" VALUE 0x40044BF4 /* @ECU_Address@EOP_CanTAmbAirOvs_P@ */ Scalar_BOOLEAN 0 EcuIntgdSwGend_CM_boolean 0.0 1.0 /end CHARACTERISTIC
/begin CHARACTERISTIC EOP_CanTCooltOvs_P "SPN 1637 - Engine Coolant Temperature (High Resolution) - Override Switch" VALUE 0x40044BFC /* @ECU_Address@EOP_CanTCooltOvs_P@ */ Scalar_BOOLEAN 0 EcuIntgdSwGend_CM_boolean 0.0 1.0 /end CHARACTERISTIC
/begin CHARACTERISTIC EOP_CanTEcuOvs_P "SPN 1136 - Engine ECU Temperature - Override Switch" VALUE 0x40044C04 /* @ECU_Address@EOP_CanTEcuOvs_P@ */ Scalar_BOOLEAN 0 EcuIntgdSwGend_CM_boolean 0.0 1.0 /end CHARACTERISTIC
/begin CHARACTERISTIC EOP_CanTFuOvs_P "SPN 174 - Engine Fuel Temperature - Override Switch" VALUE 0x40044C0C /* @ECU_Address@EOP_CanTFuOvs_P@ */ Scalar_BOOLEAN 0 EcuIntgdSwGend_CM_boolean 0.0 1.0 /end CHARACTERISTIC
/begin CHARACTERISTIC EOP_CanTOilOvs_P "SPN 175 - Engine Oil Temperature - Override Switch" VALUE 0x40044C14 /* @ECU_Address@EOP_CanTOilOvs_P@ */ Scalar_BOOLEAN 0 EcuIntgdSwGend_CM_boolean 0.0 1.0 /end CHARACTERISTIC
/begin CHARACTERISTIC EOP_CanVehAccrRateLimStsOvs_P "SPN 2979 - Vehicle Acceleration Rate Limit Status - Override Switch" VALUE 0x40044C1C /* @ECU_Address@EOP_CanVehAccrRateLimStsOvs_P@ */ Scalar_BOOLEAN 0 EcuIntgdSwGend_CM_boolean 0.0 1.0 /end CHARACTERISTIC
/begin CHARACTERISTIC EOP_CanWhlBasVehSpdOvs_P "SPN 84 - Wheel-Based Vehicle Speed - Override Switch" VALUE 0x40044C24 /* @ECU_Address@EOP_CanWhlBasVehSpdOvs_P@ */ Scalar_BOOLEAN 0 EcuIntgdSwGend_CM_boolean 0.0 1.0 /end CHARACTERISTIC
/begin CHARACTERISTIC EOP_CanWtrInFuOvs_P "SPN 97 - Water In Fuel Indicator - Override Switch" VALUE 0x40044C2C /* @ECU_Address@EOP_CanWtrInFuOvs_P@ */ Scalar_BOOLEAN 0 EcuIntgdSwGend_CM_boolean 0.0 1.0 /end CHARACTERISTIC
/begin CHARACTERISTIC EOP_CmbtSwtNotAvl_P "Combat Switch Not Available Parameter" VALUE 0x40044C34 /* @ECU_Address@EOP_CmbtSwtNotAvl_P@ */ Scalar_BOOLEAN 0 EcuIntgdSwGend_CM_boolean 0.0 1.0 /end CHARACTERISTIC
/begin CHARACTERISTIC EOP_ColdStrtLampNotAvl_P "Cold Start Lamp Not Available" VALUE 0x40044C38 /* @ECU_Address@EOP_ColdStrtLampNotAvl_P@ */ Scalar_BOOLEAN 0 EcuIntgdSwGend_CM_boolean 0.0 1.0 /end CHARACTERISTIC
/begin CHARACTERISTIC EOP_CrsCtrlDecSwtNotAvl_P "Cruise Control Coast (Decelerate) Switch Not Available Parameter" VALUE 0x40044C44 /* @ECU_Address@EOP_CrsCtrlDecSwtNotAvl_P@ */ Scalar_BOOLEAN 0 EcuIntgdSwGend_CM_boolean 0.0 1.0 /end CHARACTERISTIC
/begin CHARACTERISTIC EOP_CrsCtrlEnaSwtNotAvl_P "Cruise Control Enable Switch Not Available Parameter" VALUE 0x40044C48 /* @ECU_Address@EOP_CrsCtrlEnaSwtNotAvl_P@ */ Scalar_BOOLEAN 0 EcuIntgdSwGend_CM_boolean 0.0 1.0 /end CHARACTERISTIC
/begin CHARACTERISTIC EOP_CrsCtrlIncSwtNotAvl_P "Cruise Control Accelerate Switch Not Available Parameter" VALUE 0x40044C4C /* @ECU_Address@EOP_CrsCtrlIncSwtNotAvl_P@ */ Scalar_BOOLEAN 0 EcuIntgdSwGend_CM_boolean 0.0 1.0 /end CHARACTERISTIC
/begin CHARACTERISTIC EOP_CrsCtrlResSwtNotAvl_P "Cruise Control Resume Switch Not Avaible Parameter" VALUE 0x40044C50 /* @ECU_Address@EOP_CrsCtrlResSwtNotAvl_P@ */ Scalar_BOOLEAN 0 EcuIntgdSwGend_CM_boolean 0.0 1.0 /end CHARACTERISTIC
/begin CHARACTERISTIC EOP_CrsCtrlSetSwtNotAvl_P "" VALUE 0x40044C54 /* @ECU_Address@EOP_CrsCtrlSetSwtNotAvl_P@ */ Scalar_BOOLEAN 0 EcuIntgdSwGend_CM_boolean 0.0 1.0 /end CHARACTERISTIC
/begin CHARACTERISTIC EOP_EngStrtrModeNotAvl_P "Engine Starter Mode Not Available Parameter" VALUE 0x40044CEC /* @ECU_Address@EOP_EngStrtrModeNotAvl_P@ */ Scalar_BOOLEAN 0 EcuIntgdSwGend_CM_boolean 0.0 1.0 /end CHARACTERISTIC
/begin CHARACTERISTIC EOP_HndBrkPrkgNotAvl_P "Hand Brake Parking Switch Not Available" VALUE 0x40044CF8 /* @ECU_Address@EOP_HndBrkPrkgNotAvl_P@ */ Scalar_BOOLEAN 0 EcuIntgdSwGend_CM_boolean 0.0 1.0 /end CHARACTERISTIC
/begin CHARACTERISTIC EIP_VehSpdSelnSrc1_P "Vehicle Speed Selection Source 1" VALUE 0x40044730 /* @ECU_Address@EIP_VehSpdSelnSrc1_P@ */ Scalar_BYTE 0 EcuIntgdSwGend_CM_int8 0.0 3.0 /end CHARACTERISTIC
/begin CHARACTERISTIC EIP_VehSpdSelnSrc2_P "Vehicle Speed Selection Source 2" VALUE 0x40044734 /* @ECU_Address@EIP_VehSpdSelnSrc2_P@ */ Scalar_BYTE 0 EcuIntgdSwGend_CM_int8 0.0 3.0 /end CHARACTERISTIC
/begin CHARACTERISTIC EOP_CanBrkSwtOvv_P "SPN 597 - Brake Switch - Override Value" VALUE 0x40044A34 /* @ECU_Address@EOP_CanBrkSwtOvv_P@ */ Scalar_BYTE 0 EcuIntgdSwGend_CM_int8 0.0 3.0 /end CHARACTERISTIC
/begin CHARACTERISTIC EOP_CanCrsCtrlActvOvv_P "SPN 595 - Cruise Control Active - Override Value" VALUE 0x40044A44 /* @ECU_Address@EOP_CanCrsCtrlActvOvv_P@ */ Scalar_BYTE 0 EcuIntgdSwGend_CM_int8 0.0 3.0 /end CHARACTERISTIC
/begin CHARACTERISTIC EOP_CanCrsCtrlDecSwtOvv_P "SPN 600 - Cruise Control Coast (Decelerate) Switch - Override Value" VALUE 0x40044A4C /* @ECU_Address@EOP_CanCrsCtrlDecSwtOvv_P@ */ Scalar_BYTE 0 EcuIntgdSwGend_CM_int8 0.0 3.0 /end CHARACTERISTIC
/begin CHARACTERISTIC EOP_CanCrsCtrlEnaSwtOvv_P "SPN 596 - Cruise Control Enable Switch - Override Value" VALUE 0x40044A54 /* @ECU_Address@EOP_CanCrsCtrlEnaSwtOvv_P@ */ Scalar_BYTE 0 EcuIntgdSwGend_CM_int8 0.0 3.0 /end CHARACTERISTIC
/begin CHARACTERISTIC EOP_CanCrsCtrlIncSwtOvv_P "SPN 602 - Cruise Control Accelerate Switch - Override Value" VALUE 0x40044A5C /* @ECU_Address@EOP_CanCrsCtrlIncSwtOvv_P@ */ Scalar_BYTE 0 EcuIntgdSwGend_CM_int8 0.0 3.0 /end CHARACTERISTIC
/begin CHARACTERISTIC EOP_CanCrsCtrlResSwtOvv_P "SPN 601 - Cruise Control Resume Switch - Override Value" VALUE 0x40044A64 /* @ECU_Address@EOP_CanCrsCtrlResSwtOvv_P@ */ Scalar_BYTE 0 EcuIntgdSwGend_CM_int8 0.0 3.0 /end CHARACTERISTIC
/begin CHARACTERISTIC EOP_CanCrsCtrlSetSwtOvv_P "SPN 599 - Cruise Control Set Switch - Override Value" VALUE 0x40044A70 /* @ECU_Address@EOP_CanCrsCtrlSetSwtOvv_P@ */ Scalar_BYTE 0 EcuIntgdSwGend_CM_int8 0.0 3.0 /end CHARACTERISTIC
/begin CHARACTERISTIC EOP_CanEngShtdwnOvrdSwtOvv_P "SPN 1237 - Engine Shutdown Override Switch - Override Value" VALUE 0x40044B10 /* @ECU_Address@EOP_CanEngShtdwnOvrdSwtOvv_P@ */ Scalar_BYTE 0 EcuIntgdSwGend_CM_int8 0.0 3.0 /end CHARACTERISTIC
/begin CHARACTERISTIC EOP_CanEngStrtrModOvv_P "SPN 1675 - Engine Starter Mode - Override Value" VALUE 0x40044B60 /* @ECU_Address@EOP_CanEngStrtrModOvv_P@ */ Scalar_BYTE 0 EcuIntgdSwGend_CM_int8 0.0 15.0 /end CHARACTERISTIC
/begin CHARACTERISTIC EOP_CanHndBrkPrkgOvv_P "SPN 70 - Parking Brake Switch - Override Value" VALUE 0x40044B78 /* @ECU_Address@EOP_CanHndBrkPrkgOvv_P@ */ Scalar_BYTE 0 EcuIntgdSwGend_CM_int8 0.0 3.0 /end CHARACTERISTIC
/begin CHARACTERISTIC EOP_CanPTOGovrStOvv_P "SPN 976 - PTO Governor State - Override Value" VALUE 0x40044BB8 /* @ECU_Address@EOP_CanPTOGovrStOvv_P@ */ Scalar_BYTE 0 EcuIntgdSwGend_CM_int8 0.0 31.0 /end CHARACTERISTIC
/begin CHARACTERISTIC EIP_CanEngPtoGovrAccrSwtOvv_P "CAN Pto Governor - Accelerator Switch - Override Value Parameter" VALUE 0x400440AC /* @ECU_Address@EIP_CanEngPtoGovrAccrSwtOvv_P@ */ Scalar_UBYTE 0 EcuIntgdSwGend_CM_uint8 0.0 3.0 /end CHARACTERISTIC
/begin CHARACTERISTIC EIP_CanEngPtoGovrCoastSwtOvv_P "CAN Pto Governor - Coast Switch - Override Value Parameter" VALUE 0x400440B4 /* @ECU_Address@EIP_CanEngPtoGovrCoastSwtOvv_P@ */ Scalar_UBYTE 0 EcuIntgdSwGend_CM_uint8 0.0 3.0 /end CHARACTERISTIC
/begin CHARACTERISTIC EIP_CanEngPtoGovrResuSwtOvv_P "CAN Pto Governor - Resume Switch - Override Value Parameter" VALUE 0x400440C4 /* @ECU_Address@EIP_CanEngPtoGovrResuSwtOvv_P@ */ Scalar_UBYTE 0 EcuIntgdSwGend_CM_uint8 0.0 3.0 /end CHARACTERISTIC
/begin CHARACTERISTIC EIP_CanEngPtoGovrSetSwtOvv_P "CAN Pto Governor - Set Switch - Override Value Parameter" VALUE 0x400440CC /* @ECU_Address@EIP_CanEngPtoGovrSetSwtOvv_P@ */ Scalar_UBYTE 0 EcuIntgdSwGend_CM_uint8 0.0 3.0 /end CHARACTERISTIC
/begin CHARACTERISTIC EOP_CanAccrPedl1LoIdleSwtOvv_P "SPN 558 - Accelerator Pedal 1 Low Idle Switch - Override Value" VALUE 0x400449F4 /* @ECU_Address@EOP_CanAccrPedl1LoIdleSwtOvv_P@ */ Scalar_UBYTE 0 EcuIntgdSwGend_CM_uint8 0.0 1.0 /end CHARACTERISTIC
/begin CHARACTERISTIC EOP_CanActEngPercTqHiReslOvv_P "SPN 4154 - Actual Engine Percent Torque High Resolution - Override Value" VALUE 0x40044A0C /* @ECU_Address@EOP_CanActEngPercTqHiReslOvv_P@ */ Scalar_UBYTE 0 EcuIntgdSwGend_CM_uint8 0.0 7.0 /end CHARACTERISTIC
/begin CHARACTERISTIC EOP_CanColdStrtLampOvv_P "SPN 1081 - Engine Wait to Start Lamp - Override Value" VALUE 0x40044A3C /* @ECU_Address@EOP_CanColdStrtLampOvv_P@ */ Scalar_UBYTE 0 EcuIntgdSwGend_CM_uint8 0.0 3.0 /end CHARACTERISTIC
/begin CHARACTERISTIC EOP_CanCrsCtrlStOvv_P "SPN 527 - Cruise Control State - Override Value" VALUE 0x40044A78 /* @ECU_Address@EOP_CanCrsCtrlStOvv_P@ */ Scalar_UBYTE 0 EcuIntgdSwGend_CM_uint8 0.0 7.0 /end CHARACTERISTIC
/begin CHARACTERISTIC EOP_CanEngAmberWarnLampCmdOvv_P "SPN 5078 - Engine Amber Warning Lamp Command - Override Value" VALUE 0x40044A90 /* @ECU_Address@EOP_CanEngAmberWarnLampCmdOvv_P@ */ Scalar_UBYTE 0 EcuIntgdSwGend_CM_uint8 0.0 3.0 /end CHARACTERISTIC
/begin CHARACTERISTIC EOP_CanEngBrkActvdLampCmdOvv_P "SPN 5081 -  Engine Brake Active Lamp Command - Override Value" VALUE 0x40044A98 /* @ECU_Address@EOP_CanEngBrkActvdLampCmdOvv_P@ */ Scalar_UBYTE 0 EcuIntgdSwGend_CM_uint8 0.0 3.0 /end CHARACTERISTIC
/begin CHARACTERISTIC EOP_CanEngRedStopLampCmdOvv_P "SPN 5079 - Engine Red Stop Lamp Command - Override Value" VALUE 0x40044B00 /* @ECU_Address@EOP_CanEngRedStopLampCmdOvv_P@ */ Scalar_UBYTE 0 EcuIntgdSwGend_CM_uint8 0.0 3.0 /end CHARACTERISTIC
/begin CHARACTERISTIC EOP_CanEngStOvv_P "SPN 3543 - Engine Operating State - Override Value" VALUE 0x40044B58 /* @ECU_Address@EOP_CanEngStOvv_P@ */ Scalar_UBYTE 0 EcuIntgdSwGend_CM_uint8 0.0 15.0 /end CHARACTERISTIC
/begin CHARACTERISTIC EOP_CanVehAccrRateLimStsOvv_P "SPN 2979 - Vehicle Acceleration Rate Limit Status - Override Value" VALUE 0x40044C20 /* @ECU_Address@EOP_CanVehAccrRateLimStsOvv_P@ */ Scalar_UBYTE 0 EcuIntgdSwGend_CM_uint8 0.0 3.0 /end CHARACTERISTIC
/begin CHARACTERISTIC EOP_CanWtrInFuOvv_P "SPN 97 - Water In Fuel Indicator - Override Value" VALUE 0x40044C30 /* @ECU_Address@EOP_CanWtrInFuOvv_P@ */ Scalar_UBYTE 0 EcuIntgdSwGend_CM_uint8 0.0 3.0 /end CHARACTERISTIC
/begin MEASUREMENT IC_FuCnsLt "" FLOAT32_IEEE EcuIntgdSwGend_CM_single_L 0 0 0.0 10000.0 ECU_ADDRESS 0x4000E5CC /* @ECU_Address@IC_FuCnsLt@ */ /end MEASUREMENT
/begin MEASUREMENT IC_CorrnFacCyl1 "Correction Factor for Cylinder 1" FLOAT32_IEEE EcuIntgdSwGend_CM_single_mm_3_stk 0 0 0.0 5000.0 ECU_ADDRESS 0x4000E00C /* @ECU_Address@IC_CorrnFacCyl1@ */ /end MEASUREMENT
/begin MEASUREMENT IC_CorrnFacCyl2 "Correction Factor for Cylinder 2" FLOAT32_IEEE EcuIntgdSwGend_CM_single_mm_3_stk 0 0 0.0 5000.0 ECU_ADDRESS 0x4000E258 /* @ECU_Address@IC_CorrnFacCyl2@ */ /end MEASUREMENT
/begin MEASUREMENT IC_CorrnFacCyl3 "Correction Factor for Cylinder 3" FLOAT32_IEEE EcuIntgdSwGend_CM_single_mm_3_stk 0 0 0.0 5000.0 ECU_ADDRESS 0x4000DE60 /* @ECU_Address@IC_CorrnFacCyl3@ */ /end MEASUREMENT
/begin MEASUREMENT IC_CorrnFacCyl4 "Correction Factor for Cylinder 4" FLOAT32_IEEE EcuIntgdSwGend_CM_single_mm_3_stk 0 0 0.0 5000.0 ECU_ADDRESS 0x4000E260 /* @ECU_Address@IC_CorrnFacCyl4@ */ /end MEASUREMENT
/begin MEASUREMENT IC_CorrnFacCyl6 "Correction Factor for Cylinder 6" FLOAT32_IEEE EcuIntgdSwGend_CM_single_mm_3_stk 0 0 0.0 5000.0 ECU_ADDRESS 0x4000E020 /* @ECU_Address@IC_CorrnFacCyl6@ */ /end MEASUREMENT
/begin MEASUREMENT IC_CorrnFacCyl5 "Correction Factor for Cylinder 5" FLOAT32_IEEE EcuIntgdSwGend_CM_single_mm_3_stk 0 0 0.0 5000.0 ECU_ADDRESS 0x4000E01C /* @ECU_Address@IC_CorrnFacCyl5@ */ /end MEASUREMENT
/begin MEASUREMENT EngBrk_DrvrDmdEngBrkPercTq "Driver Demand Engine Brake Percent Torque" FLOAT32_IEEE EcuIntgdSwGend_CM_single__ 0 0 -125.0 125.0 ECU_ADDRESS 0x4000DFB8 /* @ECU_Address@EngBrk_DrvrDmdEngBrkPercTq@ */ /end MEASUREMENT
/begin MEASUREMENT EOP_CanLvlOil "SPN 98 - Engine Oil Level" FLOAT32_IEEE EcuIntgdSwGend_CM_single__ 0 0 0.0 100.0 ECU_ADDRESS 0x4000DD38 /* @ECU_Address@EOP_CanLvlOil@ */ /end MEASUREMENT
/begin MEASUREMENT EOP_CanPFu "SPN 94 - Engine Fuel Delivery Pressure" FLOAT32_IEEE EcuIntgdSwGend_CM_single_kPa 0 0 0.0 1000.0 ECU_ADDRESS 0x4000E714 /* @ECU_Address@EOP_CanPFu@ */ /end MEASUREMENT
/begin MEASUREMENT EOP_CanPercLoadAtCurrentSpd "SPN 92 - Engine Percent Load At Current Speed" FLOAT32_IEEE EcuIntgdSwGend_CM_single__ 0 0 0.0 250.0 ECU_ADDRESS 0x4000E824 /* @ECU_Address@EOP_CanPercLoadAtCurrentSpd@ */ /end MEASUREMENT
/begin MEASUREMENT EOP_CanAccrPedlPosn1 "SPN 91 - Accelerator Pedal Position 1" FLOAT32_IEEE EcuIntgdSwGend_CM_single__ 0 0 0.0 100.0 ECU_ADDRESS 0x4000DCBC /* @ECU_Address@EOP_CanAccrPedlPosn1@ */ /end MEASUREMENT
/begin MEASUREMENT EOP_CanActEngPercTq "SPN 513 - Actual Engine Percent Torque" FLOAT32_IEEE EcuIntgdSwGend_CM_single__ 0 0 0.0 125.0 ECU_ADDRESS 0x4000DAA0 /* @ECU_Address@EOP_CanActEngPercTq@ */ /end MEASUREMENT
/begin MEASUREMENT EOP_CanEngTqMod "SPN 899 - Engine Torque Mode" FLOAT32_IEEE EcuIntgdSwGend_CM_single 0 0 0.0 15.0 ECU_ADDRESS 0x4000D8E4 /* @ECU_Address@EOP_CanEngTqMod@ */ /end MEASUREMENT
/begin MEASUREMENT EOP_CanWhlBasVehSpd "SPN 84 - Wheel-Based Vehicle Speed" FLOAT32_IEEE EcuIntgdSwGend_CM_single_km_h 0 0 0.0 250.0 ECU_ADDRESS 0x4000DCFC /* @ECU_Address@EOP_CanWhlBasVehSpd@ */ /end MEASUREMENT
/begin MEASUREMENT EOP_CanRefEngBrkTq "SPN 556 - Reference Retarder Torque" FLOAT32_IEEE EcuIntgdSwGend_CM_single_N_m 0 0 0.0 5000.0 ECU_ADDRESS 0x4000DEE0 /* @ECU_Address@EOP_CanRefEngBrkTq@ */ /end MEASUREMENT
/begin MEASUREMENT EOP_CanEngRefTq "SPN 544 - Engine Reference Torque" FLOAT32_IEEE EcuIntgdSwGend_CM_single_N_m 0 0 0.0 64255.0 ECU_ADDRESS 0x4000E2B4 /* @ECU_Address@EOP_CanEngRefTq@ */ /end MEASUREMENT
/begin MEASUREMENT EOP_CanEngPercTqPoint5 "SPN 539 - Engine Percent Torque Point 5" FLOAT32_IEEE EcuIntgdSwGend_CM_single__ 0 0 0.0 125.0 ECU_ADDRESS 0x4000E664 /* @ECU_Address@EOP_CanEngPercTqPoint5@ */ /end MEASUREMENT
/begin MEASUREMENT EOP_CanEngPercTqPoint4 "SPN 539 - Engine Percent Torque Point 4" FLOAT32_IEEE EcuIntgdSwGend_CM_single__ 0 0 0.0 125.0 ECU_ADDRESS 0x4000E19C /* @ECU_Address@EOP_CanEngPercTqPoint4@ */ /end MEASUREMENT
/begin MEASUREMENT EOP_CanEngPercTqPoint3 "SPN 539 - Engine Percent Torque Point 3" FLOAT32_IEEE EcuIntgdSwGend_CM_single__ 0 0 0.0 125.0 ECU_ADDRESS 0x4000E198 /* @ECU_Address@EOP_CanEngPercTqPoint3@ */ /end MEASUREMENT
/begin MEASUREMENT EOP_CanEngPercTqPoint2 "SPN 539 - Engine Percent Torque Point 2" FLOAT32_IEEE EcuIntgdSwGend_CM_single__ 0 0 0.0 125.0 ECU_ADDRESS 0x4000E194 /* @ECU_Address@EOP_CanEngPercTqPoint2@ */ /end MEASUREMENT
/begin MEASUREMENT EOP_CanEngPercTqPoint1 "SPN 539 - Engine Percent Torque Point 1" FLOAT32_IEEE EcuIntgdSwGend_CM_single__ 0 0 0.0 125.0 ECU_ADDRESS 0x4000E190 /* @ECU_Address@EOP_CanEngPercTqPoint1@ */ /end MEASUREMENT
/begin MEASUREMENT EOP_CanEngSpdPoint7 "SPN 533 - Engine Speed Point 7" FLOAT32_IEEE EcuIntgdSwGend_CM_single_rpm 0 0 0.0 8031.0 ECU_ADDRESS 0x4000D88C /* @ECU_Address@EOP_CanEngSpdPoint7@ */ /end MEASUREMENT
/begin MEASUREMENT EOP_CanEngSpdPoint6 "SPN 532 - Engine Speed Point 6" FLOAT32_IEEE EcuIntgdSwGend_CM_single_rpm 0 0 0.0 8031.0 ECU_ADDRESS 0x4000E324 /* @ECU_Address@EOP_CanEngSpdPoint6@ */ /end MEASUREMENT
/begin MEASUREMENT EOP_CanEngSpdPoint5 "SPN 531 - Engine Speed Point 5" FLOAT32_IEEE EcuIntgdSwGend_CM_single_rpm 0 0 0.0 8031.0 ECU_ADDRESS 0x4000E320 /* @ECU_Address@EOP_CanEngSpdPoint5@ */ /end MEASUREMENT
/begin MEASUREMENT EOP_CanEngSpdPoint4 "SPN 530 - Engine Speed Point 4" FLOAT32_IEEE EcuIntgdSwGend_CM_single_rpm 0 0 0.0 8031.0 ECU_ADDRESS 0x4000E564 /* @ECU_Address@EOP_CanEngSpdPoint4@ */ /end MEASUREMENT
/begin MEASUREMENT EOP_CanEngSpdPoint3 "SPN 529 - Engine Speed Point 3" FLOAT32_IEEE EcuIntgdSwGend_CM_single_rpm 0 0 0.0 8031.0 ECU_ADDRESS 0x4000E560 /* @ECU_Address@EOP_CanEngSpdPoint3@ */ /end MEASUREMENT
/begin MEASUREMENT EOP_CanEngSpdPoint2 "SPN 528 - Engine Speed Point 2" FLOAT32_IEEE EcuIntgdSwGend_CM_single_rpm 0 0 0.0 8031.0 ECU_ADDRESS 0x4000E318 /* @ECU_Address@EOP_CanEngSpdPoint2@ */ /end MEASUREMENT
/begin MEASUREMENT EOP_CanActEngBrkPercTq "SPN 520 - Actual Retarder - Percent Torque" FLOAT32_IEEE EcuIntgdSwGend_CM_single__ 0 0 -125.0 125.0 ECU_ADDRESS 0x4000E36C /* @ECU_Address@EOP_CanActEngBrkPercTq@ */ /end MEASUREMENT
/begin MEASUREMENT EOP_CanNomFricPercTq "SPN 514 - Nominal Friction - Percent Torque" FLOAT32_IEEE EcuIntgdSwGend_CM_single__ 0 0 0.0 100.0 ECU_ADDRESS 0x4000E804 /* @ECU_Address@EOP_CanNomFricPercTq@ */ /end MEASUREMENT
/begin MEASUREMENT EOP_CanDrvrDmdPercTq "SPN 512 - Driver Demand Percent Torque" FLOAT32_IEEE EcuIntgdSwGend_CM_single__ 0 0 0.0 125.0 ECU_ADDRESS 0x4000E44C /* @ECU_Address@EOP_CanDrvrDmdPercTq@ */ /end MEASUREMENT
/begin MEASUREMENT EOP_CanEngParasiticLoss "SPN 2978 - Estimated Engine Parasitic Losses" FLOAT32_IEEE EcuIntgdSwGend_CM_single__ 0 0 0.0 255.0 ECU_ADDRESS 0x4000DEC8 /* @ECU_Address@EOP_CanEngParasiticLoss@ */ /end MEASUREMENT
/begin MEASUREMENT EOP_CanEngTotFuQnty "SPN 250 - Engine Total Fuel Used" FLOAT32_IEEE EcuIntgdSwGend_CM_single_L 0 0 0.0 2.105540608E+9 ECU_ADDRESS 0x4000E3A8 /* @ECU_Address@EOP_CanEngTotFuQnty@ */ /end MEASUREMENT
/begin MEASUREMENT EOP_CanEngHr "SPN 247 - Engine Total Hours of Operation" FLOAT32_IEEE EcuIntgdSwGend_CM_single_h 0 0 0.0 2.10554061E+8 ECU_ADDRESS 0x4000E3A0 /* @ECU_Address@EOP_CanEngHr@ */ /end MEASUREMENT
/begin MEASUREMENT EOP_CanEngDmdPercTq "SPN 2432 - Engine Demand Percent Torque" FLOAT32_IEEE EcuIntgdSwGend_CM_single__ 0 0 0.0 125.0 ECU_ADDRESS 0x4000DD20 /* @ECU_Address@EOP_CanEngDmdPercTq@ */ /end MEASUREMENT
/begin MEASUREMENT EOP_CanEngSpd "SPN 190 - Engine Speed" FLOAT32_IEEE EcuIntgdSwGend_CM_single_rpm 0 0 0.0 8032.0 ECU_ADDRESS 0x4000E42C /* @ECU_Address@EOP_CanEngSpd@ */ /end MEASUREMENT
/begin MEASUREMENT EOP_CanEngRatedSpd "SPN 189 - Engine Rated Speed" FLOAT32_IEEE EcuIntgdSwGend_CM_single_rpm 0 0 0.0 8032.0 ECU_ADDRESS 0x4000E004 /* @ECU_Address@EOP_CanEngRatedSpd@ */ /end MEASUREMENT
/begin MEASUREMENT EOP_CanEngSpdPoint1 "SPN 188 - Engine Speed Point 1" FLOAT32_IEEE EcuIntgdSwGend_CM_single_rpm 0 0 0.0 8031.0 ECU_ADDRESS 0x4000E314 /* @ECU_Address@EOP_CanEngSpdPoint1@ */ /end MEASUREMENT
/begin MEASUREMENT EOP_CanEngDftTqLim "SPN 1846 - Engine Default Torque Limit" FLOAT32_IEEE EcuIntgdSwGend_CM_single_N_m 0 0 0.0 64255.0 ECU_ADDRESS 0x4000D878 /* @ECU_Address@EOP_CanEngDftTqLim@ */ /end MEASUREMENT
/begin MEASUREMENT EOP_CanEngFuRate "SPN 183 - Engine Fuel Rate" FLOAT32_IEEE EcuIntgdSwGend_CM_single_L_h 0 0 0.0 3213.0 ECU_ADDRESS 0x4000D828 /* @ECU_Address@EOP_CanEngFuRate@ */ /end MEASUREMENT
/begin MEASUREMENT EOP_CanTOil "SPN 175 - Engine Oil Temperature" FLOAT32_IEEE EcuIntgdSwGend_CM_single_degC 0 0 -273.0 1735.0 ECU_ADDRESS 0x4000E030 /* @ECU_Address@EOP_CanTOil@ */ /end MEASUREMENT
/begin MEASUREMENT EOP_CanTFu "SPN 174 - Engine Fuel Temperature" FLOAT32_IEEE EcuIntgdSwGend_CM_single_degC 0 0 -40.0 210.0 ECU_ADDRESS 0x4000E978 /* @ECU_Address@EOP_CanTFu@ */ /end MEASUREMENT
/begin MEASUREMENT EOP_CanActMaxAvlEngBrkPercTq "SPN 1717 - Actual Maximum Available Retarder - Percent Torque" FLOAT32_IEEE EcuIntgdSwGend_CM_single__ 0 0 -125.0 125.0 ECU_ADDRESS 0x4000E66C /* @ECU_Address@EOP_CanActMaxAvlEngBrkPercTq@ */ /end MEASUREMENT
/begin MEASUREMENT EOP_CanDrvrDmdEngBrkPercTq "SPN 1715 - Drivers Demand Retarder - Percent Torque" FLOAT32_IEEE EcuIntgdSwGend_CM_single__ 0 0 -125.0 125.0 ECU_ADDRESS 0x4000E29C /* @ECU_Address@EOP_CanDrvrDmdEngBrkPercTq@ */ /end MEASUREMENT
/begin MEASUREMENT EOP_CanTAmbAir "SPN 171 - Ambient Air Temperature" FLOAT32_IEEE EcuIntgdSwGend_CM_single_degC 0 0 -40.0 250.0 ECU_ADDRESS 0x4000E45C /* @ECU_Address@EOP_CanTAmbAir@ */ /end MEASUREMENT
/begin MEASUREMENT EOP_CanBattVolt1 "SPN 168 - Battery Potential - Power Input 1" FLOAT32_IEEE EcuIntgdSwGend_CM_single_V 0 0 0.0 3213.0 ECU_ADDRESS 0x4000DD1C /* @ECU_Address@EOP_CanBattVolt1@ */ /end MEASUREMENT
/begin MEASUREMENT EOP_CanEngRatedPwr "SPN 166 - Engine Rated Power" FLOAT32_IEEE EcuIntgdSwGend_CM_single_kW 0 0 0.0 32128.0 ECU_ADDRESS 0x4000E010 /* @ECU_Address@EOP_CanEngRatedPwr@ */ /end MEASUREMENT
/begin MEASUREMENT EOP_CanTCoolt "SPN 1637 - Engine Coolant Temperature (High Resolution)" FLOAT32_IEEE EcuIntgdSwGend_CM_single_degC 0 0 -273.0 1735.0 ECU_ADDRESS 0x4000E5C4 /* @ECU_Address@EOP_CanTCoolt@ */ /end MEASUREMENT
/begin MEASUREMENT EOP_CanTAirBoost "SPN 105 - Engine Intake Manifold 1 Temperature" FLOAT32_IEEE EcuIntgdSwGend_CM_single_degC 0 0 -40.0 210.0 ECU_ADDRESS 0x4000E228 /* @ECU_Address@EOP_CanTAirBoost@ */ /end MEASUREMENT
/begin MEASUREMENT EOP_CanTAirBoostHiResl "SPN 1636 - Engine Intake Manifold 1 Temperature (High Resolution)" FLOAT32_IEEE EcuIntgdSwGend_CM_single_degC 0 0 -273.0 1735.0 ECU_ADDRESS 0x4000DBF0 /* @ECU_Address@EOP_CanTAirBoostHiResl@ */ /end MEASUREMENT
/begin MEASUREMENT EOP_CanPRail "SPN 157 - Engine Injector Metering Rail 1 Pressure" FLOAT32_IEEE EcuIntgdSwGend_CM_single_MPa 0 0 0.0 251.0 ECU_ADDRESS 0x4000E2A0 /* @ECU_Address@EOP_CanPRail@ */ /end MEASUREMENT
/begin MEASUREMENT EOP_CanSoiMaiInj "SPN1436 - Engine Actual Ignition Timing" FLOAT32_IEEE EcuIntgdSwGend_CM_single_deg 0 0 -200.0 302.0 ECU_ADDRESS 0x4000E420 /* @ECU_Address@EOP_CanSoiMaiInj@ */ /end MEASUREMENT
/begin MEASUREMENT EOP_CanPosOfWg1 "SPN 1188 - Engine Turbocharger Wastegate Actuator 1 Position" FLOAT32_IEEE EcuIntgdSwGend_CM_single__ 0 0 0.0 100.0 ECU_ADDRESS 0x4000DC14 /* @ECU_Address@EOP_CanPosOfWg1@ */ /end MEASUREMENT
/begin MEASUREMENT EOP_CanTEcu "SPN 1136 - Engine ECU Temperature" FLOAT32_IEEE EcuIntgdSwGend_CM_single_degC 0 0 -273.0 1735.0 ECU_ADDRESS 0x4000E5F4 /* @ECU_Address@EOP_CanTEcu@ */ /end MEASUREMENT
/begin MEASUREMENT EOP_CanPBaro "SPN 108 - Barometric Pressure" FLOAT32_IEEE EcuIntgdSwGend_CM_single_kPa 0 0 0.0 125.0 ECU_ADDRESS 0x4000E0EC /* @ECU_Address@EOP_CanPBaro@ */ /end MEASUREMENT
/begin MEASUREMENT EOP_CanPAirBoost "SPN 102 - Engine Intake Manifold 1 Pressure" FLOAT32_IEEE EcuIntgdSwGend_CM_single_kPa 0 0 0.0 500.0 ECU_ADDRESS 0x4000DD04 /* @ECU_Address@EOP_CanPAirBoost@ */ /end MEASUREMENT
/begin MEASUREMENT EOP_CanPOil "SPN 100 - Engine Oil Pressure" FLOAT32_IEEE EcuIntgdSwGend_CM_single_kPa 0 0 0.0 1000.0 ECU_ADDRESS 0x4000DEC4 /* @ECU_Address@EOP_CanPOil@ */ /end MEASUREMENT
/begin MEASUREMENT EIP_UClmp30Fild "Filtered Battery Voltage" FLOAT32_IEEE EcuIntgdSwGend_CM_single_V 0 0 0.0 50.0 ECU_ADDRESS 0x4000E8B4 /* @ECU_Address@EIP_UClmp30Fild@ */ /end MEASUREMENT
/begin MEASUREMENT EIP_TiElpdErrUClmp30 "Elapsed Time for Error Battery Voltage Sensor" FLOAT32_IEEE EcuIntgdSwGend_CM_single_ms 0 0 0.0 250000.0 ECU_ADDRESS 0x4000E7E8 /* @ECU_Address@EIP_TiElpdErrUClmp30@ */ /end MEASUREMENT
/begin MEASUREMENT EIP_VehV "Vehicle Speed" FLOAT32_IEEE EcuIntgdSwGend_CM_single_km_h 0 0 0.0 250.0 ECU_ADDRESS 0x4000DBFC /* @ECU_Address@EIP_VehV@ */ /end MEASUREMENT
/begin MEASUREMENT EIP_PAirBoostGrdtAbsOut "Air Boost Pressure Gradient Absolute Output" FLOAT32_IEEE EcuIntgdSwGend_CM_single_mbar 0 0 0.0 20000.0 ECU_ADDRESS 0x4000E8D8 /* @ECU_Address@EIP_PAirBoostGrdtAbsOut@ */ /end MEASUREMENT
/begin MEASUREMENT EIP_PAmbAirGrdtAbsOut "Ambient Air Pressure Gradient Absolute Output" FLOAT32_IEEE EcuIntgdSwGend_CM_single_mbar 0 0 0.0 20000.0 ECU_ADDRESS 0x4000DF54 /* @ECU_Address@EIP_PAmbAirGrdtAbsOut@ */ /end MEASUREMENT
/begin MEASUREMENT EIP_PRailGrdtAbsOut "Rail Pressure Gradient Absolute Output" FLOAT32_IEEE EcuIntgdSwGend_CM_single_bar 0 0 0.0 20000.0 ECU_ADDRESS 0x4000DC9C /* @ECU_Address@EIP_PRailGrdtAbsOut@ */ /end MEASUREMENT
/begin MEASUREMENT EIP_PFuGrdtAbsOut "Fuel Pressure Gradient Absolute Output" FLOAT32_IEEE EcuIntgdSwGend_CM_single_mbar 0 0 0.0 20000.0 ECU_ADDRESS 0x4000D9E8 /* @ECU_Address@EIP_PFuGrdtAbsOut@ */ /end MEASUREMENT
/begin MEASUREMENT EIP_POilGrdtAbsOut "Oil Pressure Gradient Absolute Output" FLOAT32_IEEE EcuIntgdSwGend_CM_single_mbar 0 0 0.0 20000.0 ECU_ADDRESS 0x4000DBC4 /* @ECU_Address@EIP_POilGrdtAbsOut@ */ /end MEASUREMENT
/begin MEASUREMENT EIP_PercgAccrDiff "Acelerator Pedal Percentage Difference" FLOAT32_IEEE EcuIntgdSwGend_CM_single__ 0 0 -100.0 100.0 ECU_ADDRESS 0x4000E954 /* @ECU_Address@EIP_PercgAccrDiff@ */ /end MEASUREMENT
/begin MEASUREMENT EIP_TAirBoostGrdtAbsOut "Air Boost Temperature Gradient Absolute Output" FLOAT32_IEEE EcuIntgdSwGend_CM_single 0 0 0.0 20000.0 ECU_ADDRESS 0x4000E0BC /* @ECU_Address@EIP_TAirBoostGrdtAbsOut@ */ /end MEASUREMENT
/begin MEASUREMENT EIP_TOilGrdtAbsOut "Oil Temperature Gradient Absolute Output" FLOAT32_IEEE EcuIntgdSwGend_CM_single 0 0 0.0 20000.0 ECU_ADDRESS 0x4000DD60 /* @ECU_Address@EIP_TOilGrdtAbsOut@ */ /end MEASUREMENT
/begin MEASUREMENT EIP_TCooltGrdtAbsOut "Coolant High Temperature Gradient Absolute Output" FLOAT32_IEEE EcuIntgdSwGend_CM_single 0 0 0.0 20000.0 ECU_ADDRESS 0x4000D810 /* @ECU_Address@EIP_TCooltGrdtAbsOut@ */ /end MEASUREMENT
/begin MEASUREMENT EIP_TFuGrdtAbsOut "Fuel Temperature Gradient Absolute Output" FLOAT32_IEEE EcuIntgdSwGend_CM_single 0 0 0.0 20000.0 ECU_ADDRESS 0x4000E914 /* @ECU_Address@EIP_TFuGrdtAbsOut@ */ /end MEASUREMENT
/begin MEASUREMENT EIP_TEcuGrdtAbsOut "Ecu Temperature Gradient Absolute Output" FLOAT32_IEEE EcuIntgdSwGend_CM_single 0 0 0.0 20000.0 ECU_ADDRESS 0x4000DE28 /* @ECU_Address@EIP_TEcuGrdtAbsOut@ */ /end MEASUREMENT
/begin MEASUREMENT EIP_TAmbAirGrdtAbsOut "Ambient Air Temperature Gradient Absolute Output" FLOAT32_IEEE EcuIntgdSwGend_CM_single 0 0 0.0 20000.0 ECU_ADDRESS 0x4000DCDC /* @ECU_Address@EIP_TAmbAirGrdtAbsOut@ */ /end MEASUREMENT
/begin MEASUREMENT EIP_LvlOilGrdtAbsOut "Oil Level Gradient Absolute Output" FLOAT32_IEEE EcuIntgdSwGend_CM_single__ 0 0 0.0 20000.0 ECU_ADDRESS 0x4000E6D4 /* @ECU_Address@EIP_LvlOilGrdtAbsOut@ */ /end MEASUREMENT
/begin MEASUREMENT EIP_TiElpdStrtReqSwt "Elapsed Time for Strart Request Switch" FLOAT32_IEEE EcuIntgdSwGend_CM_single_ms 0 0 0.0 50000.0 ECU_ADDRESS 0x4000D954 /* @ECU_Address@EIP_TiElpdStrtReqSwt@ */ /end MEASUREMENT
/begin MEASUREMENT EIP_TiElpdDecCrsCtrlBtn "Elapsed Time for Decrement Cruise Control Button" FLOAT32_IEEE EcuIntgdSwGend_CM_single_ms 0 0 0.0 50000.0 ECU_ADDRESS 0x4000E784 /* @ECU_Address@EIP_TiElpdDecCrsCtrlBtn@ */ /end MEASUREMENT
/begin MEASUREMENT EIP_TiElpdIncCrsCtrlBtn "Elapsed Time for Cruise Control Button" FLOAT32_IEEE EcuIntgdSwGend_CM_single_ms 0 0 0.0 50000.0 ECU_ADDRESS 0x4000E0C8 /* @ECU_Address@EIP_TiElpdIncCrsCtrlBtn@ */ /end MEASUREMENT
/begin MEASUREMENT EIP_TiElpdHandBrkPrkg "Elapsed Time for Hand Brake Parking" FLOAT32_IEEE EcuIntgdSwGend_CM_single_ms 0 0 0.0 50000.0 ECU_ADDRESS 0x4000E03C /* @ECU_Address@EIP_TiElpdHandBrkPrkg@ */ /end MEASUREMENT
/begin MEASUREMENT EIP_TiElpdEngBrkReq1Btn "Elapsed Time for Engine Brake Require 1 Button" FLOAT32_IEEE EcuIntgdSwGend_CM_single_ms 0 0 0.0 50000.0 ECU_ADDRESS 0x4000D898 /* @ECU_Address@EIP_TiElpdEngBrkReq1Btn@ */ /end MEASUREMENT
/begin MEASUREMENT EIP_TiElpdEngBrkReq2Btn "Elapsed Time for Engine Brake Require 2 Button" FLOAT32_IEEE EcuIntgdSwGend_CM_single_ms 0 0 0.0 50000.0 ECU_ADDRESS 0x4000DE50 /* @ECU_Address@EIP_TiElpdEngBrkReq2Btn@ */ /end MEASUREMENT
/begin MEASUREMENT EIP_TiElpdBrkPedl "Elapsed Time for Brake Pedal" FLOAT32_IEEE EcuIntgdSwGend_CM_single_ms 0 0 0.0 50000.0 ECU_ADDRESS 0x4000E17C /* @ECU_Address@EIP_TiElpdBrkPedl@ */ /end MEASUREMENT
/begin MEASUREMENT EIP_TiElpdIgnSwt "Elapsed Time for Ingnition Switch" FLOAT32_IEEE EcuIntgdSwGend_CM_single_ms 0 0 0.0 50000.0 ECU_ADDRESS 0x4000D850 /* @ECU_Address@EIP_TiElpdIgnSwt@ */ /end MEASUREMENT
/begin MEASUREMENT EIP_TiElpdCrsCtrlOnOffBtn "Elapsed Time for Cruise Control On Off Button" FLOAT32_IEEE EcuIntgdSwGend_CM_single_ms 0 0 0.0 50000.0 ECU_ADDRESS 0x4000D9AC /* @ECU_Address@EIP_TiElpdCrsCtrlOnOffBtn@ */ /end MEASUREMENT
/begin MEASUREMENT EIP_TiElpdAcvCmbtSwt "Elapsed Time for Combat Switch Active" FLOAT32_IEEE EcuIntgdSwGend_CM_single_ms 0 0 0.0 250000.0 ECU_ADDRESS 0x4000E150 /* @ECU_Address@EIP_TiElpdAcvCmbtSwt@ */ /end MEASUREMENT
/begin MEASUREMENT EIP_TiElpdSpdLimrOnOffBtn "Elapsed Time of Speed Limiter Of Button Debouncer" FLOAT32_IEEE EcuIntgdSwGend_CM_single_ms 0 0 0.0 10000.0 ECU_ADDRESS 0x4000E3B0 /* @ECU_Address@EIP_TiElpdSpdLimrOnOffBtn@ */ /end MEASUREMENT
/begin MEASUREMENT EOP_CanCrsCtrlSetSpd "SPN 86 - Cruise Control Set Speed" SWORD EcuIntgdSwGend_CM_int16_km_h 0 0 0.0 250.0 ECU_ADDRESS 0x4000D830 /* @ECU_Address@EOP_CanCrsCtrlSetSpd@ */ /end MEASUREMENT
/begin MEASUREMENT EIP_VehVFromGear "Vehicle Speed From Gear" SWORD EcuIntgdSwGend_CM_int16_km_h 0 0 0.0 250.0 ECU_ADDRESS 0x4000E47A /* @ECU_Address@EIP_VehVFromGear@ */ /end MEASUREMENT
/begin MEASUREMENT EIP_VehVSelnFromInpSrc1 "Velocity Selection From Input Source 1" SWORD EcuIntgdSwGend_CM_int16_km_h 0 0 0.0 250.0 ECU_ADDRESS 0x4000DED0 /* @ECU_Address@EIP_VehVSelnFromInpSrc1@ */ /end MEASUREMENT
/begin MEASUREMENT EIP_VehVSelnFromInpSrc2 "Velocity Selection From Input Source 2" SWORD EcuIntgdSwGend_CM_int16_km_h 0 0 0.0 250.0 ECU_ADDRESS 0x4000DD84 /* @ECU_Address@EIP_VehVSelnFromInpSrc2@ */ /end MEASUREMENT
/begin MEASUREMENT EIP_VehVFromSrc1AndSrc2 "Vehicle Speed From Source 1 and Source 2" SWORD EcuIntgdSwGend_CM_int16_km_h 0 0 0.0 250.0 ECU_ADDRESS 0x4000E202 /* @ECU_Address@EIP_VehVFromSrc1AndSrc2@ */ /end MEASUREMENT
/begin MEASUREMENT EIP_VehVRaw "Vehicle Speed Raw Value" SWORD EcuIntgdSwGend_CM_int16_km_h 0 0 0.0 250.0 ECU_ADDRESS 0x4000DBDC /* @ECU_Address@EIP_VehVRaw@ */ /end MEASUREMENT
/begin MEASUREMENT EOP_CanWtrInFu "SPN 97 - Water In Fuel Indicator" UBYTE EcuIntgdSwGend_CM_uint8 0 0 0.0 3.0 ECU_ADDRESS 0x4000E8FC /* @ECU_Address@EOP_CanWtrInFu@ */ /end MEASUREMENT
/begin MEASUREMENT EOP_CanAccrPedl1LoIdleSwt "SPN 558 - Accelerator Pedal 1 Low Idle Switch" UBYTE EcuIntgdSwGend_CM_uint8 0 0 0.0 4.0 ECU_ADDRESS 0x4000E008 /* @ECU_Address@EOP_CanAccrPedl1LoIdleSwt@ */ /end MEASUREMENT
/begin MEASUREMENT EOP_CanColdStrtLamp "SPN 1081 - Engine Wait to Start Lamp" UBYTE EcuIntgdSwGend_CM_uint8 0 0 0.0 3.0 ECU_ADDRESS 0x4000DC80 /* @ECU_Address@EOP_CanColdStrtLamp@ */ /end MEASUREMENT
/begin MEASUREMENT EOP_CanEngSt "SPN 3543 - Engine Operating State" UBYTE EcuIntgdSwGend_CM_uint8 0 0 0.0 15.0 ECU_ADDRESS 0x4000E8CC /* @ECU_Address@EOP_CanEngSt@ */ /end MEASUREMENT
/begin MEASUREMENT EOP_CanActEngPercTqHiResl "SPN 4154 - Actual Engine Percent Torque High Resolution" UBYTE EcuIntgdSwGend_CM_uint8 0 0 0.0 7.0 ECU_ADDRESS 0x4000DB88 /* @ECU_Address@EOP_CanActEngPercTqHiResl@ */ /end MEASUREMENT
/begin MEASUREMENT EOP_CanEngAmberWarnLampCmd "SPN 5078 - Engine Amber Warning Lamp Command" UBYTE EcuIntgdSwGend_CM_uint8 0 0 0.0 3.0 ECU_ADDRESS 0x4000DC23 /* @ECU_Address@EOP_CanEngAmberWarnLampCmd@ */ /end MEASUREMENT
/begin MEASUREMENT EOP_CanEngRedStopLampCmd "SPN 5079 - Engine Red Stop Lamp Command" UBYTE EcuIntgdSwGend_CM_uint8 0 0 0.0 3.0 ECU_ADDRESS 0x4000DB1E /* @ECU_Address@EOP_CanEngRedStopLampCmd@ */ /end MEASUREMENT
/begin MEASUREMENT EOP_CanCrsCtrlSt "SPN 527 - Cruise Control State" UBYTE EcuIntgdSwGend_CM_uint8 0 0 0.0 7.0 ECU_ADDRESS 0x4000E402 /* @ECU_Address@EOP_CanCrsCtrlSt@ */ /end MEASUREMENT
/begin MEASUREMENT EOP_CanEngBrkActvdLampCmd "SPN 5081 -  Engine Brake Active Lamp Command" UBYTE EcuIntgdSwGend_CM_uint8 0 0 0.0 3.0 ECU_ADDRESS 0x4000E87E /* @ECU_Address@EOP_CanEngBrkActvdLampCmd@ */ /end MEASUREMENT
/begin MEASUREMENT EOP_CanVehAccrRateLimSts "SPN 2979 - Vehicle Acceleration Rate Limit Status" UBYTE EcuIntgdSwGend_CM_uint8 0 0 0.0 3.0 ECU_ADDRESS 0x4000DAC0 /* @ECU_Address@EOP_CanVehAccrRateLimSts@ */ /end MEASUREMENT
/begin MEASUREMENT EIP_CanEngPtoGovrSetSwt "CAN Pto Governor - Set Switch" UBYTE EcuIntgdSwGend_CM_uint8 0 0 0.0 3.0 ECU_ADDRESS 0x4000DF04 /* @ECU_Address@EIP_CanEngPtoGovrSetSwt@ */ /end MEASUREMENT
/begin MEASUREMENT EIP_CanEngPtoGovrCoastSwt "CAN Pto Governor - Coast Switch" UBYTE EcuIntgdSwGend_CM_uint8 0 0 0.0 3.0 ECU_ADDRESS 0x4000E2AE /* @ECU_Address@EIP_CanEngPtoGovrCoastSwt@ */ /end MEASUREMENT
/begin MEASUREMENT EIP_CanEngPtoGovrResuSwt "CAN Pto Governor - Resume Switch" UBYTE EcuIntgdSwGend_CM_uint8 0 0 0.0 3.0 ECU_ADDRESS 0x4000E3BE /* @ECU_Address@EIP_CanEngPtoGovrResuSwt@ */ /end MEASUREMENT
/begin MEASUREMENT EIP_CanEngPtoGovrAccrSwt "CAN Pto Governor - Accelerator Switch" UBYTE EcuIntgdSwGend_CM_uint8 0 0 0.0 3.0 ECU_ADDRESS 0x4000E823 /* @ECU_Address@EIP_CanEngPtoGovrAccrSwt@ */ /end MEASUREMENT
/begin MEASUREMENT EOP_CanPTOGovrSt "SPN 976 - PTO Governor State" SBYTE EcuIntgdSwGend_CM_int8 0 0 0.0 31.0 ECU_ADDRESS 0x4000E171 /* @ECU_Address@EOP_CanPTOGovrSt@ */ /end MEASUREMENT
/begin MEASUREMENT EOP_CanCrsCtrlActv "SPN 595 - Cruise Control Active" SBYTE EcuIntgdSwGend_CM_int8 0 0 0.0 3.0 ECU_ADDRESS 0x4000E179 /* @ECU_Address@EOP_CanCrsCtrlActv@ */ /end MEASUREMENT
/begin MEASUREMENT EOP_CanHndBrkPrkg "SPN 70 - Parking Brake Switch" SBYTE EcuIntgdSwGend_CM_int8 0 0 0.0 3.0 ECU_ADDRESS 0x4000D9F6 /* @ECU_Address@EOP_CanHndBrkPrkg@ */ /end MEASUREMENT
/begin MEASUREMENT EOP_CanCrsCtrlSetSwt "SPN 599 - Cruise Control Set Switch" SBYTE EcuIntgdSwGend_CM_int8 0 0 0.0 3.0 ECU_ADDRESS 0x4000DFB5 /* @ECU_Address@EOP_CanCrsCtrlSetSwt@ */ /end MEASUREMENT
/begin MEASUREMENT EOP_CanCrsCtrlIncSwt "SPN 602 - Cruise Control Accelerate Switch" SBYTE EcuIntgdSwGend_CM_int8 0 0 0.0 3.0 ECU_ADDRESS 0x4000DE11 /* @ECU_Address@EOP_CanCrsCtrlIncSwt@ */ /end MEASUREMENT
/begin MEASUREMENT EOP_CanCrsCtrlDecSwt "SPN 600 - Cruise Control Coast (Decelerate) Switch" SBYTE EcuIntgdSwGend_CM_int8 0 0 0.0 3.0 ECU_ADDRESS 0x4000E958 /* @ECU_Address@EOP_CanCrsCtrlDecSwt@ */ /end MEASUREMENT
/begin MEASUREMENT EOP_CanCrsCtrlResSwt "SPN 601 - Cruise Control Resume Switch" SBYTE EcuIntgdSwGend_CM_int8 0 0 0.0 3.0 ECU_ADDRESS 0x4000DDD8 /* @ECU_Address@EOP_CanCrsCtrlResSwt@ */ /end MEASUREMENT
/begin MEASUREMENT EOP_CanBrkSwt "SPN 597 - Brake Switch" SBYTE EcuIntgdSwGend_CM_int8 0 0 0.0 3.0 ECU_ADDRESS 0x4000DB69 /* @ECU_Address@EOP_CanBrkSwt@ */ /end MEASUREMENT
/begin MEASUREMENT EOP_CanCrsCtrlEnaSwt "SPN 596 - Cruise Control Enable Switch" SBYTE EcuIntgdSwGend_CM_int8 0 0 0.0 3.0 ECU_ADDRESS 0x4000DBCC /* @ECU_Address@EOP_CanCrsCtrlEnaSwt@ */ /end MEASUREMENT
/begin MEASUREMENT EOP_CanEngStrtrMod "SPN 1675 - Engine Starter Mode" SBYTE EcuIntgdSwGend_CM_int8 0 0 0.0 15.0 ECU_ADDRESS 0x4000E2CD /* @ECU_Address@EOP_CanEngStrtrMod@ */ /end MEASUREMENT
/begin MEASUREMENT EOP_CanEngShtdwnOvrdSwt "SPN 1237 - Engine Shutdown Override Switch" SBYTE EcuIntgdSwGend_CM_int8 0 0 0.0 3.0 ECU_ADDRESS 0x4000DC40 /* @ECU_Address@EOP_CanEngShtdwnOvrdSwt@ */ /end MEASUREMENT
/begin MEASUREMENT EOP_CanAmberWarnLamp "SPN 624 - Amber Warning Lamp" UBYTE EcuIntgdSwGend_CM_boolean 0 0 0.0 1.0 ECU_ADDRESS 0x4000D8DC /* @ECU_Address@EOP_CanAmberWarnLamp@ */ /end MEASUREMENT
/begin MEASUREMENT EOP_CanRedStopLamp "SPN 623 - Red Stop Lamp" UBYTE EcuIntgdSwGend_CM_boolean 0 0 0.0 1.0 ECU_ADDRESS 0x4000DB1D /* @ECU_Address@EOP_CanRedStopLamp@ */ /end MEASUREMENT
/begin MEASUREMENT EIP_InjrCfg "Injector Configuration Signal" UBYTE EcuIntgdSwGend_CM_boolean 0 0 0.0 1.0 ECU_ADDRESS 0x4000E430 /* @ECU_Address@EIP_InjrCfg@ */ /end MEASUREMENT
/begin MEASUREMENT EIP_WgCfg "Wastegate Configuration Signal" UBYTE EcuIntgdSwGend_CM_boolean 0 0 0.0 1.0 ECU_ADDRESS 0x4000E26C /* @ECU_Address@EIP_WgCfg@ */ /end MEASUREMENT
/begin MEASUREMENT EIP_EngBrkCfg "Engine Brake Configuration" UBYTE EcuIntgdSwGend_CM_boolean 0 0 0.0 1.0 ECU_ADDRESS 0x4000DA69 /* @ECU_Address@EIP_EngBrkCfg@ */ /end MEASUREMENT
/begin MEASUREMENT EIP_EngBrkLvlCfg "Engine Brake Level Configration" UBYTE EcuIntgdSwGend_CM_boolean 0 0 0.0 1.0 ECU_ADDRESS 0x4000E33B /* @ECU_Address@EIP_EngBrkLvlCfg@ */ /end MEASUREMENT
/begin MEASUREMENT EIP_StOfVehVSelnFromInpSrc1 "State of Velocity Selection From Input Source 1" UBYTE EcuIntgdSwGend_CM_boolean 0 0 0.0 1.0 ECU_ADDRESS 0x4000E2BC /* @ECU_Address@EIP_StOfVehVSelnFromInpSrc1@ */ /end MEASUREMENT
/begin MEASUREMENT EIP_StOfVehVSelnFromInpSrc2 "State of Velocity Selection From Input Source 2" UBYTE EcuIntgdSwGend_CM_boolean 0 0 0.0 1.0 ECU_ADDRESS 0x4000DFFD /* @ECU_Address@EIP_StOfVehVSelnFromInpSrc2@ */ /end MEASUREMENT
/begin MEASUREMENT EIP_bErrVehV "Vehicle Speed Error" UBYTE EcuIntgdSwGend_CM_boolean 0 0 0.0 1.0 ECU_ADDRESS 0x4000DC5D /* @ECU_Address@EIP_bErrVehV@ */ /end MEASUREMENT
/begin MEASUREMENT EIP_bErrPAirBoostRng "Error Air Boost Pressure Range" UBYTE EcuIntgdSwGend_CM_boolean 0 0 0.0 1.0 ECU_ADDRESS 0x4000E31C /* @ECU_Address@EIP_bErrPAirBoostRng@ */ /end MEASUREMENT
/begin MEASUREMENT EIP_bErrPAirBoostGrdt "Error Air Boost Pressure Gradient" UBYTE EcuIntgdSwGend_CM_boolean 0 0 0.0 1.0 ECU_ADDRESS 0x4000DB80 /* @ECU_Address@EIP_bErrPAirBoostGrdt@ */ /end MEASUREMENT
/begin MEASUREMENT EIP_bErrPAirBoostSnsr "Error Air Boost Pressure Sensor" UBYTE EcuIntgdSwGend_CM_boolean 0 0 0.0 1.0 ECU_ADDRESS 0x4000E874 /* @ECU_Address@EIP_bErrPAirBoostSnsr@ */ /end MEASUREMENT
/begin MEASUREMENT EIP_bErrPAmbAirRng "Error Ambient Air Pressure Range" UBYTE EcuIntgdSwGend_CM_boolean 0 0 0.0 1.0 ECU_ADDRESS 0x4000DC6C /* @ECU_Address@EIP_bErrPAmbAirRng@ */ /end MEASUREMENT
/begin MEASUREMENT EIP_bErrPAmbAirGrdt "Error Ambient Air Pressure Gradient" UBYTE EcuIntgdSwGend_CM_boolean 0 0 0.0 1.0 ECU_ADDRESS 0x4000E338 /* @ECU_Address@EIP_bErrPAmbAirGrdt@ */ /end MEASUREMENT
/begin MEASUREMENT EIP_bErrPAmbAirSnsr "Error Ambient Air Pressure Sensor" UBYTE EcuIntgdSwGend_CM_boolean 0 0 0.0 1.0 ECU_ADDRESS 0x4000DEB6 /* @ECU_Address@EIP_bErrPAmbAirSnsr@ */ /end MEASUREMENT
/begin MEASUREMENT EIP_bErrPRailRng "Error Rail Pressure Range" UBYTE EcuIntgdSwGend_CM_boolean 0 0 0.0 1.0 ECU_ADDRESS 0x4000E704 /* @ECU_Address@EIP_bErrPRailRng@ */ /end MEASUREMENT
/begin MEASUREMENT EIP_bErrPRailGrdt "Error Rail Pressure Gradient" UBYTE EcuIntgdSwGend_CM_boolean 0 0 0.0 1.0 ECU_ADDRESS 0x4000DEAC /* @ECU_Address@EIP_bErrPRailGrdt@ */ /end MEASUREMENT
/begin MEASUREMENT EIP_bErrPFuRng "Error Fuel Pressure Range" UBYTE EcuIntgdSwGend_CM_boolean 0 0 0.0 1.0 ECU_ADDRESS 0x4000DB78 /* @ECU_Address@EIP_bErrPFuRng@ */ /end MEASUREMENT
/begin MEASUREMENT EIP_bErrPFuGrdt "Error Fuel Pressure Gradient" UBYTE EcuIntgdSwGend_CM_boolean 0 0 0.0 1.0 ECU_ADDRESS 0x4000DF84 /* @ECU_Address@EIP_bErrPFuGrdt@ */ /end MEASUREMENT
/begin MEASUREMENT EIP_bErrPOilRng "Error Oil Pressure Range" UBYTE EcuIntgdSwGend_CM_boolean 0 0 0.0 1.0 ECU_ADDRESS 0x4000DE94 /* @ECU_Address@EIP_bErrPOilRng@ */ /end MEASUREMENT
/begin MEASUREMENT EIP_bErrPOilGrdt "Error Oil Pressure Gradient" UBYTE EcuIntgdSwGend_CM_boolean 0 0 0.0 1.0 ECU_ADDRESS 0x4000E200 /* @ECU_Address@EIP_bErrPOilGrdt@ */ /end MEASUREMENT
/begin MEASUREMENT EIP_bErrPOilSnsr "Error Oil Pressure Sensor" UBYTE EcuIntgdSwGend_CM_boolean 0 0 0.0 1.0 ECU_ADDRESS 0x4000DE10 /* @ECU_Address@EIP_bErrPOilSnsr@ */ /end MEASUREMENT
/begin MEASUREMENT EIP_bErrPFuSnsr "Error Fuel Pressure Sensor" UBYTE EcuIntgdSwGend_CM_boolean 0 0 0.0 1.0 ECU_ADDRESS 0x4000DB24 /* @ECU_Address@EIP_bErrPFuSnsr@ */ /end MEASUREMENT
/begin MEASUREMENT EIP_bErrPRailSnsr "Error Rail Pressure Sensor" UBYTE EcuIntgdSwGend_CM_boolean 0 0 0.0 1.0 ECU_ADDRESS 0x4000DA08 /* @ECU_Address@EIP_bErrPRailSnsr@ */ /end MEASUREMENT
/begin MEASUREMENT EIP_bErrAccr2Oor "Error Accelerator 2 Out of Range" UBYTE EcuIntgdSwGend_CM_boolean 0 0 0.0 1.0 ECU_ADDRESS 0x4000DA68 /* @ECU_Address@EIP_bErrAccr2Oor@ */ /end MEASUREMENT
/begin MEASUREMENT EIP_bErrAccr1Oor "Error Accelerator 1 Out of Range" UBYTE EcuIntgdSwGend_CM_boolean 0 0 0.0 1.0 ECU_ADDRESS 0x4000E2C4 /* @ECU_Address@EIP_bErrAccr1Oor@ */ /end MEASUREMENT
/begin MEASUREMENT EIP_bErrAccr1 "Error Accelerator 1" UBYTE EcuIntgdSwGend_CM_boolean 0 0 0.0 1.0 ECU_ADDRESS 0x4000DB30 /* @ECU_Address@EIP_bErrAccr1@ */ /end MEASUREMENT
/begin MEASUREMENT EIP_bErrAccr2 "Error Accelerator 2" UBYTE EcuIntgdSwGend_CM_boolean 0 0 0.0 1.0 ECU_ADDRESS 0x4000DB31 /* @ECU_Address@EIP_bErrAccr2@ */ /end MEASUREMENT
/begin MEASUREMENT EIP_bErrAccrRedncy "Error Accelerator Redundancy" UBYTE EcuIntgdSwGend_CM_boolean 0 0 0.0 1.0 ECU_ADDRESS 0x4000E06C /* @ECU_Address@EIP_bErrAccrRedncy@ */ /end MEASUREMENT
/begin MEASUREMENT EIP_bErrAccrTotLoss "Error Accelerator Total Loss " UBYTE EcuIntgdSwGend_CM_boolean 0 0 0.0 1.0 ECU_ADDRESS 0x4000E720 /* @ECU_Address@EIP_bErrAccrTotLoss@ */ /end MEASUREMENT
/begin MEASUREMENT EIP_bPercgAccrDiffDetn "Acceleartor Percentage Difference Detection" UBYTE EcuIntgdSwGend_CM_boolean 0 0 0.0 1.0 ECU_ADDRESS 0x4000E0F3 /* @ECU_Address@EIP_bPercgAccrDiffDetn@ */ /end MEASUREMENT
/begin MEASUREMENT EIP_bErrAccrDervDiff "Error Accelerator Derivative Difference" UBYTE EcuIntgdSwGend_CM_boolean 0 0 0.0 1.0 ECU_ADDRESS 0x4000E3E7 /* @ECU_Address@EIP_bErrAccrDervDiff@ */ /end MEASUREMENT
/begin MEASUREMENT EIP_bAcvEmgcyShtdwnForOvspd "Emergency Shutdown for Overspeed Active" UBYTE EcuIntgdSwGend_CM_boolean 0 0 0.0 1.0 ECU_ADDRESS 0x4000E0E8 /* @ECU_Address@EIP_bAcvEmgcyShtdwnForOvspd@ */ /end MEASUREMENT
/begin MEASUREMENT EIP_bErrTAirBoostRng "Error Air Boost Temperature Range" UBYTE EcuIntgdSwGend_CM_boolean 0 0 0.0 1.0 ECU_ADDRESS 0x4000E358 /* @ECU_Address@EIP_bErrTAirBoostRng@ */ /end MEASUREMENT
/begin MEASUREMENT EIP_bErrTAirBoostGrdt "Error Air Boost Temperature Gradient" UBYTE EcuIntgdSwGend_CM_boolean 0 0 0.0 1.0 ECU_ADDRESS 0x4000DB71 /* @ECU_Address@EIP_bErrTAirBoostGrdt@ */ /end MEASUREMENT
/begin MEASUREMENT EIP_bErrTAirBoostSnsr "Error Air Boost Temperature Sensor" UBYTE EcuIntgdSwGend_CM_boolean 0 0 0.0 1.0 ECU_ADDRESS 0x4000E86B /* @ECU_Address@EIP_bErrTAirBoostSnsr@ */ /end MEASUREMENT
/begin MEASUREMENT EIP_bErrTOilRng "Error Oil Temperature Range" UBYTE EcuIntgdSwGend_CM_boolean 0 0 0.0 1.0 ECU_ADDRESS 0x4000DE54 /* @ECU_Address@EIP_bErrTOilRng@ */ /end MEASUREMENT
/begin MEASUREMENT EIP_bErrTOilGrdt "Error Oil Temperature Gradient" UBYTE EcuIntgdSwGend_CM_boolean 0 0 0.0 1.0 ECU_ADDRESS 0x4000DA29 /* @ECU_Address@EIP_bErrTOilGrdt@ */ /end MEASUREMENT
/begin MEASUREMENT EIP_bErrTOilCoh "Error Oil Temperature Coherance" UBYTE EcuIntgdSwGend_CM_boolean 0 0 0.0 1.0 ECU_ADDRESS 0x4000E1D0 /* @ECU_Address@EIP_bErrTOilCoh@ */ /end MEASUREMENT
/begin MEASUREMENT EIP_bErrTOilSnsr "Error Oil Temperature Sensor" UBYTE EcuIntgdSwGend_CM_boolean 0 0 0.0 1.0 ECU_ADDRESS 0x4000E730 /* @ECU_Address@EIP_bErrTOilSnsr@ */ /end MEASUREMENT
/begin MEASUREMENT EIP_bErrTCooltRng "Error Coolant Temperature Range" UBYTE EcuIntgdSwGend_CM_boolean 0 0 0.0 1.0 ECU_ADDRESS 0x4000D868 /* @ECU_Address@EIP_bErrTCooltRng@ */ /end MEASUREMENT
/begin MEASUREMENT EIP_bErrTCooltGrdt "Error Coolant Temperature Gradient" UBYTE EcuIntgdSwGend_CM_boolean 0 0 0.0 1.0 ECU_ADDRESS 0x4000E808 /* @ECU_Address@EIP_bErrTCooltGrdt@ */ /end MEASUREMENT
/begin MEASUREMENT EIP_bErrTCooltSnsr "Error Coolant Temperature Sensor" UBYTE EcuIntgdSwGend_CM_boolean 0 0 0.0 1.0 ECU_ADDRESS 0x4000E364 /* @ECU_Address@EIP_bErrTCooltSnsr@ */ /end MEASUREMENT
/begin MEASUREMENT EIP_bErrTFuRng "Error Fuel Temperature Range" UBYTE EcuIntgdSwGend_CM_boolean 0 0 0.0 1.0 ECU_ADDRESS 0x4000DEC0 /* @ECU_Address@EIP_bErrTFuRng@ */ /end MEASUREMENT
/begin MEASUREMENT EIP_bErrTFuGrdt "Error Fuel Temperature Gradient" UBYTE EcuIntgdSwGend_CM_boolean 0 0 0.0 1.0 ECU_ADDRESS 0x4000E2AF /* @ECU_Address@EIP_bErrTFuGrdt@ */ /end MEASUREMENT
/begin MEASUREMENT EIP_bErrTEcuRng "Error ECU Temperature Range" UBYTE EcuIntgdSwGend_CM_boolean 0 0 0.0 1.0 ECU_ADDRESS 0x4000E7D0 /* @ECU_Address@EIP_bErrTEcuRng@ */ /end MEASUREMENT
/begin MEASUREMENT EIP_bErrTEcuGrdt "Error ECU Temperature Gradient" UBYTE EcuIntgdSwGend_CM_boolean 0 0 0.0 1.0 ECU_ADDRESS 0x4000E78A /* @ECU_Address@EIP_bErrTEcuGrdt@ */ /end MEASUREMENT
/begin MEASUREMENT EIP_bErrTAmbAirRng "Error Ambient Air Temperature Range" UBYTE EcuIntgdSwGend_CM_boolean 0 0 0.0 1.0 ECU_ADDRESS 0x4000E11C /* @ECU_Address@EIP_bErrTAmbAirRng@ */ /end MEASUREMENT
/begin MEASUREMENT EIP_bErrTAmbAirGrdt "Error Ambient Air Temperature Gradient" UBYTE EcuIntgdSwGend_CM_boolean 0 0 0.0 1.0 ECU_ADDRESS 0x4000DB6F /* @ECU_Address@EIP_bErrTAmbAirGrdt@ */ /end MEASUREMENT
/begin MEASUREMENT EIP_bErrTAmbAirSnsr "Error Ambient Air Temperature Sensor" UBYTE EcuIntgdSwGend_CM_boolean 0 0 0.0 1.0 ECU_ADDRESS 0x4000E86A /* @ECU_Address@EIP_bErrTAmbAirSnsr@ */ /end MEASUREMENT
/begin MEASUREMENT EIP_bErrTEcuSnsr "Error ECU Temperature Sensor" UBYTE EcuIntgdSwGend_CM_boolean 0 0 0.0 1.0 ECU_ADDRESS 0x4000E2D6 /* @ECU_Address@EIP_bErrTEcuSnsr@ */ /end MEASUREMENT
/begin MEASUREMENT EIP_bErrTFuSnsr "Error Fuel Temperature Sensor" UBYTE EcuIntgdSwGend_CM_boolean 0 0 0.0 1.0 ECU_ADDRESS 0x4000DEB5 /* @ECU_Address@EIP_bErrTFuSnsr@ */ /end MEASUREMENT
/begin MEASUREMENT EIP_bErrLvlOilRng "Error Oil Level Range" UBYTE EcuIntgdSwGend_CM_boolean 0 0 0.0 1.0 ECU_ADDRESS 0x4000E92A /* @ECU_Address@EIP_bErrLvlOilRng@ */ /end MEASUREMENT
/begin MEASUREMENT EIP_bErrLvlOilGrdt "Error Oil Level Gradient" UBYTE EcuIntgdSwGend_CM_boolean 0 0 0.0 1.0 ECU_ADDRESS 0x4000E1A2 /* @ECU_Address@EIP_bErrLvlOilGrdt@ */ /end MEASUREMENT
/begin MEASUREMENT EIP_bErrLvlOilSnsr "Error Oil Level Sensor" UBYTE EcuIntgdSwGend_CM_boolean 0 0 0.0 1.0 ECU_ADDRESS 0x4000DDA8 /* @ECU_Address@EIP_bErrLvlOilSnsr@ */ /end MEASUREMENT
/begin MEASUREMENT EIP_StOfCanEngPtoGovrSetSwt "Engine Input Processing State Of Can Engine Pto Governor Set Switch" UBYTE EcuIntgdSwGend_CM_boolean 0 0 0.0 1.0 ECU_ADDRESS 0x4000E478 /* @ECU_Address@EIP_StOfCanEngPtoGovrSetSwt@ */ /end MEASUREMENT
/begin MEASUREMENT EIP_StOfCanEngPtoGovrCoastSwt "Engine Input Processing State Of Can Engine Pto Governor Coast Switch" UBYTE EcuIntgdSwGend_CM_boolean 0 0 0.0 1.0 ECU_ADDRESS 0x4000E33A /* @ECU_Address@EIP_StOfCanEngPtoGovrCoastSwt@ */ /end MEASUREMENT
/begin MEASUREMENT EIP_StOfCanEngPtoGovrResuSwt "Engine Input Processing State Of Can Engine Pto Governor Resume Switch" UBYTE EcuIntgdSwGend_CM_boolean 0 0 0.0 1.0 ECU_ADDRESS 0x4000DF2C /* @ECU_Address@EIP_StOfCanEngPtoGovrResuSwt@ */ /end MEASUREMENT
/begin MEASUREMENT EIP_StOfCanEngPtoGovrAccrSwt "Engine Input Processing State Of Can Engine Pto Governor Accelerate Switch" UBYTE EcuIntgdSwGend_CM_boolean 0 0 0.0 1.0 ECU_ADDRESS 0x4000E668 /* @ECU_Address@EIP_StOfCanEngPtoGovrAccrSwt@ */ /end MEASUREMENT
/begin COMPU_METHOD EcuIntgdSwGend_CM_single_N_m "Q = V" RAT_FUNC "%8.6" "N*m" COEFFS 0 1 0 0 0 1 /end COMPU_METHOD
/begin COMPU_METHOD EcuIntgdSwGend_CM_single_rpm "Q = V" RAT_FUNC "%8.6" "rpm" COEFFS 0 1 0 0 0 1 /end COMPU_METHOD
/begin COMPU_METHOD EcuIntgdSwGend_CM_single_degC "Q = V" RAT_FUNC "%8.6" "degC" COEFFS 0 1 0 0 0 1 /end COMPU_METHOD
/begin COMPU_METHOD EcuIntgdSwGend_CM_single__ "Q = V" RAT_FUNC "%8.6" "%" COEFFS 0 1 0 0 0 1 /end COMPU_METHOD
/begin COMPU_METHOD EcuIntgdSwGend_CM_single "Q = V" RAT_FUNC "%8.6" "" COEFFS 0 1 0 0 0 1 /end COMPU_METHOD
/begin COMPU_METHOD EcuIntgdSwGend_CM_single_L "Q = V" RAT_FUNC "%8.6" "L" COEFFS 0 1 0 0 0 1 /end COMPU_METHOD
/begin COMPU_METHOD EcuIntgdSwGend_CM_single_deg "Q = V" RAT_FUNC "%8.6" "deg" COEFFS 0 1 0 0 0 1 /end COMPU_METHOD
/begin COMPU_METHOD EcuIntgdSwGend_CM_single_ms "Q = V" RAT_FUNC "%8.6" "ms" COEFFS 0 1 0 0 0 1 /end COMPU_METHOD
/begin COMPU_METHOD EcuIntgdSwGend_CM_single_mbar "Q = V" RAT_FUNC "%8.6" "mbar" COEFFS 0 1 0 0 0 1 /end COMPU_METHOD
/begin COMPU_METHOD EcuIntgdSwGend_CM_single_bar "Q = V" RAT_FUNC "%8.6" "bar" COEFFS 0 1 0 0 0 1 /end COMPU_METHOD
/begin COMPU_METHOD EcuIntgdSwGend_CM_single_mm_3_stk "Q = V" RAT_FUNC "%8.6" "mm^3/stk" COEFFS 0 1 0 0 0 1 /end COMPU_METHOD
/begin COMPU_METHOD EcuIntgdSwGend_CM_single_V "Q = V" RAT_FUNC "%8.6" "V" COEFFS 0 1 0 0 0 1 /end COMPU_METHOD
/begin COMPU_METHOD EcuIntgdSwGend_CM_single_km_h "Q = V" RAT_FUNC "%8.6" "km/h" COEFFS 0 1 0 0 0 1 /end COMPU_METHOD
/begin COMPU_METHOD EcuIntgdSwGend_CM_single_us "Q = V" RAT_FUNC "%8.6" "us" COEFFS 0 1 0 0 0 1 /end COMPU_METHOD
/begin COMPU_METHOD EcuIntgdSwGend_CM_single_h "Q = V" RAT_FUNC "%8.6" "h" COEFFS 0 1 0 0 0 1 /end COMPU_METHOD
/begin COMPU_METHOD EcuIntgdSwGend_CM_single_mbar_sec "Q = V" RAT_FUNC "%8.6" "mbar/sec" COEFFS 0 1 0 0 0 1 /end COMPU_METHOD
/begin COMPU_METHOD EcuIntgdSwGend_CM_single_bar_sec "Q = V" RAT_FUNC "%8.6" "bar/sec" COEFFS 0 1 0 0 0 1 /end COMPU_METHOD
/begin COMPU_METHOD EcuIntgdSwGend_CM_single_degC_sec "Q = V" RAT_FUNC "%8.6" "degC/sec" COEFFS 0 1 0 0 0 1 /end COMPU_METHOD
/begin COMPU_METHOD EcuIntgdSwGend_CM_single_L_h "Q = V" RAT_FUNC "%8.6" "L/h" COEFFS 0 1 0 0 0 1 /end COMPU_METHOD
/begin COMPU_METHOD EcuIntgdSwGend_CM_single_kW "Q = V" RAT_FUNC "%8.6" "kW" COEFFS 0 1 0 0 0 1 /end COMPU_METHOD
/begin COMPU_METHOD EcuIntgdSwGend_CM_single_kPa "Q = V" RAT_FUNC "%8.6" "kPa" COEFFS 0 1 0 0 0 1 /end COMPU_METHOD
/begin COMPU_METHOD EcuIntgdSwGend_CM_single_MPa "Q = V" RAT_FUNC "%8.6" "MPa" COEFFS 0 1 0 0 0 1 /end COMPU_METHOD
/begin COMPU_METHOD EcuIntgdSwGend_CM_int16_km_h "Q = V" RAT_FUNC "%5.0" "km/h" COEFFS 0 1 0 0 0 1 /end COMPU_METHOD
/begin COMPU_METHOD EcuIntgdSwGend_CM_boolean "Q = V" RAT_FUNC "%1.0" "" COEFFS 0 1 0 0 0 1 /end COMPU_METHOD
/begin COMPU_METHOD EcuIntgdSwGend_CM_boolean_deg "Q = V" RAT_FUNC "%1.0" "deg" COEFFS 0 1 0 0 0 1 /end COMPU_METHOD
/begin COMPU_METHOD EcuIntgdSwGend_CM_int8 "Q = V" RAT_FUNC "%3.0" "" COEFFS 0 1 0 0 0 1 /end COMPU_METHOD
/begin COMPU_METHOD EcuIntgdSwGend_CM_uint8 "Q = V" RAT_FUNC "%3.0" "" COEFFS 0 1 0 0 0 1 /end COMPU_METHOD
/begin GROUP S85_SPN_981___Engine_PTO_Governor_Accelerate_Switch "EcuIntgdSwGend/ControlSoftware/EcuInpPrcsg/CAN Signals/SPN 981 - Engine PTO Governor Accelerate Switch"
 /begin REF_CHARACTERISTIC EIP_CanEngPtoGovrAccrSwtOvs_P EIP_CanEngPtoGovrAccrSwtOvv_P EIP_StOfCanEngPtoGovrAccrSwtOvs_P EIP_StOfCanEngPtoGovrAccrSwtOvv_P /end REF_CHARACTERISTIC
 /begin REF_MEASUREMENT EIP_CanEngPtoGovrAccrSwt EIP_StOfCanEngPtoGovrAccrSwt /end REF_MEASUREMENT
/end GROUP
/begin GROUP S85_SPN_982___Engine_PTO_Governor_Resume_Switch "EcuIntgdSwGend/ControlSoftware/EcuInpPrcsg/CAN Signals/SPN 982 - Engine PTO Governor Resume Switch"
 /begin REF_CHARACTERISTIC EIP_CanEngPtoGovrResuSwtOvs_P EIP_CanEngPtoGovrResuSwtOvv_P EIP_StOfCanEngPtoGovrResuSwtOvs_P EIP_StOfCanEngPtoGovrResuSwtOvv_P /end REF_CHARACTERISTIC
 /begin REF_MEASUREMENT EIP_CanEngPtoGovrResuSwt EIP_StOfCanEngPtoGovrResuSwt /end REF_MEASUREMENT
/end GROUP
/begin GROUP S85_SPN_983___Engine_PTO_Governor_Coast__Decelerate_Switch "EcuIntgdSwGend/ControlSoftware/EcuInpPrcsg/CAN Signals/SPN 983 - Engine PTO Governor Coast//Decelerate Switch"
 /begin REF_CHARACTERISTIC EIP_CanEngPtoGovrCoastSwtOvs_P EIP_CanEngPtoGovrCoastSwtOvv_P EIP_StOfCanEngPtoGovrCoastSwtOvs_P EIP_StOfCanEngPtoGovrCoastSwtOvv_P /end REF_CHARACTERISTIC
 /begin REF_MEASUREMENT EIP_CanEngPtoGovrCoastSwt EIP_StOfCanEngPtoGovrCoastSwt /end REF_MEASUREMENT
/end GROUP
/begin GROUP S85_SPN_984___Engine_PTO_Governor_Set_Switch "EcuIntgdSwGend/ControlSoftware/EcuInpPrcsg/CAN Signals/SPN 984 - Engine PTO Governor Set Switch"
 /begin REF_CHARACTERISTIC EIP_CanEngPtoGovrSetSwtOvs_P EIP_CanEngPtoGovrSetSwtOvv_P EIP_StOfCanEngPtoGovrSetSwtOvs_P EIP_StOfCanEngPtoGovrSetSwtOvv_P /end REF_CHARACTERISTIC
 /begin REF_MEASUREMENT EIP_CanEngPtoGovrSetSwt EIP_StOfCanEngPtoGovrSetSwt /end REF_MEASUREMENT
/end GROUP
/begin GROUP S87_Debouncer1 "EcuIntgdSwGend/ControlSoftware/EcuInpPrcsg/Driver Commands/Debouncer1" /begin REF_MEASUREMENT EIP_TiElpdStrtReqSwt /end REF_MEASUREMENT /end GROUP
/begin GROUP S87_Debouncer10 "EcuIntgdSwGend/ControlSoftware/EcuInpPrcsg/Driver Commands/Debouncer10" /begin REF_MEASUREMENT EIP_TiElpdHandBrkPrkg /end REF_MEASUREMENT /end GROUP
/begin GROUP S87_Debouncer11 "EcuIntgdSwGend/ControlSoftware/EcuInpPrcsg/Driver Commands/Debouncer11" /begin REF_MEASUREMENT EIP_TiElpdEngBrkReq1Btn /end REF_MEASUREMENT /end GROUP
/begin GROUP S87_Debouncer12 "EcuIntgdSwGend/ControlSoftware/EcuInpPrcsg/Driver Commands/Debouncer12" /begin REF_MEASUREMENT EIP_TiElpdEngBrkReq2Btn /end REF_MEASUREMENT /end GROUP
/begin GROUP S87_Debouncer2 "EcuIntgdSwGend/ControlSoftware/EcuInpPrcsg/Driver Commands/Debouncer2" /begin REF_MEASUREMENT EIP_TiElpdBrkPedl /end REF_MEASUREMENT /end GROUP
/begin GROUP S87_Debouncer3 "EcuIntgdSwGend/ControlSoftware/EcuInpPrcsg/Driver Commands/Debouncer3" /begin REF_MEASUREMENT EIP_TiElpdIgnSwt /end REF_MEASUREMENT /end GROUP
/begin GROUP S87_Debouncer4 "EcuIntgdSwGend/ControlSoftware/EcuInpPrcsg/Driver Commands/Debouncer4" /begin REF_MEASUREMENT EIP_TiElpdCrsCtrlOnOffBtn /end REF_MEASUREMENT /end GROUP
/begin GROUP S87_Debouncer5 "EcuIntgdSwGend/ControlSoftware/EcuInpPrcsg/Driver Commands/Debouncer5" /begin REF_MEASUREMENT EIP_TiElpdDecCrsCtrlBtn /end REF_MEASUREMENT /end GROUP
/begin GROUP S87_Debouncer6 "EcuIntgdSwGend/ControlSoftware/EcuInpPrcsg/Driver Commands/Debouncer6" /begin REF_MEASUREMENT EIP_TiElpdAcvCmbtSwt /end REF_MEASUREMENT /end GROUP
/begin GROUP S87_Debouncer7 "EcuIntgdSwGend/ControlSoftware/EcuInpPrcsg/Driver Commands/Debouncer7" /begin REF_MEASUREMENT EIP_TiElpdIncCrsCtrlBtn /end REF_MEASUREMENT /end GROUP
/begin GROUP S87_Debouncer9 "EcuIntgdSwGend/ControlSoftware/EcuInpPrcsg/Driver Commands/Debouncer9" /begin REF_MEASUREMENT EIP_TiElpdSpdLimrOnOffBtn /end REF_MEASUREMENT /end GROUP
/begin GROUP S88_Engine_Brake_Configuration "EcuIntgdSwGend/ControlSoftware/EcuInpPrcsg/ECU Configuration/Engine Brake Configuration" /begin REF_CHARACTERISTIC EIP_EngBrkCfg_P /end REF_CHARACTERISTIC /begin REF_MEASUREMENT EIP_EngBrkCfg /end REF_MEASUREMENT /end GROUP
/begin GROUP S88_Engine_Brake_Level_Configuration "EcuIntgdSwGend/ControlSoftware/EcuInpPrcsg/ECU Configuration/Engine Brake Level Configuration" /begin REF_CHARACTERISTIC EIP_EngBrkLvlCfg_P /end REF_CHARACTERISTIC /begin REF_MEASUREMENT EIP_EngBrkLvlCfg /end REF_MEASUREMENT /end GROUP
/begin GROUP S88_Injector_Configuration "EcuIntgdSwGend/ControlSoftware/EcuInpPrcsg/ECU Configuration/Injector Configuration" /begin REF_CHARACTERISTIC EIP_InjrCfg_C /end REF_CHARACTERISTIC /begin REF_MEASUREMENT EIP_InjrCfg /end REF_MEASUREMENT /end GROUP
/begin GROUP S88_Wastegate_Configuration "EcuIntgdSwGend/ControlSoftware/EcuInpPrcsg/ECU Configuration/Wastegate Configuration" /begin REF_CHARACTERISTIC EIP_WgCfg_P /end REF_CHARACTERISTIC /begin REF_MEASUREMENT EIP_WgCfg /end REF_MEASUREMENT /end GROUP
/begin GROUP S89_Battery_Voltage_Diagnostics_Info "EcuIntgdSwGend/ControlSoftware/EcuInpPrcsg/Electrical Contact Signals/Battery Voltage Diagnostics Info"
 /begin REF_CHARACTERISTIC EG_DiagcSnsrFltInfoNone_C EG_DiagcSnsrInfoUClmp30_C EG_Mask32Bit0_C EG_Mask32Bit256_C EG_Mask32Bit512_C /end REF_CHARACTERISTIC
/end GROUP
/begin GROUP S89_Debouncer "EcuIntgdSwGend/ControlSoftware/EcuInpPrcsg/Electrical Contact Signals/Debouncer" /begin REF_MEASUREMENT EIP_TiElpdErrUClmp30 /end REF_MEASUREMENT /end GROUP
/begin GROUP S89_LowPassFilter1 "EcuIntgdSwGend/ControlSoftware/EcuInpPrcsg/Electrical Contact Signals/LowPassFilter1" /begin REF_CHARACTERISTIC EG_NmrSng0_C EG_bFlgTrue_C /end REF_CHARACTERISTIC /begin REF_MEASUREMENT EIP_UClmp30Fild /end REF_MEASUREMENT /end GROUP
/begin GROUP S91_InRow_Debouncer "EcuIntgdSwGend/ControlSoftware/EcuInpPrcsg/Engine Steady State Detection/InRow_Debouncer" /begin SUB_GROUP S196_SetRstLtch /end SUB_GROUP /begin REF_CHARACTERISTIC EG_NmrInt0_C /end REF_CHARACTERISTIC /end GROUP
/begin GROUP S93_Level_Sensor_Errors "EcuIntgdSwGend/ControlSoftware/EcuInpPrcsg/Level Sensor Signals/Level Sensor Errors"
 /begin SUB_GROUP S200_Debouncer1 S200_Level_Sensor_Diagnostics_Info S200_LowPassFilter2 /end SUB_GROUP
 /begin REF_CHARACTERISTIC EG_NmrSng0_C EG_TsSw20_C EIP_GrdtLvlOil_P EIP_LvlOilMax_P EIP_LvlOilMin_P EIP_TcLvlOilFil_P EIP_TiLvlOilSnsrDeb_P EIP_bErrLvlOilSnsrOvs_P EIP_bErrLvlOilSnsrOvv_P /end REF_CHARACTERISTIC
 /begin REF_MEASUREMENT EIP_LvlOilGrdtAbsOut EIP_bErrLvlOilGrdt EIP_bErrLvlOilRng EIP_bErrLvlOilSnsr /end REF_MEASUREMENT
/end GROUP
/begin GROUP S95_Accelerator_Pedal_Sensor_Monitoring "EcuIntgdSwGend/ControlSoftware/EcuInpPrcsg/Position & Speed Sensor Signals/Accelerator Pedal Sensor Monitoring"
 /begin SUB_GROUP S206_Debouncer1 S206_Debouncer5 S206_Debouncer6 S206_Derv S206_Derv1 S206_Derv2 S206_Derv3 S206_Pressure_Sensor_Diagnostic_Info /end SUB_GROUP
 /begin REF_CHARACTERISTIC EG_NmrSng0_C EG_TsSw_C EIP_PercgAccr1Max_P EIP_PercgAccr1Min_P EIP_PercgAccr2Max_P EIP_PercgAccr2Min_P EIP_PercgAccrDiffThd_P EIP_TiDebAccrDervThd_P EIP_bErrAccr1And2OorOvs_P EIP_bErrAccr1And2OorOvv_P EIP_bErrAccrRedncyOvs_P EIP_bErrAccrRedncyOvv_P /end REF_CHARACTERISTIC
 /begin REF_MEASUREMENT EIP_PercgAccrDiff EIP_bErrAccr1 EIP_bErrAccr1Oor EIP_bErrAccr2 EIP_bErrAccr2Oor EIP_bErrAccrDervDiff EIP_bErrAccrRedncy EIP_bErrAccrTotLoss EIP_bPercgAccrDiffDetn /end REF_MEASUREMENT
/end GROUP
/begin GROUP S95_Accelerator_Under_Over_Condition "EcuIntgdSwGend/ControlSoftware/EcuInpPrcsg/Position & Speed Sensor Signals/Accelerator Under Over Condition" /begin SUB_GROUP S207_SetRstLtch1 S207_SetRstLtch2 /end SUB_GROUP
 /begin REF_CHARACTERISTIC EIP_PercgAccrMaxHysThd_P EIP_PercgAccrMaxThd_P EIP_PercgAccrMax_P EIP_PercgAccrMinHysThd_P EIP_PercgAccrMinThd_P EIP_PercgAccrMin_P /end REF_CHARACTERISTIC
/end GROUP
/begin GROUP S95_Engine_Shutdown_Overspeed "EcuIntgdSwGend/ControlSoftware/EcuInpPrcsg/Position & Speed Sensor Signals/Engine Shutdown Overspeed" /begin SUB_GROUP S208_Debouncer3 /end SUB_GROUP
 /begin REF_CHARACTERISTIC EG_NmrSng0_C EG_TsSw_C EIP_NEngEmgcyShtdwnForOvspd_P EIP_TiAcvEmgcyShtdwnForOvspdDeb_P EIP_bAcvEmgcyShtdwnForOvspdOvs_P EIP_bAcvEmgcyShtdwnForOvspdOvv_P /end REF_CHARACTERISTIC
 /begin REF_MEASUREMENT EIP_bAcvEmgcyShtdwnForOvspd /end REF_MEASUREMENT
/end GROUP
/begin GROUP S95_LowPassFilter "EcuIntgdSwGend/ControlSoftware/EcuInpPrcsg/Position & Speed Sensor Signals/LowPassFilter" /begin REF_CHARACTERISTIC EG_NmrSng0_C EG_bFlgTrue_C /end REF_CHARACTERISTIC /end GROUP
/begin GROUP S95_LowPassFilter1 "EcuIntgdSwGend/ControlSoftware/EcuInpPrcsg/Position & Speed Sensor Signals/LowPassFilter1" /begin REF_CHARACTERISTIC EG_NmrSng0_C EG_bFlgTrue_C /end REF_CHARACTERISTIC /end GROUP
/begin GROUP S95_LowPassFilter2 "EcuIntgdSwGend/ControlSoftware/EcuInpPrcsg/Position & Speed Sensor Signals/LowPassFilter2" /begin REF_CHARACTERISTIC EG_NmrSng0_C EG_bFlgTrue_C /end REF_CHARACTERISTIC /end GROUP
/begin GROUP S95_LowPassFilter3 "EcuIntgdSwGend/ControlSoftware/EcuInpPrcsg/Position & Speed Sensor Signals/LowPassFilter3" /begin REF_CHARACTERISTIC EG_NmrSng0_C EG_bFlgTrue_C /end REF_CHARACTERISTIC /end GROUP
/begin GROUP S95_LowPassFilter4 "EcuIntgdSwGend/ControlSoftware/EcuInpPrcsg/Position & Speed Sensor Signals/LowPassFilter4" /begin REF_CHARACTERISTIC EG_NmrSng0_C EG_bFlgTrue_C /end REF_CHARACTERISTIC /end GROUP
/begin GROUP S96_Pressure_Sensor_Errors "EcuIntgdSwGend/ControlSoftware/EcuInpPrcsg/Pressure Sensor Signals/Pressure Sensor Errors"
 /begin SUB_GROUP S228_Debouncer S228_Debouncer2 S228_Debouncer3 S228_Debouncer4 S228_Debouncer5 S228_LowPassFilter1 S228_LowPassFilter4 S228_LowPassFilter5 S228_LowPassFilter6 S228_LowPassFilter7 S228_Pressure_Sensor_Diagnostic_Info /end SUB_GROUP
 /begin REF_CHARACTERISTIC EG_NmrSng0_C EG_NmrSng1000_C EG_TsSw_C EIP_GrdtPAirBoost_P EIP_GrdtPAmbAir_P EIP_GrdtPFu_P EIP_GrdtPOil_P EIP_GrdtPRail_P EIP_PAirBoostMax_P EIP_PAirBoostMin_P EIP_PAmbAirMax_P EIP_PAmbAirMin_P EIP_PFuMax_P EIP_PFuMin_P EIP_POilMax_P EIP_POilMin_P EIP_PRailMax_P EIP_PRailMin_P EIP_TcPAirBoostFil_P EIP_TcPAmbAirFil_P EIP_TcPFuFil_P EIP_TcPOilFil_P EIP_TcPRailFil_P EIP_TiPAirBoostSnsrDeb_P EIP_TiPAmbAirSnsrDeb_P EIP_TiPFuSnsrDeb_P EIP_TiPOilSnsrDeb_P EIP_TiPRailSnsrDeb_P EIP_bErrPAirBoostSnsrOvs_P EIP_bErrPAirBoostSnsrOvv_P EIP_bErrPAmbAirSnsrOvs_P EIP_bErrPAmbAirSnsrOvv_P EIP_bErrPFuSnsrOvs_P EIP_bErrPFuSnsrOvv_P EIP_bErrPOilSnsrOvs_P EIP_bErrPOilSnsrOvv_P EIP_bErrPRailSnsrOvs_P EIP_bErrPRailSnsrOvv_P /end REF_CHARACTERISTIC
 /begin REF_MEASUREMENT EIP_PAirBoostGrdtAbsOut EIP_PAmbAirGrdtAbsOut EIP_PFuGrdtAbsOut EIP_POilGrdtAbsOut EIP_PRailGrdtAbsOut EIP_bErrPAirBoostGrdt EIP_bErrPAirBoostRng EIP_bErrPAirBoostSnsr EIP_bErrPAmbAirGrdt EIP_bErrPAmbAirRng EIP_bErrPAmbAirSnsr EIP_bErrPFuGrdt EIP_bErrPFuRng EIP_bErrPFuSnsr EIP_bErrPOilGrdt EIP_bErrPOilRng EIP_bErrPOilSnsr EIP_bErrPRailGrdt EIP_bErrPRailRng EIP_bErrPRailSnsr /end REF_MEASUREMENT
/end GROUP
/begin GROUP S99_Temperature_Sensor_Errors "EcuIntgdSwGend/ControlSoftware/EcuInpPrcsg/Temperature Sensor Signals/Temperature Sensor Errors"
 /begin SUB_GROUP S250_Debouncer S250_Debouncer1 S250_Debouncer3 S250_Debouncer4 S250_Debouncer5 S250_Debouncer7 S250_LowPassFilter1 S250_LowPassFilter2 S250_LowPassFilter4 S250_LowPassFilter5 S250_LowPassFilter6 S250_LowPassFilter8 S250_Temperature_Sensor_Diagnostic_Info /end SUB_GROUP
 /begin REF_CHARACTERISTIC EG_NmrSng0_C EG_TsSw20_C EIP_GrdtTAirBoost_P EIP_GrdtTAmbAir_P EIP_GrdtTCoolt_P EIP_GrdtTEcu_P EIP_GrdtTFu_P EIP_GrdtTOil_P EIP_TAirBoostMax_P EIP_TAirBoostMin_P EIP_TAmbAirMax_P EIP_TAmbAirMin_P EIP_TCooltMax_P EIP_TCooltMin_P EIP_TCooltTOilCohThd_P EIP_TEcuMax_P EIP_TEcuMin_P EIP_TFuMax_P EIP_TFuMin_P EIP_TOilMax_P EIP_TOilMin_P EIP_TcTAirBoostFil_P EIP_TcTAmbAirFil_P EIP_TcTCooltFil_P EIP_TcTEcuFil_P EIP_TcTFuFil_P EIP_TcTOilFil_P EIP_TiTAirBoostSnsrDeb_P EIP_TiTAmbAirSnsrDeb_P EIP_TiTCooltSnsrDeb_P EIP_TiTEcuSnsrDeb_P EIP_TiTFuSnsrDeb_P EIP_TiTOilSnsrDeb_P EIP_bErrTAirBoostSnsrOvs_P EIP_bErrTAirBoostSnsrOvv_P EIP_bErrTAmbAirSnsrOvs_P EIP_bErrTAmbAirSnsrOvv_P EIP_bErrTCooltSnsrOvs_P EIP_bErrTCooltSnsrOvv_P EIP_bErrTEcuSnsrOvs_P EIP_bErrTEcuSnsrOvv_P EIP_bErrTFuSnsrOvs_P EIP_bErrTFuSnsrOvv_P EIP_bErrTOilSnsrOvs_P EIP_bErrTOilSnsrOvv_P /end REF_CHARACTERISTIC
 /begin REF_MEASUREMENT EIP_TAirBoostGrdtAbsOut EIP_TAmbAirGrdtAbsOut EIP_TCooltGrdtAbsOut EIP_TEcuGrdtAbsOut EIP_TFuGrdtAbsOut EIP_TOilGrdtAbsOut EIP_bErrTAirBoostGrdt EIP_bErrTAirBoostRng EIP_bErrTAirBoostSnsr EIP_bErrTAmbAirGrdt EIP_bErrTAmbAirRng EIP_bErrTAmbAirSnsr EIP_bErrTCooltGrdt EIP_bErrTCooltRng EIP_bErrTCooltSnsr EIP_bErrTEcuGrdt EIP_bErrTEcuRng EIP_bErrTEcuSnsr EIP_bErrTFuGrdt EIP_bErrTFuRng EIP_bErrTFuSnsr EIP_bErrTOilCoh EIP_bErrTOilGrdt EIP_bErrTOilRng EIP_bErrTOilSnsr /end REF_MEASUREMENT
/end GROUP
/begin GROUP S100_Gear_Based_Vehicle_Speed_Calculation "EcuIntgdSwGend/ControlSoftware/EcuInpPrcsg/Vehicle Velocity Calculation/Gear Based Vehicle Speed Calculation" /begin REF_CHARACTERISTIC EIP_GearSpdCnvnFacForTrsm_P /end REF_CHARACTERISTIC /begin REF_MEASUREMENT EIP_VehVFromGear /end REF_MEASUREMENT /end GROUP
/begin GROUP S100_LowPassFilter "EcuIntgdSwGend/ControlSoftware/EcuInpPrcsg/Vehicle Velocity Calculation/LowPassFilter" /begin REF_CHARACTERISTIC EG_NmrSng0_C EG_bFlgTrue_C /end REF_CHARACTERISTIC /begin REF_MEASUREMENT EIP_VehV /end REF_MEASUREMENT /end GROUP
/begin GROUP S100_Selection_Of_Source_1_and_Source_2 "EcuIntgdSwGend/ControlSoftware/EcuInpPrcsg/Vehicle Velocity Calculation/Selection Of Source 1 and Source 2"
 /begin REF_CHARACTERISTIC EIP_VehSpdSelnNoSrc_C EIP_VehSpdSelnSrc1_P EIP_VehSpdSelnSrc2_P /end REF_CHARACTERISTIC
 /begin REF_MEASUREMENT EIP_StOfVehVSelnFromInpSrc1 EIP_StOfVehVSelnFromInpSrc2 EIP_VehVSelnFromInpSrc1 EIP_VehVSelnFromInpSrc2 /end REF_MEASUREMENT
/end GROUP
/begin GROUP S100_Vehicle_Velocity_Calculation "EcuIntgdSwGend/ControlSoftware/EcuInpPrcsg/Vehicle Velocity Calculation/Vehicle Velocity Calculation" /begin SUB_GROUP S279_Debouncer /end SUB_GROUP
 /begin REF_CHARACTERISTIC EG_NmrInt0_C EG_NmrSng100_C EG_NmrSng10_C EG_TsSw_C EIP_TiVehVDevErrThd_P EIP_VehVDevErrThd_P EIP_VldInpSt_C /end REF_CHARACTERISTIC
 /begin REF_MEASUREMENT EIP_VehVFromSrc1AndSrc2 EIP_VehVRaw EIP_bErrVehV /end REF_MEASUREMENT
/end GROUP
/begin GROUP S285_Neg_Edge "EcuIntgdSwGend/ControlSoftware/EcuModSeln/Cruise Control to Stop Transition/Neg_Edge" /begin REF_CHARACTERISTIC EG_NmrSng0_C /end REF_CHARACTERISTIC /end GROUP
/begin GROUP S290_Neg_Edge "EcuIntgdSwGend/ControlSoftware/EcuModSeln/Idle Speed to Stop Transition/Neg_Edge" /begin REF_CHARACTERISTIC EG_NmrSng0_C /end REF_CHARACTERISTIC /end GROUP
/begin GROUP S293_Neg_Edge "EcuIntgdSwGend/ControlSoftware/EcuModSeln/Overspeed to Stop Transition/Neg_Edge" /begin REF_CHARACTERISTIC EG_NmrSng0_C /end REF_CHARACTERISTIC /end GROUP
/begin GROUP S296_Neg_Edge "EcuIntgdSwGend/ControlSoftware/EcuModSeln/PTO to Stop Transition/Neg_Edge" /begin REF_CHARACTERISTIC EG_NmrSng0_C /end REF_CHARACTERISTIC /end GROUP
/begin GROUP S299_Neg_Edge "EcuIntgdSwGend/ControlSoftware/EcuModSeln/Start to Stop Transition/Neg_Edge" /begin REF_CHARACTERISTIC EG_NmrSng0_C /end REF_CHARACTERISTIC /end GROUP
/begin GROUP S304_Neg_Edge "EcuIntgdSwGend/ControlSoftware/EcuModSeln/TSC1 to Stop Transition/Neg_Edge" /begin REF_CHARACTERISTIC EG_NmrSng0_C /end REF_CHARACTERISTIC /end GROUP
/begin GROUP S308_Neg_Edge "EcuIntgdSwGend/ControlSoftware/EcuModSeln/Torque to Stop Transition/Neg_Edge" /begin REF_CHARACTERISTIC EG_NmrSng0_C /end REF_CHARACTERISTIC /end GROUP
/begin GROUP S318_SPN_100___Engine_Oil_Pressure "EcuIntgdSwGend/ControlSoftware/EcuOutpPrcsg/CAN Signals/SPN 100 - Engine Oil Pressure" /begin REF_CHARACTERISTIC EG_mBar2kPa_C EOP_CanPOilOvs_P EOP_CanPOilOvv_P /end REF_CHARACTERISTIC /begin REF_MEASUREMENT EOP_CanPOil /end REF_MEASUREMENT /end GROUP
/begin GROUP S318_SPN_102___Engine_Intake_Manifold_1_Pressure "EcuIntgdSwGend/ControlSoftware/EcuOutpPrcsg/CAN Signals/SPN 102 - Engine Intake Manifold 1 Pressure" /begin REF_CHARACTERISTIC EG_mBar2kPa_C EOP_CanPAirBoostOvs_P EOP_CanPAirBoostOvv_P /end REF_CHARACTERISTIC /begin REF_MEASUREMENT EOP_CanPAirBoost /end REF_MEASUREMENT /end GROUP
/begin GROUP S318_SPN_105___Engine_Intake_Manifold_1_Temperature "EcuIntgdSwGend/ControlSoftware/EcuOutpPrcsg/CAN Signals/SPN 105 - Engine Intake Manifold 1 Temperature" /begin REF_CHARACTERISTIC EOP_CanTAirBoostOvs_P EOP_CanTAirBoostOvv_P /end REF_CHARACTERISTIC /begin REF_MEASUREMENT EOP_CanTAirBoost /end REF_MEASUREMENT /end GROUP
/begin GROUP S318_SPN_108___Barometric_Pressure "EcuIntgdSwGend/ControlSoftware/EcuOutpPrcsg/CAN Signals/SPN 108 - Barometric Pressure" /begin REF_CHARACTERISTIC EG_mBar2kPa_C EOP_CanPBaroOvs_P EOP_CanPBaroOvv_P /end REF_CHARACTERISTIC /begin REF_MEASUREMENT EOP_CanPBaro /end REF_MEASUREMENT /end GROUP
/begin GROUP S318_SPN_1081___Engine_Wait_to_Start_Lamp "EcuIntgdSwGend/ControlSoftware/EcuOutpPrcsg/CAN Signals/SPN 1081 - Engine Wait to Start Lamp"
 /begin REF_CHARACTERISTIC EG_ColdStrtLampErr_C EG_ColdStrtLampNotAvl_C EG_ColdStrtLampOff_C EG_ColdStrtLampOn_C EOP_CanColdStrtLampOvs_P EOP_CanColdStrtLampOvv_P EOP_ColdStrtLampNotAvl_P /end REF_CHARACTERISTIC
 /begin REF_MEASUREMENT EOP_CanColdStrtLamp /end REF_MEASUREMENT
/end GROUP
/begin GROUP S318_SPN_1136___Engine_ECU_Temperature "EcuIntgdSwGend/ControlSoftware/EcuOutpPrcsg/CAN Signals/SPN 1136 - Engine ECU Temperature" /begin REF_CHARACTERISTIC EOP_CanTEcuOvs_P EOP_CanTEcuOvv_P /end REF_CHARACTERISTIC /begin REF_MEASUREMENT EOP_CanTEcu /end REF_MEASUREMENT /end GROUP
/begin GROUP S318_SPN_1188___Engine_Turbocharger_Wastegate_Actuator_1_Position "EcuIntgdSwGend/ControlSoftware/EcuOutpPrcsg/CAN Signals/SPN 1188 - Engine Turbocharger Wastegate Actuator 1 Position" /begin REF_CHARACTERISTIC EOP_CanPosOfWg1Ovs_P EOP_CanPosOfWg1Ovv_P /end REF_CHARACTERISTIC /begin REF_MEASUREMENT EOP_CanPosOfWg1 /end REF_MEASUREMENT /end GROUP
/begin GROUP S318_SPN_1237___Engine_Shutdown_Override_Switch "EcuIntgdSwGend/ControlSoftware/EcuOutpPrcsg/CAN Signals/SPN 1237 - Engine Shutdown Override Switch"
 /begin REF_CHARACTERISTIC EG_CmbtSwtErr_C EG_CmbtSwtNotAvlNotAvl_C EG_CmbtSwtOff_C EG_CmbtSwtOn_C EOP_CanEngShtdwnOvrdSwtOvs_P EOP_CanEngShtdwnOvrdSwtOvv_P EOP_CmbtSwtNotAvl_P /end REF_CHARACTERISTIC
 /begin REF_MEASUREMENT EOP_CanEngShtdwnOvrdSwt /end REF_MEASUREMENT
/end GROUP
/begin GROUP S318_SPN_1436___Engine_Actual_Ignition_Timing "EcuIntgdSwGend/ControlSoftware/EcuOutpPrcsg/CAN Signals/SPN 1436 - Engine Actual Ignition Timing" /begin REF_CHARACTERISTIC EOP_CanSoiMaiInjOvs_P EOP_CanSoiMaiInjOvv_P /end REF_CHARACTERISTIC /begin REF_MEASUREMENT EOP_CanSoiMaiInj /end REF_MEASUREMENT /end GROUP
/begin GROUP S318_SPN_157___Engine_Injector_Metering_Rail_1_Pressure "EcuIntgdSwGend/ControlSoftware/EcuOutpPrcsg/CAN Signals/SPN 157 - Engine Injector Metering Rail 1 Pressure" /begin REF_CHARACTERISTIC EG_Bar2MPa_C EOP_CanPRailOvs_P EOP_CanPRailOvv_P /end REF_CHARACTERISTIC /begin REF_MEASUREMENT EOP_CanPRail /end REF_MEASUREMENT /end GROUP
/begin GROUP S318_SPN_1636___Engine_Intake_Manifold_1_Air_Temperature__High_Resolution_ "EcuIntgdSwGend/ControlSoftware/EcuOutpPrcsg/CAN Signals/SPN 1636 - Engine Intake Manifold 1 Air Temperature (High Resolution)" /begin REF_CHARACTERISTIC EOP_CanTAirBoostHiReslOvs_P EOP_CanTAirBoostHiReslOvv_P /end REF_CHARACTERISTIC /begin REF_MEASUREMENT EOP_CanTAirBoostHiResl /end REF_MEASUREMENT /end GROUP
/begin GROUP S318_SPN_1637___Engine_Coolant_Temperature__High_Resolution_ "EcuIntgdSwGend/ControlSoftware/EcuOutpPrcsg/CAN Signals/SPN 1637 - Engine Coolant Temperature (High Resolution)" /begin REF_CHARACTERISTIC EOP_CanTCooltOvs_P EOP_CanTCooltOvv_P /end REF_CHARACTERISTIC /begin REF_MEASUREMENT EOP_CanTCoolt /end REF_MEASUREMENT /end GROUP
/begin GROUP S318_SPN_166___Engine_Rated_Power "EcuIntgdSwGend/ControlSoftware/EcuOutpPrcsg/CAN Signals/SPN 166 - Engine Rated Power"
 /begin REF_CHARACTERISTIC EOP_CanEngRatedPwrOvs_P EOP_CanEngRatedPwrOvv_P EOP_EngRatedPwr_P /end REF_CHARACTERISTIC
 /begin REF_MEASUREMENT EOP_CanEngRatedPwr /end REF_MEASUREMENT
/end GROUP
/begin GROUP S318_SPN_1675___Engine_Starter_Mode "EcuIntgdSwGend/ControlSoftware/EcuOutpPrcsg/CAN Signals/SPN 1675 - Engine Starter Mode"
 /begin REF_CHARACTERISTIC EG_EngStrtrModeNotAvl_C EOP_CanEngStrtrModOvs_P EOP_CanEngStrtrModOvv_P EOP_EngStrtrModeNotAvl_P /end REF_CHARACTERISTIC
 /begin REF_MEASUREMENT EOP_CanEngStrtrMod /end REF_MEASUREMENT
/end GROUP
/begin GROUP S318_SPN_168___Battery_Potential____Power_Input_1 "EcuIntgdSwGend/ControlSoftware/EcuOutpPrcsg/CAN Signals/SPN 168 - Battery Potential // Power Input 1" /begin REF_CHARACTERISTIC EOP_CanBattVolt1Ovs_P EOP_CanBattVolt1Ovv_P /end REF_CHARACTERISTIC /begin REF_MEASUREMENT EOP_CanBattVolt1 /end REF_MEASUREMENT /end GROUP
/begin GROUP S318_SPN_171___Ambient_Air_Temperature "EcuIntgdSwGend/ControlSoftware/EcuOutpPrcsg/CAN Signals/SPN 171 - Ambient Air Temperature" /begin REF_CHARACTERISTIC EOP_CanTAmbAirOvs_P EOP_CanTAmbAirOvv_P /end REF_CHARACTERISTIC /begin REF_MEASUREMENT EOP_CanTAmbAir /end REF_MEASUREMENT /end GROUP
/begin GROUP S318_SPN_1715___Drivers_Demand_Retarder___Percent_Torque "EcuIntgdSwGend/ControlSoftware/EcuOutpPrcsg/CAN Signals/SPN 1715 - Drivers Demand Retarder - Percent Torque"
 /begin REF_CHARACTERISTIC EOP_CanDrvrDmdEngBrkPercTqOvs_P EOP_CanDrvrDmdEngBrkPercTqOvv_P /end REF_CHARACTERISTIC
 /begin REF_MEASUREMENT EOP_CanDrvrDmdEngBrkPercTq /end REF_MEASUREMENT
/end GROUP
/begin GROUP S318_SPN_1717___Actual_Maximum_Available_Retarder___Percent_Torque "EcuIntgdSwGend/ControlSoftware/EcuOutpPrcsg/CAN Signals/SPN 1717 - Actual Maximum Available Retarder - Percent Torque"
 /begin REF_CHARACTERISTIC EOP_CanActMaxAvlEngBrkPercTqOvs_P EOP_CanActMaxAvlEngBrkPercTqOvv_P /end REF_CHARACTERISTIC
 /begin REF_MEASUREMENT EOP_CanActMaxAvlEngBrkPercTq /end REF_MEASUREMENT
/end GROUP
/begin GROUP S318_SPN_174___Engine_Fuel_Temperature_1 "EcuIntgdSwGend/ControlSoftware/EcuOutpPrcsg/CAN Signals/SPN 174 - Engine Fuel Temperature 1" /begin REF_CHARACTERISTIC EOP_CanTFuOvs_P EOP_CanTFuOvv_P /end REF_CHARACTERISTIC /begin REF_MEASUREMENT EOP_CanTFu /end REF_MEASUREMENT /end GROUP
/begin GROUP S318_SPN_175___Engine_Oil_Temperature_1 "EcuIntgdSwGend/ControlSoftware/EcuOutpPrcsg/CAN Signals/SPN 175 - Engine Oil Temperature 1" /begin REF_CHARACTERISTIC EOP_CanTOilOvs_P EOP_CanTOilOvv_P /end REF_CHARACTERISTIC /begin REF_MEASUREMENT EOP_CanTOil /end REF_MEASUREMENT /end GROUP
/begin GROUP S318_SPN_183___Engine_Fuel_Rate "EcuIntgdSwGend/ControlSoftware/EcuOutpPrcsg/CAN Signals/SPN 183 - Engine Fuel Rate" /begin REF_CHARACTERISTIC EOP_CanEngFuRateOvs_P EOP_CanEngFuRateOvv_P /end REF_CHARACTERISTIC /begin REF_MEASUREMENT EOP_CanEngFuRate /end REF_MEASUREMENT /end GROUP
/begin GROUP S318_SPN_1846___Engine_Default_Torque_Limit "EcuIntgdSwGend/ControlSoftware/EcuOutpPrcsg/CAN Signals/SPN 1846 - Engine Default Torque Limit" /begin REF_CHARACTERISTIC EOP_CanEngDftTqLimOvs_P EOP_CanEngDftTqLimOvv_P /end REF_CHARACTERISTIC /begin REF_MEASUREMENT EOP_CanEngDftTqLim /end REF_MEASUREMENT /end GROUP
/begin GROUP S318_SPN_188___Engine_Speed_At_Idle__Point_1 "EcuIntgdSwGend/ControlSoftware/EcuOutpPrcsg/CAN Signals/SPN 188 - Engine Speed At Idle, Point 1" /begin REF_CHARACTERISTIC EOP_CanEngSpdPoint1Ovs_P EOP_CanEngSpdPoint1Ovv_P /end REF_CHARACTERISTIC /begin REF_MEASUREMENT EOP_CanEngSpdPoint1 /end REF_MEASUREMENT /end GROUP
/begin GROUP S318_SPN_189___Engine_Rated_Speed "EcuIntgdSwGend/ControlSoftware/EcuOutpPrcsg/CAN Signals/SPN 189 - Engine Rated Speed"
 /begin REF_CHARACTERISTIC EOP_CanEngRatedSpdOvs_P EOP_CanEngRatedSpdOvv_P EOP_EngRatedSpd_P /end REF_CHARACTERISTIC
 /begin REF_MEASUREMENT EOP_CanEngRatedSpd /end REF_MEASUREMENT
/end GROUP
/begin GROUP S318_SPN_190___Engine_Speed "EcuIntgdSwGend/ControlSoftware/EcuOutpPrcsg/CAN Signals/SPN 190 - Engine Speed" /begin REF_CHARACTERISTIC EOP_CanEngSpdOvs_P EOP_CanEngSpdOvv_P /end REF_CHARACTERISTIC /begin REF_MEASUREMENT EOP_CanEngSpd /end REF_MEASUREMENT /end GROUP
/begin GROUP S318_SPN_2432___Engine_Demand___Percent_Torque "EcuIntgdSwGend/ControlSoftware/EcuOutpPrcsg/CAN Signals/SPN 2432 - Engine Demand  Percent Torque" /begin REF_CHARACTERISTIC EOP_CanEngDmdPercTqOvs_P EOP_CanEngDmdPercTqOvv_P /end REF_CHARACTERISTIC /begin REF_MEASUREMENT EOP_CanEngDmdPercTq /end REF_MEASUREMENT /end GROUP
/begin GROUP S318_SPN_247___Engine_Total_Hours_of_Operation "EcuIntgdSwGend/ControlSoftware/EcuOutpPrcsg/CAN Signals/SPN 247 - Engine Total Hours of Operation" /begin REF_CHARACTERISTIC EOP_CanEngHrOvs_P EOP_CanEngHrOvv_P /end REF_CHARACTERISTIC /begin REF_MEASUREMENT EOP_CanEngHr /end REF_MEASUREMENT /end GROUP
/begin GROUP S318_SPN_250___Engine_Total_Fuel_Used "EcuIntgdSwGend/ControlSoftware/EcuOutpPrcsg/CAN Signals/SPN 250 - Engine Total Fuel Used" /begin REF_CHARACTERISTIC EOP_CanEngTotFuQntyOvs_P EOP_CanEngTotFuQntyOvv_P /end REF_CHARACTERISTIC /begin REF_MEASUREMENT EOP_CanEngTotFuQnty /end REF_MEASUREMENT /end GROUP
/begin GROUP S318_SPN_2978___Estimated_Engine_Parasitic_Losses___Percent_Torque "EcuIntgdSwGend/ControlSoftware/EcuOutpPrcsg/CAN Signals/SPN 2978 - Estimated Engine Parasitic Losses - Percent Torque"
 /begin REF_CHARACTERISTIC EG_0xFB_C EOP_CanEngParasiticLossOvs_P EOP_CanEngParasiticLossOvv_P /end REF_CHARACTERISTIC
 /begin REF_MEASUREMENT EOP_CanEngParasiticLoss /end REF_MEASUREMENT
/end GROUP
/begin GROUP S318_SPN_2979___Vehicle_Acceleration_Rate_Limit_Status "EcuIntgdSwGend/ControlSoftware/EcuOutpPrcsg/CAN Signals/SPN 2979 - Vehicle Acceleration Rate Limit Status"
 /begin REF_CHARACTERISTIC EOP_CanVehAccrRateLimStsOvs_P EOP_CanVehAccrRateLimStsOvv_P /end REF_CHARACTERISTIC
 /begin REF_MEASUREMENT EOP_CanVehAccrRateLimSts /end REF_MEASUREMENT
/end GROUP
/begin GROUP S318_SPN_3543___Engine_Operating_State "EcuIntgdSwGend/ControlSoftware/EcuOutpPrcsg/CAN Signals/SPN 3543 - Engine Operating State"
 /begin SUB_GROUP S354_Cool_Down S354_Engine_Running_Mode S354_Engine_Stopped___Ready S354_Not_Available S354_Post_Run S354_Pre_Start S354_Running S354_Starting S354_Stopping S354_Warm_Up /end SUB_GROUP
 /begin REF_CHARACTERISTIC EG_ModEngCtlPwrOn_C EG_ModEngCtlStp_C EG_ModEngCtlStrt_C EOP_CanEngStOvs_P EOP_CanEngStOvv_P /end REF_CHARACTERISTIC
 /begin REF_MEASUREMENT EOP_CanEngSt /end REF_MEASUREMENT
/end GROUP
/begin GROUP S318_SPN_4154___Actual_Engine___Percent_Torque_High_Resolution "EcuIntgdSwGend/ControlSoftware/EcuOutpPrcsg/CAN Signals/SPN 4154 - Actual Engine - Percent Torque High Resolution"
 /begin REF_CHARACTERISTIC EOP_CanActEngPercTqHiReslOvs_P EOP_CanActEngPercTqHiReslOvv_P EOP_SPN4154LoLim_C EOP_SPN4154Resl_C EOP_SPN4154UpLim_C /end REF_CHARACTERISTIC
 /begin REF_MEASUREMENT EOP_CanActEngPercTqHiResl /end REF_MEASUREMENT
/end GROUP
/begin GROUP S318_SPN_5078___Engine_Amber_Warning_Lamp_Command "EcuIntgdSwGend/ControlSoftware/EcuOutpPrcsg/CAN Signals/SPN 5078 - Engine Amber Warning Lamp Command"
 /begin REF_CHARACTERISTIC EOP_CanEngAmberWarnLampCmdOvs_P EOP_CanEngAmberWarnLampCmdOvv_P /end REF_CHARACTERISTIC
 /begin REF_MEASUREMENT EOP_CanEngAmberWarnLampCmd /end REF_MEASUREMENT
/end GROUP
/begin GROUP S318_SPN_5079___Engine_Red_Stop_Lamp_Command "EcuIntgdSwGend/ControlSoftware/EcuOutpPrcsg/CAN Signals/SPN 5079 - Engine Red Stop Lamp Command"
 /begin REF_CHARACTERISTIC EOP_CanEngRedStopLampCmdOvs_P EOP_CanEngRedStopLampCmdOvv_P /end REF_CHARACTERISTIC
 /begin REF_MEASUREMENT EOP_CanEngRedStopLampCmd /end REF_MEASUREMENT
/end GROUP
/begin GROUP S318_SPN_5081___Engine_Brake_Active_Lamp_Command "EcuIntgdSwGend/ControlSoftware/EcuOutpPrcsg/CAN Signals/SPN 5081 - Engine Brake Active Lamp Command"
 /begin REF_CHARACTERISTIC EOP_CanEngBrkActvdLampCmdOvs_P EOP_CanEngBrkActvdLampCmdOvv_P /end REF_CHARACTERISTIC
 /begin REF_MEASUREMENT EOP_CanEngBrkActvdLampCmd /end REF_MEASUREMENT
/end GROUP
/begin GROUP 0 "EcuIntgdSwGend/ControlSoftware/EcuOutpPrcsg/CAN Signals/SPN 512 - Driver's Demand Engine - Percent Torque" /begin REF_CHARACTERISTIC EOP_CanDrvrDmdPercTqOvs_P EOP_CanDrvrDmdPercTqOvv_P /end REF_CHARACTERISTIC /begin REF_MEASUREMENT EOP_CanDrvrDmdPercTq /end REF_MEASUREMENT /end GROUP
/begin GROUP S318_SPN_513___Actual_Engine___Percent_Torque "EcuIntgdSwGend/ControlSoftware/EcuOutpPrcsg/CAN Signals/SPN 513 - Actual Engine - Percent Torque" /begin REF_CHARACTERISTIC EOP_CanActEngPercTqOvs_P EOP_CanActEngPercTqOvv_P /end REF_CHARACTERISTIC /begin REF_MEASUREMENT EOP_CanActEngPercTq /end REF_MEASUREMENT /end GROUP
/begin GROUP S318_SPN_514___Nominal_Friction___Percent_Torque "EcuIntgdSwGend/ControlSoftware/EcuOutpPrcsg/CAN Signals/SPN 514 - Nominal Friction - Percent Torque" /begin REF_CHARACTERISTIC EOP_CanNomFricPercTqOvs_P EOP_CanNomFricPercTqOvv_P /end REF_CHARACTERISTIC /begin REF_MEASUREMENT EOP_CanNomFricPercTq /end REF_MEASUREMENT /end GROUP
/begin GROUP S318_SPN_520___Actual_Retarder___Percent_Torque "EcuIntgdSwGend/ControlSoftware/EcuOutpPrcsg/CAN Signals/SPN 520 - Actual Retarder - Percent Torque" /begin REF_CHARACTERISTIC EOP_CanActEngBrkPercTqOvs_P EOP_CanActEngBrkPercTqOvv_P /end REF_CHARACTERISTIC /begin REF_MEASUREMENT EOP_CanActEngBrkPercTq /end REF_MEASUREMENT /end GROUP
/begin GROUP S318_SPN_527___Cruise_Control_States "EcuIntgdSwGend/ControlSoftware/EcuOutpPrcsg/CAN Signals/SPN 527 - Cruise Control States" /begin REF_CHARACTERISTIC EOP_CanCrsCtrlStOvs_P EOP_CanCrsCtrlStOvv_P /end REF_CHARACTERISTIC /begin REF_MEASUREMENT EOP_CanCrsCtrlSt /end REF_MEASUREMENT /end GROUP
/begin GROUP S318_SPN_528___Engine_Speed_At_Point_2 "EcuIntgdSwGend/ControlSoftware/EcuOutpPrcsg/CAN Signals/SPN 528 - Engine Speed At Point 2" /begin REF_CHARACTERISTIC EOP_CanEngSpdPoint2Ovs_P EOP_CanEngSpdPoint2Ovv_P /end REF_CHARACTERISTIC /begin REF_MEASUREMENT EOP_CanEngSpdPoint2 /end REF_MEASUREMENT /end GROUP
/begin GROUP S318_SPN_529___Engine_Speed_At_Point_3 "EcuIntgdSwGend/ControlSoftware/EcuOutpPrcsg/CAN Signals/SPN 529 - Engine Speed At Point 3" /begin REF_CHARACTERISTIC EOP_CanEngSpdPoint3Ovs_P EOP_CanEngSpdPoint3Ovv_P /end REF_CHARACTERISTIC /begin REF_MEASUREMENT EOP_CanEngSpdPoint3 /end REF_MEASUREMENT /end GROUP
/begin GROUP S318_SPN_530___Engine_Speed_At_Point_4 "EcuIntgdSwGend/ControlSoftware/EcuOutpPrcsg/CAN Signals/SPN 530 - Engine Speed At Point 4" /begin REF_CHARACTERISTIC EOP_CanEngSpdPoint4Ovs_P EOP_CanEngSpdPoint4Ovv_P /end REF_CHARACTERISTIC /begin REF_MEASUREMENT EOP_CanEngSpdPoint4 /end REF_MEASUREMENT /end GROUP
/begin GROUP S318_SPN_531___Engine_Speed_At_Point_5 "EcuIntgdSwGend/ControlSoftware/EcuOutpPrcsg/CAN Signals/SPN 531 - Engine Speed At Point 5" /begin REF_CHARACTERISTIC EOP_CanEngSpdPoint5Ovs_P EOP_CanEngSpdPoint5Ovv_P /end REF_CHARACTERISTIC /begin REF_MEASUREMENT EOP_CanEngSpdPoint5 /end REF_MEASUREMENT /end GROUP
/begin GROUP S318_SPN_532___Engine_Speed_At_High_Idle__Point_6 "EcuIntgdSwGend/ControlSoftware/EcuOutpPrcsg/CAN Signals/SPN 532 - Engine Speed At High Idle, Point 6" /begin REF_CHARACTERISTIC EOP_CanEngSpdPoint6Ovs_P EOP_CanEngSpdPoint6Ovv_P /end REF_CHARACTERISTIC /begin REF_MEASUREMENT EOP_CanEngSpdPoint6 /end REF_MEASUREMENT /end GROUP
/begin GROUP S318_SPN_533___Engine_Maximum_Momentary_Override_Speed__Point_7 "EcuIntgdSwGend/ControlSoftware/EcuOutpPrcsg/CAN Signals/SPN 533 - Engine Maximum Momentary Override Speed, Point 7" /begin REF_CHARACTERISTIC EOP_CanEngSpdPoint7Ovs_P EOP_CanEngSpdPoint7Ovv_P /end REF_CHARACTERISTIC /begin REF_MEASUREMENT EOP_CanEngSpdPoint7 /end REF_MEASUREMENT /end GROUP
/begin GROUP S318_SPN_539___Engine_Percent_Torque_At_Idle__Point_1 "EcuIntgdSwGend/ControlSoftware/EcuOutpPrcsg/CAN Signals/SPN 539 - Engine Percent Torque At Idle, Point 1" /begin REF_CHARACTERISTIC EOP_CanEngPercTqPoint1Ovs_P EOP_CanEngPercTqPoint1Ovv_P /end REF_CHARACTERISTIC /begin REF_MEASUREMENT EOP_CanEngPercTqPoint1 /end REF_MEASUREMENT /end GROUP
/begin GROUP S318_SPN_540___Engine_Percent_Torque_At_Point_2 "EcuIntgdSwGend/ControlSoftware/EcuOutpPrcsg/CAN Signals/SPN 540 - Engine Percent Torque At Point 2" /begin REF_CHARACTERISTIC EOP_CanEngPercTqPoint2Ovs_P EOP_CanEngPercTqPoint2Ovv_P /end REF_CHARACTERISTIC /begin REF_MEASUREMENT EOP_CanEngPercTqPoint2 /end REF_MEASUREMENT /end GROUP
/begin GROUP S318_SPN_541___Engine_Percent_Torque_At_Point_3 "EcuIntgdSwGend/ControlSoftware/EcuOutpPrcsg/CAN Signals/SPN 541 - Engine Percent Torque At Point 3" /begin REF_CHARACTERISTIC EOP_CanEngPercTqPoint3Ovs_P EOP_CanEngPercTqPoint3Ovv_P /end REF_CHARACTERISTIC /begin REF_MEASUREMENT EOP_CanEngPercTqPoint3 /end REF_MEASUREMENT /end GROUP
/begin GROUP S318_SPN_542___Engine_Percent_Torque_At_Point_4 "EcuIntgdSwGend/ControlSoftware/EcuOutpPrcsg/CAN Signals/SPN 542 - Engine Percent Torque At Point 4" /begin REF_CHARACTERISTIC EOP_CanEngPercTqPoint4Ovs_P EOP_CanEngPercTqPoint4Ovv_P /end REF_CHARACTERISTIC /begin REF_MEASUREMENT EOP_CanEngPercTqPoint4 /end REF_MEASUREMENT /end GROUP
/begin GROUP S318_SPN_543___Engine_Percent_Torque_At_Point_5 "EcuIntgdSwGend/ControlSoftware/EcuOutpPrcsg/CAN Signals/SPN 543 - Engine Percent Torque At Point 5" /begin REF_CHARACTERISTIC EOP_CanEngPercTqPoint5Ovs_P EOP_CanEngPercTqPoint5Ovv_P /end REF_CHARACTERISTIC /begin REF_MEASUREMENT EOP_CanEngPercTqPoint5 /end REF_MEASUREMENT /end GROUP
/begin GROUP S318_SPN_544___Engine_Reference_Torque "EcuIntgdSwGend/ControlSoftware/EcuOutpPrcsg/CAN Signals/SPN 544 - Engine Reference Torque" /begin REF_CHARACTERISTIC EOP_CanEngRefTqOvs_P EOP_CanEngRefTqOvv_P /end REF_CHARACTERISTIC /begin REF_MEASUREMENT EOP_CanEngRefTq /end REF_MEASUREMENT /end GROUP
/begin GROUP S318_SPN_556___Reference_Retarder_Torque__Retarder_Configuration_ "EcuIntgdSwGend/ControlSoftware/EcuOutpPrcsg/CAN Signals/SPN 556 - Reference Retarder Torque (Retarder Configuration)" /begin REF_CHARACTERISTIC EOP_CanRefEngBrkTqOvs_P EOP_CanRefEngBrkTqOvv_P /end REF_CHARACTERISTIC /begin REF_MEASUREMENT EOP_CanRefEngBrkTq /end REF_MEASUREMENT /end GROUP
/begin GROUP S318_SPN_558___Accelerator_Pedal_1_Low_Idle_Switch "EcuIntgdSwGend/ControlSoftware/EcuOutpPrcsg/CAN Signals/SPN 558 - Accelerator Pedal 1 Low Idle Switch"
 /begin REF_CHARACTERISTIC EG_AccrPedl1IdleAvl_C EG_AccrPedl1IdleErr_C EG_AccrPedl1Idle_C EG_AccrPedl1NotIdle_C EOP_AccrPedl1IdleCndThd_P EOP_CanAccrPedl1LoIdleSwtOvs_P EOP_CanAccrPedl1LoIdleSwtOvv_P EOP_HndBrkPrkgNotAvl_P /end REF_CHARACTERISTIC
 /begin REF_MEASUREMENT EOP_CanAccrPedl1LoIdleSwt /end REF_MEASUREMENT
/end GROUP
/begin GROUP S318_SPN_595___Cruise_Control_Active "EcuIntgdSwGend/ControlSoftware/EcuOutpPrcsg/CAN Signals/SPN 595 - Cruise Control Active"
 /begin REF_CHARACTERISTIC EOP_CanCrsCtrlActvOvs_P EOP_CanCrsCtrlActvOvv_P EOP_CrsCtrlModOn_C /end REF_CHARACTERISTIC
 /begin REF_MEASUREMENT EOP_CanCrsCtrlActv /end REF_MEASUREMENT
/end GROUP
/begin GROUP S318_SPN_596___Cruise_Control_Enable_Switch "EcuIntgdSwGend/ControlSoftware/EcuOutpPrcsg/CAN Signals/SPN 596 - Cruise Control Enable Switch"
 /begin REF_CHARACTERISTIC EG_CrsCtrlDi_C EG_CrsCtrlEnaSwtErr_C EG_CrsCtrlEnaSwtNotAvl_C EG_CrsCtrlEna_C EOP_CanCrsCtrlEnaSwtOvs_P EOP_CanCrsCtrlEnaSwtOvv_P EOP_CrsCtrlEnaSwtNotAvl_P /end REF_CHARACTERISTIC
 /begin REF_MEASUREMENT EOP_CanCrsCtrlEnaSwt /end REF_MEASUREMENT
/end GROUP
/begin GROUP S318_SPN_597___Brake_Switch "EcuIntgdSwGend/ControlSoftware/EcuOutpPrcsg/CAN Signals/SPN 597 - Brake Switch"
 /begin REF_CHARACTERISTIC EG_BrkPdlDepressed_C EG_BrkPdlReld_C EG_BrkPedlErr_C EG_BrkPedlNotAvl_C EOP_BrkPedlNotAvl_P EOP_CanBrkSwtOvs_P EOP_CanBrkSwtOvv_P /end REF_CHARACTERISTIC
 /begin REF_MEASUREMENT EOP_CanBrkSwt /end REF_MEASUREMENT
/end GROUP
/begin GROUP S318_SPN_599___Cruise_Control_Set_Switch "EcuIntgdSwGend/ControlSoftware/EcuOutpPrcsg/CAN Signals/SPN 599 - Cruise Control Set Switch"
 /begin REF_CHARACTERISTIC EG_CrsCtrlSetSwtDi_C EG_CrsCtrlSetSwtEna_C EG_CrsCtrlSetSwtErr_C EG_CrsCtrlSetSwtNotAvl_C EOP_CanCrsCtrlSetSwtOvs_P EOP_CanCrsCtrlSetSwtOvv_P EOP_CrsCtrlSetSwtNotAvl_P /end REF_CHARACTERISTIC
 /begin REF_MEASUREMENT EOP_CanCrsCtrlSetSwt /end REF_MEASUREMENT
/end GROUP
/begin GROUP S318_SPN_600___Cruise_Control_Coast__Decelerate__Switch "EcuIntgdSwGend/ControlSoftware/EcuOutpPrcsg/CAN Signals/SPN 600 - Cruise Control Coast (Decelerate) Switch"
 /begin REF_CHARACTERISTIC EG_CrsCtrlDecSwtDi_C EG_CrsCtrlDecSwtEna_C EG_CrsCtrlDecSwtErr_C EG_CrsCtrlDecSwtNotAvl_C EOP_CanCrsCtrlDecSwtOvs_P EOP_CanCrsCtrlDecSwtOvv_P EOP_CrsCtrlDecSwtNotAvl_P /end REF_CHARACTERISTIC
 /begin REF_MEASUREMENT EOP_CanCrsCtrlDecSwt /end REF_MEASUREMENT
/end GROUP
/begin GROUP S318_SPN_601___Cruise_Control_Resume_Switch "EcuIntgdSwGend/ControlSoftware/EcuOutpPrcsg/CAN Signals/SPN 601 - Cruise Control Resume Switch"
 /begin REF_CHARACTERISTIC EG_CrsCtrlResSwtDi_C EG_CrsCtrlResSwtEna_C EG_CrsCtrlResSwtErr_C EG_CrsCtrlResSwtNotAvl_C EOP_CanCrsCtrlResSwtOvs_P EOP_CanCrsCtrlResSwtOvv_P EOP_CrsCtrlResSwtNotAvl_P /end REF_CHARACTERISTIC
 /begin REF_MEASUREMENT EOP_CanCrsCtrlResSwt /end REF_MEASUREMENT
/end GROUP
/begin GROUP S318_SPN_602___Cruise_Control_Accelerate_Switch "EcuIntgdSwGend/ControlSoftware/EcuOutpPrcsg/CAN Signals/SPN 602 - Cruise Control Accelerate Switch"
 /begin REF_CHARACTERISTIC EG_CrsCtrlIncSwtDi_C EG_CrsCtrlIncSwtEna_C EG_CrsCtrlIncSwtErr_C EG_CrsCtrlIncSwtNotAvl_C EOP_CanCrsCtrlIncSwtOvs_P EOP_CanCrsCtrlIncSwtOvv_P EOP_CrsCtrlIncSwtNotAvl_P /end REF_CHARACTERISTIC
 /begin REF_MEASUREMENT EOP_CanCrsCtrlIncSwt /end REF_MEASUREMENT
/end GROUP
/begin GROUP S318_SPN_623___Red_Stop_Lamp "EcuIntgdSwGend/ControlSoftware/EcuOutpPrcsg/CAN Signals/SPN 623 - Red Stop Lamp" /begin REF_CHARACTERISTIC EOP_CanRedStopLampOvs_P EOP_CanRedStopLampOvv_P /end REF_CHARACTERISTIC /begin REF_MEASUREMENT EOP_CanRedStopLamp /end REF_MEASUREMENT /end GROUP
/begin GROUP S318_SPN_624___Amber_Warning_Lamp "EcuIntgdSwGend/ControlSoftware/EcuOutpPrcsg/CAN Signals/SPN 624 - Amber Warning Lamp" /begin REF_CHARACTERISTIC EOP_CanAmberWarnLampOvs_P EOP_CanAmberWarnLampOvv_P /end REF_CHARACTERISTIC /begin REF_MEASUREMENT EOP_CanAmberWarnLamp /end REF_MEASUREMENT /end GROUP
/begin GROUP S318_SPN_70___Parking_Brake_Switch "EcuIntgdSwGend/ControlSoftware/EcuOutpPrcsg/CAN Signals/SPN 70 - Parking Brake Switch"
 /begin REF_CHARACTERISTIC EG_PrkgBrkErr_C EG_PrkgBrkNotAvl_C EG_PrkgBrkNotSet_C EG_PrkgBrkSet_C EOP_CanHndBrkPrkgOvs_P EOP_CanHndBrkPrkgOvv_P EOP_HndBrkPrkgNotAvl_P /end REF_CHARACTERISTIC
 /begin REF_MEASUREMENT EOP_CanHndBrkPrkg /end REF_MEASUREMENT
/end GROUP
/begin GROUP S318_SPN_84___Wheel_Based_Vehicle_Speed "EcuIntgdSwGend/ControlSoftware/EcuOutpPrcsg/CAN Signals/SPN 84 - Wheel-Based Vehicle Speed" /begin REF_CHARACTERISTIC EOP_CanWhlBasVehSpdOvs_P EOP_CanWhlBasVehSpdOvv_P /end REF_CHARACTERISTIC /begin REF_MEASUREMENT EOP_CanWhlBasVehSpd /end REF_MEASUREMENT /end GROUP
/begin GROUP S318_SPN_86___Cruise_Control_Set_Speed "EcuIntgdSwGend/ControlSoftware/EcuOutpPrcsg/CAN Signals/SPN 86 - Cruise Control Set Speed" /begin REF_CHARACTERISTIC EOP_CanCrsCtrlSetSpdOvs_P EOP_CanCrsCtrlSetSpdOvv_P /end REF_CHARACTERISTIC /begin REF_MEASUREMENT EOP_CanCrsCtrlSetSpd /end REF_MEASUREMENT /end GROUP
/begin GROUP S318_SPN_899___Engine_Torque_Mode "EcuIntgdSwGend/ControlSoftware/EcuOutpPrcsg/CAN Signals/SPN 899 - Engine Torque Mode"
 /begin SUB_GROUP S390_ABS_Control___Activated S390_ABS_control S390_ASR_Control___Activated S390_ASR_control S390_Accelerator_pedal__operator_selection S390_Cruise_Control S390_High_speed_governor S390_Low_idle_governor__no_request__default_mode_ S390_Not_Defined S390_Road_speed_governor S390_Torque_limiting S390_Transmission_control /end SUB_GROUP
 /begin REF_CHARACTERISTIC EG_CrsCtrlActvd_C EG_ModEngCtlIdleSpd_C EG_ModEngCtlTq_C EOP_CanEngTqModOvs_P EOP_CanEngTqModOvv_P /end REF_CHARACTERISTIC
 /begin REF_MEASUREMENT EOP_CanEngTqMod /end REF_MEASUREMENT
/end GROUP
/begin GROUP S318_SPN_91___Accelerator_Pedal_Position_1 "EcuIntgdSwGend/ControlSoftware/EcuOutpPrcsg/CAN Signals/SPN 91 - Accelerator Pedal Position 1" /begin REF_CHARACTERISTIC EOP_CanAccrPedlPosn1Ovs_P EOP_CanAccrPedlPosn1Ovv_P /end REF_CHARACTERISTIC /begin REF_MEASUREMENT EOP_CanAccrPedlPosn1 /end REF_MEASUREMENT /end GROUP
/begin GROUP S318_SPN_92___Engine_Percent_Load_At_Current_Speed "EcuIntgdSwGend/ControlSoftware/EcuOutpPrcsg/CAN Signals/SPN 92 - Engine Percent Load At Current Speed" /begin SUB_GROUP S392_avoidzerodivision_single /end SUB_GROUP
 /begin REF_CHARACTERISTIC EG_NmrSng100_C EOP_CanPercLoadAtCurrentSpdOvs_P EOP_CanPercLoadAtCurrentSpdOvv_P /end REF_CHARACTERISTIC
 /begin REF_MEASUREMENT EOP_CanPercLoadAtCurrentSpd /end REF_MEASUREMENT
/end GROUP
/begin GROUP S318_SPN_94___Engine_Fuel_Delivery_Pressure "EcuIntgdSwGend/ControlSoftware/EcuOutpPrcsg/CAN Signals/SPN 94 - Engine Fuel Delivery Pressure" /begin REF_CHARACTERISTIC EG_mBar2kPa_C EOP_CanPFuOvs_P EOP_CanPFuOvv_P /end REF_CHARACTERISTIC /begin REF_MEASUREMENT EOP_CanPFu /end REF_MEASUREMENT /end GROUP
/begin GROUP S318_SPN_97___Water_In_Fuel_Indicator "EcuIntgdSwGend/ControlSoftware/EcuOutpPrcsg/CAN Signals/SPN 97 - Water In Fuel Indicator" /begin REF_CHARACTERISTIC EOP_CanWtrInFuOvs_P EOP_CanWtrInFuOvv_P /end REF_CHARACTERISTIC /begin REF_MEASUREMENT EOP_CanWtrInFu /end REF_MEASUREMENT /end GROUP
/begin GROUP S318_SPN_976___PTO_Governor_State "EcuIntgdSwGend/ControlSoftware/EcuOutpPrcsg/CAN Signals/SPN 976 - PTO Governor State" /begin REF_CHARACTERISTIC EOP_CanPTOGovrStOvs_P EOP_CanPTOGovrStOvv_P /end REF_CHARACTERISTIC /begin REF_MEASUREMENT EOP_CanPTOGovrSt /end REF_MEASUREMENT /end GROUP
/begin GROUP S318_SPN_98___Engine_Oil_Level "EcuIntgdSwGend/ControlSoftware/EcuOutpPrcsg/CAN Signals/SPN 98 - Engine Oil Level" /begin REF_CHARACTERISTIC EOP_CanLvlOilOvs_P EOP_CanLvlOilOvv_P /end REF_CHARACTERISTIC /begin REF_MEASUREMENT EOP_CanLvlOil /end REF_MEASUREMENT /end GROUP
/begin GROUP S425_Hysteresis_Switch "EcuIntgdSwGend/ControlSoftware/EngBrk/Enable Conditionals/Hysteresis_Switch" /begin REF_CHARACTERISTIC EG_NmrSng0_C EG_NmrSng1_C /end REF_CHARACTERISTIC /end GROUP
/begin GROUP S427_If_Action_Subsystem "EcuIntgdSwGend/ControlSoftware/EngBrk/Engine Brake CAN Signals/If Action Subsystem" /begin REF_CHARACTERISTIC EngBrk_DrvrBrkLvrPosn1_P /end REF_CHARACTERISTIC /end GROUP
/begin GROUP S427_If_Action_Subsystem1 "EcuIntgdSwGend/ControlSoftware/EngBrk/Engine Brake CAN Signals/If Action Subsystem1" /begin REF_CHARACTERISTIC EngBrk_DrvrBrkLvrPosn2_P /end REF_CHARACTERISTIC /end GROUP
/begin GROUP S427_If_Action_Subsystem2 "EcuIntgdSwGend/ControlSoftware/EngBrk/Engine Brake CAN Signals/If Action Subsystem2" /begin REF_CHARACTERISTIC EngBrk_DrvrBrkLvrPosn0_P /end REF_CHARACTERISTIC /end GROUP
/begin GROUP S427_saturation1 "EcuIntgdSwGend/ControlSoftware/EngBrk/Engine Brake CAN Signals/saturation1" /begin REF_MEASUREMENT EngBrk_DrvrDmdEngBrkPercTq /end REF_MEASUREMENT /end GROUP
/begin GROUP S442_Cylinder_Balancing_For_Cylinder_1 "EcuIntgdSwGend/ControlSoftware/InjCtl/Cylinder Balancing/Cylinder Balancing For Cylinder 1" /begin REF_MEASUREMENT IC_CorrnFacCyl1 /end REF_MEASUREMENT /end GROUP
/begin GROUP S442_Cylinder_Balancing_For_Cylinder_2 "EcuIntgdSwGend/ControlSoftware/InjCtl/Cylinder Balancing/Cylinder Balancing For Cylinder 2" /begin REF_MEASUREMENT IC_CorrnFacCyl2 /end REF_MEASUREMENT /end GROUP
/begin GROUP S442_Cylinder_Balancing_For_Cylinder_3 "EcuIntgdSwGend/ControlSoftware/InjCtl/Cylinder Balancing/Cylinder Balancing For Cylinder 3" /begin REF_MEASUREMENT IC_CorrnFacCyl3 /end REF_MEASUREMENT /end GROUP
/begin GROUP S442_Cylinder_Balancing_For_Cylinder_4 "EcuIntgdSwGend/ControlSoftware/InjCtl/Cylinder Balancing/Cylinder Balancing For Cylinder 4" /begin REF_MEASUREMENT IC_CorrnFacCyl4 /end REF_MEASUREMENT /end GROUP
/begin GROUP S442_Cylinder_Balancing_For_Cylinder_5 "EcuIntgdSwGend/ControlSoftware/InjCtl/Cylinder Balancing/Cylinder Balancing For Cylinder 5" /begin REF_MEASUREMENT IC_CorrnFacCyl5 /end REF_MEASUREMENT /end GROUP
/begin GROUP S442_Cylinder_Balancing_For_Cylinder_6 "EcuIntgdSwGend/ControlSoftware/InjCtl/Cylinder Balancing/Cylinder Balancing For Cylinder 6" /begin REF_MEASUREMENT IC_CorrnFacCyl6 /end REF_MEASUREMENT /end GROUP
/begin GROUP S442_Cylinder_Balancing_PID_Controllers_ "EcuIntgdSwGend/ControlSoftware/InjCtl/Cylinder Balancing/Cylinder Balancing PID Controllers "
 /begin SUB_GROUP S455_PID_Controller_for_Cylinder_1 S455_PID_Controller_for_Cylinder_2 S455_PID_Controller_for_Cylinder_3 S455_PID_Controller_for_Cylinder_4 S455_PID_Controller_for_Cylinder_5 S455_PID_Controller_for_Cylinder_6 /end SUB_GROUP
 /begin REF_CHARACTERISTIC IC_FacCyl1SatMax_P IC_FacCyl1SatMin_P IC_FacCyl2SatMax_P IC_FacCyl2SatMin_P IC_FacCyl3SatMax_P IC_FacCyl3SatMin_P IC_FacCyl4SatMax_P IC_FacCyl4SatMin_P IC_FacCyl5SatMax_P IC_FacCyl5SatMin_P IC_FacCyl6SatMax_P IC_FacCyl6SatMin_P IC_KdCoeffCyl1_P IC_KdCoeffCyl2_P IC_KdCoeffCyl3_P IC_KdCoeffCyl4_P IC_KdCoeffCyl5_P IC_KdCoeffCyl6_P IC_KdCyl1_P IC_KdCyl2_P IC_KdCyl3_P IC_KdCyl4_P IC_KdCyl5_P IC_KdCyl6_P IC_KiCyl1_P IC_KiCyl2_P IC_KiCyl3_P IC_KiCyl4_P IC_KiCyl5_P IC_KiCyl6_P IC_KpCyl1_P IC_KpCyl2_P IC_KpCyl3_P IC_KpCyl4_P IC_KpCyl5_P IC_KpCyl6_P /end REF_CHARACTERISTIC
/end GROUP
/begin GROUP S443_LowPassFilter "EcuIntgdSwGend/ControlSoftware/InjCtl/Fuel Consumption Calculation/LowPassFilter" /begin REF_CHARACTERISTIC EG_NmrSng0_C EG_bFlgTrue_C /end REF_CHARACTERISTIC /end GROUP
/begin GROUP S443_LowPassFilter1 "EcuIntgdSwGend/ControlSoftware/InjCtl/Fuel Consumption Calculation/LowPassFilter1" /begin REF_CHARACTERISTIC EG_NmrSng0_C EG_bFlgTrue_C /end REF_CHARACTERISTIC /end GROUP
/begin GROUP S443_LowPassFilter2 "EcuIntgdSwGend/ControlSoftware/InjCtl/Fuel Consumption Calculation/LowPassFilter2" /begin REF_CHARACTERISTIC EG_NmrSng0_C EG_bFlgTrue_C /end REF_CHARACTERISTIC /end GROUP
/begin GROUP S443_avoidzerodivision_single3 "EcuIntgdSwGend/ControlSoftware/InjCtl/Fuel Consumption Calculation/avoidzerodivision_single3" /begin REF_CHARACTERISTIC EG_NmrSng0_C EG_NmrSng1_C /end REF_CHARACTERISTIC /end GROUP
/begin GROUP S443_avoidzerodivision_single4 "EcuIntgdSwGend/ControlSoftware/InjCtl/Fuel Consumption Calculation/avoidzerodivision_single4" /begin REF_CHARACTERISTIC EG_NmrSng0_C EG_NmrSng1_C /end REF_CHARACTERISTIC /begin REF_MEASUREMENT IC_FuCnsLt /end REF_MEASUREMENT /end GROUP
/begin GROUP S443_avoidzerodivision_single5 "EcuIntgdSwGend/ControlSoftware/InjCtl/Fuel Consumption Calculation/avoidzerodivision_single5" /begin REF_CHARACTERISTIC EG_NmrSng0_C EG_NmrSng1_C /end REF_CHARACTERISTIC /end GROUP
/begin GROUP S445_Injector_1_Characteristic "EcuIntgdSwGend/ControlSoftware/InjCtl/Main Injector Characteristic Maps/Injector 1 Characteristic"
 /begin SUB_GROUP S480_Injector_1_Characteristic_Map_1 S480_Injector_1_Characteristic_Map_2 S480_Injector_1_Characteristic_Map_3 S480_Injector_1_Characteristic_Map_4 S480_Injector_1_Characteristic_Map_5 /end SUB_GROUP
/end GROUP
/begin GROUP S445_Injector_1_Characteristic_Calibration_ "EcuIntgdSwGend/ControlSoftware/InjCtl/Main Injector Characteristic Maps/Injector 1 Characteristic Calibration " /begin REF_CHARACTERISTIC IC_DurMaiLimd_M /end REF_CHARACTERISTIC /end GROUP
/begin GROUP S445_Injector_2_Characteristic "EcuIntgdSwGend/ControlSoftware/InjCtl/Main Injector Characteristic Maps/Injector 2 Characteristic"
 /begin SUB_GROUP S482_Injector_2_Characteristic_Map_1 S482_Injector_2_Characteristic_Map_2 S482_Injector_2_Characteristic_Map_3 S482_Injector_2_Characteristic_Map_4 S482_Injector_2_Characteristic_Map_5 /end SUB_GROUP
/end GROUP
/begin GROUP S445_Injector_2_Characteristic_Calibration_ "EcuIntgdSwGend/ControlSoftware/InjCtl/Main Injector Characteristic Maps/Injector 2 Characteristic Calibration " /begin REF_CHARACTERISTIC IC_DurMaiLimd_M /end REF_CHARACTERISTIC /end GROUP
/begin GROUP S445_Injector_3_Characteristic "EcuIntgdSwGend/ControlSoftware/InjCtl/Main Injector Characteristic Maps/Injector 3 Characteristic"
 /begin SUB_GROUP S484_Injector_3_Characteristic_Map_1 S484_Injector_3_Characteristic_Map_2 S484_Injector_3_Characteristic_Map_3 S484_Injector_3_Characteristic_Map_4 S484_Injector_3_Characteristic_Map_5 /end SUB_GROUP
/end GROUP
/begin GROUP S445_Injector_3_Characteristic_Calibration_ "EcuIntgdSwGend/ControlSoftware/InjCtl/Main Injector Characteristic Maps/Injector 3 Characteristic Calibration " /begin REF_CHARACTERISTIC IC_DurMaiLimd_M /end REF_CHARACTERISTIC /end GROUP
/begin GROUP S445_Injector_4_Characteristic "EcuIntgdSwGend/ControlSoftware/InjCtl/Main Injector Characteristic Maps/Injector 4 Characteristic"
 /begin SUB_GROUP S486_Injector_4_Characteristic_Map_1 S486_Injector_4_Characteristic_Map_2 S486_Injector_4_Characteristic_Map_3 S486_Injector_4_Characteristic_Map_4 S486_Injector_4_Characteristic_Map_5 /end SUB_GROUP
/end GROUP
/begin GROUP S445_Injector_4_Characteristic_Calibration_ "EcuIntgdSwGend/ControlSoftware/InjCtl/Main Injector Characteristic Maps/Injector 4 Characteristic Calibration " /begin REF_CHARACTERISTIC IC_DurMaiLimd_M /end REF_CHARACTERISTIC /end GROUP
/begin GROUP S445_Injector_5_Characteristic "EcuIntgdSwGend/ControlSoftware/InjCtl/Main Injector Characteristic Maps/Injector 5 Characteristic"
 /begin SUB_GROUP S488_Injector_5_Characteristic_Map_1 S488_Injector_5_Characteristic_Map_2 S488_Injector_5_Characteristic_Map_3 S488_Injector_5_Characteristic_Map_4 S488_Injector_5_Characteristic_Map_5 /end SUB_GROUP
/end GROUP
/begin GROUP S445_Injector_5_Characteristic_Calibration_ "EcuIntgdSwGend/ControlSoftware/InjCtl/Main Injector Characteristic Maps/Injector 5 Characteristic Calibration " /begin REF_CHARACTERISTIC IC_DurMaiLimd_M /end REF_CHARACTERISTIC /end GROUP
/begin GROUP S445_Injector_6_Characteristic "EcuIntgdSwGend/ControlSoftware/InjCtl/Main Injector Characteristic Maps/Injector 6 Characteristic"
 /begin SUB_GROUP S490_Injector_6_Characteristic_Map_1 S490_Injector_6_Characteristic_Map_2 S490_Injector_6_Characteristic_Map_3 S490_Injector_6_Characteristic_Map_4 S490_Injector_6_Characteristic_Map_5 /end SUB_GROUP
/end GROUP
/begin GROUP S445_Injector_6_Characteristic_Calibration "EcuIntgdSwGend/ControlSoftware/InjCtl/Main Injector Characteristic Maps/Injector 6 Characteristic Calibration" /begin REF_CHARACTERISTIC IC_DurMaiLimd_M /end REF_CHARACTERISTIC /end GROUP
/begin GROUP S446__Injector_1_Characteristic "EcuIntgdSwGend/ControlSoftware/InjCtl/Pilot Injector Characteristic Maps/ Injector 1 Characteristic"
 /begin SUB_GROUP S522_Injector_1_Characteristic_Map_1 S522_Injector_1_Characteristic_Map_2 S522_Injector_1_Characteristic_Map_3 S522_Injector_1_Characteristic_Map_4 S522_Injector_1_Characteristic_Map_5 /end SUB_GROUP
/end GROUP
/end MODULE
/end PROJECT
