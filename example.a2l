ASAP2_VERSION 1 6
/begin PROJECT ECEMTAG_CR8 ""
/begin MODULE DIM ""
/begin MOD_COMMON "Mod Common Comment Here" DEPOSIT ABSOLUTE BYTE_ORDER MSB_FIRST /end MOD_COMMON
/begin CHARACTERISTIC Save_Cal "calibration save start-trigger" VALUE 0x4001067C /* @ECU_Address@flash_save_eeprom_cal_flag@ */ UBYTE 1 NO_COMPU_METHOD 0 1 FORMAT "%20.0" /end CHARACTERISTIC
/begin CHARACTERISTIC Clr_Diag_List_Flg "Clear Diag Info List Flag " VALUE 0x400107E8 /* @ECU_Address@ClearFlagFaultLists@ */ ULONG 1 NO_COMPU_METHOD 0 1 FORMAT "%20.0" /end CHARACTERISTIC
/begin MEASUREMENT Flash_Sts "The status of the Flash" UBYTE NO_COMPU_METHOD 1 100 0 4 FORMAT "%20.0" ECU_ADDRESS 0x4001068C /* @ECU_Address@gucflash_status@ */ /end MEASUREMENT
/begin MEASUREMENT Cpu_Load "Cpu Load Percentage" FLOAT32_IEEE Percent_CM 1 100 0 100 FORMAT "%20.2" ECU_ADDRESS 0x4001BFCC /* @ECU_Address@WatchdogFile.cpu_load@ */ /end MEASUREMENT
/begin MEASUREMENT sw_ident_start_addr "sw_ident_start_addr" UBYTE NO_COMPU_METHOD 1 100 0 255 FORMAT "%20.0" ECU_ADDRESS 0x009FFF00 /* @ECU_Address@gstSoftwareIdent@ */ /end MEASUREMENT
/begin MEASUREMENT SVNREVNUM "software version" ULONG NO_COMPU_METHOD 1 100 0 4000000000 FORMAT "%20.0" ECU_ADDRESS 0x009FFF1C /* @ECU_Address@gstSoftwareIdent.build_rev@ */ /end MEASUREMENT
/*****************************************RTC START*******************************************/
/begin CHARACTERISTIC RTC_Cfg_IniSec "RTC Config Initial Second" VALUE 0x008557CC /* @ECU_Address@g_sRtcDefaultConfigTime.second@ */ UBYTE 1 NO_COMPU_METHOD 0 255 FORMAT "%20.0" /end CHARACTERISTIC
/begin CHARACTERISTIC RTC_Cfg_IniMins "RTC Config Initial Minute" VALUE 0x008557CD /* @ECU_Address@g_sRtcDefaultConfigTime.minute@ */ UBYTE 1 NO_COMPU_METHOD 0 255 FORMAT "%20.0" /end CHARACTERISTIC
/begin CHARACTERISTIC RTC_Cfg_IniHr "RTC Config Initial Hour" VALUE 0x008557CE /* @ECU_Address@g_sRtcDefaultConfigTime.hour@ */ UBYTE 1 NO_COMPU_METHOD 0 255 FORMAT "%20.0" /end CHARACTERISTIC
/begin CHARACTERISTIC RTC_Cfg_IniDay "RTC Config Initial Day" VALUE 0x008557CF /* @ECU_Address@g_sRtcDefaultConfigTime.day@ */ UBYTE 1 NO_COMPU_METHOD 0 255 FORMAT "%20.0" /end CHARACTERISTIC
/begin CHARACTERISTIC RTC_Cfg_IniWeekDay "RTC Config Initial Weekday" VALUE 0x008557D0 /* @ECU_Address@g_sRtcDefaultConfigTime.weekday@ */ UBYTE 1 NO_COMPU_METHOD 0 255 FORMAT "%20.0" /end CHARACTERISTIC
/begin CHARACTERISTIC RTC_Cfg_IniMth "RTC Config Initial Month" VALUE 0x008557D1 /* @ECU_Address@g_sRtcDefaultConfigTime.month@ */ UBYTE 1 NO_COMPU_METHOD 0 255 FORMAT "%20.0" /end CHARACTERISTIC
/begin CHARACTERISTIC RTC_Cfg_IniYr "RTC Config Initial Year" VALUE 0x008557D2 /* @ECU_Address@g_sRtcDefaultConfigTime.year@ */ UBYTE 1 NO_COMPU_METHOD 0 255 FORMAT "%20.0" /end CHARACTERISTIC
/*****************************************RTC END*******************************************/ /***************************************** FF START *******************************************/
/begin CHARACTERISTIC FF_Nr "Requested freeze frame number" VALUE 0x4000B230 /* @ECU_Address@A2L_FF_DM4.freeze_frame_number@ */ UBYTE 80 NO_COMPU_METHOD 1 80 FORMAT "%20.0" /end CHARACTERISTIC
/begin MEASUREMENT FF_Idx_Nr "Index of next freeze frame" UBYTE NO_COMPU_METHOD 1 100 0 255 FORMAT "%20.2" ECU_ADDRESS 0x400107E7 /* @ECU_Address@a2l_freeze_frame_index_number@ */ /end MEASUREMENT
/begin MEASUREMENT FF_SPN "Suspect Parameter Number" ULONG CM_SPNList 1 100 0 4000000000 FORMAT "%20.2" ECU_ADDRESS 0x4000B234 /* @ECU_Address@A2L_FF_DM4.spn@ */ /end MEASUREMENT
/begin MEASUREMENT FF_FMI "Failure Mode Identifier" UBYTE CM_FMIList 1 100 0 255 FORMAT "%20.0" ECU_ADDRESS 0x4000B238 /* @ECU_Address@A2L_FF_DM4.fmi@ */ /end MEASUREMENT
/begin MEASUREMENT FF_OC "Occurrence Count" UBYTE NO_COMPU_METHOD 1 100 0 255 FORMAT "%20.0" ECU_ADDRESS 0x4000B239 /* @ECU_Address@A2L_FF_DM4.oc@ */ /end MEASUREMENT
/begin MEASUREMENT FF_EngTqMod "Engine Torque Mode" UBYTE NO_COMPU_METHOD 1 100 0 255 FORMAT "%20.0" ECU_ADDRESS 0x4000B23A /* @ECU_Address@A2L_FF_DM4.engine_torque_mode@ */ /end MEASUREMENT
/begin MEASUREMENT FF_PAirBoost "Air Boost Pressure" UBYTE kPa_CM 1 100 0 255 ECU_ADDRESS 0x4000B23B /* @ECU_Address@A2L_FF_DM4.boost@ */ /end MEASUREMENT
/begin MEASUREMENT FF_NEng "Engine Speed" UWORD SpeedSensor_CM 1 100 0 65535 ECU_ADDRESS 0x4000B23C /* @ECU_Address@A2L_FF_DM4.engine_speed_raw@ */ /end MEASUREMENT
/begin MEASUREMENT FF_EngPrcLoadAtCurrentSpd "Engine Percent Load At Current Speed" UBYTE percent_CM 1 100 0 255 ECU_ADDRESS 0x4000B23E /* @ECU_Address@A2L_FF_DM4.engine_percent_load@ */ /end MEASUREMENT
/begin MEASUREMENT FF_TCoolt "Coolant Temperature" SWORD degC_CM 1 100 0 255 FORMAT "%20.0" ECU_ADDRESS 0x4000B240 /* @ECU_Address@A2L_FF_DM4.coolant_temp@ */ /end MEASUREMENT
/begin MEASUREMENT FF_VehV "Wheel-Based Vehicle Speed" UWORD kmh_CM 1 100 0 65535 ECU_ADDRESS 0x4000B242 /* @ECU_Address@A2L_FF_DM4.vehicle_speed_raw@ */ /end MEASUREMENT
/begin MEASUREMENT FF_TOil "Oil Temperature" UWORD degC_CM 1 100 0 65535 FORMAT "%20.0" ECU_ADDRESS 0x4000B244 /* @ECU_Address@A2L_FF_DM4.engine_oil_temp@ */ /end MEASUREMENT
/begin MEASUREMENT FF_TrsmCurrentGear "Transmission Current Gear" UWORD NO_COMPU_METHOD 1 100 0 65535 FORMAT "%20.0" ECU_ADDRESS 0x4000B246 /* @ECU_Address@A2L_FF_DM4.trasnmission_current_gear@ */ /end MEASUREMENT
/begin COMPU_METHOD CM_SPNList "" TAB_VERB "%0.0" "" COMPU_TAB_REF CT_SPNList /end COMPU_METHOD
/begin COMPU_VTAB CT_SPNList "" TAB_VERB 212 /*START_SPN_VALUE_PAIR*/ 85 "Coolant Temperature" 1 "Air Boost Temperature" 2 "Fuel Temperature" 3 "Oil Temperature" 4 "Ambient Air Temperature" 5 "Air Boost Pressure" 6 "Ambient Air Pressure" 7 "Oil Pressure" 8 "Fuel Pressure" 9 "Rail Pressure" 10 "Battery Voltage" 106 "Battery Voltage Coherence" 11 "Ecu Temperature" 12 "Cylinder Misfire" 13 "Cam Crank Sensor Defect" 14 "Injector Defect" 15 "Over Speed Error" 17 "Start Request" 18 "Engine Break100" 19 "Cruise Control 1" 20 "Cruise Control 2" 21 "Brake Pedal 1" 22 "Cruise Control 3" 23 "Engine Break 50" 25 "Hand Brake Parking" 26 "Overriding Switch" 27 "Ignition" 28 "Grid Heater" 42 "Coolant Temperature Diag" 43 "Air Boost Temperature Diag" 51 "Accelerator Pedal 1" 52 "Accelerator Pedal 2" 61 "VCV Current Output" 62 "PCV Current Output" 66 "VoltageDigitalOutputFeedback1" 69 "RSL Lamp Diagnostic" 70 "CSL Lamp Diagnostic" 72 "AWL Lamp Diagnostic" 73 "Voltage48V" 74 "Voltage24V" 75 "Voltage12V" 76 "Voltage5V" 77 "Voltage5VRef" 78 "Voltage3_3V" 79 "Voltage1_25V" 80 "Voltage12VCamDiag" 108 "Voltage12VCrankDiag" 81 "Voltage5VDiag1" 82 "Voltage5VDiag2" 83 "Voltage Temperature Sensor 1" 84 "Voltage Pressure Sensor" 109 "Voltage 5V Referance MCU Diagnostic" 98 "Starter" 102 "Heat Flange Relay" 111 "Engine Break Selonoid 1" 112 "RSL Lamp" 113 "CSL Lamp" 115 "AWL Lamp" 104 "VCV" 105 "PCV" 87 "Injector 1" 88 "Injector 2" 89 "Injector 3" 90 "Injector 4" 93 "Camshaft Sensor" 94 "Crankshaft Sensor" 107 "Coolant Temperature Coherence" 116 "Air Boost Temperature Coherence" 117 "Fuel Temperature Coherence" 118 "Oil Temperature Coherence" 119 "Ambient Air Temperature Coherence" 120 "Air Boost Pressure Coherence" 121 "Ambient Air Pressure Coherence" 122 "Oil Pressure Coherence" 123 "Fuel Pressure Coherence" 124 "Rail Pressure Coherence" 125 "Oil Level Coherence" 126 "ECU Temperature Coherence" 126 "Cam Crank Defect Coherence" 127 "Injector Defect Coherence" 128 "Cylinder Misfire Coherence" 129 "Over Speed Coherence" 130 "Start Request POR Error" 131 "Start Request SPI Error" 132 "Start Request TSD Error" 133 "Start Request TW Error" 134 "Start Request OV Error" 135 "Start Request UV Error" 136 "Start Request VS0 Error" 137 "Start Request VS1 Error" 138 "Start Request WetDiag Error" 139 "Start Request ADC Diag Error" 140 "Start Request Chk Error" 141 "Start Request Com Error" 142 "Start Request Init Error" 143 "Engine Break 100 POR Error" 144 "Engine Break 100 SPI Error" 145 "Engine Break 100 TSD Error" 146 "Engine Break 100 TW Error" 147 "Engine Break 100 OV Error" 148 "Engine Break 100 UV Error" 149 "Engine Break 100 VS0 Error" 150 "Engine Break 100 VS1 Error" 151 "Engine Break 100 WetDiag Error" 152 "Engine Break 100 ADC Diag Error" 153 "Engine Break 100 Chk Error" 154 "Engine Break 100 Com Error" 155 "Engine Break 100 Init Error" 156 "Cruise Control 1 POR Error" 157 "Cruise Control 1 SPI Error" 158 "Cruise Control 1 TSD Error" 159 "Cruise Control 1 TW Error" 160 "Cruise Control 1 OV Error" 161 "Cruise Control 1 UV Error" 162 "Cruise Control 1 VS0 Error" 163 "Cruise Control 1 VS1 Error" 164 "Cruise Control 1 WetDiag Error" 165 "Cruise Control 1 ADC Diag Error" 166 "Cruise Control 1 Chk Error" 167 "Cruise Control 1 Com Error" 168 "Cruise Control 1 Init Error" 169 "Cruise Control 2 POR Error" 170 "Cruise Control 2 SPI Error" 171 "Cruise Control 2 TSD Error" 172 "Cruise Control 2 TW Error" 173 "Cruise Control 2 OV Error" 174 "Cruise Control 2 UV Error" 175 "Cruise Control 2 VS0 Error" 176 "Cruise Control 2 VS1 Error" 177 "Cruise Control 2 WetDiag Error" 178 "Cruise Control 2 ADC Diag Error" 179 "Cruise Control 2 Chk Error" 180 "Cruise Control 2 Com Error" 181 "Cruise Control 2 Init Error" 182 "Brake Pedal 1 POR Error" 183 "Brake Pedal 1 SPI Error" 184 "Brake Pedal 1 TSD Error" 185 "Brake Pedal 1 TW Error" 186 "Brake Pedal 1 OV Error" 187 "Brake Pedal 1 UV Error" 188 "Brake Pedal 1 VS0 Error" 189 "Brake Pedal 1 VS1 Error" 190 "Brake Pedal 1 WetDiag Error" 191 "Brake Pedal 1 ADC Diag Error" 192 "Brake Pedal 1 Chk Error" 193 "Brake Pedal 1 Com Error" 194 "Brake Pedal 1 Init Error" 195 "Cruise Control 3 POR Error" 196 "Cruise Control 3 SPI Error" 197 "Cruise Control 3 TSD Error" 198 "Cruise Control 3 TW Error" 199 "Cruise Control 3 OV Error" 200 "Cruise Control 3 UV Error" 201 "Cruise Control 3 VS0 Error" 202 "Cruise Control 3 VS1 Error" 203 "Cruise Control 3 WetDiag Error" 204 "Cruise Control 3 ADC Diag Error" 205 "Cruise Control 3 Chk Error" 206 "Cruise Control 3 Com Error" 207 "Cruise Control 3 Init Error" 208 "Engine Break 50 POR Error" 209 "Engine Break 50 SPI Error" 210 "Engine Break 50 TSD Error" 211 "Engine Break 50 TW Error" 212 "Engine Break 50 OV Error" 213 "Engine Break 50 UV Error" 214 "Engine Break 50 VS0 Error" 215 "Engine Break 50 VS1 Error" 216 "Engine Break 50 WetDiag Error" 217 "Engine Break 50 ADC Diag Error" 218 "Engine Break 50 Chk Error" 219 "Engine Break 50 Com Error" 220 "Engine Break 50 Init Error" 221 "Trouble Shooting Button POR Error" 222 "Trouble Shooting Button SPI Error" 223 "Trouble Shooting Button TSD Error" 224 "Trouble Shooting Button TW Error" 225 "Trouble Shooting Button OV Error" 226 "Trouble Shooting Button UV Error" 227 "Trouble Shooting Button VS0 Error" 228 "Trouble Shooting Button VS1 Error" 229 "Trouble Shooting Button WetDiag Error" 230 "Trouble Shooting Button ADC Diag Error" 231 "Trouble Shooting Button Chk Error" 232 "Trouble Shooting Button Com Error" 233 "Trouble Shooting Button Init Error" 234 "Hand Brake Parking POR Error" 235 "Hand Brake Parking SPI Error" 236 "Hand Brake Parking TSD Error" 237 "Hand Brake Parking TW Error" 238 "Hand Brake Parking OV Error" 239 "Hand Brake Parking UV Error" 240 "Hand Brake Parking VS0 Error" 241 "Hand Brake Parking VS1 Error" 242 "Hand Brake Parking WetDiag Error" 243 "Hand Brake Parking ADC Diag Error" 244 "Hand Brake Parking Chk Error" 245 "Hand Brake Parking Com Error" 246 "Hand Brake Parking Init Error" 247 "Overriding Switch POR Error" 248 "Overriding Switch SPI Error" 249 "Overriding Switch TSD Error" 250 "Overriding Switch TW Error" 251 "Overriding Switch OV Error" 252 "Overriding Switch UV Error" 253 "Overriding Switch VS0 Error" 254 "Overriding Switch VS1 Error" 255 "Overriding Switch WetDiag Error" 256 "Overriding Switch ADC Diag Error" 257 "Overriding Switch Chk Error" 258 "Overriding Switch Com Error" 259 "Overriding Switch Init Error" /*END_SPN_VALUE_PAIR*/ /end COMPU_VTAB
/begin COMPU_METHOD CM_FMIList "" TAB_VERB "%0.0" "" COMPU_TAB_REF CT_FMIList /end COMPU_METHOD
/begin COMPU_VTAB CT_FMIList "" TAB_VERB 21 /*START_FMI_VALUE_PAIR*/ 0 "Over Shutdown" 1 "Under Shutdown" 2 "Intermittent" 3 "Short to Battery" 4 "Short to Ground" 5 "Open Load" 6 "Over Current" 7 "Wire Break" 8 "Freq Error" 9 "Update Rate Error" 10 "Gradient" 11 "Unknown Cause" 12 "Bad Component" 13 "Out Of Calibration" 14 "Special Instruction" 15 "Over Warning" 16 "Over Reduction" 17 "Under Warning" 18 "Under Reduction" 20 "Data Drift High" 21 "Data Drift Low" /*END_FMI_VALUE_PAIR*/ /end COMPU_VTAB
/begin COMPU_METHOD Percent_CM "Scale 1" RAT_FUNC "%20.1" "%" COEFFS 0 1 0 0 0 1 /end COMPU_METHOD
/begin COMPU_METHOD degC_CM "Scale 1" RAT_FUNC "%20.1" "degC" COEFFS 0 1 0 0 0 1 /end COMPU_METHOD
/begin COMPU_METHOD SpeedSensor_CM "Scale 1" RAT_FUNC "%20.0" "rpm" COEFFS 0 1 0 0 0 1 /end COMPU_METHOD
/begin COMPU_METHOD kmh_CM "Scale 1" RAT_FUNC "%20.0" "km/h" COEFFS 0 1 0 0 0 1 /end COMPU_METHOD
/begin COMPU_METHOD kPa_CM "Scale 1" RAT_FUNC "%20.0" "kPa" COEFFS 0 1 0 0 0 1 /end COMPU_METHOD
/begin COMPU_METHOD percent_CM "Scale 1" RAT_FUNC "%20.0" "%" COEFFS 0 1 0 0 0 1 /end COMPU_METHOD
/begin RECORD_LAYOUT FLOAT32_IEEE FNC_VALUES 1 FLOAT32_IEEE ROW_DIR DIRECT /end RECORD_LAYOUT
/begin RECORD_LAYOUT ULONG FNC_VALUES 1 ULONG ROW_DIR DIRECT /end RECORD_LAYOUT
/begin RECORD_LAYOUT UWORD FNC_VALUES 1 UWORD ROW_DIR DIRECT /end RECORD_LAYOUT
/begin RECORD_LAYOUT SWORD FNC_VALUES 1 SWORD ROW_DIR DIRECT /end RECORD_LAYOUT
/begin RECORD_LAYOUT UBYTE FNC_VALUES 1 UBYTE ROW_DIR DIRECT /end RECORD_LAYOUT
/begin RECORD_LAYOUT SBYTE FNC_VALUES 1 SBYTE ROW_DIR DIRECT /end RECORD_LAYOUT
/******************************* From MATLAB ***************************************/ /* MATLAB_SECTION_START_1 */
/begin RECORD_LAYOUT Scalar_BOOLEAN FNC_VALUES 1 UBYTE ROW_DIR DIRECT /end RECORD_LAYOUT
/begin RECORD_LAYOUT Scalar_ULONG FNC_VALUES 1 ULONG ROW_DIR DIRECT /end RECORD_LAYOUT
/begin RECORD_LAYOUT Scalar_FLOAT32_IEEE FNC_VALUES 1 FLOAT32_IEEE ROW_DIR DIRECT /end RECORD_LAYOUT
/begin RECORD_LAYOUT Lookup1D_FLOAT32_IEEE FNC_VALUES 1 FLOAT32_IEEE ROW_DIR DIRECT /end RECORD_LAYOUT
/begin RECORD_LAYOUT Lookup1D_X_FLOAT32_IEEE AXIS_PTS_X 1 FLOAT32_IEEE INDEX_INCR DIRECT /end RECORD_LAYOUT
/begin RECORD_LAYOUT Lookup2D_BOOLEAN FNC_VALUES 1 UBYTE ROW_DIR DIRECT /end RECORD_LAYOUT
/begin RECORD_LAYOUT Lookup2D_X_BOOLEAN AXIS_PTS_X 1 UBYTE INDEX_INCR DIRECT /end RECORD_LAYOUT
/begin RECORD_LAYOUT Lookup2D_UBYTE FNC_VALUES 1 UBYTE ROW_DIR DIRECT /end RECORD_LAYOUT
/begin RECORD_LAYOUT Lookup2D_X_UBYTE AXIS_PTS_X 1 UBYTE INDEX_INCR DIRECT /end RECORD_LAYOUT
/begin RECORD_LAYOUT Lookup2D_BYTE FNC_VALUES 1 SBYTE ROW_DIR DIRECT /end RECORD_LAYOUT
/begin RECORD_LAYOUT Lookup2D_X_BYTE AXIS_PTS_X 1 SBYTE INDEX_INCR DIRECT /end RECORD_LAYOUT
/begin RECORD_LAYOUT Lookup2D_UWORD FNC_VALUES 1 UWORD ROW_DIR DIRECT /end RECORD_LAYOUT
/begin RECORD_LAYOUT Lookup2D_X_UWORD AXIS_PTS_X 1 UWORD INDEX_INCR DIRECT /end RECORD_LAYOUT
/begin AXIS_PTS WM_NEng_A "Engine Speed Map Axis" 0x40050AE8 /* @ECU_Address@WM_NEng_A@ */ EIP_NEng Lookup1D_X_FLOAT32_IEEE 0 EcuIntgdSwGend_CM_single_rpm 5 0.0 6000.0 /end AXIS_PTS
/begin CHARACTERISTIC WM_PAirBoostUndLvl1_M "Air Boost Pressure Under Level 1 Map" CURVE 0x40050B58 /* @ECU_Address@WM_PAirBoostUndLvl1_M@ */ Lookup1D_FLOAT32_IEEE 0 EcuIntgdSwGend_CM_single_mbar 0.0 15000.0
 /begin AXIS_DESCR COM_AXIS EIP_NEng EcuIntgdSwGend_CM_single_rpm 5 0.0 6000.0 AXIS_PTS_REF WM_NEng_A /end AXIS_DESCR
/end CHARACTERISTIC
/begin CHARACTERISTIC WM_PAirBoostUndLvl2_M "Air Boost Pressure Under Level 2 Map" CURVE 0x40050B6C /* @ECU_Address@WM_PAirBoostUndLvl2_M@ */ Lookup1D_FLOAT32_IEEE 0 EcuIntgdSwGend_CM_single_mbar 0.0 15000.0
 /begin AXIS_DESCR COM_AXIS EIP_NEng EcuIntgdSwGend_CM_single_rpm 5 0.0 6000.0 AXIS_PTS_REF WM_NEng_A /end AXIS_DESCR
/end CHARACTERISTIC
/begin CHARACTERISTIC WM_PAirBoostUndLvl3_M "Air Boost Pressure Under Level 3 Map" CURVE 0x40050B80 /* @ECU_Address@WM_PAirBoostUndLvl3_M@ */ Lookup1D_FLOAT32_IEEE 0 EcuIntgdSwGend_CM_single_mbar 0.0 15000.0
 /begin AXIS_DESCR COM_AXIS EIP_NEng EcuIntgdSwGend_CM_single_rpm 5 0.0 6000.0 AXIS_PTS_REF WM_NEng_A /end AXIS_DESCR
/end CHARACTERISTIC
/begin CHARACTERISTIC WM_PAmbAirOvLvl1_M "Ambient Air Pressure Over Level 1 Map" CURVE 0x40050BA4 /* @ECU_Address@WM_PAmbAirOvLvl1_M@ */ Lookup1D_FLOAT32_IEEE 0 EcuIntgdSwGend_CM_single_mbar 0.0 15000.0
 /begin AXIS_DESCR COM_AXIS EIP_NEng EcuIntgdSwGend_CM_single_rpm 5 0.0 6000.0 AXIS_PTS_REF WM_NEng_A /end AXIS_DESCR
/end CHARACTERISTIC
/begin CHARACTERISTIC WM_PAmbAirOvLvl2_M "Ambient Air Pressure Over Level 2 Map" CURVE 0x40050BB8 /* @ECU_Address@WM_PAmbAirOvLvl2_M@ */ Lookup1D_FLOAT32_IEEE 0 EcuIntgdSwGend_CM_single_mbar 0.0 15000.0
 /begin AXIS_DESCR COM_AXIS EIP_NEng EcuIntgdSwGend_CM_single_rpm 5 0.0 6000.0 AXIS_PTS_REF WM_NEng_A /end AXIS_DESCR
/end CHARACTERISTIC
/begin CHARACTERISTIC WM_PAmbAirOvLvl3_M "Ambient Air Pressure Over Level 3 Map" CURVE 0x40050BCC /* @ECU_Address@WM_PAmbAirOvLvl3_M@ */ Lookup1D_FLOAT32_IEEE 0 EcuIntgdSwGend_CM_single_mbar 0.0 15000.0
 /begin AXIS_DESCR COM_AXIS EIP_NEng EcuIntgdSwGend_CM_single_rpm 5 0.0 6000.0 AXIS_PTS_REF WM_NEng_A /end AXIS_DESCR
/end CHARACTERISTIC
/begin CHARACTERISTIC WM_PAmbAirUndLvl1_M "Ambient Air Pressure Under Level 1 Map" CURVE 0x40050BF0 /* @ECU_Address@WM_PAmbAirUndLvl1_M@ */ Lookup1D_FLOAT32_IEEE 0 EcuIntgdSwGend_CM_single_mbar 0.0 15000.0
 /begin AXIS_DESCR COM_AXIS EIP_NEng EcuIntgdSwGend_CM_single_rpm 5 0.0 6000.0 AXIS_PTS_REF WM_NEng_A /end AXIS_DESCR
/end CHARACTERISTIC
/begin CHARACTERISTIC WM_PAmbAirUndLvl2_M "Ambient Air Pressure Under Level 2 Map" CURVE 0x40050C04 /* @ECU_Address@WM_PAmbAirUndLvl2_M@ */ Lookup1D_FLOAT32_IEEE 0 EcuIntgdSwGend_CM_single_mbar 0.0 15000.0
 /begin AXIS_DESCR COM_AXIS EIP_NEng EcuIntgdSwGend_CM_single_rpm 5 0.0 6000.0 AXIS_PTS_REF WM_NEng_A /end AXIS_DESCR
/end CHARACTERISTIC
/begin CHARACTERISTIC WM_PAmbAirUndLvl3_M "Ambient Air Pressure Under Level 3 Map" CURVE 0x40050C18 /* @ECU_Address@WM_PAmbAirUndLvl3_M@ */ Lookup1D_FLOAT32_IEEE 0 EcuIntgdSwGend_CM_single_mbar 0.0 15000.0
 /begin AXIS_DESCR COM_AXIS EIP_NEng EcuIntgdSwGend_CM_single_rpm 5 0.0 6000.0 AXIS_PTS_REF WM_NEng_A /end AXIS_DESCR
/end CHARACTERISTIC
/begin CHARACTERISTIC WM_PFuOvLvl1_M "Fuel Pressure Over Level 1 Map" CURVE 0x40050C3C /* @ECU_Address@WM_PFuOvLvl1_M@ */ Lookup1D_FLOAT32_IEEE 0 EcuIntgdSwGend_CM_single_mbar 0.0 15000.0
 /begin AXIS_DESCR COM_AXIS EIP_NEng EcuIntgdSwGend_CM_single_rpm 5 0.0 6000.0 AXIS_PTS_REF WM_NEng_A /end AXIS_DESCR
/end CHARACTERISTIC
/begin CHARACTERISTIC WM_PFuOvLvl2_M "Fuel Pressure Over Level 2 Map" CURVE 0x40050C50 /* @ECU_Address@WM_PFuOvLvl2_M@ */ Lookup1D_FLOAT32_IEEE 0 EcuIntgdSwGend_CM_single_mbar 0.0 15000.0
 /begin AXIS_DESCR COM_AXIS EIP_NEng EcuIntgdSwGend_CM_single_rpm 5 0.0 6000.0 AXIS_PTS_REF WM_NEng_A /end AXIS_DESCR
/end CHARACTERISTIC
/begin CHARACTERISTIC WM_PFuOvLvl3_M "Fuel Pressure Over Level 3 Map" CURVE 0x40050C64 /* @ECU_Address@WM_PFuOvLvl3_M@ */ Lookup1D_FLOAT32_IEEE 0 EcuIntgdSwGend_CM_single_mbar 0.0 15000.0
 /begin AXIS_DESCR COM_AXIS EIP_NEng EcuIntgdSwGend_CM_single_rpm 5 0.0 6000.0 AXIS_PTS_REF WM_NEng_A /end AXIS_DESCR
/end CHARACTERISTIC
/begin CHARACTERISTIC WM_PFuUndLvl1_M "Fuel Pressure Under Level 1 Map" CURVE 0x40050C88 /* @ECU_Address@WM_PFuUndLvl1_M@ */ Lookup1D_FLOAT32_IEEE 0 EcuIntgdSwGend_CM_single_mbar 0.0 15000.0
 /begin AXIS_DESCR COM_AXIS EIP_NEng EcuIntgdSwGend_CM_single_rpm 5 0.0 6000.0 AXIS_PTS_REF WM_NEng_A /end AXIS_DESCR
/end CHARACTERISTIC
/begin CHARACTERISTIC WM_PFuUndLvl2_M "Fuel Pressure Under Level 2 Map" CURVE 0x40050C9C /* @ECU_Address@WM_PFuUndLvl2_M@ */ Lookup1D_FLOAT32_IEEE 0 EcuIntgdSwGend_CM_single_mbar 0.0 15000.0
 /begin AXIS_DESCR COM_AXIS EIP_NEng EcuIntgdSwGend_CM_single_rpm 5 0.0 6000.0 AXIS_PTS_REF WM_NEng_A /end AXIS_DESCR
/end CHARACTERISTIC
/begin CHARACTERISTIC WM_PFuUndLvl3_M "Fuel Pressure Under Level 3 Map" CURVE 0x40050CB0 /* @ECU_Address@WM_PFuUndLvl3_M@ */ Lookup1D_FLOAT32_IEEE 0 EcuIntgdSwGend_CM_single_mbar 0.0 15000.0
 /begin AXIS_DESCR COM_AXIS EIP_NEng EcuIntgdSwGend_CM_single_rpm 5 0.0 6000.0 AXIS_PTS_REF WM_NEng_A /end AXIS_DESCR
/end CHARACTERISTIC
/begin CHARACTERISTIC WM_POilOvLvl1_M "Oil Pressure Over Level 1 Map" CURVE 0x40050CD4 /* @ECU_Address@WM_POilOvLvl1_M@ */ Lookup1D_FLOAT32_IEEE 0 EcuIntgdSwGend_CM_single_mbar 0.0 15000.0
 /begin AXIS_DESCR COM_AXIS EIP_NEng EcuIntgdSwGend_CM_single_rpm 5 0.0 6000.0 AXIS_PTS_REF WM_NEng_A /end AXIS_DESCR
/end CHARACTERISTIC
/begin CHARACTERISTIC WM_POilOvLvl2_M "Oil Pressure Over Level 2 Map" CURVE 0x40050CE8 /* @ECU_Address@WM_POilOvLvl2_M@ */ Lookup1D_FLOAT32_IEEE 0 EcuIntgdSwGend_CM_single_mbar 0.0 15000.0
 /begin AXIS_DESCR COM_AXIS EIP_NEng EcuIntgdSwGend_CM_single_rpm 5 0.0 6000.0 AXIS_PTS_REF WM_NEng_A /end AXIS_DESCR
/end CHARACTERISTIC
/begin CHARACTERISTIC WM_POilOvLvl3_M "Oil Pressure Over Level 3 Map" CURVE 0x40050CFC /* @ECU_Address@WM_POilOvLvl3_M@ */ Lookup1D_FLOAT32_IEEE 0 EcuIntgdSwGend_CM_single_mbar 0.0 15000.0
 /begin AXIS_DESCR COM_AXIS EIP_NEng EcuIntgdSwGend_CM_single_rpm 5 0.0 6000.0 AXIS_PTS_REF WM_NEng_A /end AXIS_DESCR
/end CHARACTERISTIC
/begin CHARACTERISTIC WM_POilUndLvl1_M "Oil Pressure Under Level 1 Map" CURVE 0x40050D20 /* @ECU_Address@WM_POilUndLvl1_M@ */ Lookup1D_FLOAT32_IEEE 0 EcuIntgdSwGend_CM_single_mbar 0.0 15000.0
 /begin AXIS_DESCR COM_AXIS EIP_NEng EcuIntgdSwGend_CM_single_rpm 5 0.0 6000.0 AXIS_PTS_REF WM_NEng_A /end AXIS_DESCR
/end CHARACTERISTIC
/begin CHARACTERISTIC WM_POilUndLvl2_M "Oil Pressure Under Level 2 Map" CURVE 0x40050D34 /* @ECU_Address@WM_POilUndLvl2_M@ */ Lookup1D_FLOAT32_IEEE 0 EcuIntgdSwGend_CM_single_mbar 0.0 15000.0
 /begin AXIS_DESCR COM_AXIS EIP_NEng EcuIntgdSwGend_CM_single_rpm 5 0.0 6000.0 AXIS_PTS_REF WM_NEng_A /end AXIS_DESCR
/end CHARACTERISTIC
/begin CHARACTERISTIC WM_POilUndLvl3_M "Oil Pressure Under Level 3 Map" CURVE 0x40050D48 /* @ECU_Address@WM_POilUndLvl3_M@ */ Lookup1D_FLOAT32_IEEE 0 EcuIntgdSwGend_CM_single_mbar 0.0 15000.0
 /begin AXIS_DESCR COM_AXIS EIP_NEng EcuIntgdSwGend_CM_single_rpm 5 0.0 6000.0 AXIS_PTS_REF WM_NEng_A /end AXIS_DESCR
/end CHARACTERISTIC
/begin CHARACTERISTIC WM_PRailOvLvl1_M "Rail Pressure Over Level 1 Map" CURVE 0x40050D78 /* @ECU_Address@WM_PRailOvLvl1_M@ */ Lookup1D_FLOAT32_IEEE 0 EcuIntgdSwGend_CM_single_bar 0.0 2500.0
 /begin AXIS_DESCR COM_AXIS EIP_NEng EcuIntgdSwGend_CM_single_rpm 5 0.0 6000.0 AXIS_PTS_REF WM_NEng_A /end AXIS_DESCR
/end CHARACTERISTIC
/begin CHARACTERISTIC WM_PRailOvLvl2_M "Rail Pressure Over Level 2 Map" CURVE 0x40050D8C /* @ECU_Address@WM_PRailOvLvl2_M@ */ Lookup1D_FLOAT32_IEEE 0 EcuIntgdSwGend_CM_single_bar 0.0 2500.0
 /begin AXIS_DESCR COM_AXIS EIP_NEng EcuIntgdSwGend_CM_single_rpm 5 0.0 6000.0 AXIS_PTS_REF WM_NEng_A /end AXIS_DESCR
/end CHARACTERISTIC
/begin CHARACTERISTIC WM_PRailOvLvl3_M "Rail Pressure Over Level 3 Map" CURVE 0x40050DA0 /* @ECU_Address@WM_PRailOvLvl3_M@ */ Lookup1D_FLOAT32_IEEE 0 EcuIntgdSwGend_CM_single_bar 0.0 2500.0
 /begin AXIS_DESCR COM_AXIS EIP_NEng EcuIntgdSwGend_CM_single_rpm 5 0.0 6000.0 AXIS_PTS_REF WM_NEng_A /end AXIS_DESCR
/end CHARACTERISTIC
/begin CHARACTERISTIC WM_PRailUndLvl1_M "Rail Pressure Under Level 1 Map" CURVE 0x40050DC8 /* @ECU_Address@WM_PRailUndLvl1_M@ */ Lookup1D_FLOAT32_IEEE 0 EcuIntgdSwGend_CM_single_bar 0.0 2500.0
 /begin AXIS_DESCR COM_AXIS EIP_NEng EcuIntgdSwGend_CM_single_rpm 5 0.0 6000.0 AXIS_PTS_REF WM_NEng_A /end AXIS_DESCR
/end CHARACTERISTIC
/begin CHARACTERISTIC WM_PRailUndLvl2_M "Rail Pressure Under Level 2 Map" CURVE 0x40050DDC /* @ECU_Address@WM_PRailUndLvl2_M@ */ Lookup1D_FLOAT32_IEEE 0 EcuIntgdSwGend_CM_single_bar 0.0 2500.0
 /begin AXIS_DESCR COM_AXIS EIP_NEng EcuIntgdSwGend_CM_single_rpm 5 0.0 6000.0 AXIS_PTS_REF WM_NEng_A /end AXIS_DESCR
/end CHARACTERISTIC
/begin CHARACTERISTIC WM_PRailUndLvl3_M "Rail Pressure Under Level 3 Map" CURVE 0x40050DF0 /* @ECU_Address@WM_PRailUndLvl3_M@ */ Lookup1D_FLOAT32_IEEE 0 EcuIntgdSwGend_CM_single_bar 0.0 2500.0
 /begin AXIS_DESCR COM_AXIS EIP_NEng EcuIntgdSwGend_CM_single_rpm 5 0.0 6000.0 AXIS_PTS_REF WM_NEng_A /end AXIS_DESCR
/end CHARACTERISTIC
/begin CHARACTERISTIC WM_TAirBoostOvLvl1_M "Air Boost Temperature Over Level 1 Map" CURVE 0x40050E14 /* @ECU_Address@WM_TAirBoostOvLvl1_M@ */ Lookup1D_FLOAT32_IEEE 0 EcuIntgdSwGend_CM_single_degC -40.0 250.0
 /begin AXIS_DESCR COM_AXIS EIP_NEng EcuIntgdSwGend_CM_single_rpm 5 0.0 6000.0 AXIS_PTS_REF WM_NEng_A /end AXIS_DESCR
/end CHARACTERISTIC
/begin CHARACTERISTIC WM_TAirBoostOvLvl2_M "Air Boost Temperature Over Level 2 Map" CURVE 0x40050E28 /* @ECU_Address@WM_TAirBoostOvLvl2_M@ */ Lookup1D_FLOAT32_IEEE 0 EcuIntgdSwGend_CM_single_degC -40.0 250.0
 /begin AXIS_DESCR COM_AXIS EIP_NEng EcuIntgdSwGend_CM_single_rpm 5 0.0 6000.0 AXIS_PTS_REF WM_NEng_A /end AXIS_DESCR
/end CHARACTERISTIC
/begin CHARACTERISTIC WM_TAirBoostOvLvl3_M "Air Boost Temperature Over Level 3 Map" CURVE 0x40050E3C /* @ECU_Address@WM_TAirBoostOvLvl3_M@ */ Lookup1D_FLOAT32_IEEE 0 EcuIntgdSwGend_CM_single_degC -40.0 250.0
 /begin AXIS_DESCR COM_AXIS EIP_NEng EcuIntgdSwGend_CM_single_rpm 5 0.0 6000.0 AXIS_PTS_REF WM_NEng_A /end AXIS_DESCR
/end CHARACTERISTIC
/begin CHARACTERISTIC WM_TAirBoostUndLvl1_M "Air Boost Temperature Under Level 1 Map" CURVE 0x40050E60 /* @ECU_Address@WM_TAirBoostUndLvl1_M@ */ Lookup1D_FLOAT32_IEEE 0 EcuIntgdSwGend_CM_single_degC -40.0 250.0
 /begin AXIS_DESCR COM_AXIS EIP_NEng EcuIntgdSwGend_CM_single_rpm 5 0.0 6000.0 AXIS_PTS_REF WM_NEng_A /end AXIS_DESCR
/end CHARACTERISTIC
/begin CHARACTERISTIC WM_TAirBoostUndLvl2_M "Air Boost Temperature Under Level 2 Map" CURVE 0x40050E74 /* @ECU_Address@WM_TAirBoostUndLvl2_M@ */ Lookup1D_FLOAT32_IEEE 0 EcuIntgdSwGend_CM_single_degC -40.0 250.0
 /begin AXIS_DESCR COM_AXIS EIP_NEng EcuIntgdSwGend_CM_single_rpm 5 0.0 6000.0 AXIS_PTS_REF WM_NEng_A /end AXIS_DESCR
/end CHARACTERISTIC
/begin CHARACTERISTIC WM_TAirBoostUndLvl3_M "Air Boost Temperature Under Level 3 Map" CURVE 0x40050E88 /* @ECU_Address@WM_TAirBoostUndLvl3_M@ */ Lookup1D_FLOAT32_IEEE 0 EcuIntgdSwGend_CM_single_degC -40.0 250.0
 /begin AXIS_DESCR COM_AXIS EIP_NEng EcuIntgdSwGend_CM_single_rpm 5 0.0 6000.0 AXIS_PTS_REF WM_NEng_A /end AXIS_DESCR
/end CHARACTERISTIC
/begin CHARACTERISTIC WM_TAmbAirOvLvl1_M "Ambient Air Temperature Over Level 1 Map" CURVE 0x40050EAC /* @ECU_Address@WM_TAmbAirOvLvl1_M@ */ Lookup1D_FLOAT32_IEEE 0 EcuIntgdSwGend_CM_single_degC -40.0 250.0
 /begin AXIS_DESCR COM_AXIS EIP_NEng EcuIntgdSwGend_CM_single_rpm 5 0.0 6000.0 AXIS_PTS_REF WM_NEng_A /end AXIS_DESCR
/end CHARACTERISTIC
/begin CHARACTERISTIC WM_TAmbAirOvLvl2_M "Ambient Air Temperature Over Level 2 Map" CURVE 0x40050EC0 /* @ECU_Address@WM_TAmbAirOvLvl2_M@ */ Lookup1D_FLOAT32_IEEE 0 EcuIntgdSwGend_CM_single_degC -40.0 250.0
 /begin AXIS_DESCR COM_AXIS EIP_NEng EcuIntgdSwGend_CM_single_rpm 5 0.0 6000.0 AXIS_PTS_REF WM_NEng_A /end AXIS_DESCR
/end CHARACTERISTIC
/begin CHARACTERISTIC WM_TAmbAirOvLvl3_M "Ambient Air Temperature Over Level 3 Map" CURVE 0x40050ED4 /* @ECU_Address@WM_TAmbAirOvLvl3_M@ */ Lookup1D_FLOAT32_IEEE 0 EcuIntgdSwGend_CM_single_degC -40.0 250.0
 /begin AXIS_DESCR COM_AXIS EIP_NEng EcuIntgdSwGend_CM_single_rpm 5 0.0 6000.0 AXIS_PTS_REF WM_NEng_A /end AXIS_DESCR
/end CHARACTERISTIC
/begin CHARACTERISTIC WM_TAmbAirUndLvl1_M "Ambient Air Temperature Under Level 1 Map" CURVE 0x40050EF8 /* @ECU_Address@WM_TAmbAirUndLvl1_M@ */ Lookup1D_FLOAT32_IEEE 0 EcuIntgdSwGend_CM_single_degC -40.0 250.0
 /begin AXIS_DESCR COM_AXIS EIP_NEng EcuIntgdSwGend_CM_single_rpm 5 0.0 6000.0 AXIS_PTS_REF WM_NEng_A /end AXIS_DESCR
/end CHARACTERISTIC
/begin CHARACTERISTIC WM_TAmbAirUndLvl2_M "Ambient Air Temperature Under Level 2 Map" CURVE 0x40050F0C /* @ECU_Address@WM_TAmbAirUndLvl2_M@ */ Lookup1D_FLOAT32_IEEE 0 EcuIntgdSwGend_CM_single_degC -40.0 250.0
 /begin AXIS_DESCR COM_AXIS EIP_NEng EcuIntgdSwGend_CM_single_rpm 5 0.0 6000.0 AXIS_PTS_REF WM_NEng_A /end AXIS_DESCR
/end CHARACTERISTIC
/begin CHARACTERISTIC WM_TAmbAirUndLvl3_M "Ambient Air Temperature Under Level 3 Map" CURVE 0x40050F20 /* @ECU_Address@WM_TAmbAirUndLvl3_M@ */ Lookup1D_FLOAT32_IEEE 0 EcuIntgdSwGend_CM_single_degC -40.0 250.0
 /begin AXIS_DESCR COM_AXIS EIP_NEng EcuIntgdSwGend_CM_single_rpm 5 0.0 6000.0 AXIS_PTS_REF WM_NEng_A /end AXIS_DESCR
/end CHARACTERISTIC
/begin CHARACTERISTIC WM_TCooltOvLvl1_M "Coolant Temperature Over Level 1 Map" CURVE 0x40050F44 /* @ECU_Address@WM_TCooltOvLvl1_M@ */ Lookup1D_FLOAT32_IEEE 0 EcuIntgdSwGend_CM_single_degC -40.0 250.0
 /begin AXIS_DESCR COM_AXIS EIP_NEng EcuIntgdSwGend_CM_single_rpm 5 0.0 6000.0 AXIS_PTS_REF WM_NEng_A /end AXIS_DESCR
/end CHARACTERISTIC
/begin CHARACTERISTIC WM_TCooltOvLvl2_M "Coolant Temperature Over Level 2 Map" CURVE 0x40050F58 /* @ECU_Address@WM_TCooltOvLvl2_M@ */ Lookup1D_FLOAT32_IEEE 0 EcuIntgdSwGend_CM_single_degC -40.0 250.0
 /begin AXIS_DESCR COM_AXIS EIP_NEng EcuIntgdSwGend_CM_single_rpm 5 0.0 6000.0 AXIS_PTS_REF WM_NEng_A /end AXIS_DESCR
/end CHARACTERISTIC
/begin CHARACTERISTIC WM_TCooltOvLvl3_M "Coolant Temperature Over Level 3 Map" CURVE 0x40050F6C /* @ECU_Address@WM_TCooltOvLvl3_M@ */ Lookup1D_FLOAT32_IEEE 0 EcuIntgdSwGend_CM_single_degC -40.0 250.0
 /begin AXIS_DESCR COM_AXIS EIP_NEng EcuIntgdSwGend_CM_single_rpm 5 0.0 6000.0 AXIS_PTS_REF WM_NEng_A /end AXIS_DESCR
/end CHARACTERISTIC
/begin CHARACTERISTIC WM_TCooltUndLvl1_M "Coolant Temperature Under Level 1 Map" CURVE 0x40050F90 /* @ECU_Address@WM_TCooltUndLvl1_M@ */ Lookup1D_FLOAT32_IEEE 0 EcuIntgdSwGend_CM_single_degC -40.0 250.0
 /begin AXIS_DESCR COM_AXIS EIP_NEng EcuIntgdSwGend_CM_single_rpm 5 0.0 6000.0 AXIS_PTS_REF WM_NEng_A /end AXIS_DESCR
/end CHARACTERISTIC
/begin CHARACTERISTIC WM_TCooltUndLvl2_M "Coolant Temperature Under Level 2 Map" CURVE 0x40050FA4 /* @ECU_Address@WM_TCooltUndLvl2_M@ */ Lookup1D_FLOAT32_IEEE 0 EcuIntgdSwGend_CM_single_degC -40.0 250.0
 /begin AXIS_DESCR COM_AXIS EIP_NEng EcuIntgdSwGend_CM_single_rpm 5 0.0 6000.0 AXIS_PTS_REF WM_NEng_A /end AXIS_DESCR
/end CHARACTERISTIC
/begin CHARACTERISTIC WM_TCooltUndLvl3_M "Coolant Temperature Under Level 3 Map" CURVE 0x40050FB8 /* @ECU_Address@WM_TCooltUndLvl3_M@ */ Lookup1D_FLOAT32_IEEE 0 EcuIntgdSwGend_CM_single_degC -40.0 250.0
 /begin AXIS_DESCR COM_AXIS EIP_NEng EcuIntgdSwGend_CM_single_rpm 5 0.0 6000.0 AXIS_PTS_REF WM_NEng_A /end AXIS_DESCR
/end CHARACTERISTIC
/begin CHARACTERISTIC WM_TFuOvLvl1_M "Fuel Temperature Over Level 1 Map" CURVE 0x40050FF8 /* @ECU_Address@WM_TFuOvLvl1_M@ */ Lookup1D_FLOAT32_IEEE 0 EcuIntgdSwGend_CM_single_degC -40.0 250.0
 /begin AXIS_DESCR COM_AXIS EIP_NEng EcuIntgdSwGend_CM_single_rpm 5 0.0 6000.0 AXIS_PTS_REF WM_NEng_A /end AXIS_DESCR
/end CHARACTERISTIC
/begin CHARACTERISTIC WM_TFuOvLvl2_M "Fuel Temperature Over Level 2 Map" CURVE 0x4005100C /* @ECU_Address@WM_TFuOvLvl2_M@ */ Lookup1D_FLOAT32_IEEE 0 EcuIntgdSwGend_CM_single_degC -40.0 250.0
 /begin AXIS_DESCR COM_AXIS EIP_NEng EcuIntgdSwGend_CM_single_rpm 5 0.0 6000.0 AXIS_PTS_REF WM_NEng_A /end AXIS_DESCR
/end CHARACTERISTIC
/begin CHARACTERISTIC WM_TFuOvLvl3_M "Fuel Temperature Over Level 3 Map" CURVE 0x40051020 /* @ECU_Address@WM_TFuOvLvl3_M@ */ Lookup1D_FLOAT32_IEEE 0 EcuIntgdSwGend_CM_single_degC -40.0 250.0
 /begin AXIS_DESCR COM_AXIS EIP_NEng EcuIntgdSwGend_CM_single_rpm 5 0.0 6000.0 AXIS_PTS_REF WM_NEng_A /end AXIS_DESCR
/end CHARACTERISTIC
/begin CHARACTERISTIC WM_TOilOvLvl1_M "Oil Temperature Over Level 1 Map" CURVE 0x40051044 /* @ECU_Address@WM_TOilOvLvl1_M@ */ Lookup1D_FLOAT32_IEEE 0 EcuIntgdSwGend_CM_single_degC -40.0 250.0
 /begin AXIS_DESCR COM_AXIS EIP_NEng EcuIntgdSwGend_CM_single_rpm 5 0.0 6000.0 AXIS_PTS_REF WM_NEng_A /end AXIS_DESCR
/end CHARACTERISTIC
/begin CHARACTERISTIC WM_TOilOvLvl2_M "Oil Temperature Over Level 2 Map" CURVE 0x40051058 /* @ECU_Address@WM_TOilOvLvl2_M@ */ Lookup1D_FLOAT32_IEEE 0 EcuIntgdSwGend_CM_single_degC -40.0 250.0
 /begin AXIS_DESCR COM_AXIS EIP_NEng EcuIntgdSwGend_CM_single_rpm 5 0.0 6000.0 AXIS_PTS_REF WM_NEng_A /end AXIS_DESCR
/end CHARACTERISTIC
/begin CHARACTERISTIC WM_TOilOvLvl3_M "Oil Temperature Over Level 3 Map" CURVE 0x4005106C /* @ECU_Address@WM_TOilOvLvl3_M@ */ Lookup1D_FLOAT32_IEEE 0 EcuIntgdSwGend_CM_single_degC -40.0 250.0
 /begin AXIS_DESCR COM_AXIS EIP_NEng EcuIntgdSwGend_CM_single_rpm 5 0.0 6000.0 AXIS_PTS_REF WM_NEng_A /end AXIS_DESCR
/end CHARACTERISTIC
/begin CHARACTERISTIC WM_TOilUndLvl1_M "Oil Temperature Under Level 1 Map" CURVE 0x40051090 /* @ECU_Address@WM_TOilUndLvl1_M@ */ Lookup1D_FLOAT32_IEEE 0 EcuIntgdSwGend_CM_single_degC -40.0 250.0
 /begin AXIS_DESCR COM_AXIS EIP_NEng EcuIntgdSwGend_CM_single_rpm 5 0.0 6000.0 AXIS_PTS_REF WM_NEng_A /end AXIS_DESCR
/end CHARACTERISTIC
/begin CHARACTERISTIC WM_TOilUndLvl2_M "Oil Temperature Under Level 2 Map" CURVE 0x400510A4 /* @ECU_Address@WM_TOilUndLvl2_M@ */ Lookup1D_FLOAT32_IEEE 0 EcuIntgdSwGend_CM_single_degC -40.0 250.0
 /begin AXIS_DESCR COM_AXIS EIP_NEng EcuIntgdSwGend_CM_single_rpm 5 0.0 6000.0 AXIS_PTS_REF WM_NEng_A /end AXIS_DESCR
/end CHARACTERISTIC
/begin CHARACTERISTIC WM_TOilUndLvl3_M "Oil Temperature Under Level 3 Map" CURVE 0x400510B8 /* @ECU_Address@WM_TOilUndLvl3_M@ */ Lookup1D_FLOAT32_IEEE 0 EcuIntgdSwGend_CM_single_degC -40.0 250.0
 /begin AXIS_DESCR COM_AXIS EIP_NEng EcuIntgdSwGend_CM_single_rpm 5 0.0 6000.0 AXIS_PTS_REF WM_NEng_A /end AXIS_DESCR
/end CHARACTERISTIC
/begin CHARACTERISTIC DTqC_DynRateLoLim_P "Dynamic Rate Low Limit Parameter" VALUE 0x400419F0 /* @ECU_Address@DTqC_DynRateLoLim_P@ */ Scalar_FLOAT32_IEEE 0 EcuIntgdSwGend_CM_single -10000.0 0.0 /end CHARACTERISTIC
/begin CHARACTERISTIC DTqC_DynRateUpLim_P "Dynamic Rate Up Limit Parameter" VALUE 0x400419F4 /* @ECU_Address@DTqC_DynRateUpLim_P@ */ Scalar_FLOAT32_IEEE 0 EcuIntgdSwGend_CM_single 0.0 10000.0 /end CHARACTERISTIC
/begin CHARACTERISTIC DTqC_TiMaxAcvHardLimLtch_P "" VALUE 0x4004203C /* @ECU_Address@DTqC_TiMaxAcvHardLimLtch_P@ */ Scalar_FLOAT32_IEEE 0 EcuIntgdSwGend_CM_single_ms 0.0 50000.0 /end CHARACTERISTIC
/begin CHARACTERISTIC WM_NEngThdPRailHi_P "Engine Speed Threshold for Rail Pressure High Parameter" VALUE 0x40050AD8 /* @ECU_Address@WM_NEngThdPRailHi_P@ */ Scalar_FLOAT32_IEEE 0 EcuIntgdSwGend_CM_single_rpm 0.0 6000.0 /end CHARACTERISTIC
/begin CHARACTERISTIC WM_NEngThdPRailLo_P "Engine Speed Threshold for Rail Pressure Low Parameter" VALUE 0x40050ADC /* @ECU_Address@WM_NEngThdPRailLo_P@ */ Scalar_FLOAT32_IEEE 0 EcuIntgdSwGend_CM_single_rpm 0.0 6000.0 /end CHARACTERISTIC
/begin CHARACTERISTIC WM_NEngThdPRailNotCtld_P "Engine Speed Threshold for Rail Pressure Is Not Controlled Parameter" VALUE 0x40050AE0 /* @ECU_Address@WM_NEngThdPRailNotCtld_P@ */ Scalar_FLOAT32_IEEE 0 EcuIntgdSwGend_CM_single_rpm 0.0 6000.0 /end CHARACTERISTIC
/begin CHARACTERISTIC WM_NEngThdPRailTooHi_P "Engine Speed Threshold for Rail Pressure Too High Parameter" VALUE 0x40050AE4 /* @ECU_Address@WM_NEngThdPRailTooHi_P@ */ Scalar_FLOAT32_IEEE 0 EcuIntgdSwGend_CM_single_rpm 0.0 6000.0 /end CHARACTERISTIC
/begin CHARACTERISTIC WM_PAirBoostUndDesLvlQnty_P "Air Boost Pressure Under Desired Severity Level Quantity Parameter" VALUE 0x40050B48 /* @ECU_Address@WM_PAirBoostUndDesLvlQnty_P@ */ Scalar_FLOAT32_IEEE 0 EcuIntgdSwGend_CM_single 0.0 3.0 /end CHARACTERISTIC
/begin CHARACTERISTIC WM_PAirBoostUndHysDeacLvl1_P "Air Boost Pressure Under Level 1 Hysteresis Deactivation Parameter" VALUE 0x40050B4C /* @ECU_Address@WM_PAirBoostUndHysDeacLvl1_P@ */ Scalar_FLOAT32_IEEE 0 EcuIntgdSwGend_CM_single_mbar 0.0 15000.0 /end CHARACTERISTIC
/begin CHARACTERISTIC WM_PAirBoostUndHysDeacLvl2_P "Air Boost Pressure Under Level 2 Hysteresis Deactivation Parameter" VALUE 0x40050B50 /* @ECU_Address@WM_PAirBoostUndHysDeacLvl2_P@ */ Scalar_FLOAT32_IEEE 0 EcuIntgdSwGend_CM_single_mbar 0.0 15000.0 /end CHARACTERISTIC
/begin CHARACTERISTIC WM_PAirBoostUndHysDeacLvl3_P "Air Boost Pressure Under Level 3 Hysteresis Deactivation Parameter" VALUE 0x40050B54 /* @ECU_Address@WM_PAirBoostUndHysDeacLvl3_P@ */ Scalar_FLOAT32_IEEE 0 EcuIntgdSwGend_CM_single_mbar 0.0 15000.0 /end CHARACTERISTIC
/begin CHARACTERISTIC WM_PAmbAirOvDesLvlQnty_P "Ambient Air Pressure Over Desired Severity Level Quantity Parameter" VALUE 0x40050B94 /* @ECU_Address@WM_PAmbAirOvDesLvlQnty_P@ */ Scalar_FLOAT32_IEEE 0 EcuIntgdSwGend_CM_single 0.0 3.0 /end CHARACTERISTIC
/begin CHARACTERISTIC WM_PAmbAirOvHysDeacLvl1_P "Ambient Air Pressure Over Level 1 Hysteresis Deactivation Parameter" VALUE 0x40050B98 /* @ECU_Address@WM_PAmbAirOvHysDeacLvl1_P@ */ Scalar_FLOAT32_IEEE 0 EcuIntgdSwGend_CM_single_mbar 0.0 15000.0 /end CHARACTERISTIC
/begin CHARACTERISTIC WM_PAmbAirOvHysDeacLvl2_P "Ambient Air Pressure Over Level 2 Hysteresis Deactivation Parameter" VALUE 0x40050B9C /* @ECU_Address@WM_PAmbAirOvHysDeacLvl2_P@ */ Scalar_FLOAT32_IEEE 0 EcuIntgdSwGend_CM_single_mbar 0.0 15000.0 /end CHARACTERISTIC
/begin CHARACTERISTIC WM_PAmbAirOvHysDeacLvl3_P "Ambient Air Pressure Over Level 3 Hysteresis Deactivation Parameter" VALUE 0x40050BA0 /* @ECU_Address@WM_PAmbAirOvHysDeacLvl3_P@ */ Scalar_FLOAT32_IEEE 0 EcuIntgdSwGend_CM_single_mbar 0.0 15000.0 /end CHARACTERISTIC
/begin CHARACTERISTIC WM_PAmbAirUndDesLvlQnty_P "Ambient Air Pressure Under Desired Severity Level Quantity Parameter" VALUE 0x40050BE0 /* @ECU_Address@WM_PAmbAirUndDesLvlQnty_P@ */ Scalar_FLOAT32_IEEE 0 EcuIntgdSwGend_CM_single 0.0 3.0 /end CHARACTERISTIC
/begin CHARACTERISTIC WM_PAmbAirUndHysDeacLvl1_P "Ambient Air Pressure Under Level 1 Hysteresis Deactivation Parameter" VALUE 0x40050BE4 /* @ECU_Address@WM_PAmbAirUndHysDeacLvl1_P@ */ Scalar_FLOAT32_IEEE 0 EcuIntgdSwGend_CM_single_mbar 0.0 15000.0 /end CHARACTERISTIC
/begin CHARACTERISTIC WM_PAmbAirUndHysDeacLvl2_P "Ambient Air Pressure Under Level 2 Hysteresis Deactivation Parameter" VALUE 0x40050BE8 /* @ECU_Address@WM_PAmbAirUndHysDeacLvl2_P@ */ Scalar_FLOAT32_IEEE 0 EcuIntgdSwGend_CM_single_mbar 0.0 15000.0 /end CHARACTERISTIC
/begin CHARACTERISTIC WM_PAmbAirUndHysDeacLvl3_P "Ambient Air Pressure Under Level 3 Hysteresis Deactivation Parameter" VALUE 0x40050BEC /* @ECU_Address@WM_PAmbAirUndHysDeacLvl3_P@ */ Scalar_FLOAT32_IEEE 0 EcuIntgdSwGend_CM_single_mbar 0.0 15000.0 /end CHARACTERISTIC
/begin CHARACTERISTIC WM_PFuOvDesLvlQnty_P "Fuel Pressure Over Desired Severity Level Quantity Parameter" VALUE 0x40050C2C /* @ECU_Address@WM_PFuOvDesLvlQnty_P@ */ Scalar_FLOAT32_IEEE 0 EcuIntgdSwGend_CM_single 0.0 3.0 /end CHARACTERISTIC
/begin CHARACTERISTIC WM_PFuOvHysDeacLvl1_P "Fuel Pressure Over Level 1 Hysteresis Deactivation Parameter" VALUE 0x40050C30 /* @ECU_Address@WM_PFuOvHysDeacLvl1_P@ */ Scalar_FLOAT32_IEEE 0 EcuIntgdSwGend_CM_single_mbar 0.0 15000.0 /end CHARACTERISTIC
/begin CHARACTERISTIC WM_PFuOvHysDeacLvl2_P "Fuel Pressure Over Level 2 Hysteresis Deactivation Parameter" VALUE 0x40050C34 /* @ECU_Address@WM_PFuOvHysDeacLvl2_P@ */ Scalar_FLOAT32_IEEE 0 EcuIntgdSwGend_CM_single_mbar 0.0 15000.0 /end CHARACTERISTIC
/begin CHARACTERISTIC WM_PFuOvHysDeacLvl3_P "Fuel Pressure Over Level 3 Hysteresis Deactivation Parameter" VALUE 0x40050C38 /* @ECU_Address@WM_PFuOvHysDeacLvl3_P@ */ Scalar_FLOAT32_IEEE 0 EcuIntgdSwGend_CM_single_mbar 0.0 15000.0 /end CHARACTERISTIC
/begin CHARACTERISTIC WM_PFuUndDesLvlQnty_P "Fuel Pressure Under Desired Severity Level Quantity Parameter" VALUE 0x40050C78 /* @ECU_Address@WM_PFuUndDesLvlQnty_P@ */ Scalar_FLOAT32_IEEE 0 EcuIntgdSwGend_CM_single 0.0 3.0 /end CHARACTERISTIC
/begin CHARACTERISTIC WM_PFuUndHysDeacLvl1_P "Fuel Pressure Under Level 1 Hysteresis Deactivation Parameter" VALUE 0x40050C7C /* @ECU_Address@WM_PFuUndHysDeacLvl1_P@ */ Scalar_FLOAT32_IEEE 0 EcuIntgdSwGend_CM_single_mbar 0.0 15000.0 /end CHARACTERISTIC
/begin CHARACTERISTIC WM_PFuUndHysDeacLvl2_P "Fuel Pressure Under Level 2 Hysteresis Deactivation Parameter" VALUE 0x40050C80 /* @ECU_Address@WM_PFuUndHysDeacLvl2_P@ */ Scalar_FLOAT32_IEEE 0 EcuIntgdSwGend_CM_single_mbar 0.0 15000.0 /end CHARACTERISTIC
/begin CHARACTERISTIC WM_PFuUndHysDeacLvl3_P "Fuel Pressure Under Level 3 Hysteresis Deactivation Parameter" VALUE 0x40050C84 /* @ECU_Address@WM_PFuUndHysDeacLvl3_P@ */ Scalar_FLOAT32_IEEE 0 EcuIntgdSwGend_CM_single_mbar 0.0 15000.0 /end CHARACTERISTIC
/begin CHARACTERISTIC WM_POilOvDesLvlQnty_P "Oil Pressure Over Desired Severity Level Quantity Parameter" VALUE 0x40050CC4 /* @ECU_Address@WM_POilOvDesLvlQnty_P@ */ Scalar_FLOAT32_IEEE 0 EcuIntgdSwGend_CM_single 0.0 3.0 /end CHARACTERISTIC
/begin CHARACTERISTIC WM_POilOvHysDeacLvl1_P "Oil Pressure Over Level 1 Hysteresis Deactivation Parameter" VALUE 0x40050CC8 /* @ECU_Address@WM_POilOvHysDeacLvl1_P@ */ Scalar_FLOAT32_IEEE 0 EcuIntgdSwGend_CM_single_mbar 0.0 15000.0 /end CHARACTERISTIC
/begin CHARACTERISTIC WM_POilOvHysDeacLvl2_P "Oil Pressure Over Level 2 Hysteresis Deactivation Parameter" VALUE 0x40050CCC /* @ECU_Address@WM_POilOvHysDeacLvl2_P@ */ Scalar_FLOAT32_IEEE 0 EcuIntgdSwGend_CM_single_mbar 0.0 15000.0 /end CHARACTERISTIC
/begin CHARACTERISTIC WM_POilOvHysDeacLvl3_P "Oil Pressure Over Level 3 Hysteresis Deactivation Parameter" VALUE 0x40050CD0 /* @ECU_Address@WM_POilOvHysDeacLvl3_P@ */ Scalar_FLOAT32_IEEE 0 EcuIntgdSwGend_CM_single_mbar 0.0 15000.0 /end CHARACTERISTIC
/begin CHARACTERISTIC WM_POilUndDesLvlQnty_P "Oil Pressure Under Desired Severity Level Quantity Parameter" VALUE 0x40050D10 /* @ECU_Address@WM_POilUndDesLvlQnty_P@ */ Scalar_FLOAT32_IEEE 0 EcuIntgdSwGend_CM_single 0.0 3.0 /end CHARACTERISTIC
/begin CHARACTERISTIC WM_POilUndHysDeacLvl1_P "Oil Pressure Under Level 1 Hysteresis Deactivation Parameter" VALUE 0x40050D14 /* @ECU_Address@WM_POilUndHysDeacLvl1_P@ */ Scalar_FLOAT32_IEEE 0 EcuIntgdSwGend_CM_single_mbar 0.0 15000.0 /end CHARACTERISTIC
/begin CHARACTERISTIC WM_POilUndHysDeacLvl2_P "Oil Pressure Under Level 2 Hysteresis Deactivation Parameter" VALUE 0x40050D18 /* @ECU_Address@WM_POilUndHysDeacLvl2_P@ */ Scalar_FLOAT32_IEEE 0 EcuIntgdSwGend_CM_single_mbar 0.0 15000.0 /end CHARACTERISTIC
/begin CHARACTERISTIC WM_POilUndHysDeacLvl3_P "Oil Pressure Under Level 3 Hysteresis Deactivation Parameter" VALUE 0x40050D1C /* @ECU_Address@WM_POilUndHysDeacLvl3_P@ */ Scalar_FLOAT32_IEEE 0 EcuIntgdSwGend_CM_single_mbar 0.0 15000.0 /end CHARACTERISTIC
/begin CHARACTERISTIC WM_PRailHiThd_P "Rail Pressure High Threshold Parameter" VALUE 0x40050D5C /* @ECU_Address@WM_PRailHiThd_P@ */ Scalar_FLOAT32_IEEE 0 EcuIntgdSwGend_CM_single_bar 0.0 500.0 /end CHARACTERISTIC
/begin CHARACTERISTIC WM_PRailLo_P "Rail Pressure Low Threshold Parameter" VALUE 0x40050D60 /* @ECU_Address@WM_PRailLo_P@ */ Scalar_FLOAT32_IEEE 0 EcuIntgdSwGend_CM_single_bar 0.0 2500.0 /end CHARACTERISTIC
/begin CHARACTERISTIC WM_PRailNotCtldThd_P "Rail Pressure Is Not Controlled Threshold Parameter" VALUE 0x40050D64 /* @ECU_Address@WM_PRailNotCtldThd_P@ */ Scalar_FLOAT32_IEEE 0 EcuIntgdSwGend_CM_single_bar 0.0 500.0 /end CHARACTERISTIC
/begin CHARACTERISTIC WM_PRailOvDesLvlQnty_P "Rail Pressure Over Desired Severity Level Quantity Parameter" VALUE 0x40050D68 /* @ECU_Address@WM_PRailOvDesLvlQnty_P@ */ Scalar_FLOAT32_IEEE 0 EcuIntgdSwGend_CM_single 0.0 3.0 /end CHARACTERISTIC
/begin CHARACTERISTIC WM_PRailOvHysDeacLvl1_P "Rail Pressure Over Level 1 Hysteresis Deactivation Parameter" VALUE 0x40050D6C /* @ECU_Address@WM_PRailOvHysDeacLvl1_P@ */ Scalar_FLOAT32_IEEE 0 EcuIntgdSwGend_CM_single_bar 0.0 2500.0 /end CHARACTERISTIC
/begin CHARACTERISTIC WM_PRailOvHysDeacLvl2_P "Rail Pressure Over Level 2 Hysteresis Deactivation Parameter" VALUE 0x40050D70 /* @ECU_Address@WM_PRailOvHysDeacLvl2_P@ */ Scalar_FLOAT32_IEEE 0 EcuIntgdSwGend_CM_single_bar 0.0 2500.0 /end CHARACTERISTIC
/begin CHARACTERISTIC WM_PRailOvHysDeacLvl3_P "Rail Pressure Over Level 3 Hysteresis Deactivation Parameter" VALUE 0x40050D74 /* @ECU_Address@WM_PRailOvHysDeacLvl3_P@ */ Scalar_FLOAT32_IEEE 0 EcuIntgdSwGend_CM_single_bar 0.0 2500.0 /end CHARACTERISTIC
/begin CHARACTERISTIC WM_PRailTooHi_P "Rail Pressure Too High Threshold Parameter" VALUE 0x40050DB4 /* @ECU_Address@WM_PRailTooHi_P@ */ Scalar_FLOAT32_IEEE 0 EcuIntgdSwGend_CM_single_bar 0.0 2500.0 /end CHARACTERISTIC
/begin CHARACTERISTIC WM_PRailUndDesLvlQnty_P "Rail Pressure Under Desired Severity Level Quantity Parameter" VALUE 0x40050DB8 /* @ECU_Address@WM_PRailUndDesLvlQnty_P@ */ Scalar_FLOAT32_IEEE 0 EcuIntgdSwGend_CM_single 0.0 3.0 /end CHARACTERISTIC
/begin CHARACTERISTIC WM_PRailUndHysDeacLvl1_P "Rail Pressure Under Level 1 Hysteresis Deactivation Parameter" VALUE 0x40050DBC /* @ECU_Address@WM_PRailUndHysDeacLvl1_P@ */ Scalar_FLOAT32_IEEE 0 EcuIntgdSwGend_CM_single_bar 0.0 2500.0 /end CHARACTERISTIC
/begin CHARACTERISTIC WM_PRailUndHysDeacLvl2_P "Rail Pressure Under Level 2 Hysteresis Deactivation Parameter" VALUE 0x40050DC0 /* @ECU_Address@WM_PRailUndHysDeacLvl2_P@ */ Scalar_FLOAT32_IEEE 0 EcuIntgdSwGend_CM_single_bar 0.0 2500.0 /end CHARACTERISTIC
/begin CHARACTERISTIC WM_PRailUndHysDeacLvl3_P "Rail Pressure Under Level 3 Hysteresis Deactivation Parameter" VALUE 0x40050DC4 /* @ECU_Address@WM_PRailUndHysDeacLvl3_P@ */ Scalar_FLOAT32_IEEE 0 EcuIntgdSwGend_CM_single_bar 0.0 2500.0 /end CHARACTERISTIC
/begin CHARACTERISTIC WM_TAirBoostOvDesLvlQnty_P "Air Boost Temperature Over Desired Severity Level Quantity Parameter" VALUE 0x40050E04 /* @ECU_Address@WM_TAirBoostOvDesLvlQnty_P@ */ Scalar_FLOAT32_IEEE 0 EcuIntgdSwGend_CM_single 0.0 3.0 /end CHARACTERISTIC
/begin CHARACTERISTIC WM_TAirBoostOvHysDeacLvl1_P "Air Boost Temperature Over Level 1 Hysteresis Deactivation Parameter" VALUE 0x40050E08 /* @ECU_Address@WM_TAirBoostOvHysDeacLvl1_P@ */ Scalar_FLOAT32_IEEE 0 EcuIntgdSwGend_CM_single_degC -40.0 250.0 /end CHARACTERISTIC
/begin CHARACTERISTIC WM_TAirBoostOvHysDeacLvl2_P "Air Boost Temperature Over Level 2 Hysteresis Deactivation Parameter" VALUE 0x40050E0C /* @ECU_Address@WM_TAirBoostOvHysDeacLvl2_P@ */ Scalar_FLOAT32_IEEE 0 EcuIntgdSwGend_CM_single_degC -40.0 250.0 /end CHARACTERISTIC
/begin CHARACTERISTIC WM_TAirBoostOvHysDeacLvl3_P "Air Boost Temperature Over Level 3 Hysteresis Deactivation Parameter" VALUE 0x40050E10 /* @ECU_Address@WM_TAirBoostOvHysDeacLvl3_P@ */ Scalar_FLOAT32_IEEE 0 EcuIntgdSwGend_CM_single_degC -40.0 250.0 /end CHARACTERISTIC
/begin CHARACTERISTIC WM_TAirBoostUndDesLvlQnty_P "Air Boost Temperature Under Desired Severity Level Quantity Parameter" VALUE 0x40050E50 /* @ECU_Address@WM_TAirBoostUndDesLvlQnty_P@ */ Scalar_FLOAT32_IEEE 0 EcuIntgdSwGend_CM_single 0.0 3.0 /end CHARACTERISTIC
/begin CHARACTERISTIC WM_TAirBoostUndHysDeacLvl1_P "Air Boost Temperature Under Level 1 Hysteresis Deactivation Parameter" VALUE 0x40050E54 /* @ECU_Address@WM_TAirBoostUndHysDeacLvl1_P@ */ Scalar_FLOAT32_IEEE 0 EcuIntgdSwGend_CM_single_degC -40.0 250.0 /end CHARACTERISTIC
/begin CHARACTERISTIC WM_TAirBoostUndHysDeacLvl2_P "Air Boost Temperature Under Level 2 Hysteresis Deactivation Parameter" VALUE 0x40050E58 /* @ECU_Address@WM_TAirBoostUndHysDeacLvl2_P@ */ Scalar_FLOAT32_IEEE 0 EcuIntgdSwGend_CM_single_degC -40.0 250.0 /end CHARACTERISTIC
/begin CHARACTERISTIC WM_TAirBoostUndHysDeacLvl3_P "Air Boost Temperature Under Level 3 Hysteresis Deactivation Parameter" VALUE 0x40050E5C /* @ECU_Address@WM_TAirBoostUndHysDeacLvl3_P@ */ Scalar_FLOAT32_IEEE 0 EcuIntgdSwGend_CM_single_degC -40.0 250.0 /end CHARACTERISTIC
/begin CHARACTERISTIC WM_TAmbAirOvDesLvlQnty_P "Ambient Air Temperature Over Desired Severity Level Quantity Parameter" VALUE 0x40050E9C /* @ECU_Address@WM_TAmbAirOvDesLvlQnty_P@ */ Scalar_FLOAT32_IEEE 0 EcuIntgdSwGend_CM_single 0.0 3.0 /end CHARACTERISTIC
/begin CHARACTERISTIC WM_TAmbAirOvHysDeacLvl1_P "Ambient Air Temperature Over Level 1 Hysteresis Deactivation Parameter" VALUE 0x40050EA0 /* @ECU_Address@WM_TAmbAirOvHysDeacLvl1_P@ */ Scalar_FLOAT32_IEEE 0 EcuIntgdSwGend_CM_single_degC -40.0 250.0 /end CHARACTERISTIC
/begin CHARACTERISTIC WM_TAmbAirOvHysDeacLvl2_P "Ambient Air Temperature Over Level 2 Hysteresis Deactivation Parameter" VALUE 0x40050EA4 /* @ECU_Address@WM_TAmbAirOvHysDeacLvl2_P@ */ Scalar_FLOAT32_IEEE 0 EcuIntgdSwGend_CM_single_degC -40.0 250.0 /end CHARACTERISTIC
/begin CHARACTERISTIC WM_TAmbAirOvHysDeacLvl3_P "Ambient Air Temperature Over Level 3 Hysteresis Deactivation Parameter" VALUE 0x40050EA8 /* @ECU_Address@WM_TAmbAirOvHysDeacLvl3_P@ */ Scalar_FLOAT32_IEEE 0 EcuIntgdSwGend_CM_single_degC -40.0 250.0 /end CHARACTERISTIC
/begin CHARACTERISTIC WM_TAmbAirUndDesLvlQnty_P "Ambient Air Temperature Under Desired Severity Level Quantity Parameter" VALUE 0x40050EE8 /* @ECU_Address@WM_TAmbAirUndDesLvlQnty_P@ */ Scalar_FLOAT32_IEEE 0 EcuIntgdSwGend_CM_single 0.0 3.0 /end CHARACTERISTIC
/begin CHARACTERISTIC WM_TAmbAirUndHysDeacLvl1_P "Ambient Air Temperature Under Level 1 Hysteresis Deactivation Parameter" VALUE 0x40050EEC /* @ECU_Address@WM_TAmbAirUndHysDeacLvl1_P@ */ Scalar_FLOAT32_IEEE 0 EcuIntgdSwGend_CM_single_degC -40.0 250.0 /end CHARACTERISTIC
/begin CHARACTERISTIC WM_TAmbAirUndHysDeacLvl2_P "Ambient Air Temperature Under Level 2 Hysteresis Deactivation Parameter" VALUE 0x40050EF0 /* @ECU_Address@WM_TAmbAirUndHysDeacLvl2_P@ */ Scalar_FLOAT32_IEEE 0 EcuIntgdSwGend_CM_single_degC -40.0 250.0 /end CHARACTERISTIC
/begin CHARACTERISTIC WM_TAmbAirUndHysDeacLvl3_P "Ambient Air Temperature Under Level 3 Hysteresis Deactivation Parameter" VALUE 0x40050EF4 /* @ECU_Address@WM_TAmbAirUndHysDeacLvl3_P@ */ Scalar_FLOAT32_IEEE 0 EcuIntgdSwGend_CM_single_degC -40.0 250.0 /end CHARACTERISTIC
/begin CHARACTERISTIC WM_TCooltOvDesLvlQnty_P "Coolant Temperature Over Desired Severity Level Quantity Parameter" VALUE 0x40050F34 /* @ECU_Address@WM_TCooltOvDesLvlQnty_P@ */ Scalar_FLOAT32_IEEE 0 EcuIntgdSwGend_CM_single 0.0 3.0 /end CHARACTERISTIC
/begin CHARACTERISTIC WM_TCooltOvHysDeacLvl1_P "Coolant Temperature Over Level 1 Hysteresis Deactivation Parameter" VALUE 0x40050F38 /* @ECU_Address@WM_TCooltOvHysDeacLvl1_P@ */ Scalar_FLOAT32_IEEE 0 EcuIntgdSwGend_CM_single_degC -40.0 250.0 /end CHARACTERISTIC
/begin CHARACTERISTIC WM_TCooltOvHysDeacLvl2_P "Coolant Temperature Over Level 2 Hysteresis Deactivation Parameter" VALUE 0x40050F3C /* @ECU_Address@WM_TCooltOvHysDeacLvl2_P@ */ Scalar_FLOAT32_IEEE 0 EcuIntgdSwGend_CM_single_degC -40.0 250.0 /end CHARACTERISTIC
/begin CHARACTERISTIC WM_TCooltOvHysDeacLvl3_P "Coolant Temperature Over Level 3 Hysteresis Deactivation Parameter" VALUE 0x40050F40 /* @ECU_Address@WM_TCooltOvHysDeacLvl3_P@ */ Scalar_FLOAT32_IEEE 0 EcuIntgdSwGend_CM_single_degC -40.0 250.0 /end CHARACTERISTIC
/begin CHARACTERISTIC WM_TCooltUndDesLvlQnty_P "Coolant Temperature Under Desired Severity Level Quantity Parameter" VALUE 0x40050F80 /* @ECU_Address@WM_TCooltUndDesLvlQnty_P@ */ Scalar_FLOAT32_IEEE 0 EcuIntgdSwGend_CM_single 0.0 3.0 /end CHARACTERISTIC
/begin CHARACTERISTIC WM_TCooltUndHysDeacLvl1_P "Coolant Temperature Under Level 1 Hysteresis Deactivation Parameter" VALUE 0x40050F84 /* @ECU_Address@WM_TCooltUndHysDeacLvl1_P@ */ Scalar_FLOAT32_IEEE 0 EcuIntgdSwGend_CM_single_degC -40.0 250.0 /end CHARACTERISTIC
/begin CHARACTERISTIC WM_TCooltUndHysDeacLvl2_P "Coolant Temperature Under Level 2 Hysteresis Deactivation Parameter" VALUE 0x40050F88 /* @ECU_Address@WM_TCooltUndHysDeacLvl2_P@ */ Scalar_FLOAT32_IEEE 0 EcuIntgdSwGend_CM_single_degC -40.0 250.0 /end CHARACTERISTIC
/begin CHARACTERISTIC WM_TCooltUndHysDeacLvl3_P "Coolant Temperature Under Level 3 Hysteresis Deactivation Parameter" VALUE 0x40050F8C /* @ECU_Address@WM_TCooltUndHysDeacLvl3_P@ */ Scalar_FLOAT32_IEEE 0 EcuIntgdSwGend_CM_single_degC -40.0 250.0 /end CHARACTERISTIC
/begin CHARACTERISTIC WM_TEcuDesLvlQnty_P "ECU Temperature Desired Severity Level Quantity Parameter" VALUE 0x40050FCC /* @ECU_Address@WM_TEcuDesLvlQnty_P@ */ Scalar_FLOAT32_IEEE 0 EcuIntgdSwGend_CM_single 0.0 3.0 /end CHARACTERISTIC
/begin CHARACTERISTIC WM_TEcuHysDeacLvl1_P "ECU Temperature Level 1 Hysteresis Deactivation Parameter" VALUE 0x40050FD0 /* @ECU_Address@WM_TEcuHysDeacLvl1_P@ */ Scalar_FLOAT32_IEEE 0 EcuIntgdSwGend_CM_single_degC -40.0 250.0 /end CHARACTERISTIC
/begin CHARACTERISTIC WM_TEcuHysDeacLvl2_P "ECU Temperature Level 2 Hysteresis Deactivation Parameter" VALUE 0x40050FD4 /* @ECU_Address@WM_TEcuHysDeacLvl2_P@ */ Scalar_FLOAT32_IEEE 0 EcuIntgdSwGend_CM_single_degC -40.0 250.0 /end CHARACTERISTIC
/begin CHARACTERISTIC WM_TEcuHysDeacLvl3_P "ECU Temperature Level 3 Hysteresis Deactivation Parameter" VALUE 0x40050FD8 /* @ECU_Address@WM_TEcuHysDeacLvl3_P@ */ Scalar_FLOAT32_IEEE 0 EcuIntgdSwGend_CM_single_degC -40.0 250.0 /end CHARACTERISTIC
/begin CHARACTERISTIC WM_TEcuLvl1_P "ECU Temperature Level 1 Map" VALUE 0x40050FDC /* @ECU_Address@WM_TEcuLvl1_P@ */ Scalar_FLOAT32_IEEE 0 EcuIntgdSwGend_CM_single_degC -40.0 250.0 /end CHARACTERISTIC
/begin CHARACTERISTIC WM_TEcuLvl2_P "ECU Temperature Level 2 Map" VALUE 0x40050FE0 /* @ECU_Address@WM_TEcuLvl2_P@ */ Scalar_FLOAT32_IEEE 0 EcuIntgdSwGend_CM_single_degC -40.0 250.0 /end CHARACTERISTIC
/begin CHARACTERISTIC WM_TEcuLvl3_P "ECU Temperature Level 3 Map" VALUE 0x40050FE4 /* @ECU_Address@WM_TEcuLvl3_P@ */ Scalar_FLOAT32_IEEE 0 EcuIntgdSwGend_CM_single_degC -40.0 250.0 /end CHARACTERISTIC
/begin CHARACTERISTIC WM_TFuOvDesLvlQnty_P "Fuel Temperature Over Desired Severity Level Quantity Parameter" VALUE 0x40050FE8 /* @ECU_Address@WM_TFuOvDesLvlQnty_P@ */ Scalar_FLOAT32_IEEE 0 EcuIntgdSwGend_CM_single 0.0 3.0 /end CHARACTERISTIC
/begin CHARACTERISTIC WM_TFuOvHysDeacLvl1_P "Fuel Temperature Over Level 1 Hysteresis Deactivation Parameter" VALUE 0x40050FEC /* @ECU_Address@WM_TFuOvHysDeacLvl1_P@ */ Scalar_FLOAT32_IEEE 0 EcuIntgdSwGend_CM_single_degC -40.0 250.0 /end CHARACTERISTIC
/begin CHARACTERISTIC WM_TFuOvHysDeacLvl2_P "Fuel Temperature Over Level 2 Hysteresis Deactivation Parameter" VALUE 0x40050FF0 /* @ECU_Address@WM_TFuOvHysDeacLvl2_P@ */ Scalar_FLOAT32_IEEE 0 EcuIntgdSwGend_CM_single_degC -40.0 250.0 /end CHARACTERISTIC
/begin CHARACTERISTIC WM_TFuOvHysDeacLvl3_P "Fuel Temperature Over Level 3 Hysteresis Deactivation Parameter" VALUE 0x40050FF4 /* @ECU_Address@WM_TFuOvHysDeacLvl3_P@ */ Scalar_FLOAT32_IEEE 0 EcuIntgdSwGend_CM_single_degC -40.0 250.0 /end CHARACTERISTIC
/begin CHARACTERISTIC WM_TOilOvDesLvlQnty_P "Oil Temperature Over Desired Severity Level Quantity Parameter" VALUE 0x40051034 /* @ECU_Address@WM_TOilOvDesLvlQnty_P@ */ Scalar_FLOAT32_IEEE 0 EcuIntgdSwGend_CM_single 0.0 3.0 /end CHARACTERISTIC
/begin CHARACTERISTIC WM_TOilOvHysDeacLvl1_P "Oil Temperature Over Level 1 Hysteresis Deactivation Parameter" VALUE 0x40051038 /* @ECU_Address@WM_TOilOvHysDeacLvl1_P@ */ Scalar_FLOAT32_IEEE 0 EcuIntgdSwGend_CM_single_degC -40.0 250.0 /end CHARACTERISTIC
/begin CHARACTERISTIC WM_TOilOvHysDeacLvl2_P "Oil Temperature Over Level 2 Hysteresis Deactivation Parameter" VALUE 0x4005103C /* @ECU_Address@WM_TOilOvHysDeacLvl2_P@ */ Scalar_FLOAT32_IEEE 0 EcuIntgdSwGend_CM_single_degC -40.0 250.0 /end CHARACTERISTIC
/begin CHARACTERISTIC WM_TOilOvHysDeacLvl3_P "Oil Temperature Over Level 3 Hysteresis Deactivation Parameter" VALUE 0x40051040 /* @ECU_Address@WM_TOilOvHysDeacLvl3_P@ */ Scalar_FLOAT32_IEEE 0 EcuIntgdSwGend_CM_single_degC -40.0 250.0 /end CHARACTERISTIC
/begin CHARACTERISTIC WM_TOilUndDesLvlQnty_P "Oil Temperature Under Desired Severity Level Quantity Parameter" VALUE 0x40051080 /* @ECU_Address@WM_TOilUndDesLvlQnty_P@ */ Scalar_FLOAT32_IEEE 0 EcuIntgdSwGend_CM_single 0.0 3.0 /end CHARACTERISTIC
/begin CHARACTERISTIC WM_TOilUndHysDeacLvl1_P "Oil Temperature Under Level 1 Hysteresis Deactivation Parameter" VALUE 0x40051084 /* @ECU_Address@WM_TOilUndHysDeacLvl1_P@ */ Scalar_FLOAT32_IEEE 0 EcuIntgdSwGend_CM_single_degC -40.0 250.0 /end CHARACTERISTIC
/begin CHARACTERISTIC WM_TOilUndHysDeacLvl2_P "Oil Temperature Under Level 2 Hysteresis Deactivation Parameter" VALUE 0x40051088 /* @ECU_Address@WM_TOilUndHysDeacLvl2_P@ */ Scalar_FLOAT32_IEEE 0 EcuIntgdSwGend_CM_single_degC -40.0 250.0 /end CHARACTERISTIC
/begin CHARACTERISTIC WM_TOilUndHysDeacLvl3_P "Oil Temperature Under Level 3 Hysteresis Deactivation Parameter" VALUE 0x4005108C /* @ECU_Address@WM_TOilUndHysDeacLvl3_P@ */ Scalar_FLOAT32_IEEE 0 EcuIntgdSwGend_CM_single_degC -40.0 250.0 /end CHARACTERISTIC
/begin CHARACTERISTIC WM_TiAcvWarnPRailNotCtldDeb_P "Rail Pressure Is Not Controlled Debouncer Activation Timer Parameter" VALUE 0x400510CC /* @ECU_Address@WM_TiAcvWarnPRailNotCtldDeb_P@ */ Scalar_FLOAT32_IEEE 0 EcuIntgdSwGend_CM_single_ms 0.0 25000.0 /end CHARACTERISTIC
/begin CHARACTERISTIC WM_TiAcvWarnPRailTooHiDeb_P "Rail Pressure Is Too High Debouncer Activation Timer Parameter" VALUE 0x400510D0 /* @ECU_Address@WM_TiAcvWarnPRailTooHiDeb_P@ */ Scalar_FLOAT32_IEEE 0 EcuIntgdSwGend_CM_single_ms 0.0 25000.0 /end CHARACTERISTIC
/begin CHARACTERISTIC WM_TiPAirBoostUndDebHi_P "Air Boost Pressure Under Debouncer High Time Parameter" VALUE 0x400510E4 /* @ECU_Address@WM_TiPAirBoostUndDebHi_P@ */ Scalar_FLOAT32_IEEE 0 EcuIntgdSwGend_CM_single_ms 0.0 25000.0 /end CHARACTERISTIC
/begin CHARACTERISTIC WM_TiPAirBoostUndDebLo_P "Air Boost Pressure Under Debouncer Low Time Parameter" VALUE 0x400510E8 /* @ECU_Address@WM_TiPAirBoostUndDebLo_P@ */ Scalar_FLOAT32_IEEE 0 EcuIntgdSwGend_CM_single_ms 0.0 25000.0 /end CHARACTERISTIC
/begin CHARACTERISTIC WM_TiPAmbAirOvDebHi_P "Ambient Air Pressure Over Debouncer High Time Parameter" VALUE 0x400510EC /* @ECU_Address@WM_TiPAmbAirOvDebHi_P@ */ Scalar_FLOAT32_IEEE 0 EcuIntgdSwGend_CM_single_ms 0.0 25000.0 /end CHARACTERISTIC
/begin CHARACTERISTIC WM_TiPAmbAirOvDebLo_P "Ambient Air Pressure Over Debouncer Low Time Parameter" VALUE 0x400510F0 /* @ECU_Address@WM_TiPAmbAirOvDebLo_P@ */ Scalar_FLOAT32_IEEE 0 EcuIntgdSwGend_CM_single_ms 0.0 25000.0 /end CHARACTERISTIC
/begin CHARACTERISTIC WM_TiPAmbAirUndDebHi_P "Ambient Air Pressure Under Debouncer High Time Parameter" VALUE 0x400510F4 /* @ECU_Address@WM_TiPAmbAirUndDebHi_P@ */ Scalar_FLOAT32_IEEE 0 EcuIntgdSwGend_CM_single_ms 0.0 25000.0 /end CHARACTERISTIC
/begin CHARACTERISTIC WM_TiPAmbAirUndDebLo_P "Ambient Air Pressure Under Debouncer Low Time Parameter" VALUE 0x400510F8 /* @ECU_Address@WM_TiPAmbAirUndDebLo_P@ */ Scalar_FLOAT32_IEEE 0 EcuIntgdSwGend_CM_single_ms 0.0 25000.0 /end CHARACTERISTIC
/begin CHARACTERISTIC WM_TiPFuOvDebHi_P "Fuel Pressure Over Debouncer High Time Parameter" VALUE 0x400510FC /* @ECU_Address@WM_TiPFuOvDebHi_P@ */ Scalar_FLOAT32_IEEE 0 EcuIntgdSwGend_CM_single_ms 0.0 25000.0 /end CHARACTERISTIC
/begin CHARACTERISTIC WM_TiPFuOvDebLo_P "Fuel Pressure Over Debouncer Low Time Parameter" VALUE 0x40051100 /* @ECU_Address@WM_TiPFuOvDebLo_P@ */ Scalar_FLOAT32_IEEE 0 EcuIntgdSwGend_CM_single_ms 0.0 25000.0 /end CHARACTERISTIC
/begin CHARACTERISTIC WM_TiPFuUndDebHi_P "Fuel Pressure Under Debouncer High Time Parameter" VALUE 0x40051104 /* @ECU_Address@WM_TiPFuUndDebHi_P@ */ Scalar_FLOAT32_IEEE 0 EcuIntgdSwGend_CM_single_ms 0.0 25000.0 /end CHARACTERISTIC
/begin CHARACTERISTIC WM_TiPFuUndDebLo_P "Fuel Pressure Under Debouncer Low Time Parameter" VALUE 0x40051108 /* @ECU_Address@WM_TiPFuUndDebLo_P@ */ Scalar_FLOAT32_IEEE 0 EcuIntgdSwGend_CM_single_ms 0.0 25000.0 /end CHARACTERISTIC
/begin CHARACTERISTIC WM_TiPOilOvDebHi_P "Oil Pressure Over Debouncer High Time Parameter" VALUE 0x4005110C /* @ECU_Address@WM_TiPOilOvDebHi_P@ */ Scalar_FLOAT32_IEEE 0 EcuIntgdSwGend_CM_single_ms 0.0 25000.0 /end CHARACTERISTIC
/begin CHARACTERISTIC WM_TiPOilOvDebLo_P "Oil Pressure Over Debouncer Low Time Parameter" VALUE 0x40051110 /* @ECU_Address@WM_TiPOilOvDebLo_P@ */ Scalar_FLOAT32_IEEE 0 EcuIntgdSwGend_CM_single_ms 0.0 25000.0 /end CHARACTERISTIC
/begin CHARACTERISTIC WM_TiPOilUndDebHi_P "Oil Pressure Under Debouncer High Time Parameter" VALUE 0x40051114 /* @ECU_Address@WM_TiPOilUndDebHi_P@ */ Scalar_FLOAT32_IEEE 0 EcuIntgdSwGend_CM_single_ms 0.0 25000.0 /end CHARACTERISTIC
/begin CHARACTERISTIC WM_TiPOilUndDebLo_P "Oil Pressure Under Debouncer Low Time Parameter" VALUE 0x40051118 /* @ECU_Address@WM_TiPOilUndDebLo_P@ */ Scalar_FLOAT32_IEEE 0 EcuIntgdSwGend_CM_single_ms 0.0 25000.0 /end CHARACTERISTIC
/begin CHARACTERISTIC WM_TiPRailHiAcvDeb_P "Rail Pressure High Debouncer Time Parameter" VALUE 0x4005111C /* @ECU_Address@WM_TiPRailHiAcvDeb_P@ */ Scalar_FLOAT32_IEEE 0 EcuIntgdSwGend_CM_single_ms 0.0 25000.0 /end CHARACTERISTIC
/begin CHARACTERISTIC WM_TiPRailLoAcvWarnDeb_P "Rail Pressure Low Debouncer Time Parameter" VALUE 0x40051120 /* @ECU_Address@WM_TiPRailLoAcvWarnDeb_P@ */ Scalar_FLOAT32_IEEE 0 EcuIntgdSwGend_CM_single_ms 0.0 25000.0 /end CHARACTERISTIC
/begin CHARACTERISTIC WM_TiPRailOvDebHi_P "Rail Pressure Over Debouncer High Time Parameter" VALUE 0x40051124 /* @ECU_Address@WM_TiPRailOvDebHi_P@ */ Scalar_FLOAT32_IEEE 0 EcuIntgdSwGend_CM_single_ms 0.0 25000.0 /end CHARACTERISTIC
/begin CHARACTERISTIC WM_TiPRailOvDebLo_P "Rail Pressure Over Debouncer Low Time Parameter" VALUE 0x40051128 /* @ECU_Address@WM_TiPRailOvDebLo_P@ */ Scalar_FLOAT32_IEEE 0 EcuIntgdSwGend_CM_single_ms 0.0 25000.0 /end CHARACTERISTIC
/begin CHARACTERISTIC WM_TiPRailUndDebHi_P "Rail Pressure Under Debouncer High Time Parameter" VALUE 0x4005112C /* @ECU_Address@WM_TiPRailUndDebHi_P@ */ Scalar_FLOAT32_IEEE 0 EcuIntgdSwGend_CM_single_ms 0.0 25000.0 /end CHARACTERISTIC
/begin CHARACTERISTIC WM_TiPRailUndDebLo_P "Rail Pressure Under Debouncer Low Time Parameter" VALUE 0x40051130 /* @ECU_Address@WM_TiPRailUndDebLo_P@ */ Scalar_FLOAT32_IEEE 0 EcuIntgdSwGend_CM_single_ms 0.0 25000.0 /end CHARACTERISTIC
/begin CHARACTERISTIC WM_TiTAirBoostOvDebHi_P "Air Boost Temperature Over Debouncer High Time Parameter" VALUE 0x40051134 /* @ECU_Address@WM_TiTAirBoostOvDebHi_P@ */ Scalar_FLOAT32_IEEE 0 EcuIntgdSwGend_CM_single_ms 0.0 25000.0 /end CHARACTERISTIC
/begin CHARACTERISTIC WM_TiTAirBoostOvDebLo_P "Air Boost Temperature Over Debouncer Low Time Parameter" VALUE 0x40051138 /* @ECU_Address@WM_TiTAirBoostOvDebLo_P@ */ Scalar_FLOAT32_IEEE 0 EcuIntgdSwGend_CM_single_ms 0.0 25000.0 /end CHARACTERISTIC
/begin CHARACTERISTIC WM_TiTAirBoostUndDebHi_P "Air Boost Temperature Under Debouncer High Time Parameter" VALUE 0x4005113C /* @ECU_Address@WM_TiTAirBoostUndDebHi_P@ */ Scalar_FLOAT32_IEEE 0 EcuIntgdSwGend_CM_single_ms 0.0 25000.0 /end CHARACTERISTIC
/begin CHARACTERISTIC WM_TiTAirBoostUndDebLo_P "Air Boost Temperature Under Debouncer Low Time Parameter" VALUE 0x40051140 /* @ECU_Address@WM_TiTAirBoostUndDebLo_P@ */ Scalar_FLOAT32_IEEE 0 EcuIntgdSwGend_CM_single_ms 0.0 25000.0 /end CHARACTERISTIC
/begin CHARACTERISTIC WM_TiTAmbAirOvDebHi_P "Ambient Air Temperature Over Debouncer High Time Parameter" VALUE 0x40051144 /* @ECU_Address@WM_TiTAmbAirOvDebHi_P@ */ Scalar_FLOAT32_IEEE 0 EcuIntgdSwGend_CM_single_ms 0.0 25000.0 /end CHARACTERISTIC
/begin CHARACTERISTIC WM_TiTAmbAirOvDebLo_P "Ambient Air Temperature Over Debouncer Low Time Parameter" VALUE 0x40051148 /* @ECU_Address@WM_TiTAmbAirOvDebLo_P@ */ Scalar_FLOAT32_IEEE 0 EcuIntgdSwGend_CM_single_ms 0.0 25000.0 /end CHARACTERISTIC
/begin CHARACTERISTIC WM_TiTAmbAirUndDebHi_P "Ambient Air Temperature Under Debouncer High Time Parameter" VALUE 0x4005114C /* @ECU_Address@WM_TiTAmbAirUndDebHi_P@ */ Scalar_FLOAT32_IEEE 0 EcuIntgdSwGend_CM_single_ms 0.0 25000.0 /end CHARACTERISTIC
/begin CHARACTERISTIC WM_TiTAmbAirUndDebLo_P "Ambient Air Temperature Under Debouncer Low Time Parameter" VALUE 0x40051150 /* @ECU_Address@WM_TiTAmbAirUndDebLo_P@ */ Scalar_FLOAT32_IEEE 0 EcuIntgdSwGend_CM_single_ms 0.0 25000.0 /end CHARACTERISTIC
/begin CHARACTERISTIC WM_TiTCooltOvDebHi_P "Coolant Temperature Over Debouncer High Time Parameter" VALUE 0x40051154 /* @ECU_Address@WM_TiTCooltOvDebHi_P@ */ Scalar_FLOAT32_IEEE 0 EcuIntgdSwGend_CM_single_ms 0.0 25000.0 /end CHARACTERISTIC
/begin CHARACTERISTIC WM_TiTCooltOvDebLo_P "Coolant Temperature Over Debouncer Low Time Parameter" VALUE 0x40051158 /* @ECU_Address@WM_TiTCooltOvDebLo_P@ */ Scalar_FLOAT32_IEEE 0 EcuIntgdSwGend_CM_single_ms 0.0 25000.0 /end CHARACTERISTIC
/begin CHARACTERISTIC WM_TiTCooltUndDebHi_P "Coolant Temperature Under Debouncer High Time Parameter" VALUE 0x4005115C /* @ECU_Address@WM_TiTCooltUndDebHi_P@ */ Scalar_FLOAT32_IEEE 0 EcuIntgdSwGend_CM_single_ms 0.0 25000.0 /end CHARACTERISTIC
/begin CHARACTERISTIC WM_TiTCooltUndDebLo_P "Coolant Temperature Under Debouncer Low Time Parameter" VALUE 0x40051160 /* @ECU_Address@WM_TiTCooltUndDebLo_P@ */ Scalar_FLOAT32_IEEE 0 EcuIntgdSwGend_CM_single_ms 0.0 25000.0 /end CHARACTERISTIC
/begin CHARACTERISTIC WM_TiTEcuDebHi_P "ECU Temperature Debouncer High Time Parameter" VALUE 0x40051164 /* @ECU_Address@WM_TiTEcuDebHi_P@ */ Scalar_FLOAT32_IEEE 0 EcuIntgdSwGend_CM_single_ms 0.0 25000.0 /end CHARACTERISTIC
/begin CHARACTERISTIC WM_TiTEcuDebLo_P "ECU Temperature Debouncer Low Time Parameter" VALUE 0x40051168 /* @ECU_Address@WM_TiTEcuDebLo_P@ */ Scalar_FLOAT32_IEEE 0 EcuIntgdSwGend_CM_single_ms 0.0 25000.0 /end CHARACTERISTIC
/begin CHARACTERISTIC WM_TiTFuOvDebHi_P "Fuel Temperature Over Debouncer High Time Parameter" VALUE 0x4005116C /* @ECU_Address@WM_TiTFuOvDebHi_P@ */ Scalar_FLOAT32_IEEE 0 EcuIntgdSwGend_CM_single_ms 0.0 25000.0 /end CHARACTERISTIC
/begin CHARACTERISTIC WM_TiTFuOvDebLo_P "Fuel Temperature Over Debouncer Low Time Parameter" VALUE 0x40051170 /* @ECU_Address@WM_TiTFuOvDebLo_P@ */ Scalar_FLOAT32_IEEE 0 EcuIntgdSwGend_CM_single_ms 0.0 25000.0 /end CHARACTERISTIC
/begin CHARACTERISTIC WM_TiTOilOvDebHi_P "Oil Temperature Over Debouncer High Time Parameter" VALUE 0x40051174 /* @ECU_Address@WM_TiTOilOvDebHi_P@ */ Scalar_FLOAT32_IEEE 0 EcuIntgdSwGend_CM_single_ms 0.0 25000.0 /end CHARACTERISTIC
/begin CHARACTERISTIC WM_TiTOilOvDebLo_P "Oil Temperature Over Debouncer Low Time Parameter" VALUE 0x40051178 /* @ECU_Address@WM_TiTOilOvDebLo_P@ */ Scalar_FLOAT32_IEEE 0 EcuIntgdSwGend_CM_single_ms 0.0 25000.0 /end CHARACTERISTIC
/begin CHARACTERISTIC WM_TiTOilUndDebHi_P "Oil Temperature Under Debouncer High Time Parameter" VALUE 0x4005117C /* @ECU_Address@WM_TiTOilUndDebHi_P@ */ Scalar_FLOAT32_IEEE 0 EcuIntgdSwGend_CM_single_ms 0.0 25000.0 /end CHARACTERISTIC
/begin CHARACTERISTIC WM_TiTOilUndDebLo_P "Oil Temperature Under Debouncer Low Time Parameter" VALUE 0x40051180 /* @ECU_Address@WM_TiTOilUndDebLo_P@ */ Scalar_FLOAT32_IEEE 0 EcuIntgdSwGend_CM_single_ms 0.0 25000.0 /end CHARACTERISTIC
/begin CHARACTERISTIC WM_MaskPAirBoostUndEnaCond_P "Airboost Pressure Under Global Enable Condition Parameter" VALUE 0x40050808 /* @ECU_Address@WM_MaskPAirBoostUndEnaCond_P@ */ Scalar_ULONG 0 EcuIntgdSwGend_CM_uint32 0.0 4.294967295E+9 /end CHARACTERISTIC
/begin CHARACTERISTIC WM_MaskPAmbAirOvEnaCond_P "Ambient Air Pressure Over Global Enable Condition Parameter" VALUE 0x4005080C /* @ECU_Address@WM_MaskPAmbAirOvEnaCond_P@ */ Scalar_ULONG 0 EcuIntgdSwGend_CM_uint32 0.0 4.294967295E+9 /end CHARACTERISTIC
/begin CHARACTERISTIC WM_MaskPAmbAirUndEnaCond_P "Ambient Air Pressure Under Global Enable Condition Parameter" VALUE 0x40050810 /* @ECU_Address@WM_MaskPAmbAirUndEnaCond_P@ */ Scalar_ULONG 0 EcuIntgdSwGend_CM_uint32 0.0 4.294967295E+9 /end CHARACTERISTIC
/begin CHARACTERISTIC WM_MaskPFuOvEnaCond_P "Fuel Pressure Over Global Enable Condition Parameter" VALUE 0x40050814 /* @ECU_Address@WM_MaskPFuOvEnaCond_P@ */ Scalar_ULONG 0 EcuIntgdSwGend_CM_uint32 0.0 4.294967295E+9 /end CHARACTERISTIC
/begin CHARACTERISTIC WM_MaskPFuUndEnaCond_P "Fuel Pressure Under Global Enable Condition Parameter" VALUE 0x40050818 /* @ECU_Address@WM_MaskPFuUndEnaCond_P@ */ Scalar_ULONG 0 EcuIntgdSwGend_CM_uint32 0.0 4.294967295E+9 /end CHARACTERISTIC
/begin CHARACTERISTIC WM_MaskPOilOvEnaCond_P "Oil Pressure Over Global Enable Condition Parameter" VALUE 0x4005081C /* @ECU_Address@WM_MaskPOilOvEnaCond_P@ */ Scalar_ULONG 0 EcuIntgdSwGend_CM_uint32 0.0 4.294967295E+9 /end CHARACTERISTIC
/begin CHARACTERISTIC WM_MaskPOilUndEnaCond_P "Oil Pressure Under Global Enable Condition Parameter" VALUE 0x40050820 /* @ECU_Address@WM_MaskPOilUndEnaCond_P@ */ Scalar_ULONG 0 EcuIntgdSwGend_CM_uint32 0.0 4.294967295E+9 /end CHARACTERISTIC
/begin CHARACTERISTIC WM_MaskPRailOvEnaCond_P "Rail Pressure Over Global Enable Condition Parameter" VALUE 0x40050824 /* @ECU_Address@WM_MaskPRailOvEnaCond_P@ */ Scalar_ULONG 0 EcuIntgdSwGend_CM_uint32 0.0 4.294967295E+9 /end CHARACTERISTIC
/begin CHARACTERISTIC WM_MaskPRailUndEnaCond_P "Rail Pressure Under Global Enable Condition Parameter" VALUE 0x40050828 /* @ECU_Address@WM_MaskPRailUndEnaCond_P@ */ Scalar_ULONG 0 EcuIntgdSwGend_CM_uint32 0.0 4.294967295E+9 /end CHARACTERISTIC
/begin CHARACTERISTIC WM_MaskRTNForErrComb1_P "Return To Normal Mask for Error Combo 1 Parameter" VALUE 0x40050838 /* @ECU_Address@WM_MaskRTNForErrComb1_P@ */ Scalar_ULONG 0 EcuIntgdSwGend_CM_uint32 0.0 4.294967295E+9 /end CHARACTERISTIC
/begin CHARACTERISTIC WM_MaskRTNForErrComb2_P "Return To Normal Mask for Error Combo 2 Parameter" VALUE 0x4005083C /* @ECU_Address@WM_MaskRTNForErrComb2_P@ */ Scalar_ULONG 0 EcuIntgdSwGend_CM_uint32 0.0 4.294967295E+9 /end CHARACTERISTIC
/begin CHARACTERISTIC WM_MaskRTNForErrComb3_P "Return To Normal Mask for Error Combo 3 Parameter" VALUE 0x40050840 /* @ECU_Address@WM_MaskRTNForErrComb3_P@ */ Scalar_ULONG 0 EcuIntgdSwGend_CM_uint32 0.0 4.294967295E+9 /end CHARACTERISTIC
/begin CHARACTERISTIC WM_MaskRTNForErrComb4_P "Return To Normal Mask for Error Combo 4 Parameter" VALUE 0x40050844 /* @ECU_Address@WM_MaskRTNForErrComb4_P@ */ Scalar_ULONG 0 EcuIntgdSwGend_CM_uint32 0.0 4.294967295E+9 /end CHARACTERISTIC
/begin CHARACTERISTIC WM_MaskRTNForErrComb5_P "Return To Normal Mask for Error Combo 5 Parameter" VALUE 0x40050848 /* @ECU_Address@WM_MaskRTNForErrComb5_P@ */ Scalar_ULONG 0 EcuIntgdSwGend_CM_uint32 0.0 4.294967295E+9 /end CHARACTERISTIC
/begin CHARACTERISTIC WM_MaskRTNForErrPAirBoostUnd_P "Return To Normal Mask for Air Boost Pressure Under Parameter" VALUE 0x40050858 /* @ECU_Address@WM_MaskRTNForErrPAirBoostUnd_P@ */ Scalar_ULONG 0 EcuIntgdSwGend_CM_uint32 0.0 4.294967295E+9 /end CHARACTERISTIC
/begin CHARACTERISTIC WM_MaskRTNForErrPAmbAirOv_P "Return To Normal Mask for Ambient Air Pressure Over Parameter" VALUE 0x4005085C /* @ECU_Address@WM_MaskRTNForErrPAmbAirOv_P@ */ Scalar_ULONG 0 EcuIntgdSwGend_CM_uint32 0.0 4.294967295E+9 /end CHARACTERISTIC
/begin CHARACTERISTIC WM_MaskRTNForErrPAmbAirUnd_P "Return To Normal Mask for Ambient Air Pressure Under Parameter" VALUE 0x40050860 /* @ECU_Address@WM_MaskRTNForErrPAmbAirUnd_P@ */ Scalar_ULONG 0 EcuIntgdSwGend_CM_uint32 0.0 4.294967295E+9 /end CHARACTERISTIC
/begin CHARACTERISTIC WM_MaskRTNForErrPFuOv_P "Return To Normal Mask for Fuel Pressure Over Parameter" VALUE 0x40050864 /* @ECU_Address@WM_MaskRTNForErrPFuOv_P@ */ Scalar_ULONG 0 EcuIntgdSwGend_CM_uint32 0.0 4.294967295E+9 /end CHARACTERISTIC
/begin CHARACTERISTIC WM_MaskRTNForErrPFuUnd_P "Return To Normal Mask for Fuel Pressure Under Parameter" VALUE 0x40050868 /* @ECU_Address@WM_MaskRTNForErrPFuUnd_P@ */ Scalar_ULONG 0 EcuIntgdSwGend_CM_uint32 0.0 4.294967295E+9 /end CHARACTERISTIC
/begin CHARACTERISTIC WM_MaskRTNForErrPOilOv_P "Return To Normal Mask for Oil Pressure Over Parameter" VALUE 0x4005086C /* @ECU_Address@WM_MaskRTNForErrPOilOv_P@ */ Scalar_ULONG 0 EcuIntgdSwGend_CM_uint32 0.0 4.294967295E+9 /end CHARACTERISTIC
/begin CHARACTERISTIC WM_MaskRTNForErrPOilUnd_P "Return To Normal Mask for Oil Pressure Under Parameter" VALUE 0x40050870 /* @ECU_Address@WM_MaskRTNForErrPOilUnd_P@ */ Scalar_ULONG 0 EcuIntgdSwGend_CM_uint32 0.0 4.294967295E+9 /end CHARACTERISTIC
/begin CHARACTERISTIC WM_MaskRTNForErrPRailOv_P "Return To Normal Mask for Rail Pressure Over Parameter" VALUE 0x40050874 /* @ECU_Address@WM_MaskRTNForErrPRailOv_P@ */ Scalar_ULONG 0 EcuIntgdSwGend_CM_uint32 0.0 4.294967295E+9 /end CHARACTERISTIC
/begin CHARACTERISTIC WM_MaskRTNForErrPRailUnd_P "Return To Normal Mask for Rail Pressure Under Parameter" VALUE 0x40050878 /* @ECU_Address@WM_MaskRTNForErrPRailUnd_P@ */ Scalar_ULONG 0 EcuIntgdSwGend_CM_uint32 0.0 4.294967295E+9 /end CHARACTERISTIC
/begin CHARACTERISTIC WM_MaskRTNForErrTAirBoostOv_P "Return To Normal Mask for Air Boost Temperature Over Parameter" VALUE 0x4005087C /* @ECU_Address@WM_MaskRTNForErrTAirBoostOv_P@ */ Scalar_ULONG 0 EcuIntgdSwGend_CM_uint32 0.0 4.294967295E+9 /end CHARACTERISTIC
/begin CHARACTERISTIC WM_MaskRTNForErrTAirBoostUnd_P "Return To Normal Mask for Air Boost Temperature Under Parameter" VALUE 0x40050880 /* @ECU_Address@WM_MaskRTNForErrTAirBoostUnd_P@ */ Scalar_ULONG 0 EcuIntgdSwGend_CM_uint32 0.0 4.294967295E+9 /end CHARACTERISTIC
/begin CHARACTERISTIC WM_MaskRTNForErrTAmbAirOv_P "Return To Normal Mask for Ambient Air Temperature Over Parameter" VALUE 0x40050884 /* @ECU_Address@WM_MaskRTNForErrTAmbAirOv_P@ */ Scalar_ULONG 0 EcuIntgdSwGend_CM_uint32 0.0 4.294967295E+9 /end CHARACTERISTIC
/begin CHARACTERISTIC WM_MaskRTNForErrTAmbAirUnd_P "Return To Normal Mask for Ambient Air Temperature Under Parameter" VALUE 0x40050888 /* @ECU_Address@WM_MaskRTNForErrTAmbAirUnd_P@ */ Scalar_ULONG 0 EcuIntgdSwGend_CM_uint32 0.0 4.294967295E+9 /end CHARACTERISTIC
/begin CHARACTERISTIC WM_MaskRTNForErrTCooltOv_P "Return To Normal Mask for Coolant Temperature Over Parameter" VALUE 0x4005088C /* @ECU_Address@WM_MaskRTNForErrTCooltOv_P@ */ Scalar_ULONG 0 EcuIntgdSwGend_CM_uint32 0.0 4.294967295E+9 /end CHARACTERISTIC
/begin CHARACTERISTIC WM_MaskRTNForErrTCooltUnd_P "Return To Normal Mask for Coolant Temperature Under Parameter" VALUE 0x40050890 /* @ECU_Address@WM_MaskRTNForErrTCooltUnd_P@ */ Scalar_ULONG 0 EcuIntgdSwGend_CM_uint32 0.0 4.294967295E+9 /end CHARACTERISTIC
/begin CHARACTERISTIC WM_MaskRTNForErrTEcu_P "Return To Normal Mask for ECU Temperature Parameter" VALUE 0x40050894 /* @ECU_Address@WM_MaskRTNForErrTEcu_P@ */ Scalar_ULONG 0 EcuIntgdSwGend_CM_uint32 0.0 4.294967295E+9 /end CHARACTERISTIC
/begin CHARACTERISTIC WM_MaskRTNForErrTFuOv_P "Return To Normal Mask for Fuel Temperature Over Parameter" VALUE 0x40050898 /* @ECU_Address@WM_MaskRTNForErrTFuOv_P@ */ Scalar_ULONG 0 EcuIntgdSwGend_CM_uint32 0.0 4.294967295E+9 /end CHARACTERISTIC
/begin CHARACTERISTIC WM_MaskRTNForErrTOilOv_P "Return To Normal Mask for Fuel Temperature Under Parameter" VALUE 0x4005089C /* @ECU_Address@WM_MaskRTNForErrTOilOv_P@ */ Scalar_ULONG 0 EcuIntgdSwGend_CM_uint32 0.0 4.294967295E+9 /end CHARACTERISTIC
/begin CHARACTERISTIC WM_MaskRTNForErrTOilUnd_P "Return To Normal Mask for Oil Temperature Under Parameter" VALUE 0x400508A0 /* @ECU_Address@WM_MaskRTNForErrTOilUnd_P@ */ Scalar_ULONG 0 EcuIntgdSwGend_CM_uint32 0.0 4.294967295E+9 /end CHARACTERISTIC
/begin CHARACTERISTIC WM_MaskRctnForErrComb1_P "Mask Reaction for Error Combo 1 Parameter" VALUE 0x400508C4 /* @ECU_Address@WM_MaskRctnForErrComb1_P@ */ Scalar_ULONG 0 EcuIntgdSwGend_CM_uint32 0.0 4.294967295E+9 /end CHARACTERISTIC
/begin CHARACTERISTIC WM_MaskRctnForErrComb2_P "Mask Reaction for Error Combo 2 Parameter" VALUE 0x400508C8 /* @ECU_Address@WM_MaskRctnForErrComb2_P@ */ Scalar_ULONG 0 EcuIntgdSwGend_CM_uint32 0.0 4.294967295E+9 /end CHARACTERISTIC
/begin CHARACTERISTIC WM_MaskRctnForErrComb3_P "Mask Reaction for Error Combo 3 Parameter" VALUE 0x400508CC /* @ECU_Address@WM_MaskRctnForErrComb3_P@ */ Scalar_ULONG 0 EcuIntgdSwGend_CM_uint32 0.0 4.294967295E+9 /end CHARACTERISTIC
/begin CHARACTERISTIC WM_MaskRctnForErrComb4_P "Mask Reaction for Error Combo 4 Parameter" VALUE 0x400508D0 /* @ECU_Address@WM_MaskRctnForErrComb4_P@ */ Scalar_ULONG 0 EcuIntgdSwGend_CM_uint32 0.0 4.294967295E+9 /end CHARACTERISTIC
/begin CHARACTERISTIC WM_MaskRctnForErrComb5_P "Mask Reaction for Error Combo 5 Parameter" VALUE 0x400508D4 /* @ECU_Address@WM_MaskRctnForErrComb5_P@ */ Scalar_ULONG 0 EcuIntgdSwGend_CM_uint32 0.0 4.294967295E+9 /end CHARACTERISTIC
/begin CHARACTERISTIC WM_MaskRctnForPAirBoostUndLvl1Err_P "Mask Reaction for Air Boost Pressure Under Level 1 Error Parameter" VALUE 0x400508F4 /* @ECU_Address@WM_MaskRctnForPAirBoostUndLvl1Err_P@ */ Scalar_ULONG 0 EcuIntgdSwGend_CM_uint32 0.0 4.294967295E+9 /end CHARACTERISTIC
/begin CHARACTERISTIC WM_MaskRctnForPAirBoostUndLvl2Err_P "Mask Reaction for Air Boost Pressure Under Level 2 Error Parameter" VALUE 0x400508F8 /* @ECU_Address@WM_MaskRctnForPAirBoostUndLvl2Err_P@ */ Scalar_ULONG 0 EcuIntgdSwGend_CM_uint32 0.0 4.294967295E+9 /end CHARACTERISTIC
/begin CHARACTERISTIC WM_MaskRctnForPAirBoostUndLvl3Err_P "Mask Reaction for Air Boost Pressure Under Level 3 Error Parameter" VALUE 0x400508FC /* @ECU_Address@WM_MaskRctnForPAirBoostUndLvl3Err_P@ */ Scalar_ULONG 0 EcuIntgdSwGend_CM_uint32 0.0 4.294967295E+9 /end CHARACTERISTIC
/begin CHARACTERISTIC WM_MaskRctnForPAmbAirOvLvl1Err_P "Mask Reaction for Ambient Air Pressure Over Level 1 Error Parameter" VALUE 0x40050900 /* @ECU_Address@WM_MaskRctnForPAmbAirOvLvl1Err_P@ */ Scalar_ULONG 0 EcuIntgdSwGend_CM_uint32 0.0 4.294967295E+9 /end CHARACTERISTIC
/begin CHARACTERISTIC WM_MaskRctnForPAmbAirOvLvl2Err_P "Mask Reaction for Ambient Air Pressure Over Level 2 Error Parameter" VALUE 0x40050904 /* @ECU_Address@WM_MaskRctnForPAmbAirOvLvl2Err_P@ */ Scalar_ULONG 0 EcuIntgdSwGend_CM_uint32 0.0 4.294967295E+9 /end CHARACTERISTIC
/begin CHARACTERISTIC WM_MaskRctnForPAmbAirOvLvl3Err_P "Mask Reaction for Ambient Air Pressure Over Level 3 Error Parameter" VALUE 0x40050908 /* @ECU_Address@WM_MaskRctnForPAmbAirOvLvl3Err_P@ */ Scalar_ULONG 0 EcuIntgdSwGend_CM_uint32 0.0 4.294967295E+9 /end CHARACTERISTIC
/begin CHARACTERISTIC WM_MaskRctnForPAmbAirUndLvl1Err_P "Mask Reaction for Ambient Air Pressure Under Level 1 Error Parameter" VALUE 0x4005090C /* @ECU_Address@WM_MaskRctnForPAmbAirUndLvl1Err_P@ */ Scalar_ULONG 0 EcuIntgdSwGend_CM_uint32 0.0 4.294967295E+9 /end CHARACTERISTIC
/begin CHARACTERISTIC WM_MaskRctnForPAmbAirUndLvl2Err_P "Mask Reaction for Ambient Air Pressure Under Level 2 Error Parameter" VALUE 0x40050910 /* @ECU_Address@WM_MaskRctnForPAmbAirUndLvl2Err_P@ */ Scalar_ULONG 0 EcuIntgdSwGend_CM_uint32 0.0 4.294967295E+9 /end CHARACTERISTIC
/begin CHARACTERISTIC WM_MaskRctnForPAmbAirUndLvl3Err_P "Mask Reaction for Ambient Air Pressure Under Level 3 Error Parameter" VALUE 0x40050914 /* @ECU_Address@WM_MaskRctnForPAmbAirUndLvl3Err_P@ */ Scalar_ULONG 0 EcuIntgdSwGend_CM_uint32 0.0 4.294967295E+9 /end CHARACTERISTIC
/begin CHARACTERISTIC WM_MaskRctnForPFuOvLvl1Err_P "Mask Reaction for Fuel Pressure Over Level 1 Error Parameter" VALUE 0x40050918 /* @ECU_Address@WM_MaskRctnForPFuOvLvl1Err_P@ */ Scalar_ULONG 0 EcuIntgdSwGend_CM_uint32 0.0 4.294967295E+9 /end CHARACTERISTIC
/begin CHARACTERISTIC WM_MaskRctnForPFuOvLvl2Err_P "Mask Reaction for Fuel Pressure Over Level 2 Error Parameter" VALUE 0x4005091C /* @ECU_Address@WM_MaskRctnForPFuOvLvl2Err_P@ */ Scalar_ULONG 0 EcuIntgdSwGend_CM_uint32 0.0 4.294967295E+9 /end CHARACTERISTIC
/begin CHARACTERISTIC WM_MaskRctnForPFuOvLvl3Err_P "Mask Reaction for Fuel Pressure Over Level 3 Error Parameter" VALUE 0x40050920 /* @ECU_Address@WM_MaskRctnForPFuOvLvl3Err_P@ */ Scalar_ULONG 0 EcuIntgdSwGend_CM_uint32 0.0 4.294967295E+9 /end CHARACTERISTIC
/begin CHARACTERISTIC WM_MaskRctnForPFuUndLvl1Err_P "Mask Reaction for Fuel Pressure Under Level 1 Error Parameter" VALUE 0x40050924 /* @ECU_Address@WM_MaskRctnForPFuUndLvl1Err_P@ */ Scalar_ULONG 0 EcuIntgdSwGend_CM_uint32 0.0 4.294967295E+9 /end CHARACTERISTIC
/begin CHARACTERISTIC WM_MaskRctnForPFuUndLvl2Err_P "Mask Reaction for Fuel Pressure Under Level 2 Error Parameter" VALUE 0x40050928 /* @ECU_Address@WM_MaskRctnForPFuUndLvl2Err_P@ */ Scalar_ULONG 0 EcuIntgdSwGend_CM_uint32 0.0 4.294967295E+9 /end CHARACTERISTIC
/begin CHARACTERISTIC WM_MaskRctnForPFuUndLvl3Err_P "Mask Reaction for Fuel Pressure Under Level 3 Error Parameter" VALUE 0x4005092C /* @ECU_Address@WM_MaskRctnForPFuUndLvl3Err_P@ */ Scalar_ULONG 0 EcuIntgdSwGend_CM_uint32 0.0 4.294967295E+9 /end CHARACTERISTIC
/begin CHARACTERISTIC WM_MaskRctnForPOilOvLvl1Err_P "Mask Reaction for Oil Pressure Over Level 1 Error Parameter" VALUE 0x40050930 /* @ECU_Address@WM_MaskRctnForPOilOvLvl1Err_P@ */ Scalar_ULONG 0 EcuIntgdSwGend_CM_uint32 0.0 4.294967295E+9 /end CHARACTERISTIC
/begin CHARACTERISTIC WM_MaskRctnForPOilOvLvl2Err_P "Mask Reaction for Oil Pressure Over Level 2 Error Parameter" VALUE 0x40050934 /* @ECU_Address@WM_MaskRctnForPOilOvLvl2Err_P@ */ Scalar_ULONG 0 EcuIntgdSwGend_CM_uint32 0.0 4.294967295E+9 /end CHARACTERISTIC
/begin CHARACTERISTIC WM_MaskRctnForPOilOvLvl3Err_P "Mask Reaction for Oil Pressure Over Level 3 Error Parameter" VALUE 0x40050938 /* @ECU_Address@WM_MaskRctnForPOilOvLvl3Err_P@ */ Scalar_ULONG 0 EcuIntgdSwGend_CM_uint32 0.0 4.294967295E+9 /end CHARACTERISTIC
/begin CHARACTERISTIC WM_MaskRctnForPOilUndLvl1Err_P "Mask Reaction for Oil Pressure Under Level 1 Error Parameter" VALUE 0x4005093C /* @ECU_Address@WM_MaskRctnForPOilUndLvl1Err_P@ */ Scalar_ULONG 0 EcuIntgdSwGend_CM_uint32 0.0 4.294967295E+9 /end CHARACTERISTIC
/begin CHARACTERISTIC WM_MaskRctnForPOilUndLvl2Err_P "Mask Reaction for Oil Pressure Under Level 2 Error Parameter" VALUE 0x40050940 /* @ECU_Address@WM_MaskRctnForPOilUndLvl2Err_P@ */ Scalar_ULONG 0 EcuIntgdSwGend_CM_uint32 0.0 4.294967295E+9 /end CHARACTERISTIC
/begin CHARACTERISTIC WM_MaskRctnForPOilUndLvl3Err_P "Mask Reaction for Oil Pressure Under Level 3 Error Parameter" VALUE 0x40050944 /* @ECU_Address@WM_MaskRctnForPOilUndLvl3Err_P@ */ Scalar_ULONG 0 EcuIntgdSwGend_CM_uint32 0.0 4.294967295E+9 /end CHARACTERISTIC
/begin CHARACTERISTIC WM_MaskRctnForPRailOvLvl1Err_P "Mask Reaction for Rail Pressure Over Level 1 Error Parameter" VALUE 0x4005094C /* @ECU_Address@WM_MaskRctnForPRailOvLvl1Err_P@ */ Scalar_ULONG 0 EcuIntgdSwGend_CM_uint32 0.0 4.294967295E+9 /end CHARACTERISTIC
/begin CHARACTERISTIC WM_MaskRctnForPRailOvLvl2Err_P "Mask Reaction for Rail Pressure Over Level 2 Error Parameter" VALUE 0x40050950 /* @ECU_Address@WM_MaskRctnForPRailOvLvl2Err_P@ */ Scalar_ULONG 0 EcuIntgdSwGend_CM_uint32 0.0 4.294967295E+9 /end CHARACTERISTIC
/begin CHARACTERISTIC WM_MaskRctnForPRailOvLvl3Err_P "Mask Reaction for Rail Pressure Over Level 3 Error Parameter" VALUE 0x40050954 /* @ECU_Address@WM_MaskRctnForPRailOvLvl3Err_P@ */ Scalar_ULONG 0 EcuIntgdSwGend_CM_uint32 0.0 4.294967295E+9 /end CHARACTERISTIC
/begin CHARACTERISTIC WM_MaskRctnForPRailUndLvl1Err_P "Mask Reaction for Rail Pressure Under Level 1 Error Parameter" VALUE 0x40050958 /* @ECU_Address@WM_MaskRctnForPRailUndLvl1Err_P@ */ Scalar_ULONG 0 EcuIntgdSwGend_CM_uint32 0.0 4.294967295E+9 /end CHARACTERISTIC
/begin CHARACTERISTIC WM_MaskRctnForPRailUndLvl2Err_P "Mask Reaction for Rail Pressure Under Level 2 Error Parameter" VALUE 0x4005095C /* @ECU_Address@WM_MaskRctnForPRailUndLvl2Err_P@ */ Scalar_ULONG 0 EcuIntgdSwGend_CM_uint32 0.0 4.294967295E+9 /end CHARACTERISTIC
/begin CHARACTERISTIC WM_MaskRctnForPRailUndLvl3Err_P "Mask Reaction for Rail Pressure Under Level 3 Error Parameter" VALUE 0x40050960 /* @ECU_Address@WM_MaskRctnForPRailUndLvl3Err_P@ */ Scalar_ULONG 0 EcuIntgdSwGend_CM_uint32 0.0 4.294967295E+9 /end CHARACTERISTIC
/begin CHARACTERISTIC WM_MaskRctnForTAirBoostOvLvl1Err_P "Mask Reaction for Air Boost Temperature Over Level 1 Error Parameter" VALUE 0x40050964 /* @ECU_Address@WM_MaskRctnForTAirBoostOvLvl1Err_P@ */ Scalar_ULONG 0 EcuIntgdSwGend_CM_uint32 0.0 4.294967295E+9 /end CHARACTERISTIC
/begin CHARACTERISTIC WM_MaskRctnForTAirBoostOvLvl2Err_P "Mask Reaction for Air Boost Temperature Over Level 2 Error Parameter" VALUE 0x40050968 /* @ECU_Address@WM_MaskRctnForTAirBoostOvLvl2Err_P@ */ Scalar_ULONG 0 EcuIntgdSwGend_CM_uint32 0.0 4.294967295E+9 /end CHARACTERISTIC
/begin CHARACTERISTIC WM_MaskRctnForTAirBoostOvLvl3Err_P "Mask Reaction for Air Boost Temperature Over Level 3 Error Parameter" VALUE 0x4005096C /* @ECU_Address@WM_MaskRctnForTAirBoostOvLvl3Err_P@ */ Scalar_ULONG 0 EcuIntgdSwGend_CM_uint32 0.0 4.294967295E+9 /end CHARACTERISTIC
/begin CHARACTERISTIC WM_MaskRctnForTAirBoostUndLvl1Err_P "Mask Reaction for Air Boost Temperature Under Level 1 Error Parameter" VALUE 0x40050970 /* @ECU_Address@WM_MaskRctnForTAirBoostUndLvl1Err_P@ */ Scalar_ULONG 0 EcuIntgdSwGend_CM_uint32 0.0 4.294967295E+9 /end CHARACTERISTIC
/begin CHARACTERISTIC WM_MaskRctnForTAirBoostUndLvl2Err_P "Mask Reaction for Air Boost Temperature Under Level 2 Error Parameter" VALUE 0x40050974 /* @ECU_Address@WM_MaskRctnForTAirBoostUndLvl2Err_P@ */ Scalar_ULONG 0 EcuIntgdSwGend_CM_uint32 0.0 4.294967295E+9 /end CHARACTERISTIC
/begin CHARACTERISTIC WM_MaskRctnForTAirBoostUndLvl3Err_P "Mask Reaction for Air Boost Temperature Under Level 3 Error Parameter" VALUE 0x40050978 /* @ECU_Address@WM_MaskRctnForTAirBoostUndLvl3Err_P@ */ Scalar_ULONG 0 EcuIntgdSwGend_CM_uint32 0.0 4.294967295E+9 /end CHARACTERISTIC
/begin CHARACTERISTIC WM_MaskRctnForTAmbAirOvLvl1Err_P "Mask Reaction for Ambient Air Temperature Over Level 1 Error Parameter" VALUE 0x4005097C /* @ECU_Address@WM_MaskRctnForTAmbAirOvLvl1Err_P@ */ Scalar_ULONG 0 EcuIntgdSwGend_CM_uint32 0.0 4.294967295E+9 /end CHARACTERISTIC
/begin CHARACTERISTIC WM_MaskRctnForTAmbAirOvLvl2Err_P "Mask Reaction for Ambient Air Temperature Over Level 2 Error Parameter" VALUE 0x40050980 /* @ECU_Address@WM_MaskRctnForTAmbAirOvLvl2Err_P@ */ Scalar_ULONG 0 EcuIntgdSwGend_CM_uint32 0.0 4.294967295E+9 /end CHARACTERISTIC
/begin CHARACTERISTIC WM_MaskRctnForTAmbAirOvLvl3Err_P "Mask Reaction for Ambient Air Temperature Over Level 3 Error Parameter" VALUE 0x40050984 /* @ECU_Address@WM_MaskRctnForTAmbAirOvLvl3Err_P@ */ Scalar_ULONG 0 EcuIntgdSwGend_CM_uint32 0.0 4.294967295E+9 /end CHARACTERISTIC
/begin CHARACTERISTIC WM_MaskRctnForTAmbAirUndLvl1Err_P "Mask Reaction for Ambient Air Temperature Under Level 1 Error Parameter" VALUE 0x40050988 /* @ECU_Address@WM_MaskRctnForTAmbAirUndLvl1Err_P@ */ Scalar_ULONG 0 EcuIntgdSwGend_CM_uint32 0.0 4.294967295E+9 /end CHARACTERISTIC
/begin CHARACTERISTIC WM_MaskRctnForTAmbAirUndLvl2Err_P "Mask Reaction for Ambient Air Temperature Under Level 2 Error Parameter" VALUE 0x4005098C /* @ECU_Address@WM_MaskRctnForTAmbAirUndLvl2Err_P@ */ Scalar_ULONG 0 EcuIntgdSwGend_CM_uint32 0.0 4.294967295E+9 /end CHARACTERISTIC
/begin CHARACTERISTIC WM_MaskRctnForTAmbAirUndLvl3Err_P "Mask Reaction for Ambient Air Temperature Under Level 3 Error Parameter" VALUE 0x40050990 /* @ECU_Address@WM_MaskRctnForTAmbAirUndLvl3Err_P@ */ Scalar_ULONG 0 EcuIntgdSwGend_CM_uint32 0.0 4.294967295E+9 /end CHARACTERISTIC
/begin CHARACTERISTIC WM_MaskRctnForTCooltOvLvl1Err_P "Mask Reaction for Coolant Temperature Over Level 1 Error Parameter" VALUE 0x40050994 /* @ECU_Address@WM_MaskRctnForTCooltOvLvl1Err_P@ */ Scalar_ULONG 0 EcuIntgdSwGend_CM_uint32 0.0 4.294967295E+9 /end CHARACTERISTIC
/begin CHARACTERISTIC WM_MaskRctnForTCooltOvLvl2Err_P "Mask Reaction for Coolant Temperature Over Level 2 Error Parameter" VALUE 0x40050998 /* @ECU_Address@WM_MaskRctnForTCooltOvLvl2Err_P@ */ Scalar_ULONG 0 EcuIntgdSwGend_CM_uint32 0.0 4.294967295E+9 /end CHARACTERISTIC
/begin CHARACTERISTIC WM_MaskRctnForTCooltOvLvl3Err_P "Mask Reaction for Coolant Temperature Over Level 3 Error Parameter" VALUE 0x4005099C /* @ECU_Address@WM_MaskRctnForTCooltOvLvl3Err_P@ */ Scalar_ULONG 0 EcuIntgdSwGend_CM_uint32 0.0 4.294967295E+9 /end CHARACTERISTIC
/begin CHARACTERISTIC WM_MaskRctnForTCooltUndLvl1Err_P "Mask Reaction for Coolant Temperature Under Level 1 Error Parameter" VALUE 0x400509A0 /* @ECU_Address@WM_MaskRctnForTCooltUndLvl1Err_P@ */ Scalar_ULONG 0 EcuIntgdSwGend_CM_uint32 0.0 4.294967295E+9 /end CHARACTERISTIC
/begin CHARACTERISTIC WM_MaskRctnForTCooltUndLvl2Err_P "Mask Reaction for Coolant Temperature Under Level 2 Error Parameter" VALUE 0x400509A4 /* @ECU_Address@WM_MaskRctnForTCooltUndLvl2Err_P@ */ Scalar_ULONG 0 EcuIntgdSwGend_CM_uint32 0.0 4.294967295E+9 /end CHARACTERISTIC
/begin CHARACTERISTIC WM_MaskRctnForTCooltUndLvl3Err_P "Mask Reaction for Coolant Temperature Under Level 3 Error Parameter" VALUE 0x400509A8 /* @ECU_Address@WM_MaskRctnForTCooltUndLvl3Err_P@ */ Scalar_ULONG 0 EcuIntgdSwGend_CM_uint32 0.0 4.294967295E+9 /end CHARACTERISTIC
/begin CHARACTERISTIC WM_MaskRctnForTEcuLvl1Err_P "Mask Reaction for ECU Temperature Level 1 Error Parameter" VALUE 0x400509AC /* @ECU_Address@WM_MaskRctnForTEcuLvl1Err_P@ */ Scalar_ULONG 0 EcuIntgdSwGend_CM_uint32 0.0 4.294967295E+9 /end CHARACTERISTIC
/begin CHARACTERISTIC WM_MaskRctnForTEcuLvl2Err_P "Mask Reaction for ECU Temperature Level 2 Error Parameter" VALUE 0x400509B0 /* @ECU_Address@WM_MaskRctnForTEcuLvl2Err_P@ */ Scalar_ULONG 0 EcuIntgdSwGend_CM_uint32 0.0 4.294967295E+9 /end CHARACTERISTIC
/begin CHARACTERISTIC WM_MaskRctnForTEcuLvl3Err_P "Mask Reaction for ECU Temperature Level 3 Error Parameter" VALUE 0x400509B4 /* @ECU_Address@WM_MaskRctnForTEcuLvl3Err_P@ */ Scalar_ULONG 0 EcuIntgdSwGend_CM_uint32 0.0 4.294967295E+9 /end CHARACTERISTIC
/begin CHARACTERISTIC WM_MaskRctnForTFuOvLvl1Err_P "Mask Reaction for Fuel Temperature Over Level 1 Error Parameter" VALUE 0x400509B8 /* @ECU_Address@WM_MaskRctnForTFuOvLvl1Err_P@ */ Scalar_ULONG 0 EcuIntgdSwGend_CM_uint32 0.0 4.294967295E+9 /end CHARACTERISTIC
/begin CHARACTERISTIC WM_MaskRctnForTFuOvLvl2Err_P "Mask Reaction for Fuel Temperature Over Level 2 Error Parameter" VALUE 0x400509BC /* @ECU_Address@WM_MaskRctnForTFuOvLvl2Err_P@ */ Scalar_ULONG 0 EcuIntgdSwGend_CM_uint32 0.0 4.294967295E+9 /end CHARACTERISTIC
/begin CHARACTERISTIC WM_MaskRctnForTFuOvLvl3Err_P "Mask Reaction for Fuel Temperature Over Level 3 Error Parameter" VALUE 0x400509C0 /* @ECU_Address@WM_MaskRctnForTFuOvLvl3Err_P@ */ Scalar_ULONG 0 EcuIntgdSwGend_CM_uint32 0.0 4.294967295E+9 /end CHARACTERISTIC
/begin CHARACTERISTIC WM_MaskRctnForTOilOvLvl1Err_P "Mask Reaction for Oil Temperature Over Level 1 Error Parameter" VALUE 0x400509C4 /* @ECU_Address@WM_MaskRctnForTOilOvLvl1Err_P@ */ Scalar_ULONG 0 EcuIntgdSwGend_CM_uint32 0.0 4.294967295E+9 /end CHARACTERISTIC
/begin CHARACTERISTIC WM_MaskRctnForTOilOvLvl2Err_P "Mask Reaction for Oil Temperature Over Level 2 Error Parameter" VALUE 0x400509C8 /* @ECU_Address@WM_MaskRctnForTOilOvLvl2Err_P@ */ Scalar_ULONG 0 EcuIntgdSwGend_CM_uint32 0.0 4.294967295E+9 /end CHARACTERISTIC
/begin CHARACTERISTIC WM_MaskRctnForTOilOvLvl3Err_P "Mask Reaction for Oil Temperature Over Level 3 Error Parameter" VALUE 0x400509CC /* @ECU_Address@WM_MaskRctnForTOilOvLvl3Err_P@ */ Scalar_ULONG 0 EcuIntgdSwGend_CM_uint32 0.0 4.294967295E+9 /end CHARACTERISTIC
/begin CHARACTERISTIC WM_MaskRctnForTOilUndLvl1Err_P "Mask Reaction for Oil Temperature Under Level 1 Error Parameter" VALUE 0x400509D0 /* @ECU_Address@WM_MaskRctnForTOilUndLvl1Err_P@ */ Scalar_ULONG 0 EcuIntgdSwGend_CM_uint32 0.0 4.294967295E+9 /end CHARACTERISTIC
/begin CHARACTERISTIC WM_MaskRctnForTOilUndLvl2Err_P "Mask Reaction for Oil Temperature Under Level 2 Error Parameter" VALUE 0x400509D4 /* @ECU_Address@WM_MaskRctnForTOilUndLvl2Err_P@ */ Scalar_ULONG 0 EcuIntgdSwGend_CM_uint32 0.0 4.294967295E+9 /end CHARACTERISTIC
/begin CHARACTERISTIC WM_MaskRctnForTOilUndLvl3Err_P "Mask Reaction for Oil Temperature Under Level 3 Error Parameter" VALUE 0x400509D8 /* @ECU_Address@WM_MaskRctnForTOilUndLvl3Err_P@ */ Scalar_ULONG 0 EcuIntgdSwGend_CM_uint32 0.0 4.294967295E+9 /end CHARACTERISTIC
/begin CHARACTERISTIC WM_MaskTAirBoostOvEnaCond_P "Air Boost Temperature Over Global Enable Condition Parameter" VALUE 0x400509FC /* @ECU_Address@WM_MaskTAirBoostOvEnaCond_P@ */ Scalar_ULONG 0 EcuIntgdSwGend_CM_uint32 0.0 4.294967295E+9 /end CHARACTERISTIC
/begin CHARACTERISTIC WM_MaskTAirBoostUndEnaCond_P "Air Boost Temperature Under Global Enable Condition Parameter" VALUE 0x40050A00 /* @ECU_Address@WM_MaskTAirBoostUndEnaCond_P@ */ Scalar_ULONG 0 EcuIntgdSwGend_CM_uint32 0.0 4.294967295E+9 /end CHARACTERISTIC
/begin CHARACTERISTIC WM_MaskTAmbAirOvEnaCond_P "Ambient Air Temperature Over Global Enable Condition Parameter" VALUE 0x40050A04 /* @ECU_Address@WM_MaskTAmbAirOvEnaCond_P@ */ Scalar_ULONG 0 EcuIntgdSwGend_CM_uint32 0.0 4.294967295E+9 /end CHARACTERISTIC
/begin CHARACTERISTIC WM_MaskTAmbAirUndEnaCond_P "Ambient Air Temperature Under Global Enable Condition Parameter" VALUE 0x40050A08 /* @ECU_Address@WM_MaskTAmbAirUndEnaCond_P@ */ Scalar_ULONG 0 EcuIntgdSwGend_CM_uint32 0.0 4.294967295E+9 /end CHARACTERISTIC
/begin CHARACTERISTIC WM_MaskTC1ErrComb1_P "Mask Error List 1 for Error Combo 1 Parameter" VALUE 0x40050A0C /* @ECU_Address@WM_MaskTC1ErrComb1_P@ */ Scalar_ULONG 0 EcuIntgdSwGend_CM_uint32 0.0 4.294967295E+9 /end CHARACTERISTIC
/begin CHARACTERISTIC WM_MaskTC1ErrComb2_P "Mask Error List 1 for Error Combo 2 Parameter" VALUE 0x40050A10 /* @ECU_Address@WM_MaskTC1ErrComb2_P@ */ Scalar_ULONG 0 EcuIntgdSwGend_CM_uint32 0.0 4.294967295E+9 /end CHARACTERISTIC
/begin CHARACTERISTIC WM_MaskTC1ErrComb3_P "Mask Error List 1 for Error Combo 3 Parameter" VALUE 0x40050A14 /* @ECU_Address@WM_MaskTC1ErrComb3_P@ */ Scalar_ULONG 0 EcuIntgdSwGend_CM_uint32 0.0 4.294967295E+9 /end CHARACTERISTIC
/begin CHARACTERISTIC WM_MaskTC1ErrComb4_P "Mask Error List 1 for Error Combo 4 Parameter" VALUE 0x40050A18 /* @ECU_Address@WM_MaskTC1ErrComb4_P@ */ Scalar_ULONG 0 EcuIntgdSwGend_CM_uint32 0.0 4.294967295E+9 /end CHARACTERISTIC
/begin CHARACTERISTIC WM_MaskTC1ErrComb5_P "Mask Error List 1 for Error Combo 5 Parameter" VALUE 0x40050A1C /* @ECU_Address@WM_MaskTC1ErrComb5_P@ */ Scalar_ULONG 0 EcuIntgdSwGend_CM_uint32 0.0 4.294967295E+9 /end CHARACTERISTIC
/begin CHARACTERISTIC WM_MaskTC1Ovv_P "Mask Error List 1 - Override Parameter" VALUE 0x40050A24 /* @ECU_Address@WM_MaskTC1Ovv_P@ */ Scalar_ULONG 0 EcuIntgdSwGend_CM_uint32 0.0 4.294967295E+9 /end CHARACTERISTIC
/begin CHARACTERISTIC WM_MaskTC2ErrComb1_P "Mask Error List 2 for Error Combo 1 Parameter" VALUE 0x40050A28 /* @ECU_Address@WM_MaskTC2ErrComb1_P@ */ Scalar_ULONG 0 EcuIntgdSwGend_CM_uint32 0.0 4.294967295E+9 /end CHARACTERISTIC
/begin CHARACTERISTIC WM_MaskTC2ErrComb2_P "Mask Error List 2 for Error Combo 2 Parameter" VALUE 0x40050A2C /* @ECU_Address@WM_MaskTC2ErrComb2_P@ */ Scalar_ULONG 0 EcuIntgdSwGend_CM_uint32 0.0 4.294967295E+9 /end CHARACTERISTIC
/begin CHARACTERISTIC WM_MaskTC2ErrComb3_P "Mask Error List 2 for Error Combo 3 Parameter" VALUE 0x40050A30 /* @ECU_Address@WM_MaskTC2ErrComb3_P@ */ Scalar_ULONG 0 EcuIntgdSwGend_CM_uint32 0.0 4.294967295E+9 /end CHARACTERISTIC
/begin CHARACTERISTIC WM_MaskTC2ErrComb4_P "Mask Error List 2 for Error Combo 4 Parameter" VALUE 0x40050A34 /* @ECU_Address@WM_MaskTC2ErrComb4_P@ */ Scalar_ULONG 0 EcuIntgdSwGend_CM_uint32 0.0 4.294967295E+9 /end CHARACTERISTIC
/begin CHARACTERISTIC WM_MaskTC2ErrComb5_P "Mask Error List 2 for Error Combo 5 Parameter" VALUE 0x40050A38 /* @ECU_Address@WM_MaskTC2ErrComb5_P@ */ Scalar_ULONG 0 EcuIntgdSwGend_CM_uint32 0.0 4.294967295E+9 /end CHARACTERISTIC
/begin CHARACTERISTIC WM_MaskTC2Ovv_P "Mask Error List 2 - Override Parameter" VALUE 0x40050A40 /* @ECU_Address@WM_MaskTC2Ovv_P@ */ Scalar_ULONG 0 EcuIntgdSwGend_CM_uint32 0.0 4.294967295E+9 /end CHARACTERISTIC
/begin CHARACTERISTIC WM_MaskTC3ErrComb1_P "Mask Error List 3 for Error Combo 1 Parameter" VALUE 0x40050A44 /* @ECU_Address@WM_MaskTC3ErrComb1_P@ */ Scalar_ULONG 0 EcuIntgdSwGend_CM_uint32 0.0 4.294967295E+9 /end CHARACTERISTIC
/begin CHARACTERISTIC WM_MaskTC3ErrComb2_P "Mask Error List 3 for Error Combo 2 Parameter" VALUE 0x40050A48 /* @ECU_Address@WM_MaskTC3ErrComb2_P@ */ Scalar_ULONG 0 EcuIntgdSwGend_CM_uint32 0.0 4.294967295E+9 /end CHARACTERISTIC
/begin CHARACTERISTIC WM_MaskTC3ErrComb3_P "Mask Error List 3 for Error Combo 3 Parameter" VALUE 0x40050A4C /* @ECU_Address@WM_MaskTC3ErrComb3_P@ */ Scalar_ULONG 0 EcuIntgdSwGend_CM_uint32 0.0 4.294967295E+9 /end CHARACTERISTIC
/begin CHARACTERISTIC WM_MaskTC3ErrComb4_P "Mask Error List 3 for Error Combo 4 Parameter" VALUE 0x40050A50 /* @ECU_Address@WM_MaskTC3ErrComb4_P@ */ Scalar_ULONG 0 EcuIntgdSwGend_CM_uint32 0.0 4.294967295E+9 /end CHARACTERISTIC
/begin CHARACTERISTIC WM_MaskTC3ErrComb5_P "Mask Error List 3 for Error Combo 5 Parameter" VALUE 0x40050A54 /* @ECU_Address@WM_MaskTC3ErrComb5_P@ */ Scalar_ULONG 0 EcuIntgdSwGend_CM_uint32 0.0 4.294967295E+9 /end CHARACTERISTIC
/begin CHARACTERISTIC WM_MaskTC3Ovv_P "Mask Error List 3 - Override Parameter" VALUE 0x40050A5C /* @ECU_Address@WM_MaskTC3Ovv_P@ */ Scalar_ULONG 0 EcuIntgdSwGend_CM_uint32 0.0 4.294967295E+9 /end CHARACTERISTIC
/begin CHARACTERISTIC WM_MaskTC4ErrComb1_P "Mask Error List 4 for Error Combo 1 Parameter" VALUE 0x40050A60 /* @ECU_Address@WM_MaskTC4ErrComb1_P@ */ Scalar_ULONG 0 EcuIntgdSwGend_CM_uint32 0.0 4.294967295E+9 /end CHARACTERISTIC
/begin CHARACTERISTIC WM_MaskTC4ErrComb2_P "Mask Error List 4 for Error Combo 2 Parameter" VALUE 0x40050A64 /* @ECU_Address@WM_MaskTC4ErrComb2_P@ */ Scalar_ULONG 0 EcuIntgdSwGend_CM_uint32 0.0 4.294967295E+9 /end CHARACTERISTIC
/begin CHARACTERISTIC WM_MaskTC4ErrComb3_P "Mask Error List 4 for Error Combo 3 Parameter" VALUE 0x40050A68 /* @ECU_Address@WM_MaskTC4ErrComb3_P@ */ Scalar_ULONG 0 EcuIntgdSwGend_CM_uint32 0.0 4.294967295E+9 /end CHARACTERISTIC
/begin CHARACTERISTIC WM_MaskTC4ErrComb4_P "Mask Error List 4 for Error Combo 4 Parameter" VALUE 0x40050A6C /* @ECU_Address@WM_MaskTC4ErrComb4_P@ */ Scalar_ULONG 0 EcuIntgdSwGend_CM_uint32 0.0 4.294967295E+9 /end CHARACTERISTIC
/begin CHARACTERISTIC WM_MaskTC4ErrComb5_P "Mask Error List 4 for Error Combo 5 Parameter" VALUE 0x40050A70 /* @ECU_Address@WM_MaskTC4ErrComb5_P@ */ Scalar_ULONG 0 EcuIntgdSwGend_CM_uint32 0.0 4.294967295E+9 /end CHARACTERISTIC
/begin CHARACTERISTIC WM_MaskTC4Ovv_P "Mask Error List 4 - Override Parameter" VALUE 0x40050A78 /* @ECU_Address@WM_MaskTC4Ovv_P@ */ Scalar_ULONG 0 EcuIntgdSwGend_CM_uint32 0.0 4.294967295E+9 /end CHARACTERISTIC
/begin CHARACTERISTIC WM_MaskTCooltOvEnaCond_P "Coolant Temperature Over Global Enable Condition Parameter" VALUE 0x40050A7C /* @ECU_Address@WM_MaskTCooltOvEnaCond_P@ */ Scalar_ULONG 0 EcuIntgdSwGend_CM_uint32 0.0 4.294967295E+9 /end CHARACTERISTIC
/begin CHARACTERISTIC WM_MaskTCooltUndEnaCond_P "Coolant Temperature Under Global Enable Condition Parameter" VALUE 0x40050A80 /* @ECU_Address@WM_MaskTCooltUndEnaCond_P@ */ Scalar_ULONG 0 EcuIntgdSwGend_CM_uint32 0.0 4.294967295E+9 /end CHARACTERISTIC
/begin CHARACTERISTIC WM_MaskTEcuEnaCond_P "ECU Temperature Global Enable Condition Parameter" VALUE 0x40050A84 /* @ECU_Address@WM_MaskTEcuEnaCond_P@ */ Scalar_ULONG 0 EcuIntgdSwGend_CM_uint32 0.0 4.294967295E+9 /end CHARACTERISTIC
/begin CHARACTERISTIC WM_MaskTFuOvEnaCond_P "Fuel Temperature Over Global Enable Condition Parameter" VALUE 0x40050A88 /* @ECU_Address@WM_MaskTFuOvEnaCond_P@ */ Scalar_ULONG 0 EcuIntgdSwGend_CM_uint32 0.0 4.294967295E+9 /end CHARACTERISTIC
/begin CHARACTERISTIC WM_MaskTOilOvEnaCond_P "Oil Temperature Under Global Enable Condition Parameter" VALUE 0x40050A8C /* @ECU_Address@WM_MaskTOilOvEnaCond_P@ */ Scalar_ULONG 0 EcuIntgdSwGend_CM_uint32 0.0 4.294967295E+9 /end CHARACTERISTIC
/begin CHARACTERISTIC WM_MaskTOilUndEnaCond_P "Oil Temperature Over Global Enable Condition Parameter" VALUE 0x40050A90 /* @ECU_Address@WM_MaskTOilUndEnaCond_P@ */ Scalar_ULONG 0 EcuIntgdSwGend_CM_uint32 0.0 4.294967295E+9 /end CHARACTERISTIC
/begin CHARACTERISTIC DTqC_AcvHardLimLtchOvs_P "Engine Speed Hard Limit Latch Activation Override Switch" VALUE 0x40040710 /* @ECU_Address@DTqC_AcvHardLimLtchOvs_P@ */ Scalar_BOOLEAN 0 EcuIntgdSwGend_CM_boolean 0.0 1.0 /end CHARACTERISTIC
/begin CHARACTERISTIC DTqC_AcvHardLimLtchOvv_P "Engine Speed Hard Limit Latch Activation Override Value" VALUE 0x40040714 /* @ECU_Address@DTqC_AcvHardLimLtchOvv_P@ */ Scalar_BOOLEAN 0 EcuIntgdSwGend_CM_boolean 0.0 1.0 /end CHARACTERISTIC
/begin CHARACTERISTIC DTqC_bAcvRateLimOvs_P "Rate Limiter Activation Override Switch" VALUE 0x40043FEC /* @ECU_Address@DTqC_bAcvRateLimOvs_P@ */ Scalar_BOOLEAN 0 EcuIntgdSwGend_CM_boolean 0.0 1.0 /end CHARACTERISTIC
/begin CHARACTERISTIC WM_MaskTC1Ovs_P "Mask Error List 1 - Override Switch" VALUE 0x40050A20 /* @ECU_Address@WM_MaskTC1Ovs_P@ */ Scalar_BOOLEAN 0 EcuIntgdSwGend_CM_boolean 0.0 1.0 /end CHARACTERISTIC
/begin CHARACTERISTIC WM_MaskTC2Ovs_P "Mask Error List 2 - Override Switch" VALUE 0x40050A3C /* @ECU_Address@WM_MaskTC2Ovs_P@ */ Scalar_BOOLEAN 0 EcuIntgdSwGend_CM_boolean 0.0 1.0 /end CHARACTERISTIC
/begin CHARACTERISTIC WM_MaskTC3Ovs_P "Mask Error List 3 - Override Switch" VALUE 0x40050A58 /* @ECU_Address@WM_MaskTC3Ovs_P@ */ Scalar_BOOLEAN 0 EcuIntgdSwGend_CM_boolean 0.0 1.0 /end CHARACTERISTIC
/begin CHARACTERISTIC WM_MaskTC4Ovs_P "Mask Error List 4 - Override Switch" VALUE 0x40050A74 /* @ECU_Address@WM_MaskTC4Ovs_P@ */ Scalar_BOOLEAN 0 EcuIntgdSwGend_CM_boolean 0.0 1.0 /end CHARACTERISTIC
/begin CHARACTERISTIC WM_bPRailHiMsgWarnOvs_P "Rail Pressure High Message - Override Switch" VALUE 0x40051260 /* @ECU_Address@WM_bPRailHiMsgWarnOvs_P@ */ Scalar_BOOLEAN 0 EcuIntgdSwGend_CM_boolean 0.0 1.0 /end CHARACTERISTIC
/begin CHARACTERISTIC WM_bPRailHiMsgWarnOvv_P "Rail Pressure High Message - Override Parameter" VALUE 0x40051264 /* @ECU_Address@WM_bPRailHiMsgWarnOvv_P@ */ Scalar_BOOLEAN 0 EcuIntgdSwGend_CM_boolean 0.0 1.0 /end CHARACTERISTIC
/begin CHARACTERISTIC WM_bPRailLoMsgWarnOvs_P "Rail Pressure Low Message - Override Switch" VALUE 0x40051268 /* @ECU_Address@WM_bPRailLoMsgWarnOvs_P@ */ Scalar_BOOLEAN 0 EcuIntgdSwGend_CM_boolean 0.0 1.0 /end CHARACTERISTIC
/begin CHARACTERISTIC WM_bPRailLoMsgWarnOvv_P "Rail Pressure Low Message - Override Parameter" VALUE 0x4005126C /* @ECU_Address@WM_bPRailLoMsgWarnOvv_P@ */ Scalar_BOOLEAN 0 EcuIntgdSwGend_CM_boolean 0.0 1.0 /end CHARACTERISTIC
/begin CHARACTERISTIC WM_bPRailNotCtldMsgWarnOvs_P "Rail Pressure Is Not Controlled Message - Override Switch" VALUE 0x40051270 /* @ECU_Address@WM_bPRailNotCtldMsgWarnOvs_P@ */ Scalar_BOOLEAN 0 EcuIntgdSwGend_CM_boolean 0.0 1.0 /end CHARACTERISTIC
/begin CHARACTERISTIC WM_bPRailNotCtldMsgWarnOvv_P "Rail Pressure Is Not Controlled Message - Override Parameter" VALUE 0x40051274 /* @ECU_Address@WM_bPRailNotCtldMsgWarnOvv_P@ */ Scalar_BOOLEAN 0 EcuIntgdSwGend_CM_boolean 0.0 1.0 /end CHARACTERISTIC
/begin CHARACTERISTIC WM_bPRailTooHiMsgWarnOvs_P "Rail Pressure Too High Message - Override Switch" VALUE 0x40051278 /* @ECU_Address@WM_bPRailTooHiMsgWarnOvs_P@ */ Scalar_BOOLEAN 0 EcuIntgdSwGend_CM_boolean 0.0 1.0 /end CHARACTERISTIC
/begin CHARACTERISTIC WM_bPRailTooHiMsgWarnOvv_P "Rail Pressure Too High Message - Override Parameter" VALUE 0x4005127C /* @ECU_Address@WM_bPRailTooHiMsgWarnOvv_P@ */ Scalar_BOOLEAN 0 EcuIntgdSwGend_CM_boolean 0.0 1.0 /end CHARACTERISTIC
/begin MEASUREMENT WM_MaskRctnForTAirBoostOvErr "Mask Reaction for Air Boost Temperature Over Error" ULONG EcuIntgdSwGend_CM_uint32 0 0 0.0 4.294967295E+9 ECU_ADDRESS 0x4000DFE0 /* @ECU_Address@WM_MaskRctnForTAirBoostOvErr@ */ /end MEASUREMENT
/begin MEASUREMENT WM_MaskRctnForTAirBoostUndErr "Mask Reaction for Air Boost Temperature Under Error" ULONG EcuIntgdSwGend_CM_uint32 0 0 0.0 4.294967295E+9 ECU_ADDRESS 0x4000DAB0 /* @ECU_Address@WM_MaskRctnForTAirBoostUndErr@ */ /end MEASUREMENT
/begin MEASUREMENT WM_MaskRctnForTAmbAirOvErr "Mask Reaction for Ambient Air Temperature Over Error" ULONG EcuIntgdSwGend_CM_uint32 0 0 0.0 4.294967295E+9 ECU_ADDRESS 0x4000E014 /* @ECU_Address@WM_MaskRctnForTAmbAirOvErr@ */ /end MEASUREMENT
/begin MEASUREMENT WM_MaskRctnForTAmbAirUndErr "Mask Reaction for Ambient Air Temperature Under Error" ULONG EcuIntgdSwGend_CM_uint32 0 0 0.0 4.294967295E+9 ECU_ADDRESS 0x4000D730 /* @ECU_Address@WM_MaskRctnForTAmbAirUndErr@ */ /end MEASUREMENT
/begin MEASUREMENT WM_MaskRctnForTCooltOvErr "Mask Reaction for Coolant Temperature Over Error" ULONG EcuIntgdSwGend_CM_uint32 0 0 0.0 4.294967295E+9 ECU_ADDRESS 0x4000DE94 /* @ECU_Address@WM_MaskRctnForTCooltOvErr@ */ /end MEASUREMENT
/begin MEASUREMENT WM_MaskRctnForTCooltUndErr "Mask Reaction for Coolant Temperature Under Error" ULONG EcuIntgdSwGend_CM_uint32 0 0 0.0 4.294967295E+9 ECU_ADDRESS 0x4000D808 /* @ECU_Address@WM_MaskRctnForTCooltUndErr@ */ /end MEASUREMENT
/begin MEASUREMENT WM_MaskRctnForTEcuErr "Mask Reaction for ECU Temperature Error" ULONG EcuIntgdSwGend_CM_uint32 0 0 0.0 4.294967295E+9 ECU_ADDRESS 0x4000E630 /* @ECU_Address@WM_MaskRctnForTEcuErr@ */ /end MEASUREMENT
/begin MEASUREMENT WM_MaskRctnForTFuOvErr "Mask Reaction for Fuel Temperature Over Error" ULONG EcuIntgdSwGend_CM_uint32 0 0 0.0 4.294967295E+9 ECU_ADDRESS 0x4000DE40 /* @ECU_Address@WM_MaskRctnForTFuOvErr@ */ /end MEASUREMENT
/begin MEASUREMENT WM_MaskRctnForTOilOvErr "Mask Reaction for Oil Temperature Over Error" ULONG EcuIntgdSwGend_CM_uint32 0 0 0.0 4.294967295E+9 ECU_ADDRESS 0x4000E0B4 /* @ECU_Address@WM_MaskRctnForTOilOvErr@ */ /end MEASUREMENT
/begin MEASUREMENT WM_MaskRctnForTOilUndErr "Mask Reaction for Oil Temperature Under Error" ULONG EcuIntgdSwGend_CM_uint32 0 0 0.0 4.294967295E+9 ECU_ADDRESS 0x4000E120 /* @ECU_Address@WM_MaskRctnForTOilUndErr@ */ /end MEASUREMENT
/begin MEASUREMENT WM_MaskTC4 "Mask Error List 4 " ULONG EcuIntgdSwGend_CM_uint32 0 0 0.0 4.294967295E+9 ECU_ADDRESS 0x4000E628 /* @ECU_Address@WM_MaskTC4@ */ /end MEASUREMENT
/begin MEASUREMENT WM_MaskTC3 "Mask Error List 3" ULONG EcuIntgdSwGend_CM_uint32 0 0 0.0 4.294967295E+9 ECU_ADDRESS 0x4000E294 /* @ECU_Address@WM_MaskTC3@ */ /end MEASUREMENT
/begin MEASUREMENT WM_MaskTC2 "Mask Error List 2" ULONG EcuIntgdSwGend_CM_uint32 0 0 0.0 4.294967295E+9 ECU_ADDRESS 0x4000D864 /* @ECU_Address@WM_MaskTC2@ */ /end MEASUREMENT
/begin MEASUREMENT WM_MaskTC1 "Mask Error List 1 " ULONG EcuIntgdSwGend_CM_uint32 0 0 0.0 4.294967295E+9 ECU_ADDRESS 0x4000DBE4 /* @ECU_Address@WM_MaskTC1@ */ /end MEASUREMENT
/begin MEASUREMENT WM_MaskRctnForPAirBoostUndErr "Mask Reaction for Air Boost Pressure Under Error" ULONG EcuIntgdSwGend_CM_uint32 0 0 0.0 4.294967295E+9 ECU_ADDRESS 0x4000DF20 /* @ECU_Address@WM_MaskRctnForPAirBoostUndErr@ */ /end MEASUREMENT
/begin MEASUREMENT WM_MaskRctnForPAmbAirOvErr "Mask Reaction for Ambient Air Pressure Over Error" ULONG EcuIntgdSwGend_CM_uint32 0 0 0.0 4.294967295E+9 ECU_ADDRESS 0x4000DF4C /* @ECU_Address@WM_MaskRctnForPAmbAirOvErr@ */ /end MEASUREMENT
/begin MEASUREMENT WM_MaskRctnForPAmbAirUndErr "Mask Reaction for Ambient Air Pressure Under Error" ULONG EcuIntgdSwGend_CM_uint32 0 0 0.0 4.294967295E+9 ECU_ADDRESS 0x4000E4F4 /* @ECU_Address@WM_MaskRctnForPAmbAirUndErr@ */ /end MEASUREMENT
/begin MEASUREMENT WM_MaskRctnForPFuOvErr "Mask Reaction for Fuel Pressure Over Error" ULONG EcuIntgdSwGend_CM_uint32 0 0 0.0 4.294967295E+9 ECU_ADDRESS 0x4000E608 /* @ECU_Address@WM_MaskRctnForPFuOvErr@ */ /end MEASUREMENT
/begin MEASUREMENT WM_MaskRctnForPFuUndErr "Mask Reaction for Fuel Pressure Under Error" ULONG EcuIntgdSwGend_CM_uint32 0 0 0.0 4.294967295E+9 ECU_ADDRESS 0x4000DB1C /* @ECU_Address@WM_MaskRctnForPFuUndErr@ */ /end MEASUREMENT
/begin MEASUREMENT WM_MaskRctnForPOilOvErr "Mask Reaction for Oil Pressure Over Error" ULONG EcuIntgdSwGend_CM_uint32 0 0 0.0 4.294967295E+9 ECU_ADDRESS 0x4000D908 /* @ECU_Address@WM_MaskRctnForPOilOvErr@ */ /end MEASUREMENT
/begin MEASUREMENT WM_MaskRctnForPOilUndErr "Mask Reaction for Oil Pressure Under Error" ULONG EcuIntgdSwGend_CM_uint32 0 0 0.0 4.294967295E+9 ECU_ADDRESS 0x4000DC54 /* @ECU_Address@WM_MaskRctnForPOilUndErr@ */ /end MEASUREMENT
/begin MEASUREMENT WM_MaskRctnForPRailOvErr "Mask Reaction for Rail Pressure Over Error" ULONG EcuIntgdSwGend_CM_uint32 0 0 0.0 4.294967295E+9 ECU_ADDRESS 0x4000D85C /* @ECU_Address@WM_MaskRctnForPRailOvErr@ */ /end MEASUREMENT
/begin MEASUREMENT WM_MaskRctnForPRailUndErr "Mask Reaction for Rail Pressure Under Error" ULONG EcuIntgdSwGend_CM_uint32 0 0 0.0 4.294967295E+9 ECU_ADDRESS 0x4000D704 /* @ECU_Address@WM_MaskRctnForPRailUndErr@ */ /end MEASUREMENT
/begin MEASUREMENT WgC_AirMassFlowCalcZeroDiv "Air Mass Flow Calculation Division by Zero Output" FLOAT32_IEEE EcuIntgdSwGend_CM_single 0 0 -20000.0 20000.0 ECU_ADDRESS 0x4000DE00 /* @ECU_Address@WgC_AirMassFlowCalcZeroDiv@ */ /end MEASUREMENT
/begin MEASUREMENT WgC_CoeffKpOut "Kp Coefficient Output" FLOAT32_IEEE EcuIntgdSwGend_CM_single 0 0 0.0 1000.0 ECU_ADDRESS 0x4000E3D4 /* @ECU_Address@WgC_CoeffKpOut@ */ /end MEASUREMENT
/begin MEASUREMENT WgC_CoeffKiOut "Ki Coefficient Output" FLOAT32_IEEE EcuIntgdSwGend_CM_single 0 0 0.0 1000.0 ECU_ADDRESS 0x4000DABC /* @ECU_Address@WgC_CoeffKiOut@ */ /end MEASUREMENT
/begin MEASUREMENT WgC_CoeffKdFbOut "Kd Coefficient Feedback Output" FLOAT32_IEEE EcuIntgdSwGend_CM_single 0 0 0.0 1000.0 ECU_ADDRESS 0x4000D710 /* @ECU_Address@WgC_CoeffKdFbOut@ */ /end MEASUREMENT
/begin MEASUREMENT WgC_CoeffKdOut "Kd Coefficient Output" FLOAT32_IEEE EcuIntgdSwGend_CM_single 0 0 0.0 1000.0 ECU_ADDRESS 0x4000E2B4 /* @ECU_Address@WgC_CoeffKdOut@ */ /end MEASUREMENT
/begin MEASUREMENT WgC_CoeffKiClampPreSatOut "Ki Coefficient Clamp Pre Saturation Output" FLOAT32_IEEE EcuIntgdSwGend_CM_single 0 0 0.0 1000.0 ECU_ADDRESS 0x4000E480 /* @ECU_Address@WgC_CoeffKiClampPreSatOut@ */ /end MEASUREMENT
/begin MEASUREMENT WgC_DutyWgtVlvPID "Wastegate Duty Valve PID" FLOAT32_IEEE EcuIntgdSwGend_CM_single__ 0 0 0.0 100.0 ECU_ADDRESS 0x4000E0AC /* @ECU_Address@WgC_DutyWgtVlvPID@ */ /end MEASUREMENT
/begin MEASUREMENT WgC_CoeffKiClampOut "Ki Coefficient Clamp Output" FLOAT32_IEEE EcuIntgdSwGend_CM_single 0 0 0.0 1000.0 ECU_ADDRESS 0x4000E344 /* @ECU_Address@WgC_CoeffKiClampOut@ */ /end MEASUREMENT
/begin MEASUREMENT WgC_CoeffKiClampSwtchOut "Ki Coefficient Clamp Switch Output" FLOAT32_IEEE EcuIntgdSwGend_CM_single 0 0 0.0 1000.0 ECU_ADDRESS 0x4000D6DC /* @ECU_Address@WgC_CoeffKiClampSwtchOut@ */ /end MEASUREMENT
/begin MEASUREMENT WM_TiElpdNEngDetdThdRTN "Return To Normal Engine Speed Over Threshold Debouncer Elapsed Time" FLOAT32_IEEE EcuIntgdSwGend_CM_single_ms 0 0 0.0 25000.0 ECU_ADDRESS 0x4000D9E4 /* @ECU_Address@WM_TiElpdNEngDetdThdRTN@ */ /end MEASUREMENT
/begin MEASUREMENT WM_TiElpdPRailTooHi "Rail Pressure Too High Debouncer Elapsed Time" FLOAT32_IEEE EcuIntgdSwGend_CM_single_ms 0 0 0.0 25000.0 ECU_ADDRESS 0x4000E234 /* @ECU_Address@WM_TiElpdPRailTooHi@ */ /end MEASUREMENT
/begin MEASUREMENT WM_TiElpdPRailHi "Rail Pressure High Debouncer Elapsed Time" FLOAT32_IEEE EcuIntgdSwGend_CM_single_ms 0 0 0.0 25000.0 ECU_ADDRESS 0x4000E474 /* @ECU_Address@WM_TiElpdPRailHi@ */ /end MEASUREMENT
/begin MEASUREMENT WM_TiElpdPRailLo "Rail Pressure Low Debouncer Elapsed Time" FLOAT32_IEEE EcuIntgdSwGend_CM_single_ms 0 0 0.0 25000.0 ECU_ADDRESS 0x4000D7C8 /* @ECU_Address@WM_TiElpdPRailLo@ */ /end MEASUREMENT
/begin MEASUREMENT WM_TiElpdPRailNotCtld "Rail Pressure Is Not Controlled Debouncer Elapsed Time" FLOAT32_IEEE EcuIntgdSwGend_CM_single_ms 0 0 0.0 25000.0 ECU_ADDRESS 0x4000D8DC /* @ECU_Address@WM_TiElpdPRailNotCtld@ */ /end MEASUREMENT
/begin MEASUREMENT RPG_TiElpdCoeffKiRst "Timer Elapsed Time Coefficient Integral Reset" FLOAT32_IEEE EcuIntgdSwGend_CM_single 0 0 0.0 10000.0 ECU_ADDRESS 0x4000E374 /* @ECU_Address@RPG_TiElpdCoeffKiRst@ */ /end MEASUREMENT
/begin MEASUREMENT DTqC_DynRateLimr "Dynamic Rate Limiter Signal" FLOAT32_IEEE EcuIntgdSwGend_CM_single_N_m 0 0 -2000.0 2000.0 ECU_ADDRESS 0x4000E25C /* @ECU_Address@DTqC_DynRateLimr@ */ /end MEASUREMENT
/begin MEASUREMENT DTqC_TqCtlTqBrk "Rate Limited Out of Break Torque Value" FLOAT32_IEEE EcuIntgdSwGend_CM_single_N_m 0 0 0.0 10000.0 ECU_ADDRESS 0x4000E31C /* @ECU_Address@DTqC_TqCtlTqBrk@ */ /end MEASUREMENT
/begin MEASUREMENT DTqC_TSC1SpdReqTq "Break Torque of TCU Speed Request Control" FLOAT32_IEEE EcuIntgdSwGend_CM_single_N_m 0 0 0.0 10000.0 ECU_ADDRESS 0x4000DDF0 /* @ECU_Address@DTqC_TSC1SpdReqTq@ */ /end MEASUREMENT
/begin MEASUREMENT DTqC_CoeffKpOutEndSpd "" FLOAT32_IEEE EcuIntgdSwGend_CM_single 0 0 -1000.0 1000.0 ECU_ADDRESS 0x4000E008 /* @ECU_Address@DTqC_CoeffKpOutEndSpd@ */ /end MEASUREMENT
/begin MEASUREMENT DTqC_CoeffKiOutEndSpd "" FLOAT32_IEEE EcuIntgdSwGend_CM_single 0 0 -1000.0 1000.0 ECU_ADDRESS 0x4000E3A0 /* @ECU_Address@DTqC_CoeffKiOutEndSpd@ */ /end MEASUREMENT
/begin MEASUREMENT DTqC_CoeffKdFbOutEndSpd "" FLOAT32_IEEE EcuIntgdSwGend_CM_single 0 0 -1000.0 1000.0 ECU_ADDRESS 0x4000DA14 /* @ECU_Address@DTqC_CoeffKdFbOutEndSpd@ */ /end MEASUREMENT
/begin MEASUREMENT DTqC_CoeffKdOutEndSpd "" FLOAT32_IEEE EcuIntgdSwGend_CM_single 0 0 -1000.0 1000.0 ECU_ADDRESS 0x4000DA10 /* @ECU_Address@DTqC_CoeffKdOutEndSpd@ */ /end MEASUREMENT
/begin MEASUREMENT DTqC_CoeffKiClampPreSatOutEndSpd "" FLOAT32_IEEE EcuIntgdSwGend_CM_single 0 0 -1000.0 1000.0 ECU_ADDRESS 0x4000D6E8 /* @ECU_Address@DTqC_CoeffKiClampPreSatOutEndSpd@ */ /end MEASUREMENT
/begin MEASUREMENT DTqC_TqSoftLimPID "Soft Limitation PID Torque" FLOAT32_IEEE EcuIntgdSwGend_CM_single_N_m 0 0 0.0 5000.0 ECU_ADDRESS 0x4000E048 /* @ECU_Address@DTqC_TqSoftLimPID@ */ /end MEASUREMENT
/begin MEASUREMENT DTqC_TiElpdAcvHardLimLtch "" FLOAT32_IEEE EcuIntgdSwGend_CM_single_ms 0 0 0.0 50000.0 ECU_ADDRESS 0x4000E30C /* @ECU_Address@DTqC_TiElpdAcvHardLimLtch@ */ /end MEASUREMENT
/begin MEASUREMENT DTqC_CoeffKiClampOutEndSpd "" FLOAT32_IEEE EcuIntgdSwGend_CM_single 0 0 -1000.0 1000.0 ECU_ADDRESS 0x4000E060 /* @ECU_Address@DTqC_CoeffKiClampOutEndSpd@ */ /end MEASUREMENT
/begin MEASUREMENT DTqC_CoeffKiClampSwtchOutEndSpd "" FLOAT32_IEEE EcuIntgdSwGend_CM_single 0 0 -1000.0 1000.0 ECU_ADDRESS 0x4000DE4C /* @ECU_Address@DTqC_CoeffKiClampSwtchOutEndSpd@ */ /end MEASUREMENT
/begin MEASUREMENT CrsCtrl_TiElpdEngBrkLvl2Actvn "Engine Brake Level 2 Activation Elapsed Time" FLOAT32_IEEE EcuIntgdSwGend_CM_single_ms 0 0 0.0 10000.0 ECU_ADDRESS 0x4000DF58 /* @ECU_Address@CrsCtrl_TiElpdEngBrkLvl2Actvn@ */ /end MEASUREMENT
/begin MEASUREMENT CrsCtrl_TiElpdEngBrkLvl1Actvn "Engine Brake Level 1 Activation Elapsed Time" FLOAT32_IEEE EcuIntgdSwGend_CM_single_ms 0 0 0.0 10000.0 ECU_ADDRESS 0x4000E5B0 /* @ECU_Address@CrsCtrl_TiElpdEngBrkLvl1Actvn@ */ /end MEASUREMENT
/begin MEASUREMENT WM_bTOilUndEna "Oil Temperature Under Error Enable" UBYTE EcuIntgdSwGend_CM_boolean 0 0 0.0 1.0 ECU_ADDRESS 0x4000E72E /* @ECU_Address@WM_bTOilUndEna@ */ /end MEASUREMENT
/begin MEASUREMENT WM_bErrTOilUndLvl1 "Oil Temperature Under Error Level 1" UBYTE EcuIntgdSwGend_CM_boolean 0 0 0.0 1.0 ECU_ADDRESS 0x4000DCD4 /* @ECU_Address@WM_bErrTOilUndLvl1@ */ /end MEASUREMENT
/begin MEASUREMENT WM_bErrTOilUndLvl2 "Oil Temperature Under Error Level 2" UBYTE EcuIntgdSwGend_CM_boolean 0 0 0.0 1.0 ECU_ADDRESS 0x4000E78D /* @ECU_Address@WM_bErrTOilUndLvl2@ */ /end MEASUREMENT
/begin MEASUREMENT WM_bErrTOilUndLvl3 "Oil Temperature Under Error Level 3" UBYTE EcuIntgdSwGend_CM_boolean 0 0 0.0 1.0 ECU_ADDRESS 0x4000D804 /* @ECU_Address@WM_bErrTOilUndLvl3@ */ /end MEASUREMENT
/begin MEASUREMENT WM_bErrTOilUnd "Oil Temperature Under Error" UBYTE EcuIntgdSwGend_CM_boolean 0 0 0.0 1.0 ECU_ADDRESS 0x4000DFA4 /* @ECU_Address@WM_bErrTOilUnd@ */ /end MEASUREMENT
/begin MEASUREMENT WM_bTOilOvEna "Oil Temperature Over Error Enable" UBYTE EcuIntgdSwGend_CM_boolean 0 0 0.0 1.0 ECU_ADDRESS 0x4000E5A9 /* @ECU_Address@WM_bTOilOvEna@ */ /end MEASUREMENT
/begin MEASUREMENT WM_bErrTOilOvLvl1 "Oil Temperature Over Error Level 1" UBYTE EcuIntgdSwGend_CM_boolean 0 0 0.0 1.0 ECU_ADDRESS 0x4000DA36 /* @ECU_Address@WM_bErrTOilOvLvl1@ */ /end MEASUREMENT
/begin MEASUREMENT WM_bErrTOilOvLvl2 "Oil Temperature Over Error Level 2" UBYTE EcuIntgdSwGend_CM_boolean 0 0 0.0 1.0 ECU_ADDRESS 0x4000DA37 /* @ECU_Address@WM_bErrTOilOvLvl2@ */ /end MEASUREMENT
/begin MEASUREMENT WM_bErrTOilOvLvl3 "Oil Temperature Over Error Level 3" UBYTE EcuIntgdSwGend_CM_boolean 0 0 0.0 1.0 ECU_ADDRESS 0x4000E0EC /* @ECU_Address@WM_bErrTOilOvLvl3@ */ /end MEASUREMENT
/begin MEASUREMENT WM_bErrTOilOv "Oil Temperature Over Error" UBYTE EcuIntgdSwGend_CM_boolean 0 0 0.0 1.0 ECU_ADDRESS 0x4000E495 /* @ECU_Address@WM_bErrTOilOv@ */ /end MEASUREMENT
/begin MEASUREMENT WM_bTFuOvEna "Coolant Temperature Over Error Enable" UBYTE EcuIntgdSwGend_CM_boolean 0 0 0.0 1.0 ECU_ADDRESS 0x4000E1EC /* @ECU_Address@WM_bTFuOvEna@ */ /end MEASUREMENT
/begin MEASUREMENT WM_bErrTFuOvLvl1 "Fuel Temperature Over Error Level 1" UBYTE EcuIntgdSwGend_CM_boolean 0 0 0.0 1.0 ECU_ADDRESS 0x4000E1FF /* @ECU_Address@WM_bErrTFuOvLvl1@ */ /end MEASUREMENT
/begin MEASUREMENT WM_bErrTFuOvLvl2 "Fuel Temperature Over Error Level 2" UBYTE EcuIntgdSwGend_CM_boolean 0 0 0.0 1.0 ECU_ADDRESS 0x4000E200 /* @ECU_Address@WM_bErrTFuOvLvl2@ */ /end MEASUREMENT
/begin MEASUREMENT WM_bErrTFuOvLvl3 "Fuel Temperature Over Error Level 3" UBYTE EcuIntgdSwGend_CM_boolean 0 0 0.0 1.0 ECU_ADDRESS 0x4000E201 /* @ECU_Address@WM_bErrTFuOvLvl3@ */ /end MEASUREMENT
/begin MEASUREMENT WM_bErrTFuOv "Fuel Temperature Over Error" UBYTE EcuIntgdSwGend_CM_boolean 0 0 0.0 1.0 ECU_ADDRESS 0x4000DF11 /* @ECU_Address@WM_bErrTFuOv@ */ /end MEASUREMENT
/begin MEASUREMENT WM_bTEcuEna "ECU Temperature Error Enable" UBYTE EcuIntgdSwGend_CM_boolean 0 0 0.0 1.0 ECU_ADDRESS 0x4000D92C /* @ECU_Address@WM_bTEcuEna@ */ /end MEASUREMENT
/begin MEASUREMENT WM_bErrTEcuLvl1 "ECU Temperature Error Level 1" UBYTE EcuIntgdSwGend_CM_boolean 0 0 0.0 1.0 ECU_ADDRESS 0x4000D6F8 /* @ECU_Address@WM_bErrTEcuLvl1@ */ /end MEASUREMENT
/begin MEASUREMENT WM_bErrTEcuLvl2 "ECU Temperature Error Level 2" UBYTE EcuIntgdSwGend_CM_boolean 0 0 0.0 1.0 ECU_ADDRESS 0x4000D6F9 /* @ECU_Address@WM_bErrTEcuLvl2@ */ /end MEASUREMENT
/begin MEASUREMENT WM_bErrTEcuLvl3 "ECU Temperature Error Level 3" UBYTE EcuIntgdSwGend_CM_boolean 0 0 0.0 1.0 ECU_ADDRESS 0x4000D6FA /* @ECU_Address@WM_bErrTEcuLvl3@ */ /end MEASUREMENT
/begin MEASUREMENT WM_bErrTEcu "ECU Temperature Error" UBYTE EcuIntgdSwGend_CM_boolean 0 0 0.0 1.0 ECU_ADDRESS 0x4000DBB9 /* @ECU_Address@WM_bErrTEcu@ */ /end MEASUREMENT
/begin MEASUREMENT WM_bTCooltUndEna "Coolant Temperature Under Error Enable" UBYTE EcuIntgdSwGend_CM_boolean 0 0 0.0 1.0 ECU_ADDRESS 0x4000DE88 /* @ECU_Address@WM_bTCooltUndEna@ */ /end MEASUREMENT
/begin MEASUREMENT WM_bErrTCooltUndLvl1 "Coolant Temperature Under Error Level 1" UBYTE EcuIntgdSwGend_CM_boolean 0 0 0.0 1.0 ECU_ADDRESS 0x4000E39C /* @ECU_Address@WM_bErrTCooltUndLvl1@ */ /end MEASUREMENT
/begin MEASUREMENT WM_bErrTCooltUndLvl2 "Coolant Temperature Under Error Level 2" UBYTE EcuIntgdSwGend_CM_boolean 0 0 0.0 1.0 ECU_ADDRESS 0x4000DCD7 /* @ECU_Address@WM_bErrTCooltUndLvl2@ */ /end MEASUREMENT
/begin MEASUREMENT WM_bErrTCooltUndLvl3 "Coolant Temperature Under Error Level 3" UBYTE EcuIntgdSwGend_CM_boolean 0 0 0.0 1.0 ECU_ADDRESS 0x4000DCD8 /* @ECU_Address@WM_bErrTCooltUndLvl3@ */ /end MEASUREMENT
/begin MEASUREMENT WM_bErrTCooltUnd "Coolant Temperature Under Error" UBYTE EcuIntgdSwGend_CM_boolean 0 0 0.0 1.0 ECU_ADDRESS 0x4000E0B1 /* @ECU_Address@WM_bErrTCooltUnd@ */ /end MEASUREMENT
/begin MEASUREMENT WM_bTCooltOvEna "Coolant Temperature Over Error Enable" UBYTE EcuIntgdSwGend_CM_boolean 0 0 0.0 1.0 ECU_ADDRESS 0x4000E08C /* @ECU_Address@WM_bTCooltOvEna@ */ /end MEASUREMENT
/begin MEASUREMENT WM_bErrTCooltOvLvl1 "Coolant Temperature Over Error Level 1" UBYTE EcuIntgdSwGend_CM_boolean 0 0 0.0 1.0 ECU_ADDRESS 0x4000E786 /* @ECU_Address@WM_bErrTCooltOvLvl1@ */ /end MEASUREMENT
/begin MEASUREMENT WM_bErrTCooltOvLvl2 "Coolant Temperature Over Error Level 2" UBYTE EcuIntgdSwGend_CM_boolean 0 0 0.0 1.0 ECU_ADDRESS 0x4000E0BD /* @ECU_Address@WM_bErrTCooltOvLvl2@ */ /end MEASUREMENT
/begin MEASUREMENT WM_bErrTCooltOvLvl3 "Coolant Temperature Over Error Level 3" UBYTE EcuIntgdSwGend_CM_boolean 0 0 0.0 1.0 ECU_ADDRESS 0x4000E0BE /* @ECU_Address@WM_bErrTCooltOvLvl3@ */ /end MEASUREMENT
/begin MEASUREMENT WM_bErrTCooltOv "Coolant Temperature Over Error" UBYTE EcuIntgdSwGend_CM_boolean 0 0 0.0 1.0 ECU_ADDRESS 0x4000D77B /* @ECU_Address@WM_bErrTCooltOv@ */ /end MEASUREMENT
/begin MEASUREMENT WM_bTAmbAirUndEna "Ambient Air Temperature Under Error Enable" UBYTE EcuIntgdSwGend_CM_boolean 0 0 0.0 1.0 ECU_ADDRESS 0x4000DA40 /* @ECU_Address@WM_bTAmbAirUndEna@ */ /end MEASUREMENT
/begin MEASUREMENT WM_bErrTAmbAirUndLvl1 "Ambient Air Temperature Under Error Level 1" UBYTE EcuIntgdSwGend_CM_boolean 0 0 0.0 1.0 ECU_ADDRESS 0x4000E4A4 /* @ECU_Address@WM_bErrTAmbAirUndLvl1@ */ /end MEASUREMENT
/begin MEASUREMENT WM_bErrTAmbAirUndLvl2 "Ambient Air Temperature Under Error Level 2" UBYTE EcuIntgdSwGend_CM_boolean 0 0 0.0 1.0 ECU_ADDRESS 0x4000D877 /* @ECU_Address@WM_bErrTAmbAirUndLvl2@ */ /end MEASUREMENT
/begin MEASUREMENT WM_bErrTAmbAirUndLvl3 "Ambient Air Temperature Under Error Level 3" UBYTE EcuIntgdSwGend_CM_boolean 0 0 0.0 1.0 ECU_ADDRESS 0x4000DD92 /* @ECU_Address@WM_bErrTAmbAirUndLvl3@ */ /end MEASUREMENT
/begin MEASUREMENT WM_bErrTAmbAirUnd "Ambient Air Temperature Under Error" UBYTE EcuIntgdSwGend_CM_boolean 0 0 0.0 1.0 ECU_ADDRESS 0x4000E5A0 /* @ECU_Address@WM_bErrTAmbAirUnd@ */ /end MEASUREMENT
/begin MEASUREMENT WM_bTAmbAirOvEna "Ambient Air Temperature Over Error Enable" UBYTE EcuIntgdSwGend_CM_boolean 0 0 0.0 1.0 ECU_ADDRESS 0x4000E454 /* @ECU_Address@WM_bTAmbAirOvEna@ */ /end MEASUREMENT
/begin MEASUREMENT WM_bErrTAmbAirOvLvl1 "Ambient Air Temperature Over Error Level 1" UBYTE EcuIntgdSwGend_CM_boolean 0 0 0.0 1.0 ECU_ADDRESS 0x4000E2B1 /* @ECU_Address@WM_bErrTAmbAirOvLvl1@ */ /end MEASUREMENT
/begin MEASUREMENT WM_bErrTAmbAirOvLvl2 "Ambient Air Temperature Over Error Level 2" UBYTE EcuIntgdSwGend_CM_boolean 0 0 0.0 1.0 ECU_ADDRESS 0x4000DCBC /* @ECU_Address@WM_bErrTAmbAirOvLvl2@ */ /end MEASUREMENT
/begin MEASUREMENT WM_bErrTAmbAirOvLvl3 "Ambient Air Temperature Over Error Level 3" UBYTE EcuIntgdSwGend_CM_boolean 0 0 0.0 1.0 ECU_ADDRESS 0x4000DCBD /* @ECU_Address@WM_bErrTAmbAirOvLvl3@ */ /end MEASUREMENT
/begin MEASUREMENT WM_bErrTAmbAirOv "Ambient Air Temperature Over Error" UBYTE EcuIntgdSwGend_CM_boolean 0 0 0.0 1.0 ECU_ADDRESS 0x4000DFD9 /* @ECU_Address@WM_bErrTAmbAirOv@ */ /end MEASUREMENT
/begin MEASUREMENT WM_bTAirBoostUndEna "Air Boost Temperature Under Error Enable" UBYTE EcuIntgdSwGend_CM_boolean 0 0 0.0 1.0 ECU_ADDRESS 0x4000DEA4 /* @ECU_Address@WM_bTAirBoostUndEna@ */ /end MEASUREMENT
/begin MEASUREMENT WM_bErrTAirBoostUndLvl1 "Air Boost Temperature Under Level 1" UBYTE EcuIntgdSwGend_CM_boolean 0 0 0.0 1.0 ECU_ADDRESS 0x4000E72D /* @ECU_Address@WM_bErrTAirBoostUndLvl1@ */ /end MEASUREMENT
/begin MEASUREMENT WM_bErrTAirBoostUndLvl2 "Air Boost Temperature Under Level 2" UBYTE EcuIntgdSwGend_CM_boolean 0 0 0.0 1.0 ECU_ADDRESS 0x4000E308 /* @ECU_Address@WM_bErrTAirBoostUndLvl2@ */ /end MEASUREMENT
/begin MEASUREMENT WM_bErrTAirBoostUndLvl3 "Air Boost Temperature Under Level 3" UBYTE EcuIntgdSwGend_CM_boolean 0 0 0.0 1.0 ECU_ADDRESS 0x4000E72F /* @ECU_Address@WM_bErrTAirBoostUndLvl3@ */ /end MEASUREMENT
/begin MEASUREMENT WM_bErrTAirBoostUnd "Air Boost Temperature Under Error" UBYTE EcuIntgdSwGend_CM_boolean 0 0 0.0 1.0 ECU_ADDRESS 0x4000E508 /* @ECU_Address@WM_bErrTAirBoostUnd@ */ /end MEASUREMENT
/begin MEASUREMENT WM_bTAirBoostOvEna "Air Boost Temperature Over Error Enable" UBYTE EcuIntgdSwGend_CM_boolean 0 0 0.0 1.0 ECU_ADDRESS 0x4000E371 /* @ECU_Address@WM_bTAirBoostOvEna@ */ /end MEASUREMENT
/begin MEASUREMENT WM_bErrTAirBoostOvLvl1 "Air Boost Temperature Over Error Level 1" UBYTE EcuIntgdSwGend_CM_boolean 0 0 0.0 1.0 ECU_ADDRESS 0x4000E2C8 /* @ECU_Address@WM_bErrTAirBoostOvLvl1@ */ /end MEASUREMENT
/begin MEASUREMENT WM_bErrTAirBoostOvLvl2 "Air Boost Temperature Over Error Level 2" UBYTE EcuIntgdSwGend_CM_boolean 0 0 0.0 1.0 ECU_ADDRESS 0x4000E178 /* @ECU_Address@WM_bErrTAirBoostOvLvl2@ */ /end MEASUREMENT
/begin MEASUREMENT WM_bErrTAirBoostOvLvl3 "Air Boost Temperature Over Error Level 3" UBYTE EcuIntgdSwGend_CM_boolean 0 0 0.0 1.0 ECU_ADDRESS 0x4000E2CA /* @ECU_Address@WM_bErrTAirBoostOvLvl3@ */ /end MEASUREMENT
/begin MEASUREMENT WM_bErrTAirBoostOv "Air Boost Temperature Over Error" UBYTE EcuIntgdSwGend_CM_boolean 0 0 0.0 1.0 ECU_ADDRESS 0x4000D698 /* @ECU_Address@WM_bErrTAirBoostOv@ */ /end MEASUREMENT
/begin MEASUREMENT WM_bNEngOverThdRTN "Engine Speed Over Threshold Return to Normal Active" UBYTE EcuIntgdSwGend_CM_boolean 0 0 0.0 1.0 ECU_ADDRESS 0x4000DF74 /* @ECU_Address@WM_bNEngOverThdRTN@ */ /end MEASUREMENT
/begin MEASUREMENT WM_bErrComb1 "Error Combo 1" UBYTE EcuIntgdSwGend_CM_boolean 0 0 0.0 1.0 ECU_ADDRESS 0x4000E4A5 /* @ECU_Address@WM_bErrComb1@ */ /end MEASUREMENT
/begin MEASUREMENT WM_bErrComb2 "Error Combo 2" UBYTE EcuIntgdSwGend_CM_boolean 0 0 0.0 1.0 ECU_ADDRESS 0x4000E4A6 /* @ECU_Address@WM_bErrComb2@ */ /end MEASUREMENT
/begin MEASUREMENT WM_bErrComb3 "Error Combo 3" UBYTE EcuIntgdSwGend_CM_boolean 0 0 0.0 1.0 ECU_ADDRESS 0x4000E4A7 /* @ECU_Address@WM_bErrComb3@ */ /end MEASUREMENT
/begin MEASUREMENT WM_bErrComb4 "Error Combo 4" UBYTE EcuIntgdSwGend_CM_boolean 0 0 0.0 1.0 ECU_ADDRESS 0x4000E4A8 /* @ECU_Address@WM_bErrComb4@ */ /end MEASUREMENT
/begin MEASUREMENT WM_bErrComb5 "Error Combo 5" UBYTE EcuIntgdSwGend_CM_boolean 0 0 0.0 1.0 ECU_ADDRESS 0x4000E4A9 /* @ECU_Address@WM_bErrComb5@ */ /end MEASUREMENT
/begin MEASUREMENT WM_bAcvAmberWarn "MIL Warning Lamp Active" UBYTE EcuIntgdSwGend_CM_boolean 0 0 0.0 1.0 ECU_ADDRESS 0x4000D9B3 /* @ECU_Address@WM_bAcvAmberWarn@ */ /end MEASUREMENT
/begin MEASUREMENT WM_bAcvRednLvl1 "Engine Torque Reaction Level 1 Active" UBYTE EcuIntgdSwGend_CM_boolean 0 0 0.0 1.0 ECU_ADDRESS 0x4000DCF8 /* @ECU_Address@WM_bAcvRednLvl1@ */ /end MEASUREMENT
/begin MEASUREMENT WM_bAcvRednLvl2 "Engine Torque Reaction Level 2 Active" UBYTE EcuIntgdSwGend_CM_boolean 0 0 0.0 1.0 ECU_ADDRESS 0x4000DCF9 /* @ECU_Address@WM_bAcvRednLvl2@ */ /end MEASUREMENT
/begin MEASUREMENT WM_bAcvLimp "Limp Active" UBYTE EcuIntgdSwGend_CM_boolean 0 0 0.0 1.0 ECU_ADDRESS 0x4000D960 /* @ECU_Address@WM_bAcvLimp@ */ /end MEASUREMENT
/begin MEASUREMENT WM_bAcvEmgcyShtdwnLamp "Emergency Shutdown Lamp Active" UBYTE EcuIntgdSwGend_CM_boolean 0 0 0.0 1.0 ECU_ADDRESS 0x4000DA60 /* @ECU_Address@WM_bAcvEmgcyShtdwnLamp@ */ /end MEASUREMENT
/begin MEASUREMENT WM_bAcvEmgcyShtdwn "Emergency Shutdown Active" UBYTE EcuIntgdSwGend_CM_boolean 0 0 0.0 1.0 ECU_ADDRESS 0x4000DE85 /* @ECU_Address@WM_bAcvEmgcyShtdwn@ */ /end MEASUREMENT
/begin MEASUREMENT WM_bAcvErrInjrShtdwnRctn "Injection Error Shutdown Reaction Active" UBYTE EcuIntgdSwGend_CM_boolean 0 0 0.0 1.0 ECU_ADDRESS 0x4000DDC0 /* @ECU_Address@WM_bAcvErrInjrShtdwnRctn@ */ /end MEASUREMENT
/begin MEASUREMENT WM_bAcvErrCamCrankTotLossRctn "Cam Crank Total Loss Reaction Active" UBYTE EcuIntgdSwGend_CM_boolean 0 0 0.0 1.0 ECU_ADDRESS 0x4000E113 /* @ECU_Address@WM_bAcvErrCamCrankTotLossRctn@ */ /end MEASUREMENT
/begin MEASUREMENT WM_bAcvErrEmgcyShtdwnForOvspdRctn "Emergency Shutdown for Overspeed Reaction Active" UBYTE EcuIntgdSwGend_CM_boolean 0 0 0.0 1.0 ECU_ADDRESS 0x4000E65C /* @ECU_Address@WM_bAcvErrEmgcyShtdwnForOvspdRctn@ */ /end MEASUREMENT
/begin MEASUREMENT WM_bAcvErrPRailNotCtldMsgRctn "Rail Pressure Is Not Controlled Reaction Active" UBYTE EcuIntgdSwGend_CM_boolean 0 0 0.0 1.0 ECU_ADDRESS 0x4000D840 /* @ECU_Address@WM_bAcvErrPRailNotCtldMsgRctn@ */ /end MEASUREMENT
/begin MEASUREMENT WM_bActvLimpRctn "Limp Reaction Activation" UBYTE EcuIntgdSwGend_CM_boolean 0 0 0.0 1.0 ECU_ADDRESS 0x4000DE8B /* @ECU_Address@WM_bActvLimpRctn@ */ /end MEASUREMENT
/begin MEASUREMENT WM_bAcvErrComb5Rctn "Error Combo 5 Reaction Active" UBYTE EcuIntgdSwGend_CM_boolean 0 0 0.0 1.0 ECU_ADDRESS 0x4000DE89 /* @ECU_Address@WM_bAcvErrComb5Rctn@ */ /end MEASUREMENT
/begin MEASUREMENT WM_bAcvErrComb4Rctn "Error Combo 4 Reaction Active" UBYTE EcuIntgdSwGend_CM_boolean 0 0 0.0 1.0 ECU_ADDRESS 0x4000DE8A /* @ECU_Address@WM_bAcvErrComb4Rctn@ */ /end MEASUREMENT
/begin MEASUREMENT WM_bAcvErrComb3Rctn "Error Combo 3 Reaction Active" UBYTE EcuIntgdSwGend_CM_boolean 0 0 0.0 1.0 ECU_ADDRESS 0x4000E3C1 /* @ECU_Address@WM_bAcvErrComb3Rctn@ */ /end MEASUREMENT
/begin MEASUREMENT WM_bAcvErrComb2Rctn "Error Combo 2 Reaction Active" UBYTE EcuIntgdSwGend_CM_boolean 0 0 0.0 1.0 ECU_ADDRESS 0x4000E68D /* @ECU_Address@WM_bAcvErrComb2Rctn@ */ /end MEASUREMENT
/begin MEASUREMENT WM_bAcvErrComb1Rctn "Error Combo 1 Reaction Active" UBYTE EcuIntgdSwGend_CM_boolean 0 0 0.0 1.0 ECU_ADDRESS 0x4000D7FD /* @ECU_Address@WM_bAcvErrComb1Rctn@ */ /end MEASUREMENT
/begin MEASUREMENT WM_bTiPRailHiAcvWarnDeb "Rail Pressure High Debouncer Active" UBYTE EcuIntgdSwGend_CM_boolean 0 0 0.0 1.0 ECU_ADDRESS 0x4000E5F5 /* @ECU_Address@WM_bTiPRailHiAcvWarnDeb@ */ /end MEASUREMENT
/begin MEASUREMENT WM_bPRailHiMsg "Rail Pressure High Message" UBYTE EcuIntgdSwGend_CM_boolean 0 0 0.0 1.0 ECU_ADDRESS 0x4000E2B0 /* @ECU_Address@WM_bPRailHiMsg@ */ /end MEASUREMENT
/begin MEASUREMENT WM_bTiAcvWarnPTooHiDeb "Rail Pressure Too High Debouncer Active" UBYTE EcuIntgdSwGend_CM_boolean 0 0 0.0 1.0 ECU_ADDRESS 0x4000D9D4 /* @ECU_Address@WM_bTiAcvWarnPTooHiDeb@ */ /end MEASUREMENT
/begin MEASUREMENT WM_bPRailTooHiMsg "Rail Pressure Too High Message" UBYTE EcuIntgdSwGend_CM_boolean 0 0 0.0 1.0 ECU_ADDRESS 0x4000E3C2 /* @ECU_Address@WM_bPRailTooHiMsg@ */ /end MEASUREMENT
/begin MEASUREMENT WM_bErrPRailOv "Rail Pressure Over Error" UBYTE EcuIntgdSwGend_CM_boolean 0 0 0.0 1.0 ECU_ADDRESS 0x4000DBBA /* @ECU_Address@WM_bErrPRailOv@ */ /end MEASUREMENT
/begin MEASUREMENT WM_bTiPRailLoAcvWarnDeb "Rail Pressure Low Debouncer Active" UBYTE EcuIntgdSwGend_CM_boolean 0 0 0.0 1.0 ECU_ADDRESS 0x4000DAD4 /* @ECU_Address@WM_bTiPRailLoAcvWarnDeb@ */ /end MEASUREMENT
/begin MEASUREMENT WM_bPRailLoMsg "Rail Pressure Low Message" UBYTE EcuIntgdSwGend_CM_boolean 0 0 0.0 1.0 ECU_ADDRESS 0x4000D920 /* @ECU_Address@WM_bPRailLoMsg@ */ /end MEASUREMENT
/begin MEASUREMENT WM_bErrPRailUnd "Rail Pressure Under Error" UBYTE EcuIntgdSwGend_CM_boolean 0 0 0.0 1.0 ECU_ADDRESS 0x4000D72D /* @ECU_Address@WM_bErrPRailUnd@ */ /end MEASUREMENT
/begin MEASUREMENT WM_bTiAcvWarnPRailNotCtldDeb "Rail Pressure Is Not Controlled Debouncer Active" UBYTE EcuIntgdSwGend_CM_boolean 0 0 0.0 1.0 ECU_ADDRESS 0x4000E4CC /* @ECU_Address@WM_bTiAcvWarnPRailNotCtldDeb@ */ /end MEASUREMENT
/begin MEASUREMENT WM_bPRailNotCtldMsg "Rail Pressure Is Not Controlled Message" UBYTE EcuIntgdSwGend_CM_boolean 0 0 0.0 1.0 ECU_ADDRESS 0x4000E045 /* @ECU_Address@WM_bPRailNotCtldMsg@ */ /end MEASUREMENT
/begin MEASUREMENT WM_bPRailUndEna "Rail Pressure Under Error Enable" UBYTE EcuIntgdSwGend_CM_boolean 0 0 0.0 1.0 ECU_ADDRESS 0x4000E55A /* @ECU_Address@WM_bPRailUndEna@ */ /end MEASUREMENT
/begin MEASUREMENT WM_bErrPRailUndLvl1 "Rail Pressure Under Error Level 1" UBYTE EcuIntgdSwGend_CM_boolean 0 0 0.0 1.0 ECU_ADDRESS 0x4000E6D9 /* @ECU_Address@WM_bErrPRailUndLvl1@ */ /end MEASUREMENT
/begin MEASUREMENT WM_bErrPRailUndLvl2 "Rail Pressure Under Error Level 2" UBYTE EcuIntgdSwGend_CM_boolean 0 0 0.0 1.0 ECU_ADDRESS 0x4000E6DA /* @ECU_Address@WM_bErrPRailUndLvl2@ */ /end MEASUREMENT
/begin MEASUREMENT WM_bErrPRailUndLvl3 "Rail Pressure Under Error Level 3" UBYTE EcuIntgdSwGend_CM_boolean 0 0 0.0 1.0 ECU_ADDRESS 0x4000E6DB /* @ECU_Address@WM_bErrPRailUndLvl3@ */ /end MEASUREMENT
/begin MEASUREMENT WM_bPRailOvEna "Rail Pressure Over Error Enable" UBYTE EcuIntgdSwGend_CM_boolean 0 0 0.0 1.0 ECU_ADDRESS 0x4000E62C /* @ECU_Address@WM_bPRailOvEna@ */ /end MEASUREMENT
/begin MEASUREMENT WM_bErrPRailOvLvl1 "Rail Pressure Over Error Level 1" UBYTE EcuIntgdSwGend_CM_boolean 0 0 0.0 1.0 ECU_ADDRESS 0x4000E5EB /* @ECU_Address@WM_bErrPRailOvLvl1@ */ /end MEASUREMENT
/begin MEASUREMENT WM_bErrPRailOvLvl2 "Rail Pressure Over Error Level 2" UBYTE EcuIntgdSwGend_CM_boolean 0 0 0.0 1.0 ECU_ADDRESS 0x4000E5EC /* @ECU_Address@WM_bErrPRailOvLvl2@ */ /end MEASUREMENT
/begin MEASUREMENT WM_bErrPRailOvLvl3 "Rail Pressure Over Error Level 3" UBYTE EcuIntgdSwGend_CM_boolean 0 0 0.0 1.0 ECU_ADDRESS 0x4000E251 /* @ECU_Address@WM_bErrPRailOvLvl3@ */ /end MEASUREMENT
/begin MEASUREMENT WM_bPOilUndEna "Oil Pressure Under Error Enable" UBYTE EcuIntgdSwGend_CM_boolean 0 0 0.0 1.0 ECU_ADDRESS 0x4000E594 /* @ECU_Address@WM_bPOilUndEna@ */ /end MEASUREMENT
/begin MEASUREMENT WM_bErrPOilUndLvl1 "Oil Pressure Under Error Level 1" UBYTE EcuIntgdSwGend_CM_boolean 0 0 0.0 1.0 ECU_ADDRESS 0x4000E3C0 /* @ECU_Address@WM_bErrPOilUndLvl1@ */ /end MEASUREMENT
/begin MEASUREMENT WM_bErrPOilUndLvl2 "Oil Pressure Under Error Level 2" UBYTE EcuIntgdSwGend_CM_boolean 0 0 0.0 1.0 ECU_ADDRESS 0x4000E372 /* @ECU_Address@WM_bErrPOilUndLvl2@ */ /end MEASUREMENT
/begin MEASUREMENT WM_bErrPOilUndLvl3 "Oil Pressure Under Error Level 3" UBYTE EcuIntgdSwGend_CM_boolean 0 0 0.0 1.0 ECU_ADDRESS 0x4000E373 /* @ECU_Address@WM_bErrPOilUndLvl3@ */ /end MEASUREMENT
/begin MEASUREMENT WM_bErrPOilUnd "Oil Pressure Under Error" UBYTE EcuIntgdSwGend_CM_boolean 0 0 0.0 1.0 ECU_ADDRESS 0x4000DF36 /* @ECU_Address@WM_bErrPOilUnd@ */ /end MEASUREMENT
/begin MEASUREMENT WM_bPOilOvEna "Oil Pressure Over Error Enable" UBYTE EcuIntgdSwGend_CM_boolean 0 0 0.0 1.0 ECU_ADDRESS 0x4000E784 /* @ECU_Address@WM_bPOilOvEna@ */ /end MEASUREMENT
/begin MEASUREMENT WM_bErrPOilOvLvl1 "Oil Pressure Over Error Level 1" UBYTE EcuIntgdSwGend_CM_boolean 0 0 0.0 1.0 ECU_ADDRESS 0x4000DAF4 /* @ECU_Address@WM_bErrPOilOvLvl1@ */ /end MEASUREMENT
/begin MEASUREMENT WM_bErrPOilOvLvl2 "Oil Pressure Over Error Level 2" UBYTE EcuIntgdSwGend_CM_boolean 0 0 0.0 1.0 ECU_ADDRESS 0x4000DAF5 /* @ECU_Address@WM_bErrPOilOvLvl2@ */ /end MEASUREMENT
/begin MEASUREMENT WM_bErrPOilOvLvl3 "Oil Pressure Over Error Level 3" UBYTE EcuIntgdSwGend_CM_boolean 0 0 0.0 1.0 ECU_ADDRESS 0x4000DAF6 /* @ECU_Address@WM_bErrPOilOvLvl3@ */ /end MEASUREMENT
/begin MEASUREMENT WM_bErrPOilOv "Oil Pressure Over Error" UBYTE EcuIntgdSwGend_CM_boolean 0 0 0.0 1.0 ECU_ADDRESS 0x4000D70D /* @ECU_Address@WM_bErrPOilOv@ */ /end MEASUREMENT
/begin MEASUREMENT WM_bPFuUndEna "Fuel Pressure Under Error Enable" UBYTE EcuIntgdSwGend_CM_boolean 0 0 0.0 1.0 ECU_ADDRESS 0x4000DFA6 /* @ECU_Address@WM_bPFuUndEna@ */ /end MEASUREMENT
/begin MEASUREMENT WM_bErrPFuUndLvl1 "Fuel Pressure Under Error Level 1" UBYTE EcuIntgdSwGend_CM_boolean 0 0 0.0 1.0 ECU_ADDRESS 0x4000DFB1 /* @ECU_Address@WM_bErrPFuUndLvl1@ */ /end MEASUREMENT
/begin MEASUREMENT WM_bErrPFuUndLvl2 "Fuel Pressure Under Error Level 2" UBYTE EcuIntgdSwGend_CM_boolean 0 0 0.0 1.0 ECU_ADDRESS 0x4000D770 /* @ECU_Address@WM_bErrPFuUndLvl2@ */ /end MEASUREMENT
/begin MEASUREMENT WM_bErrPFuUndLvl3 "Fuel Pressure Under Error Level 3" UBYTE EcuIntgdSwGend_CM_boolean 0 0 0.0 1.0 ECU_ADDRESS 0x4000DFB3 /* @ECU_Address@WM_bErrPFuUndLvl3@ */ /end MEASUREMENT
/begin MEASUREMENT WM_bErrPFuUnd "Fuel Pressure Under Error" UBYTE EcuIntgdSwGend_CM_boolean 0 0 0.0 1.0 ECU_ADDRESS 0x4000E580 /* @ECU_Address@WM_bErrPFuUnd@ */ /end MEASUREMENT
/begin MEASUREMENT WM_bPFuOvEna "Fuel Pressure Over Error Enable" UBYTE EcuIntgdSwGend_CM_boolean 0 0 0.0 1.0 ECU_ADDRESS 0x4000DF1A /* @ECU_Address@WM_bPFuOvEna@ */ /end MEASUREMENT
/begin MEASUREMENT WM_bErrPFuOvLvl1 "Fuel Pressure Over Error Level 1" UBYTE EcuIntgdSwGend_CM_boolean 0 0 0.0 1.0 ECU_ADDRESS 0x4000E410 /* @ECU_Address@WM_bErrPFuOvLvl1@ */ /end MEASUREMENT
/begin MEASUREMENT WM_bErrPFuOvLvl2 "Fuel Pressure Over Error Level 2" UBYTE EcuIntgdSwGend_CM_boolean 0 0 0.0 1.0 ECU_ADDRESS 0x4000E411 /* @ECU_Address@WM_bErrPFuOvLvl2@ */ /end MEASUREMENT
/begin MEASUREMENT WM_bErrPFuOvLvl3 "Fuel Pressure Over Error Level 3" UBYTE EcuIntgdSwGend_CM_boolean 0 0 0.0 1.0 ECU_ADDRESS 0x4000E412 /* @ECU_Address@WM_bErrPFuOvLvl3@ */ /end MEASUREMENT
/begin MEASUREMENT WM_bErrPFuOv "Fuel Pressure Over Error" UBYTE EcuIntgdSwGend_CM_boolean 0 0 0.0 1.0 ECU_ADDRESS 0x4000D88C /* @ECU_Address@WM_bErrPFuOv@ */ /end MEASUREMENT
/begin MEASUREMENT WM_bPAmbAirUndEna "Ambient Air Pressure Under Error Enable" UBYTE EcuIntgdSwGend_CM_boolean 0 0 0.0 1.0 ECU_ADDRESS 0x4000DA4B /* @ECU_Address@WM_bPAmbAirUndEna@ */ /end MEASUREMENT
/begin MEASUREMENT WM_bErrPAmbAirUndLvl1 "Ambient Air Pressure Under Error Level 1" UBYTE EcuIntgdSwGend_CM_boolean 0 0 0.0 1.0 ECU_ADDRESS 0x4000D778 /* @ECU_Address@WM_bErrPAmbAirUndLvl1@ */ /end MEASUREMENT
/begin MEASUREMENT WM_bErrPAmbAirUndLvl2 "Ambient Air Pressure Under Error Level 2" UBYTE EcuIntgdSwGend_CM_boolean 0 0 0.0 1.0 ECU_ADDRESS 0x4000D779 /* @ECU_Address@WM_bErrPAmbAirUndLvl2@ */ /end MEASUREMENT
/begin MEASUREMENT WM_bErrPAmbAirUndLvl3 "Ambient Air Pressure Under Error Level 3" UBYTE EcuIntgdSwGend_CM_boolean 0 0 0.0 1.0 ECU_ADDRESS 0x4000D77A /* @ECU_Address@WM_bErrPAmbAirUndLvl3@ */ /end MEASUREMENT
/begin MEASUREMENT WM_bErrPAmbAirUnd "Ambient Air Pressure Under Error" UBYTE EcuIntgdSwGend_CM_boolean 0 0 0.0 1.0 ECU_ADDRESS 0x4000E0F7 /* @ECU_Address@WM_bErrPAmbAirUnd@ */ /end MEASUREMENT
/begin MEASUREMENT WM_bPAmbAirOvEna "Ambient Air Pressure Over Error Enable" UBYTE EcuIntgdSwGend_CM_boolean 0 0 0.0 1.0 ECU_ADDRESS 0x4000E184 /* @ECU_Address@WM_bPAmbAirOvEna@ */ /end MEASUREMENT
/begin MEASUREMENT WM_bErrPAmbAirOvLvl1 "Ambient Air Pressure Over Error Level 1" UBYTE EcuIntgdSwGend_CM_boolean 0 0 0.0 1.0 ECU_ADDRESS 0x4000DCBF /* @ECU_Address@WM_bErrPAmbAirOvLvl1@ */ /end MEASUREMENT
/begin MEASUREMENT WM_bErrPAmbAirOvLvl2 "Ambient Air Pressure Over Error Level 2" UBYTE EcuIntgdSwGend_CM_boolean 0 0 0.0 1.0 ECU_ADDRESS 0x4000DCC0 /* @ECU_Address@WM_bErrPAmbAirOvLvl2@ */ /end MEASUREMENT
/begin MEASUREMENT WM_bErrPAmbAirOvLvl3 "Ambient Air Pressure Over Error Level 3" UBYTE EcuIntgdSwGend_CM_boolean 0 0 0.0 1.0 ECU_ADDRESS 0x4000D7F4 /* @ECU_Address@WM_bErrPAmbAirOvLvl3@ */ /end MEASUREMENT
/begin MEASUREMENT WM_bErrPAmbAirOv "Ambient Air Pressure Over Error" UBYTE EcuIntgdSwGend_CM_boolean 0 0 0.0 1.0 ECU_ADDRESS 0x4000E1C0 /* @ECU_Address@WM_bErrPAmbAirOv@ */ /end MEASUREMENT
/begin MEASUREMENT WM_bPAirBoostUndEna "Air Boost Pressure Under Error Enable" UBYTE EcuIntgdSwGend_CM_boolean 0 0 0.0 1.0 ECU_ADDRESS 0x4000DD58 /* @ECU_Address@WM_bPAirBoostUndEna@ */ /end MEASUREMENT
/begin MEASUREMENT WM_bErrPAirBoostUndLvl1 "Air Boost Pressure Under Level 1" UBYTE EcuIntgdSwGend_CM_boolean 0 0 0.0 1.0 ECU_ADDRESS 0x4000E269 /* @ECU_Address@WM_bErrPAirBoostUndLvl1@ */ /end MEASUREMENT
/begin MEASUREMENT WM_bErrPAirBoostUndLvl2 "Air Boost Pressure Under Level 2" UBYTE EcuIntgdSwGend_CM_boolean 0 0 0.0 1.0 ECU_ADDRESS 0x4000E150 /* @ECU_Address@WM_bErrPAirBoostUndLvl2@ */ /end MEASUREMENT
/begin MEASUREMENT WM_bErrPAirBoostUndLvl3 "Air Boost Pressure Under Level 3" UBYTE EcuIntgdSwGend_CM_boolean 0 0 0.0 1.0 ECU_ADDRESS 0x4000E151 /* @ECU_Address@WM_bErrPAirBoostUndLvl3@ */ /end MEASUREMENT
/begin MEASUREMENT WM_bErrPAirBoostUnd "Air Boost Pressure Under Error" UBYTE EcuIntgdSwGend_CM_boolean 0 0 0.0 1.0 ECU_ADDRESS 0x4000DE0C /* @ECU_Address@WM_bErrPAirBoostUnd@ */ /end MEASUREMENT
/begin MEASUREMENT WM_bNEngOverThd1 "Global Enable Engine Speed Level 1" UBYTE EcuIntgdSwGend_CM_boolean 0 0 0.0 1.0 ECU_ADDRESS 0x4000D728 /* @ECU_Address@WM_bNEngOverThd1@ */ /end MEASUREMENT
/begin MEASUREMENT WM_bNEngOverThd2 "Global Enable Engine Speed Level 2" UBYTE EcuIntgdSwGend_CM_boolean 0 0 0.0 1.0 ECU_ADDRESS 0x4000D729 /* @ECU_Address@WM_bNEngOverThd2@ */ /end MEASUREMENT
/begin MEASUREMENT WM_bNEngOverThd3 "Global Enable Engine Speed Level 3" UBYTE EcuIntgdSwGend_CM_boolean 0 0 0.0 1.0 ECU_ADDRESS 0x4000D72A /* @ECU_Address@WM_bNEngOverThd3@ */ /end MEASUREMENT
/begin MEASUREMENT WM_bNEngOverThd4 "Global Enable Engine Speed Level 4" UBYTE EcuIntgdSwGend_CM_boolean 0 0 0.0 1.0 ECU_ADDRESS 0x4000D72B /* @ECU_Address@WM_bNEngOverThd4@ */ /end MEASUREMENT
/begin MEASUREMENT WM_bNEngOverThd5 "Global Enable Engine Speed Level 5" UBYTE EcuIntgdSwGend_CM_boolean 0 0 0.0 1.0 ECU_ADDRESS 0x4000D72C /* @ECU_Address@WM_bNEngOverThd5@ */ /end MEASUREMENT
/begin MEASUREMENT WM_bNEngOverThd6 "Global Enable Engine Speed Level 6" UBYTE EcuIntgdSwGend_CM_boolean 0 0 0.0 1.0 ECU_ADDRESS 0x4000D9B1 /* @ECU_Address@WM_bNEngOverThd6@ */ /end MEASUREMENT
/begin MEASUREMENT WM_bNEngOverThd7 "Global Enable Engine Speed Level 7" UBYTE EcuIntgdSwGend_CM_boolean 0 0 0.0 1.0 ECU_ADDRESS 0x4000D72E /* @ECU_Address@WM_bNEngOverThd7@ */ /end MEASUREMENT
/begin MEASUREMENT DTqC_AcvHardLimLtch "Engine Speed Hard Limit Latch Activation Flag" UBYTE EcuIntgdSwGend_CM_boolean 0 0 0.0 1.0 ECU_ADDRESS 0x4000E72C /* @ECU_Address@DTqC_AcvHardLimLtch@ */ /end MEASUREMENT
/begin MEASUREMENT CrsCtrl_bEngBrkLvl2Ena "Enable Engine Brake Level 2" UBYTE EcuIntgdSwGend_CM_boolean 0 0 0.0 1.0 ECU_ADDRESS 0x4000D780 /* @ECU_Address@CrsCtrl_bEngBrkLvl2Ena@ */ /end MEASUREMENT
/begin MEASUREMENT CrsCtrl_bEngBrkLvl1Ena "Enable Engine Brake Level 1" UBYTE EcuIntgdSwGend_CM_boolean 0 0 0.0 1.0 ECU_ADDRESS 0x4000DFF4 /* @ECU_Address@CrsCtrl_bEngBrkLvl1Ena@ */ /end MEASUREMENT
/begin COMPU_METHOD EcuIntgdSwGend_CM_single_N_m "Q = V" RAT_FUNC "%8.6" "N*m" COEFFS 0 1 0 0 0 1 /end COMPU_METHOD
/begin COMPU_METHOD EcuIntgdSwGend_CM_single_rpm "Q = V" RAT_FUNC "%8.6" "rpm" COEFFS 0 1 0 0 0 1 /end COMPU_METHOD
/begin COMPU_METHOD EcuIntgdSwGend_CM_single_degC "Q = V" RAT_FUNC "%8.6" "degC" COEFFS 0 1 0 0 0 1 /end COMPU_METHOD
/begin COMPU_METHOD EcuIntgdSwGend_CM_single "Q = V" RAT_FUNC "%8.6" "" COEFFS 0 1 0 0 0 1 /end COMPU_METHOD
/begin COMPU_METHOD EcuIntgdSwGend_CM_single__ "Q = V" RAT_FUNC "%8.6" "%" COEFFS 0 1 0 0 0 1 /end COMPU_METHOD
/begin COMPU_METHOD EcuIntgdSwGend_CM_single_ms "Q = V" RAT_FUNC "%8.6" "ms" COEFFS 0 1 0 0 0 1 /end COMPU_METHOD
/begin COMPU_METHOD EcuIntgdSwGend_CM_single_mbar "Q = V" RAT_FUNC "%8.6" "mbar" COEFFS 0 1 0 0 0 1 /end COMPU_METHOD
/begin COMPU_METHOD EcuIntgdSwGend_CM_single_bar "Q = V" RAT_FUNC "%8.6" "bar" COEFFS 0 1 0 0 0 1 /end COMPU_METHOD
/begin COMPU_METHOD EcuIntgdSwGend_CM_uint32 "Q = V" RAT_FUNC "%10.0" "" COEFFS 0 1 0 0 0 1 /end COMPU_METHOD
/begin COMPU_METHOD EcuIntgdSwGend_CM_boolean "Q = V" RAT_FUNC "%1.0" "" COEFFS 0 1 0 0 0 1 /end COMPU_METHOD
/begin GROUP S684_Air_Boost_Under_Pressure "EcuIntgdSwGend/ControlSoftware/WarnMong/Warning-Reduction-Shutdown Functions/Pressure/Air Boost Under Pressure"
 /begin REF_CHARACTERISTIC EG_Mask32Bit0_C EG_NmrInt0_C EG_NmrInt1_C EG_NmrInt2_C EG_NmrInt3_C EG_TsSw20_C EG_bFlgFalse_C EG_bFlgTrue_C WM_MaskPAirBoostUndEnaCond_P WM_MaskRTNForErrPAirBoostUnd_P WM_MaskRctnForPAirBoostUndLvl1Err_P WM_MaskRctnForPAirBoostUndLvl2Err_P WM_MaskRctnForPAirBoostUndLvl3Err_P WM_PAirBoostUndDesLvlQnty_P WM_PAirBoostUndHysDeacLvl1_P WM_PAirBoostUndHysDeacLvl2_P WM_PAirBoostUndHysDeacLvl3_P WM_PAirBoostUndLvl1_M WM_PAirBoostUndLvl2_M WM_PAirBoostUndLvl3_M WM_TiPAirBoostUndDebHi_P WM_TiPAirBoostUndDebLo_P /end REF_CHARACTERISTIC
 /begin REF_MEASUREMENT WM_MaskRctnForPAirBoostUndErr WM_bErrPAirBoostUnd WM_bErrPAirBoostUndLvl1 WM_bErrPAirBoostUndLvl2 WM_bErrPAirBoostUndLvl3 WM_bPAirBoostUndEna /end REF_MEASUREMENT
/end GROUP
/begin GROUP S684_Ambient_Air_Over_Pressure "EcuIntgdSwGend/ControlSoftware/WarnMong/Warning-Reduction-Shutdown Functions/Pressure/Ambient Air Over Pressure"
 /begin REF_CHARACTERISTIC EG_Mask32Bit0_C EG_NmrInt0_C EG_NmrInt1_C EG_NmrInt2_C EG_NmrInt3_C EG_TsSw20_C EG_bFlgFalse_C EG_bFlgTrue_C WM_MaskPAmbAirOvEnaCond_P WM_MaskRTNForErrPAmbAirOv_P WM_MaskRctnForPAmbAirOvLvl1Err_P WM_MaskRctnForPAmbAirOvLvl2Err_P WM_MaskRctnForPAmbAirOvLvl3Err_P WM_PAmbAirOvDesLvlQnty_P WM_PAmbAirOvHysDeacLvl1_P WM_PAmbAirOvHysDeacLvl2_P WM_PAmbAirOvHysDeacLvl3_P WM_PAmbAirOvLvl1_M WM_PAmbAirOvLvl2_M WM_PAmbAirOvLvl3_M WM_TiPAmbAirOvDebHi_P WM_TiPAmbAirOvDebLo_P /end REF_CHARACTERISTIC
 /begin REF_MEASUREMENT WM_MaskRctnForPAmbAirOvErr WM_bErrPAmbAirOv WM_bErrPAmbAirOvLvl1 WM_bErrPAmbAirOvLvl2 WM_bErrPAmbAirOvLvl3 WM_bPAmbAirOvEna /end REF_MEASUREMENT
/end GROUP
/begin GROUP S684_Ambient_Air_Under_Pressure "EcuIntgdSwGend/ControlSoftware/WarnMong/Warning-Reduction-Shutdown Functions/Pressure/Ambient Air Under Pressure"
 /begin REF_CHARACTERISTIC EG_Mask32Bit0_C EG_NmrInt0_C EG_NmrInt1_C EG_NmrInt2_C EG_NmrInt3_C EG_TsSw20_C EG_bFlgFalse_C EG_bFlgTrue_C WM_MaskPAmbAirUndEnaCond_P WM_MaskRTNForErrPAmbAirUnd_P WM_MaskRctnForPAmbAirUndLvl1Err_P WM_MaskRctnForPAmbAirUndLvl2Err_P WM_MaskRctnForPAmbAirUndLvl3Err_P WM_PAmbAirUndDesLvlQnty_P WM_PAmbAirUndHysDeacLvl1_P WM_PAmbAirUndHysDeacLvl2_P WM_PAmbAirUndHysDeacLvl3_P WM_PAmbAirUndLvl1_M WM_PAmbAirUndLvl2_M WM_PAmbAirUndLvl3_M WM_TiPAmbAirUndDebHi_P WM_TiPAmbAirUndDebLo_P /end REF_CHARACTERISTIC
 /begin REF_MEASUREMENT WM_MaskRctnForPAmbAirUndErr WM_bErrPAmbAirUnd WM_bErrPAmbAirUndLvl1 WM_bErrPAmbAirUndLvl2 WM_bErrPAmbAirUndLvl3 WM_bPAmbAirUndEna /end REF_MEASUREMENT
/end GROUP
/begin GROUP S684_Fuel_Over_Pressure "EcuIntgdSwGend/ControlSoftware/WarnMong/Warning-Reduction-Shutdown Functions/Pressure/Fuel Over Pressure"
 /begin REF_CHARACTERISTIC EG_Mask32Bit0_C EG_NmrInt0_C EG_NmrInt1_C EG_NmrInt2_C EG_NmrInt3_C EG_TsSw20_C EG_bFlgFalse_C EG_bFlgTrue_C WM_MaskPFuOvEnaCond_P WM_MaskRTNForErrPFuOv_P WM_MaskRctnForPFuOvLvl1Err_P WM_MaskRctnForPFuOvLvl2Err_P WM_MaskRctnForPFuOvLvl3Err_P WM_PFuOvDesLvlQnty_P WM_PFuOvHysDeacLvl1_P WM_PFuOvHysDeacLvl2_P WM_PFuOvHysDeacLvl3_P WM_PFuOvLvl1_M WM_PFuOvLvl2_M WM_PFuOvLvl3_M WM_TiPFuOvDebHi_P WM_TiPFuOvDebLo_P /end REF_CHARACTERISTIC
 /begin REF_MEASUREMENT WM_MaskRctnForPFuOvErr WM_bErrPFuOv WM_bErrPFuOvLvl1 WM_bErrPFuOvLvl2 WM_bErrPFuOvLvl3 WM_bPFuOvEna /end REF_MEASUREMENT
/end GROUP
/begin GROUP S684_Fuel_Under_Pressure "EcuIntgdSwGend/ControlSoftware/WarnMong/Warning-Reduction-Shutdown Functions/Pressure/Fuel Under Pressure"
 /begin REF_CHARACTERISTIC EG_Mask32Bit0_C EG_NmrInt0_C EG_NmrInt1_C EG_NmrInt2_C EG_NmrInt3_C EG_TsSw20_C EG_bFlgFalse_C EG_bFlgTrue_C WM_MaskPFuUndEnaCond_P WM_MaskRTNForErrPFuUnd_P WM_MaskRctnForPFuUndLvl1Err_P WM_MaskRctnForPFuUndLvl2Err_P WM_MaskRctnForPFuUndLvl3Err_P WM_PFuUndDesLvlQnty_P WM_PFuUndHysDeacLvl1_P WM_PFuUndHysDeacLvl2_P WM_PFuUndHysDeacLvl3_P WM_PFuUndLvl1_M WM_PFuUndLvl2_M WM_PFuUndLvl3_M WM_TiPFuUndDebHi_P WM_TiPFuUndDebLo_P /end REF_CHARACTERISTIC
 /begin REF_MEASUREMENT WM_MaskRctnForPFuUndErr WM_bErrPFuUnd WM_bErrPFuUndLvl1 WM_bErrPFuUndLvl2 WM_bErrPFuUndLvl3 WM_bPFuUndEna /end REF_MEASUREMENT
/end GROUP
/begin GROUP S684_Oil_Over_Pressure "EcuIntgdSwGend/ControlSoftware/WarnMong/Warning-Reduction-Shutdown Functions/Pressure/Oil Over Pressure"
 /begin REF_CHARACTERISTIC EG_Mask32Bit0_C EG_NmrInt0_C EG_NmrInt1_C EG_NmrInt2_C EG_NmrInt3_C EG_TsSw20_C EG_bFlgFalse_C EG_bFlgTrue_C WM_MaskPOilOvEnaCond_P WM_MaskRTNForErrPOilOv_P WM_MaskRctnForPOilOvLvl1Err_P WM_MaskRctnForPOilOvLvl2Err_P WM_MaskRctnForPOilOvLvl3Err_P WM_POilOvDesLvlQnty_P WM_POilOvHysDeacLvl1_P WM_POilOvHysDeacLvl2_P WM_POilOvHysDeacLvl3_P WM_POilOvLvl1_M WM_POilOvLvl2_M WM_POilOvLvl3_M WM_TiPOilOvDebHi_P WM_TiPOilOvDebLo_P /end REF_CHARACTERISTIC
 /begin REF_MEASUREMENT WM_MaskRctnForPOilOvErr WM_bErrPOilOv WM_bErrPOilOvLvl1 WM_bErrPOilOvLvl2 WM_bErrPOilOvLvl3 WM_bPOilOvEna /end REF_MEASUREMENT
/end GROUP
/begin GROUP S684_Oil_Under_Pressure "EcuIntgdSwGend/ControlSoftware/WarnMong/Warning-Reduction-Shutdown Functions/Pressure/Oil Under Pressure"
 /begin REF_CHARACTERISTIC EG_Mask32Bit0_C EG_NmrInt0_C EG_NmrInt1_C EG_NmrInt2_C EG_NmrInt3_C EG_TsSw20_C EG_bFlgFalse_C EG_bFlgTrue_C WM_MaskPOilUndEnaCond_P WM_MaskRTNForErrPOilUnd_P WM_MaskRctnForPOilUndLvl1Err_P WM_MaskRctnForPOilUndLvl2Err_P WM_MaskRctnForPOilUndLvl3Err_P WM_POilUndDesLvlQnty_P WM_POilUndHysDeacLvl1_P WM_POilUndHysDeacLvl2_P WM_POilUndHysDeacLvl3_P WM_POilUndLvl1_M WM_POilUndLvl2_M WM_POilUndLvl3_M WM_TiPOilUndDebHi_P WM_TiPOilUndDebLo_P /end REF_CHARACTERISTIC
 /begin REF_MEASUREMENT WM_MaskRctnForPOilUndErr WM_bErrPOilUnd WM_bErrPOilUndLvl1 WM_bErrPOilUndLvl2 WM_bErrPOilUndLvl3 WM_bPOilUndEna /end REF_MEASUREMENT
/end GROUP
/begin GROUP S684_Rail_Over_Pressure "EcuIntgdSwGend/ControlSoftware/WarnMong/Warning-Reduction-Shutdown Functions/Pressure/Rail Over Pressure" /begin SUB_GROUP S710_High_Fuel_System_Message /end SUB_GROUP
 /begin REF_CHARACTERISTIC EG_Mask32Bit0_C EG_NmrInt0_C EG_NmrInt1_C EG_NmrInt2_C EG_NmrInt3_C EG_TsSw20_C EG_bFlgFalse_C EG_bFlgTrue_C WM_MaskPRailOvEnaCond_P WM_MaskRTNForErrPRailOv_P WM_MaskRctnForPRailOvLvl1Err_P WM_MaskRctnForPRailOvLvl2Err_P WM_MaskRctnForPRailOvLvl3Err_P WM_PRailOvDesLvlQnty_P WM_PRailOvHysDeacLvl1_P WM_PRailOvHysDeacLvl2_P WM_PRailOvHysDeacLvl3_P WM_PRailOvLvl1_M WM_PRailOvLvl2_M WM_PRailOvLvl3_M WM_TiPRailOvDebHi_P WM_TiPRailOvDebLo_P /end REF_CHARACTERISTIC
 /begin REF_MEASUREMENT WM_MaskRctnForPRailOvErr WM_bErrPRailOv WM_bErrPRailOvLvl1 WM_bErrPRailOvLvl2 WM_bErrPRailOvLvl3 WM_bPRailOvEna /end REF_MEASUREMENT
/end GROUP
/begin GROUP S684_Rail_Under_Pressure "EcuIntgdSwGend/ControlSoftware/WarnMong/Warning-Reduction-Shutdown Functions/Pressure/Rail Under Pressure" /begin SUB_GROUP S711_Low_and_Not_Control_Fuel_System_Message /end SUB_GROUP
 /begin REF_CHARACTERISTIC EG_Mask32Bit0_C EG_NmrInt0_C EG_NmrInt1_C EG_NmrInt2_C EG_NmrInt3_C EG_TsSw20_C EG_bFlgFalse_C EG_bFlgTrue_C WM_MaskPRailUndEnaCond_P WM_MaskRTNForErrPRailUnd_P WM_MaskRctnForPRailUndLvl1Err_P WM_MaskRctnForPRailUndLvl2Err_P WM_MaskRctnForPRailUndLvl3Err_P WM_PRailUndDesLvlQnty_P WM_PRailUndHysDeacLvl1_P WM_PRailUndHysDeacLvl2_P WM_PRailUndHysDeacLvl3_P WM_PRailUndLvl1_M WM_PRailUndLvl2_M WM_PRailUndLvl3_M WM_TiPRailUndDebHi_P WM_TiPRailUndDebLo_P /end REF_CHARACTERISTIC
 /begin REF_MEASUREMENT WM_MaskRctnForPRailUndErr WM_bErrPRailUnd WM_bErrPRailUndLvl1 WM_bErrPRailUndLvl2 WM_bErrPRailUndLvl3 WM_bPRailUndEna /end REF_MEASUREMENT
/end GROUP
/begin GROUP S685_Bit_Extract "EcuIntgdSwGend/ControlSoftware/WarnMong/Warning-Reduction-Shutdown Functions/Reaction/Bit Extract" /begin SUB_GROUP S728_BitwiseANDMask S728_BitwiseANDMask4 /end SUB_GROUP
 /begin REF_CHARACTERISTIC WM_MaskRctnAmberWarn_C WM_MaskRctnEngRednLvl1_C WM_MaskRctnEngRednLvl2_C WM_MaskRctnEngShtdwnWarn_C WM_MaskRctnEngShtdwn_C WM_MaskRctnLimp_C /end REF_CHARACTERISTIC
 /begin REF_MEASUREMENT WM_bAcvEmgcyShtdwn WM_bAcvLimp WM_bAcvRednLvl1 WM_bAcvRednLvl2 /end REF_MEASUREMENT
/end GROUP
/begin GROUP S685_Error_List "EcuIntgdSwGend/ControlSoftware/WarnMong/Warning-Reduction-Shutdown Functions/Reaction/Error List"
 /begin SUB_GROUP S729_Error_Combinations S729_TC1 S729_TC2 S729_TC3 S729_TC4 /end SUB_GROUP
 /begin REF_CHARACTERISTIC EG_NmrInt0_C EG_NmrInt1_C EG_bFlgFalse_C /end REF_CHARACTERISTIC
/end GROUP
/begin GROUP S685_SetResetFaultReaction "EcuIntgdSwGend/ControlSoftware/WarnMong/Warning-Reduction-Shutdown Functions/Reaction/SetResetFaultReaction" /begin SUB_GROUP S730_SetRstLtch /end SUB_GROUP /begin REF_CHARACTERISTIC EG_Mask32Bit0_C /end REF_CHARACTERISTIC /end GROUP
/begin GROUP S685_SetResetFaultReaction24 "EcuIntgdSwGend/ControlSoftware/WarnMong/Warning-Reduction-Shutdown Functions/Reaction/SetResetFaultReaction24" /begin SUB_GROUP S731_SetRstLtch /end SUB_GROUP /begin REF_CHARACTERISTIC EG_Mask32Bit0_C /end REF_CHARACTERISTIC /end GROUP
/begin GROUP S685_SetResetFaultReaction25 "EcuIntgdSwGend/ControlSoftware/WarnMong/Warning-Reduction-Shutdown Functions/Reaction/SetResetFaultReaction25" /begin SUB_GROUP S732_SetRstLtch /end SUB_GROUP /begin REF_CHARACTERISTIC EG_Mask32Bit0_C /end REF_CHARACTERISTIC /end GROUP
/begin GROUP S685_SetResetFaultReaction26 "EcuIntgdSwGend/ControlSoftware/WarnMong/Warning-Reduction-Shutdown Functions/Reaction/SetResetFaultReaction26" /begin SUB_GROUP S733_SetRstLtch /end SUB_GROUP /begin REF_CHARACTERISTIC EG_Mask32Bit0_C /end REF_CHARACTERISTIC /end GROUP
/begin GROUP S685_SetResetFaultReaction27 "EcuIntgdSwGend/ControlSoftware/WarnMong/Warning-Reduction-Shutdown Functions/Reaction/SetResetFaultReaction27" /begin SUB_GROUP S734_SetRstLtch /end SUB_GROUP /begin REF_CHARACTERISTIC EG_Mask32Bit0_C /end REF_CHARACTERISTIC /end GROUP
/begin GROUP S685_Warning_Monitoring_Diagnostic_Info "EcuIntgdSwGend/ControlSoftware/WarnMong/Warning-Reduction-Shutdown Functions/Reaction/Warning Monitoring Diagnostic Info"
 /begin REF_CHARACTERISTIC EG_DiagcSnsrFltInfoNone_C EG_DiagcSnsrFltInfoNotCtldMsg_C EG_DiagcSnsrFltInfoOv_C EG_DiagcSnsrFltInfoUnd_C EG_DiagcSnsrInfoCamCrankDfct_C EG_DiagcSnsrInfoCylMisf_C EG_DiagcSnsrInfoInjrDfct_C EG_DiagcSnsrInfoOvspd_C EG_DiagcSnsrInfoPAirBoost_C EG_DiagcSnsrInfoPAmbAir_C EG_DiagcSnsrInfoPFu_C EG_DiagcSnsrInfoPOil_C EG_DiagcSnsrInfoPRail_C EG_DiagcSnsrInfoTAirBoost_C EG_DiagcSnsrInfoTAmbAir_C EG_DiagcSnsrInfoTCoolt_C EG_DiagcSnsrInfoTEcu_C EG_DiagcSnsrInfoTFu_C EG_DiagcSnsrInfoTOil_C EG_DiagcSnsrInfoUClmp30_C /end REF_CHARACTERISTIC
/end GROUP
/begin GROUP S686_Debouncer "EcuIntgdSwGend/ControlSoftware/WarnMong/Warning-Reduction-Shutdown Functions/Return To Normal/Debouncer" /begin REF_MEASUREMENT WM_TiElpdNEngDetdThdRTN WM_bNEngOverThdRTN /end REF_MEASUREMENT /end GROUP
/begin GROUP S687_Air_Boost_Over_Temperature "EcuIntgdSwGend/ControlSoftware/WarnMong/Warning-Reduction-Shutdown Functions/Temperature/Air Boost Over Temperature"
 /begin REF_CHARACTERISTIC EG_Mask32Bit0_C EG_NmrInt0_C EG_NmrInt1_C EG_NmrInt2_C EG_NmrInt3_C EG_TsSw20_C EG_bFlgFalse_C EG_bFlgTrue_C WM_MaskRTNForErrTAirBoostOv_P WM_MaskRctnForTAirBoostOvLvl1Err_P WM_MaskRctnForTAirBoostOvLvl2Err_P WM_MaskRctnForTAirBoostOvLvl3Err_P WM_MaskTAirBoostOvEnaCond_P WM_TAirBoostOvDesLvlQnty_P WM_TAirBoostOvHysDeacLvl1_P WM_TAirBoostOvHysDeacLvl2_P WM_TAirBoostOvHysDeacLvl3_P WM_TAirBoostOvLvl1_M WM_TAirBoostOvLvl2_M WM_TAirBoostOvLvl3_M WM_TiTAirBoostOvDebHi_P WM_TiTAirBoostOvDebLo_P /end REF_CHARACTERISTIC
 /begin REF_MEASUREMENT WM_MaskRctnForTAirBoostOvErr WM_bErrTAirBoostOv WM_bErrTAirBoostOvLvl1 WM_bErrTAirBoostOvLvl2 WM_bErrTAirBoostOvLvl3 WM_bTAirBoostOvEna /end REF_MEASUREMENT
/end GROUP
/begin GROUP S687_Air_Boost_Under_Temperature "EcuIntgdSwGend/ControlSoftware/WarnMong/Warning-Reduction-Shutdown Functions/Temperature/Air Boost Under Temperature"
 /begin REF_CHARACTERISTIC EG_Mask32Bit0_C EG_NmrInt0_C EG_NmrInt1_C EG_NmrInt2_C EG_NmrInt3_C EG_TsSw20_C EG_bFlgFalse_C EG_bFlgTrue_C WM_MaskRTNForErrTAirBoostUnd_P WM_MaskRctnForTAirBoostUndLvl1Err_P WM_MaskRctnForTAirBoostUndLvl2Err_P WM_MaskRctnForTAirBoostUndLvl3Err_P WM_MaskTAirBoostUndEnaCond_P WM_TAirBoostUndDesLvlQnty_P WM_TAirBoostUndHysDeacLvl1_P WM_TAirBoostUndHysDeacLvl2_P WM_TAirBoostUndHysDeacLvl3_P WM_TAirBoostUndLvl1_M WM_TAirBoostUndLvl2_M WM_TAirBoostUndLvl3_M WM_TiTAirBoostUndDebHi_P WM_TiTAirBoostUndDebLo_P /end REF_CHARACTERISTIC
 /begin REF_MEASUREMENT WM_MaskRctnForTAirBoostUndErr WM_bErrTAirBoostUnd WM_bErrTAirBoostUndLvl1 WM_bErrTAirBoostUndLvl2 WM_bErrTAirBoostUndLvl3 WM_bTAirBoostUndEna /end REF_MEASUREMENT
/end GROUP
/begin GROUP S687_Ambient_Air_Over_Temperature "EcuIntgdSwGend/ControlSoftware/WarnMong/Warning-Reduction-Shutdown Functions/Temperature/Ambient Air Over Temperature"
 /begin REF_CHARACTERISTIC EG_Mask32Bit0_C EG_NmrInt0_C EG_NmrInt1_C EG_NmrInt2_C EG_NmrInt3_C EG_TsSw20_C EG_bFlgFalse_C EG_bFlgTrue_C WM_MaskRTNForErrTAmbAirOv_P WM_MaskRctnForTAmbAirOvLvl1Err_P WM_MaskRctnForTAmbAirOvLvl2Err_P WM_MaskRctnForTAmbAirOvLvl3Err_P WM_MaskTAmbAirOvEnaCond_P WM_TAmbAirOvDesLvlQnty_P WM_TAmbAirOvHysDeacLvl1_P WM_TAmbAirOvHysDeacLvl2_P WM_TAmbAirOvHysDeacLvl3_P WM_TAmbAirOvLvl1_M WM_TAmbAirOvLvl2_M WM_TAmbAirOvLvl3_M WM_TiTAmbAirOvDebHi_P WM_TiTAmbAirOvDebLo_P /end REF_CHARACTERISTIC
 /begin REF_MEASUREMENT WM_MaskRctnForTAmbAirOvErr WM_bErrTAmbAirOv WM_bErrTAmbAirOvLvl1 WM_bErrTAmbAirOvLvl2 WM_bErrTAmbAirOvLvl3 WM_bTAmbAirOvEna /end REF_MEASUREMENT
/end GROUP
/begin GROUP S687_Ambient_Air_Under_Temperature "EcuIntgdSwGend/ControlSoftware/WarnMong/Warning-Reduction-Shutdown Functions/Temperature/Ambient Air Under Temperature"
 /begin REF_CHARACTERISTIC EG_Mask32Bit0_C EG_NmrInt0_C EG_NmrInt1_C EG_NmrInt2_C EG_NmrInt3_C EG_TsSw20_C EG_bFlgFalse_C EG_bFlgTrue_C WM_MaskRTNForErrTAmbAirUnd_P WM_MaskRctnForTAmbAirUndLvl1Err_P WM_MaskRctnForTAmbAirUndLvl2Err_P WM_MaskRctnForTAmbAirUndLvl3Err_P WM_MaskTAmbAirUndEnaCond_P WM_TAmbAirUndDesLvlQnty_P WM_TAmbAirUndHysDeacLvl1_P WM_TAmbAirUndHysDeacLvl2_P WM_TAmbAirUndHysDeacLvl3_P WM_TAmbAirUndLvl1_M WM_TAmbAirUndLvl2_M WM_TAmbAirUndLvl3_M WM_TiTAmbAirUndDebHi_P WM_TiTAmbAirUndDebLo_P /end REF_CHARACTERISTIC
 /begin REF_MEASUREMENT WM_MaskRctnForTAmbAirUndErr WM_bErrTAmbAirUnd WM_bErrTAmbAirUndLvl1 WM_bErrTAmbAirUndLvl2 WM_bErrTAmbAirUndLvl3 WM_bTAmbAirUndEna /end REF_MEASUREMENT
/end GROUP
/begin GROUP S687_Coolant_Over_Temperature "EcuIntgdSwGend/ControlSoftware/WarnMong/Warning-Reduction-Shutdown Functions/Temperature/Coolant Over Temperature"
 /begin REF_CHARACTERISTIC EG_Mask32Bit0_C EG_NmrInt0_C EG_NmrInt1_C EG_NmrInt2_C EG_NmrInt3_C EG_TsSw20_C EG_bFlgFalse_C EG_bFlgTrue_C WM_MaskRTNForErrTCooltOv_P WM_MaskRctnForTCooltOvLvl1Err_P WM_MaskRctnForTCooltOvLvl2Err_P WM_MaskRctnForTCooltOvLvl3Err_P WM_MaskTCooltOvEnaCond_P WM_TCooltOvDesLvlQnty_P WM_TCooltOvHysDeacLvl1_P WM_TCooltOvHysDeacLvl2_P WM_TCooltOvHysDeacLvl3_P WM_TCooltOvLvl1_M WM_TCooltOvLvl2_M WM_TCooltOvLvl3_M WM_TiTCooltOvDebHi_P WM_TiTCooltOvDebLo_P /end REF_CHARACTERISTIC
 /begin REF_MEASUREMENT WM_MaskRctnForTCooltOvErr WM_bErrTCooltOv WM_bErrTCooltOvLvl1 WM_bErrTCooltOvLvl2 WM_bErrTCooltOvLvl3 WM_bTCooltOvEna /end REF_MEASUREMENT
/end GROUP
/begin GROUP S687_Coolant_Under_Temperature "EcuIntgdSwGend/ControlSoftware/WarnMong/Warning-Reduction-Shutdown Functions/Temperature/Coolant Under Temperature"
 /begin REF_CHARACTERISTIC EG_Mask32Bit0_C EG_NmrInt0_C EG_NmrInt1_C EG_NmrInt2_C EG_NmrInt3_C EG_TsSw20_C EG_bFlgFalse_C EG_bFlgTrue_C WM_MaskRTNForErrTCooltUnd_P WM_MaskRctnForTCooltUndLvl1Err_P WM_MaskRctnForTCooltUndLvl2Err_P WM_MaskRctnForTCooltUndLvl3Err_P WM_MaskTCooltUndEnaCond_P WM_TCooltUndDesLvlQnty_P WM_TCooltUndHysDeacLvl1_P WM_TCooltUndHysDeacLvl2_P WM_TCooltUndHysDeacLvl3_P WM_TCooltUndLvl1_M WM_TCooltUndLvl2_M WM_TCooltUndLvl3_M WM_TiTCooltUndDebHi_P WM_TiTCooltUndDebLo_P /end REF_CHARACTERISTIC
 /begin REF_MEASUREMENT WM_MaskRctnForTCooltUndErr WM_bErrTCooltUnd WM_bErrTCooltUndLvl1 WM_bErrTCooltUndLvl2 WM_bErrTCooltUndLvl3 WM_bTCooltUndEna /end REF_MEASUREMENT
/end GROUP
/begin GROUP S687_ECU_Temperature "EcuIntgdSwGend/ControlSoftware/WarnMong/Warning-Reduction-Shutdown Functions/Temperature/ECU Temperature"
 /begin REF_CHARACTERISTIC EG_Mask32Bit0_C EG_NmrInt0_C EG_NmrInt1_C EG_NmrInt2_C EG_NmrInt3_C EG_TsSw20_C EG_bFlgFalse_C EG_bFlgTrue_C WM_MaskRTNForErrTEcu_P WM_MaskRctnForTEcuLvl1Err_P WM_MaskRctnForTEcuLvl2Err_P WM_MaskRctnForTEcuLvl3Err_P WM_MaskTEcuEnaCond_P WM_TEcuDesLvlQnty_P WM_TEcuHysDeacLvl1_P WM_TEcuHysDeacLvl2_P WM_TEcuHysDeacLvl3_P WM_TEcuLvl1_P WM_TEcuLvl2_P WM_TEcuLvl3_P WM_TiTEcuDebHi_P WM_TiTEcuDebLo_P /end REF_CHARACTERISTIC
 /begin REF_MEASUREMENT WM_MaskRctnForTEcuErr WM_bErrTEcu WM_bErrTEcuLvl1 WM_bErrTEcuLvl2 WM_bErrTEcuLvl3 WM_bTEcuEna /end REF_MEASUREMENT
/end GROUP
/begin GROUP S687_Fuel_Over_Temperature "EcuIntgdSwGend/ControlSoftware/WarnMong/Warning-Reduction-Shutdown Functions/Temperature/Fuel Over Temperature"
 /begin REF_CHARACTERISTIC EG_Mask32Bit0_C EG_NmrInt0_C EG_NmrInt1_C EG_NmrInt2_C EG_NmrInt3_C EG_TsSw20_C EG_bFlgFalse_C EG_bFlgTrue_C WM_MaskRTNForErrTFuOv_P WM_MaskRctnForTFuOvLvl1Err_P WM_MaskRctnForTFuOvLvl2Err_P WM_MaskRctnForTFuOvLvl3Err_P WM_MaskTFuOvEnaCond_P WM_TFuOvDesLvlQnty_P WM_TFuOvHysDeacLvl1_P WM_TFuOvHysDeacLvl2_P WM_TFuOvHysDeacLvl3_P WM_TFuOvLvl1_M WM_TFuOvLvl2_M WM_TFuOvLvl3_M WM_TiTFuOvDebHi_P WM_TiTFuOvDebLo_P /end REF_CHARACTERISTIC
 /begin REF_MEASUREMENT WM_MaskRctnForTFuOvErr WM_bErrTFuOv WM_bErrTFuOvLvl1 WM_bErrTFuOvLvl2 WM_bErrTFuOvLvl3 WM_bTFuOvEna /end REF_MEASUREMENT
/end GROUP
/begin GROUP S687_Oil_Over_Temperature "EcuIntgdSwGend/ControlSoftware/WarnMong/Warning-Reduction-Shutdown Functions/Temperature/Oil Over Temperature"
 /begin REF_CHARACTERISTIC EG_Mask32Bit0_C EG_NmrInt0_C EG_NmrInt1_C EG_NmrInt2_C EG_NmrInt3_C EG_TsSw20_C EG_bFlgFalse_C EG_bFlgTrue_C WM_MaskRTNForErrTOilOv_P WM_MaskRctnForTOilOvLvl1Err_P WM_MaskRctnForTOilOvLvl2Err_P WM_MaskRctnForTOilOvLvl3Err_P WM_MaskTOilOvEnaCond_P WM_TOilOvDesLvlQnty_P WM_TOilOvHysDeacLvl1_P WM_TOilOvHysDeacLvl2_P WM_TOilOvHysDeacLvl3_P WM_TOilOvLvl1_M WM_TOilOvLvl2_M WM_TOilOvLvl3_M WM_TiTOilOvDebHi_P WM_TiTOilOvDebLo_P /end REF_CHARACTERISTIC
 /begin REF_MEASUREMENT WM_MaskRctnForTOilOvErr WM_bErrTOilOv WM_bErrTOilOvLvl1 WM_bErrTOilOvLvl2 WM_bErrTOilOvLvl3 WM_bTOilOvEna /end REF_MEASUREMENT
/end GROUP
/begin GROUP S687_Oil_Under_Temperature "EcuIntgdSwGend/ControlSoftware/WarnMong/Warning-Reduction-Shutdown Functions/Temperature/Oil Under Temperature"
 /begin REF_CHARACTERISTIC EG_Mask32Bit0_C EG_NmrInt0_C EG_NmrInt1_C EG_NmrInt2_C EG_NmrInt3_C EG_TsSw20_C EG_bFlgFalse_C EG_bFlgTrue_C WM_MaskRTNForErrTOilUnd_P WM_MaskRctnForTOilUndLvl1Err_P WM_MaskRctnForTOilUndLvl2Err_P WM_MaskRctnForTOilUndLvl3Err_P WM_MaskTOilUndEnaCond_P WM_TOilUndDesLvlQnty_P WM_TOilUndHysDeacLvl1_P WM_TOilUndHysDeacLvl2_P WM_TOilUndHysDeacLvl3_P WM_TOilUndLvl1_M WM_TOilUndLvl2_M WM_TOilUndLvl3_M WM_TiTOilUndDebHi_P WM_TiTOilUndDebLo_P /end REF_CHARACTERISTIC
 /begin REF_MEASUREMENT WM_MaskRctnForTOilUndErr WM_bErrTOilUnd WM_bErrTOilUndLvl1 WM_bErrTOilUndLvl2 WM_bErrTOilUndLvl3 WM_bTOilUndEna /end REF_MEASUREMENT
/end GROUP
/begin GROUP S843_avoidzerodivision_max "EcuIntgdSwGend/ControlSoftware/WgtCtl/TurbochargerSpeedEstimation/AirMassFlowCalc/avoidzerodivision_max" /begin REF_CHARACTERISTIC EG_NmrIntEps_C /end REF_CHARACTERISTIC /begin REF_MEASUREMENT WgC_AirMassFlowCalcZeroDiv /end REF_MEASUREMENT /end GROUP
/begin GROUP S847_avoidzerodivision_single "EcuIntgdSwGend/ControlSoftware/WgtCtl/TurbochargerSpeedEstimation/CompressorPressureRatio/avoidzerodivision_single" /begin REF_CHARACTERISTIC EG_NmrSng0_C EG_NmrSng1_C /end REF_CHARACTERISTIC /end GROUP
/begin GROUP S854_PID_Controller "EcuIntgdSwGend/ControlSoftware/WgtCtl/Wastegate Control/BoostPressurePID/PID_Controller" /begin SUB_GROUP S857_clamping_unit /end SUB_GROUP /begin REF_CHARACTERISTIC EG_NmrInt0_C /end REF_CHARACTERISTIC
 /begin REF_MEASUREMENT WgC_CoeffKdFbOut WgC_CoeffKdOut WgC_CoeffKiClampOut WgC_CoeffKiClampPreSatOut WgC_CoeffKiClampSwtchOut WgC_CoeffKiOut WgC_CoeffKpOut WgC_DutyWgtVlvPID /end REF_MEASUREMENT
/end GROUP
/begin GROUP S27_clamping_unit "EcuIntgdSwGend/ControlSoftware/CrsCtrl/CruiseControl/CruiseControlPIDController/PID_Controller/clamping_unit" /begin SUB_GROUP S28_deadzone /end SUB_GROUP /begin REF_CHARACTERISTIC EG_NmrSng0_C /end REF_CHARACTERISTIC /end GROUP
/begin GROUP S32_Debouncer2 "EcuIntgdSwGend/ControlSoftware/CrsCtrl/Engine Brake Activation via Cruise Control/Engine Brake Level Activation Condition/Engine Brake Level 1 Activation Condition/Debouncer2" /begin REF_MEASUREMENT CrsCtrl_TiElpdEngBrkLvl1Actvn /end REF_MEASUREMENT /end GROUP
/begin GROUP S32_SetRstLtch "EcuIntgdSwGend/ControlSoftware/CrsCtrl/Engine Brake Activation via Cruise Control/Engine Brake Level Activation Condition/Engine Brake Level 1 Activation Condition/SetRstLtch" /begin REF_CHARACTERISTIC EG_bFlgFalse_C EG_bFlgTrue_C /end REF_CHARACTERISTIC /begin REF_MEASUREMENT CrsCtrl_bEngBrkLvl1Ena /end REF_MEASUREMENT /end GROUP
/begin GROUP S33_Debouncer "EcuIntgdSwGend/ControlSoftware/CrsCtrl/Engine Brake Activation via Cruise Control/Engine Brake Level Activation Condition/Engine Brake Level 2 Activation Condition/Debouncer" /begin REF_MEASUREMENT CrsCtrl_TiElpdEngBrkLvl2Actvn /end REF_MEASUREMENT /end GROUP
/begin GROUP S33_SetRstLtch3 "EcuIntgdSwGend/ControlSoftware/CrsCtrl/Engine Brake Activation via Cruise Control/Engine Brake Level Activation Condition/Engine Brake Level 2 Activation Condition/SetRstLtch3" /begin REF_CHARACTERISTIC EG_bFlgFalse_C EG_bFlgTrue_C /end REF_CHARACTERISTIC /begin REF_MEASUREMENT CrsCtrl_bEngBrkLvl2Ena /end REF_MEASUREMENT /end GROUP
/begin GROUP S55_Anti_Jerk_Algorithm "EcuIntgdSwGend/ControlSoftware/DesTqClcn/Running Mode/Driver Demand Torque Calculation/N-Map Interpolation for Brake Torque/Anti-Jerk Algorithm"
 /begin REF_CHARACTERISTIC DTqC_DynRateLoLim_P DTqC_DynRateUpLim_P DTqC_bAcvRateLimOvs_P /end REF_CHARACTERISTIC
 /begin REF_MEASUREMENT DTqC_DynRateLimr DTqC_TqCtlTqBrk /end REF_MEASUREMENT
/end GROUP
/begin GROUP S55_avoidzerodivision_single "EcuIntgdSwGend/ControlSoftware/DesTqClcn/Running Mode/Driver Demand Torque Calculation/N-Map Interpolation for Brake Torque/avoidzerodivision_single" /begin REF_CHARACTERISTIC EG_NmrSng0_C EG_NmrSng1_C /end REF_CHARACTERISTIC /end GROUP
/begin GROUP S55_avoidzerodivision_single1 "EcuIntgdSwGend/ControlSoftware/DesTqClcn/Running Mode/Driver Demand Torque Calculation/N-Map Interpolation for Brake Torque/avoidzerodivision_single1" /begin REF_CHARACTERISTIC EG_NmrSng0_C EG_NmrSng1_C /end REF_CHARACTERISTIC /end GROUP
/begin GROUP S63_PID_Controller "EcuIntgdSwGend/ControlSoftware/DesTqClcn/Running Mode/EndSpeed Governor/EndSpeed Soft Limit Governor/PID_Controller" /begin SUB_GROUP S66_clamping_unit /end SUB_GROUP /begin REF_CHARACTERISTIC EG_NmrSng0_C /end REF_CHARACTERISTIC
 /begin REF_MEASUREMENT DTqC_CoeffKdFbOutEndSpd DTqC_CoeffKdOutEndSpd DTqC_CoeffKiClampOutEndSpd DTqC_CoeffKiClampPreSatOutEndSpd DTqC_CoeffKiClampSwtchOutEndSpd DTqC_CoeffKiOutEndSpd DTqC_CoeffKpOutEndSpd DTqC_TqSoftLimPID /end REF_MEASUREMENT
/end GROUP
/begin GROUP S64_Hard_Limit_Latching "EcuIntgdSwGend/ControlSoftware/DesTqClcn/Running Mode/EndSpeed Governor/Engine Speed Hysteresis for Hard Limitation/Hard Limit Latching" /begin SUB_GROUP S69_CompTimer_Strt S69_Neg_Edge S69_Pos_Edge /end SUB_GROUP
 /begin REF_CHARACTERISTIC DTqC_AcvHardLimLtchOvs_P DTqC_AcvHardLimLtchOvv_P DTqC_TiMaxAcvHardLimLtch_P EG_NmrSng0_C EG_TsSw_C /end REF_CHARACTERISTIC
 /begin REF_MEASUREMENT DTqC_AcvHardLimLtch /end REF_MEASUREMENT
/end GROUP
/begin GROUP S74_clamping_unit "EcuIntgdSwGend/ControlSoftware/DesTqClcn/Running Mode/Idle Speed Controller/PID_Controller1/clamping_unit" /begin SUB_GROUP S75_deadzone /end SUB_GROUP /begin REF_CHARACTERISTIC EG_NmrSng0_C /end REF_CHARACTERISTIC /end GROUP
/begin GROUP S77_PID_Controller1 "EcuIntgdSwGend/ControlSoftware/DesTqClcn/Running Mode/TSC1 Control Purpose/TSC1 Request for Speed Control/PID_Controller1" /begin SUB_GROUP S78_clamping_unit /end SUB_GROUP /begin REF_CHARACTERISTIC EG_NmrSng0_C /end REF_CHARACTERISTIC /begin REF_MEASUREMENT DTqC_TSC1SpdReqTq /end REF_MEASUREMENT /end GROUP
/begin GROUP S103_LowPassFilter1 "EcuIntgdSwGend/ControlSoftware/EcuInpPrcsg/Additionals/Cylinder Balancing/Cylinder 1 Speed Error Calculation/LowPassFilter1" /begin REF_CHARACTERISTIC EG_NmrSng0_C EG_bFlgTrue_C /end REF_CHARACTERISTIC /end GROUP
/begin GROUP S103_LowPassFilter2 "EcuIntgdSwGend/ControlSoftware/EcuInpPrcsg/Additionals/Cylinder Balancing/Cylinder 1 Speed Error Calculation/LowPassFilter2" /begin REF_CHARACTERISTIC EG_NmrSng0_C EG_bFlgTrue_C /end REF_CHARACTERISTIC /end GROUP
/begin GROUP S104_LowPassFilter3 "EcuIntgdSwGend/ControlSoftware/EcuInpPrcsg/Additionals/Cylinder Balancing/Cylinder 2 Speed Error Calculation/LowPassFilter3" /begin REF_CHARACTERISTIC EG_NmrSng0_C EG_bFlgTrue_C /end REF_CHARACTERISTIC /end GROUP
/begin GROUP S105_LowPassFilter4 "EcuIntgdSwGend/ControlSoftware/EcuInpPrcsg/Additionals/Cylinder Balancing/Cylinder 3 Speed Error Calculation/LowPassFilter4" /begin REF_CHARACTERISTIC EG_NmrSng0_C EG_bFlgTrue_C /end REF_CHARACTERISTIC /end GROUP
/begin GROUP S106_LowPassFilter5 "EcuIntgdSwGend/ControlSoftware/EcuInpPrcsg/Additionals/Cylinder Balancing/Cylinder 4 Speed Error Calculation/LowPassFilter5" /begin REF_CHARACTERISTIC EG_NmrSng0_C EG_bFlgTrue_C /end REF_CHARACTERISTIC /end GROUP
/begin GROUP S107_LowPassFilter6 "EcuIntgdSwGend/ControlSoftware/EcuInpPrcsg/Additionals/Cylinder Balancing/Cylinder 5 Speed Error Calculation/LowPassFilter6" /begin REF_CHARACTERISTIC EG_NmrSng0_C EG_bFlgTrue_C /end REF_CHARACTERISTIC /end GROUP
/begin GROUP S108_LowPassFilter7 "EcuIntgdSwGend/ControlSoftware/EcuInpPrcsg/Additionals/Cylinder Balancing/Cylinder 6 Speed Error Calculation/LowPassFilter7" /begin REF_CHARACTERISTIC EG_NmrSng0_C EG_bFlgTrue_C /end REF_CHARACTERISTIC /end GROUP
/begin GROUP S423_clamping_unit "EcuIntgdSwGend/ControlSoftware/InjCtl/Cylinder Balancing/Cylinder Balancing PID Controllers /PID Controller for Cylinder 1/clamping_unit" /begin SUB_GROUP S429_deadzone /end SUB_GROUP /begin REF_CHARACTERISTIC EG_NmrSng0_C /end REF_CHARACTERISTIC /end GROUP
/begin GROUP S424_clamping_unit "EcuIntgdSwGend/ControlSoftware/InjCtl/Cylinder Balancing/Cylinder Balancing PID Controllers /PID Controller for Cylinder 2/clamping_unit" /begin SUB_GROUP S431_deadzone /end SUB_GROUP /begin REF_CHARACTERISTIC EG_NmrSng0_C /end REF_CHARACTERISTIC /end GROUP
/begin GROUP S425_clamping_unit "EcuIntgdSwGend/ControlSoftware/InjCtl/Cylinder Balancing/Cylinder Balancing PID Controllers /PID Controller for Cylinder 3/clamping_unit" /begin SUB_GROUP S433_deadzone /end SUB_GROUP /begin REF_CHARACTERISTIC EG_NmrSng0_C /end REF_CHARACTERISTIC /end GROUP
/begin GROUP S426_clamping_unit "EcuIntgdSwGend/ControlSoftware/InjCtl/Cylinder Balancing/Cylinder Balancing PID Controllers /PID Controller for Cylinder 4/clamping_unit" /begin SUB_GROUP S435_deadzone /end SUB_GROUP /begin REF_CHARACTERISTIC EG_NmrSng0_C /end REF_CHARACTERISTIC /end GROUP
/begin GROUP S427_clamping_unit "EcuIntgdSwGend/ControlSoftware/InjCtl/Cylinder Balancing/Cylinder Balancing PID Controllers /PID Controller for Cylinder 5/clamping_unit" /begin SUB_GROUP S437_deadzone /end SUB_GROUP /begin REF_CHARACTERISTIC EG_NmrSng0_C /end REF_CHARACTERISTIC /end GROUP
/begin GROUP S428_clamping_unit "EcuIntgdSwGend/ControlSoftware/InjCtl/Cylinder Balancing/Cylinder Balancing PID Controllers /PID Controller for Cylinder 6/clamping_unit" /begin SUB_GROUP S439_deadzone /end SUB_GROUP /begin REF_CHARACTERISTIC EG_NmrSng0_C /end REF_CHARACTERISTIC /end GROUP
/begin GROUP S539_avoidzerodivision_single "EcuIntgdSwGend/ControlSoftware/InjCtl/Start of Injection Angle for Pilot and Main Injection/Main SOI Reference Calculation/N-Map Interpolation for Main Start of Injection/avoidzerodivision_single" /begin REF_CHARACTERISTIC EG_NmrSng0_C EG_NmrSng1_C /end REF_CHARACTERISTIC /end GROUP
/begin GROUP S539_avoidzerodivision_single1 "EcuIntgdSwGend/ControlSoftware/InjCtl/Start of Injection Angle for Pilot and Main Injection/Main SOI Reference Calculation/N-Map Interpolation for Main Start of Injection/avoidzerodivision_single1" /begin REF_CHARACTERISTIC EG_NmrSng0_C EG_NmrSng1_C /end REF_CHARACTERISTIC /end GROUP
/begin GROUP S542_avoidzerodivision_single "EcuIntgdSwGend/ControlSoftware/InjCtl/Start of Injection Angle for Pilot and Main Injection/Pilot SOI Reference Calculation/N-Map Interpolation for Pre Start of Injection /avoidzerodivision_single" /begin REF_CHARACTERISTIC EG_NmrSng0_C EG_NmrSng1_C /end REF_CHARACTERISTIC /end GROUP
/begin GROUP S542_avoidzerodivision_single1 "EcuIntgdSwGend/ControlSoftware/InjCtl/Start of Injection Angle for Pilot and Main Injection/Pilot SOI Reference Calculation/N-Map Interpolation for Pre Start of Injection /avoidzerodivision_single1" /begin REF_CHARACTERISTIC EG_NmrSng0_C EG_NmrSng1_C /end REF_CHARACTERISTIC /end GROUP
/begin GROUP S574_deadzone "EcuIntgdSwGend/ControlSoftware/PtoCtrl/PTO PID/PID_Controller/clamping_unit/deadzone" /begin REF_CHARACTERISTIC EG_NmrSng0_C /end REF_CHARACTERISTIC /end GROUP
/begin GROUP S589_Debouncer "EcuIntgdSwGend/ControlSoftware/RailPGovr/Rail Pressure PID Controller/VCV Opening Percentage PID Controller/Integrator Reset/Debouncer" /begin REF_MEASUREMENT RPG_TiElpdCoeffKiRst /end REF_MEASUREMENT /end GROUP
/begin GROUP S590_deadzone "EcuIntgdSwGend/ControlSoftware/RailPGovr/Rail Pressure PID Controller/VCV Opening Percentage PID Controller/clamping_unit/deadzone" /begin REF_CHARACTERISTIC EG_NmrSng0_C /end REF_CHARACTERISTIC /end GROUP
/begin GROUP S610_clamping_unit "EcuIntgdSwGend/ControlSoftware/SpdLimr/Speed Limiter PID/SpeedLimiterPIDController/PID_Controller/clamping_unit" /begin SUB_GROUP S611_deadzone /end SUB_GROUP /begin REF_CHARACTERISTIC EG_NmrSng0_C /end REF_CHARACTERISTIC /end GROUP
/begin GROUP S688_Hysteresis_Switch "EcuIntgdSwGend/ControlSoftware/WarnMong/Warning-Reduction-Shutdown Functions/Global Enable/Engine Speed Level Check/Hysteresis_Switch" /begin REF_CHARACTERISTIC EG_NmrSng0_C EG_NmrSng1_C /end REF_CHARACTERISTIC /begin REF_MEASUREMENT WM_bNEngOverThd1 /end REF_MEASUREMENT /end GROUP
/begin GROUP S688_Hysteresis_Switch1 "EcuIntgdSwGend/ControlSoftware/WarnMong/Warning-Reduction-Shutdown Functions/Global Enable/Engine Speed Level Check/Hysteresis_Switch1" /begin REF_CHARACTERISTIC EG_NmrSng0_C EG_NmrSng1_C /end REF_CHARACTERISTIC /begin REF_MEASUREMENT WM_bNEngOverThd2 /end REF_MEASUREMENT /end GROUP
/begin GROUP S688_Hysteresis_Switch2 "EcuIntgdSwGend/ControlSoftware/WarnMong/Warning-Reduction-Shutdown Functions/Global Enable/Engine Speed Level Check/Hysteresis_Switch2" /begin REF_CHARACTERISTIC EG_NmrSng0_C EG_NmrSng1_C /end REF_CHARACTERISTIC /begin REF_MEASUREMENT WM_bNEngOverThd3 /end REF_MEASUREMENT /end GROUP
/begin GROUP S688_Hysteresis_Switch3 "EcuIntgdSwGend/ControlSoftware/WarnMong/Warning-Reduction-Shutdown Functions/Global Enable/Engine Speed Level Check/Hysteresis_Switch3" /begin REF_CHARACTERISTIC EG_NmrSng0_C EG_NmrSng1_C /end REF_CHARACTERISTIC /begin REF_MEASUREMENT WM_bNEngOverThd4 /end REF_MEASUREMENT /end GROUP
/begin GROUP S688_Hysteresis_Switch4 "EcuIntgdSwGend/ControlSoftware/WarnMong/Warning-Reduction-Shutdown Functions/Global Enable/Engine Speed Level Check/Hysteresis_Switch4" /begin REF_CHARACTERISTIC EG_NmrSng0_C EG_NmrSng1_C /end REF_CHARACTERISTIC /begin REF_MEASUREMENT WM_bNEngOverThd5 /end REF_MEASUREMENT /end GROUP
/begin GROUP S688_Hysteresis_Switch5 "EcuIntgdSwGend/ControlSoftware/WarnMong/Warning-Reduction-Shutdown Functions/Global Enable/Engine Speed Level Check/Hysteresis_Switch5" /begin REF_CHARACTERISTIC EG_NmrSng0_C EG_NmrSng1_C /end REF_CHARACTERISTIC /begin REF_MEASUREMENT WM_bNEngOverThd6 /end REF_MEASUREMENT /end GROUP
/begin GROUP S688_Hysteresis_Switch6 "EcuIntgdSwGend/ControlSoftware/WarnMong/Warning-Reduction-Shutdown Functions/Global Enable/Engine Speed Level Check/Hysteresis_Switch6" /begin REF_CHARACTERISTIC EG_NmrSng0_C EG_NmrSng1_C /end REF_CHARACTERISTIC /begin REF_MEASUREMENT WM_bNEngOverThd7 /end REF_MEASUREMENT /end GROUP
/begin GROUP S710_High_Fuel_System_Message "EcuIntgdSwGend/ControlSoftware/WarnMong/Warning-Reduction-Shutdown Functions/Pressure/Rail Over Pressure/High Fuel System Message" /begin SUB_GROUP S721_Debouncer S721_Debouncer2 /end SUB_GROUP
 /begin REF_CHARACTERISTIC EG_NmrSng0_C EG_TsSw20_C WM_NEngThdPRailHi_P WM_NEngThdPRailTooHi_P WM_PRailHiThd_P WM_PRailTooHi_P WM_TiAcvWarnPRailTooHiDeb_P WM_TiPRailHiAcvDeb_P WM_bPRailHiMsgWarnOvs_P WM_bPRailHiMsgWarnOvv_P WM_bPRailTooHiMsgWarnOvs_P WM_bPRailTooHiMsgWarnOvv_P /end REF_CHARACTERISTIC
 /begin REF_MEASUREMENT WM_bPRailHiMsg WM_bPRailTooHiMsg WM_bTiAcvWarnPTooHiDeb WM_bTiPRailHiAcvWarnDeb /end REF_MEASUREMENT
/end GROUP
/begin GROUP S711_Low_and_Not_Control_Fuel_System_Message "EcuIntgdSwGend/ControlSoftware/WarnMong/Warning-Reduction-Shutdown Functions/Pressure/Rail Under Pressure/Low and Not Control Fuel System Message" /begin SUB_GROUP S725_Debouncer1 S725_Debouncer3 /end SUB_GROUP
 /begin REF_CHARACTERISTIC EG_NmrSng0_C EG_TsSw20_C WM_NEngThdPRailLo_P WM_NEngThdPRailNotCtld_P WM_PRailLo_P WM_PRailNotCtldThd_P WM_TiAcvWarnPRailNotCtldDeb_P WM_TiPRailLoAcvWarnDeb_P WM_bPRailLoMsgWarnOvs_P WM_bPRailLoMsgWarnOvv_P WM_bPRailNotCtldMsgWarnOvs_P WM_bPRailNotCtldMsgWarnOvv_P /end REF_CHARACTERISTIC
 /begin REF_MEASUREMENT WM_bPRailLoMsg WM_bPRailNotCtldMsg WM_bTiAcvWarnPRailNotCtldDeb WM_bTiPRailLoAcvWarnDeb /end REF_MEASUREMENT
/end GROUP
/begin GROUP S728_BitwiseANDMask "EcuIntgdSwGend/ControlSoftware/WarnMong/Warning-Reduction-Shutdown Functions/Reaction/Bit Extract/BitwiseANDMask" /begin REF_MEASUREMENT WM_bAcvAmberWarn /end REF_MEASUREMENT /end GROUP
/begin GROUP S728_BitwiseANDMask4 "EcuIntgdSwGend/ControlSoftware/WarnMong/Warning-Reduction-Shutdown Functions/Reaction/Bit Extract/BitwiseANDMask4" /begin REF_MEASUREMENT WM_bAcvEmgcyShtdwnLamp /end REF_MEASUREMENT /end GROUP
/begin GROUP S729_Error_Combinations "EcuIntgdSwGend/ControlSoftware/WarnMong/Warning-Reduction-Shutdown Functions/Reaction/Error List/Error Combinations"
 /begin SUB_GROUP S742_SetResetFaultReaction S742_SetResetFaultReaction1 S742_SetResetFaultReaction2 S742_SetResetFaultReaction3 S742_SetResetFaultReaction4 /end SUB_GROUP
 /begin REF_CHARACTERISTIC WM_MaskRTNForErrComb1_P WM_MaskRTNForErrComb2_P WM_MaskRTNForErrComb3_P WM_MaskRTNForErrComb4_P WM_MaskRTNForErrComb5_P WM_MaskRctnForErrComb1_P WM_MaskRctnForErrComb2_P WM_MaskRctnForErrComb3_P WM_MaskRctnForErrComb4_P WM_MaskRctnForErrComb5_P WM_MaskTC1ErrComb1_P WM_MaskTC1ErrComb2_P WM_MaskTC1ErrComb3_P WM_MaskTC1ErrComb4_P WM_MaskTC1ErrComb5_P WM_MaskTC2ErrComb1_P WM_MaskTC2ErrComb2_P WM_MaskTC2ErrComb3_P WM_MaskTC2ErrComb4_P WM_MaskTC2ErrComb5_P WM_MaskTC3ErrComb1_P WM_MaskTC3ErrComb2_P WM_MaskTC3ErrComb3_P WM_MaskTC3ErrComb4_P WM_MaskTC3ErrComb5_P WM_MaskTC4ErrComb1_P WM_MaskTC4ErrComb2_P WM_MaskTC4ErrComb3_P WM_MaskTC4ErrComb4_P WM_MaskTC4ErrComb5_P /end REF_CHARACTERISTIC
 /begin REF_MEASUREMENT WM_bErrComb1 WM_bErrComb2 WM_bErrComb3 WM_bErrComb4 WM_bErrComb5 /end REF_MEASUREMENT
/end GROUP
/begin GROUP S729_TC1 "EcuIntgdSwGend/ControlSoftware/WarnMong/Warning-Reduction-Shutdown Functions/Reaction/Error List/TC1"
 /begin REF_CHARACTERISTIC EG_Mask32Bit0_C EG_Mask32Bit1024_C EG_Mask32Bit1048576_C EG_Mask32Bit1073741824_C EG_Mask32Bit128_C EG_Mask32Bit131072_C EG_Mask32Bit134217728_C EG_Mask32Bit16384_C EG_Mask32Bit16777216_C EG_Mask32Bit16_C EG_Mask32Bit1_C EG_Mask32Bit2048_C EG_Mask32Bit2097152_C EG_Mask32Bit2147483648_C EG_Mask32Bit256_C EG_Mask32Bit262144_C EG_Mask32Bit268435456_C EG_Mask32Bit2_C EG_Mask32Bit32768_C EG_Mask32Bit32_C EG_Mask32Bit33554432_C EG_Mask32Bit4096_C EG_Mask32Bit4194304_C EG_Mask32Bit4_C EG_Mask32Bit512_C EG_Mask32Bit524288_C EG_Mask32Bit536870912_C EG_Mask32Bit64_C EG_Mask32Bit65536_C EG_Mask32Bit67108864_C EG_Mask32Bit8192_C EG_Mask32Bit8388608_C EG_Mask32Bit8_C WM_MaskTC1Ovs_P WM_MaskTC1Ovv_P /end REF_CHARACTERISTIC
 /begin REF_MEASUREMENT WM_MaskTC1 /end REF_MEASUREMENT
/end GROUP
/begin GROUP S729_TC2 "EcuIntgdSwGend/ControlSoftware/WarnMong/Warning-Reduction-Shutdown Functions/Reaction/Error List/TC2"
 /begin REF_CHARACTERISTIC EG_Mask32Bit0_C EG_Mask32Bit1024_C EG_Mask32Bit1048576_C EG_Mask32Bit1073741824_C EG_Mask32Bit128_C EG_Mask32Bit131072_C EG_Mask32Bit134217728_C EG_Mask32Bit16384_C EG_Mask32Bit16777216_C EG_Mask32Bit16_C EG_Mask32Bit1_C EG_Mask32Bit2048_C EG_Mask32Bit2097152_C EG_Mask32Bit2147483648_C EG_Mask32Bit256_C EG_Mask32Bit262144_C EG_Mask32Bit268435456_C EG_Mask32Bit2_C EG_Mask32Bit32768_C EG_Mask32Bit32_C EG_Mask32Bit33554432_C EG_Mask32Bit4096_C EG_Mask32Bit4194304_C EG_Mask32Bit4_C EG_Mask32Bit512_C EG_Mask32Bit524288_C EG_Mask32Bit536870912_C EG_Mask32Bit64_C EG_Mask32Bit65536_C EG_Mask32Bit67108864_C EG_Mask32Bit8192_C EG_Mask32Bit8388608_C EG_Mask32Bit8_C WM_MaskTC2Ovs_P WM_MaskTC2Ovv_P /end REF_CHARACTERISTIC
 /begin REF_MEASUREMENT WM_MaskTC2 /end REF_MEASUREMENT
/end GROUP
/begin GROUP S729_TC3 "EcuIntgdSwGend/ControlSoftware/WarnMong/Warning-Reduction-Shutdown Functions/Reaction/Error List/TC3"
 /begin REF_CHARACTERISTIC EG_Mask32Bit0_C EG_Mask32Bit1024_C EG_Mask32Bit1048576_C EG_Mask32Bit1073741824_C EG_Mask32Bit128_C EG_Mask32Bit131072_C EG_Mask32Bit134217728_C EG_Mask32Bit16384_C EG_Mask32Bit16777216_C EG_Mask32Bit16_C EG_Mask32Bit1_C EG_Mask32Bit2048_C EG_Mask32Bit2097152_C EG_Mask32Bit2147483648_C EG_Mask32Bit256_C EG_Mask32Bit262144_C EG_Mask32Bit268435456_C EG_Mask32Bit2_C EG_Mask32Bit32768_C EG_Mask32Bit32_C EG_Mask32Bit33554432_C EG_Mask32Bit4096_C EG_Mask32Bit4194304_C EG_Mask32Bit4_C EG_Mask32Bit512_C EG_Mask32Bit524288_C EG_Mask32Bit536870912_C EG_Mask32Bit64_C EG_Mask32Bit65536_C EG_Mask32Bit67108864_C EG_Mask32Bit8192_C EG_Mask32Bit8388608_C EG_Mask32Bit8_C WM_MaskTC3Ovs_P WM_MaskTC3Ovv_P /end REF_CHARACTERISTIC
 /begin REF_MEASUREMENT WM_MaskTC3 /end REF_MEASUREMENT
/end GROUP
/begin GROUP S729_TC4 "EcuIntgdSwGend/ControlSoftware/WarnMong/Warning-Reduction-Shutdown Functions/Reaction/Error List/TC4"
 /begin REF_CHARACTERISTIC EG_Mask32Bit0_C EG_Mask32Bit1024_C EG_Mask32Bit1048576_C EG_Mask32Bit1073741824_C EG_Mask32Bit128_C EG_Mask32Bit131072_C EG_Mask32Bit134217728_C EG_Mask32Bit16384_C EG_Mask32Bit16777216_C EG_Mask32Bit16_C EG_Mask32Bit1_C EG_Mask32Bit2048_C EG_Mask32Bit2097152_C EG_Mask32Bit2147483648_C EG_Mask32Bit256_C EG_Mask32Bit262144_C EG_Mask32Bit268435456_C EG_Mask32Bit2_C EG_Mask32Bit32768_C EG_Mask32Bit32_C EG_Mask32Bit33554432_C EG_Mask32Bit4096_C EG_Mask32Bit4194304_C EG_Mask32Bit4_C EG_Mask32Bit512_C EG_Mask32Bit524288_C EG_Mask32Bit536870912_C EG_Mask32Bit64_C EG_Mask32Bit65536_C EG_Mask32Bit67108864_C EG_Mask32Bit8192_C EG_Mask32Bit8388608_C EG_Mask32Bit8_C WM_MaskTC4Ovs_P WM_MaskTC4Ovv_P /end REF_CHARACTERISTIC
 /begin REF_MEASUREMENT WM_MaskTC4 /end REF_MEASUREMENT
/end GROUP
/begin GROUP S730_SetRstLtch "EcuIntgdSwGend/ControlSoftware/WarnMong/Warning-Reduction-Shutdown Functions/Reaction/SetResetFaultReaction/SetRstLtch" /begin REF_CHARACTERISTIC EG_bFlgFalse_C EG_bFlgTrue_C /end REF_CHARACTERISTIC /begin REF_MEASUREMENT WM_bActvLimpRctn /end REF_MEASUREMENT /end GROUP
/begin GROUP S731_SetRstLtch "EcuIntgdSwGend/ControlSoftware/WarnMong/Warning-Reduction-Shutdown Functions/Reaction/SetResetFaultReaction24/SetRstLtch" /begin REF_CHARACTERISTIC EG_bFlgFalse_C EG_bFlgTrue_C /end REF_CHARACTERISTIC /begin REF_MEASUREMENT WM_bAcvErrPRailNotCtldMsgRctn /end REF_MEASUREMENT /end GROUP
/begin GROUP S732_SetRstLtch "EcuIntgdSwGend/ControlSoftware/WarnMong/Warning-Reduction-Shutdown Functions/Reaction/SetResetFaultReaction25/SetRstLtch" /begin REF_CHARACTERISTIC EG_bFlgFalse_C EG_bFlgTrue_C /end REF_CHARACTERISTIC /begin REF_MEASUREMENT WM_bAcvErrEmgcyShtdwnForOvspdRctn /end REF_MEASUREMENT /end GROUP
/begin GROUP S733_SetRstLtch "EcuIntgdSwGend/ControlSoftware/WarnMong/Warning-Reduction-Shutdown Functions/Reaction/SetResetFaultReaction26/SetRstLtch" /begin REF_CHARACTERISTIC EG_bFlgFalse_C EG_bFlgTrue_C /end REF_CHARACTERISTIC /begin REF_MEASUREMENT WM_bAcvErrCamCrankTotLossRctn /end REF_MEASUREMENT /end GROUP
/begin GROUP S734_SetRstLtch "EcuIntgdSwGend/ControlSoftware/WarnMong/Warning-Reduction-Shutdown Functions/Reaction/SetResetFaultReaction27/SetRstLtch" /begin REF_CHARACTERISTIC EG_bFlgFalse_C EG_bFlgTrue_C /end REF_CHARACTERISTIC /begin REF_MEASUREMENT WM_bAcvErrInjrShtdwnRctn /end REF_MEASUREMENT /end GROUP
/begin GROUP S857_clamping_unit "EcuIntgdSwGend/ControlSoftware/WgtCtl/Wastegate Control/BoostPressurePID/PID_Controller/clamping_unit" /begin SUB_GROUP S858_deadzone /end SUB_GROUP /begin REF_CHARACTERISTIC EG_NmrInt0_C /end REF_CHARACTERISTIC /end GROUP
/begin GROUP S28_deadzone "EcuIntgdSwGend/ControlSoftware/CrsCtrl/CruiseControl/CruiseControlPIDController/PID_Controller/clamping_unit/deadzone" /begin REF_CHARACTERISTIC EG_NmrSng0_C /end REF_CHARACTERISTIC /end GROUP
/begin GROUP S66_clamping_unit "EcuIntgdSwGend/ControlSoftware/DesTqClcn/Running Mode/EndSpeed Governor/EndSpeed Soft Limit Governor/PID_Controller/clamping_unit" /begin SUB_GROUP S67_deadzone /end SUB_GROUP /begin REF_CHARACTERISTIC EG_NmrSng0_C /end REF_CHARACTERISTIC /end GROUP
/begin GROUP S69_CompTimer_Strt "EcuIntgdSwGend/ControlSoftware/DesTqClcn/Running Mode/EndSpeed Governor/Engine Speed Hysteresis for Hard Limitation/Hard Limit Latching/CompTimer_Strt" /begin SUB_GROUP S70_SetRstLtch /end SUB_GROUP /begin REF_MEASUREMENT DTqC_TiElpdAcvHardLimLtch /end REF_MEASUREMENT /end GROUP
/begin GROUP S69_Neg_Edge "EcuIntgdSwGend/ControlSoftware/DesTqClcn/Running Mode/EndSpeed Governor/Engine Speed Hysteresis for Hard Limitation/Hard Limit Latching/Neg_Edge" /begin REF_CHARACTERISTIC EG_NmrSng0_C /end REF_CHARACTERISTIC /end GROUP
/begin GROUP S69_Pos_Edge "EcuIntgdSwGend/ControlSoftware/DesTqClcn/Running Mode/EndSpeed Governor/Engine Speed Hysteresis for Hard Limitation/Hard Limit Latching/Pos_Edge" /begin REF_CHARACTERISTIC EG_NmrSng0_C /end REF_CHARACTERISTIC /end GROUP
/begin GROUP S75_deadzone "EcuIntgdSwGend/ControlSoftware/DesTqClcn/Running Mode/Idle Speed Controller/PID_Controller1/clamping_unit/deadzone" /begin REF_CHARACTERISTIC EG_NmrSng0_C /end REF_CHARACTERISTIC /end GROUP
/begin GROUP S78_clamping_unit "EcuIntgdSwGend/ControlSoftware/DesTqClcn/Running Mode/TSC1 Control Purpose/TSC1 Request for Speed Control/PID_Controller1/clamping_unit" /begin SUB_GROUP S79_deadzone /end SUB_GROUP /begin REF_CHARACTERISTIC EG_NmrSng0_C /end REF_CHARACTERISTIC /end GROUP
/begin GROUP S429_deadzone "EcuIntgdSwGend/ControlSoftware/InjCtl/Cylinder Balancing/Cylinder Balancing PID Controllers /PID Controller for Cylinder 1/clamping_unit/deadzone" /begin REF_CHARACTERISTIC EG_NmrSng0_C /end REF_CHARACTERISTIC /end GROUP
/begin GROUP S431_deadzone "EcuIntgdSwGend/ControlSoftware/InjCtl/Cylinder Balancing/Cylinder Balancing PID Controllers /PID Controller for Cylinder 2/clamping_unit/deadzone" /begin REF_CHARACTERISTIC EG_NmrSng0_C /end REF_CHARACTERISTIC /end GROUP
/begin GROUP S433_deadzone "EcuIntgdSwGend/ControlSoftware/InjCtl/Cylinder Balancing/Cylinder Balancing PID Controllers /PID Controller for Cylinder 3/clamping_unit/deadzone" /begin REF_CHARACTERISTIC EG_NmrSng0_C /end REF_CHARACTERISTIC /end GROUP
/begin GROUP S435_deadzone "EcuIntgdSwGend/ControlSoftware/InjCtl/Cylinder Balancing/Cylinder Balancing PID Controllers /PID Controller for Cylinder 4/clamping_unit/deadzone" /begin REF_CHARACTERISTIC EG_NmrSng0_C /end REF_CHARACTERISTIC /end GROUP
/begin GROUP S437_deadzone "EcuIntgdSwGend/ControlSoftware/InjCtl/Cylinder Balancing/Cylinder Balancing PID Controllers /PID Controller for Cylinder 5/clamping_unit/deadzone" /begin REF_CHARACTERISTIC EG_NmrSng0_C /end REF_CHARACTERISTIC /end GROUP
/begin GROUP S439_deadzone "EcuIntgdSwGend/ControlSoftware/InjCtl/Cylinder Balancing/Cylinder Balancing PID Controllers /PID Controller for Cylinder 6/clamping_unit/deadzone" /begin REF_CHARACTERISTIC EG_NmrSng0_C /end REF_CHARACTERISTIC /end GROUP
/begin GROUP S611_deadzone "EcuIntgdSwGend/ControlSoftware/SpdLimr/Speed Limiter PID/SpeedLimiterPIDController/PID_Controller/clamping_unit/deadzone" /begin REF_CHARACTERISTIC EG_NmrSng0_C /end REF_CHARACTERISTIC /end GROUP
/begin GROUP S721_Debouncer "EcuIntgdSwGend/ControlSoftware/WarnMong/Warning-Reduction-Shutdown Functions/Pressure/Rail Over Pressure/High Fuel System Message/Debouncer" /begin REF_MEASUREMENT WM_TiElpdPRailHi /end REF_MEASUREMENT /end GROUP
/begin GROUP S721_Debouncer2 "EcuIntgdSwGend/ControlSoftware/WarnMong/Warning-Reduction-Shutdown Functions/Pressure/Rail Over Pressure/High Fuel System Message/Debouncer2" /begin REF_MEASUREMENT WM_TiElpdPRailTooHi /end REF_MEASUREMENT /end GROUP
/begin GROUP S725_Debouncer1 "EcuIntgdSwGend/ControlSoftware/WarnMong/Warning-Reduction-Shutdown Functions/Pressure/Rail Under Pressure/Low and Not Control Fuel System Message/Debouncer1" /begin REF_MEASUREMENT WM_TiElpdPRailNotCtld /end REF_MEASUREMENT /end GROUP
/begin GROUP S725_Debouncer3 "EcuIntgdSwGend/ControlSoftware/WarnMong/Warning-Reduction-Shutdown Functions/Pressure/Rail Under Pressure/Low and Not Control Fuel System Message/Debouncer3" /begin REF_MEASUREMENT WM_TiElpdPRailLo /end REF_MEASUREMENT /end GROUP
/begin GROUP S742_SetResetFaultReaction "EcuIntgdSwGend/ControlSoftware/WarnMong/Warning-Reduction-Shutdown Functions/Reaction/Error List/Error Combinations/SetResetFaultReaction" /begin SUB_GROUP S768_SetRstLtch /end SUB_GROUP /begin REF_CHARACTERISTIC EG_Mask32Bit0_C /end REF_CHARACTERISTIC /end GROUP
/begin GROUP S742_SetResetFaultReaction1 "EcuIntgdSwGend/ControlSoftware/WarnMong/Warning-Reduction-Shutdown Functions/Reaction/Error List/Error Combinations/SetResetFaultReaction1" /begin SUB_GROUP S769_SetRstLtch /end SUB_GROUP /begin REF_CHARACTERISTIC EG_Mask32Bit0_C /end REF_CHARACTERISTIC /end GROUP
/begin GROUP S742_SetResetFaultReaction2 "EcuIntgdSwGend/ControlSoftware/WarnMong/Warning-Reduction-Shutdown Functions/Reaction/Error List/Error Combinations/SetResetFaultReaction2" /begin SUB_GROUP S770_SetRstLtch /end SUB_GROUP /begin REF_CHARACTERISTIC EG_Mask32Bit0_C /end REF_CHARACTERISTIC /end GROUP
/begin GROUP S742_SetResetFaultReaction3 "EcuIntgdSwGend/ControlSoftware/WarnMong/Warning-Reduction-Shutdown Functions/Reaction/Error List/Error Combinations/SetResetFaultReaction3" /begin SUB_GROUP S771_SetRstLtch /end SUB_GROUP /begin REF_CHARACTERISTIC EG_Mask32Bit0_C /end REF_CHARACTERISTIC /end GROUP
/begin GROUP S742_SetResetFaultReaction4 "EcuIntgdSwGend/ControlSoftware/WarnMong/Warning-Reduction-Shutdown Functions/Reaction/Error List/Error Combinations/SetResetFaultReaction4" /begin SUB_GROUP S772_SetRstLtch /end SUB_GROUP /begin REF_CHARACTERISTIC EG_Mask32Bit0_C /end REF_CHARACTERISTIC /end GROUP
/begin GROUP S858_deadzone "EcuIntgdSwGend/ControlSoftware/WgtCtl/Wastegate Control/BoostPressurePID/PID_Controller/clamping_unit/deadzone" /begin REF_CHARACTERISTIC EG_NmrInt0_C /end REF_CHARACTERISTIC /end GROUP
/begin GROUP S67_deadzone "EcuIntgdSwGend/ControlSoftware/DesTqClcn/Running Mode/EndSpeed Governor/EndSpeed Soft Limit Governor/PID_Controller/clamping_unit/deadzone" /begin REF_CHARACTERISTIC EG_NmrSng0_C /end REF_CHARACTERISTIC /end GROUP
/begin GROUP S70_SetRstLtch "EcuIntgdSwGend/ControlSoftware/DesTqClcn/Running Mode/EndSpeed Governor/Engine Speed Hysteresis for Hard Limitation/Hard Limit Latching/CompTimer_Strt/SetRstLtch" /begin REF_CHARACTERISTIC EG_bFlgFalse_C EG_bFlgTrue_C /end REF_CHARACTERISTIC /end GROUP
/begin GROUP S79_deadzone "EcuIntgdSwGend/ControlSoftware/DesTqClcn/Running Mode/TSC1 Control Purpose/TSC1 Request for Speed Control/PID_Controller1/clamping_unit/deadzone" /begin REF_CHARACTERISTIC EG_NmrSng0_C /end REF_CHARACTERISTIC /end GROUP
/begin GROUP S768_SetRstLtch "EcuIntgdSwGend/ControlSoftware/WarnMong/Warning-Reduction-Shutdown Functions/Reaction/Error List/Error Combinations/SetResetFaultReaction/SetRstLtch" /begin REF_CHARACTERISTIC EG_bFlgFalse_C EG_bFlgTrue_C /end REF_CHARACTERISTIC /begin REF_MEASUREMENT WM_bAcvErrComb1Rctn /end REF_MEASUREMENT /end GROUP
/begin GROUP S769_SetRstLtch "EcuIntgdSwGend/ControlSoftware/WarnMong/Warning-Reduction-Shutdown Functions/Reaction/Error List/Error Combinations/SetResetFaultReaction1/SetRstLtch" /begin REF_CHARACTERISTIC EG_bFlgFalse_C EG_bFlgTrue_C /end REF_CHARACTERISTIC /begin REF_MEASUREMENT WM_bAcvErrComb2Rctn /end REF_MEASUREMENT /end GROUP
/begin GROUP S770_SetRstLtch "EcuIntgdSwGend/ControlSoftware/WarnMong/Warning-Reduction-Shutdown Functions/Reaction/Error List/Error Combinations/SetResetFaultReaction2/SetRstLtch" /begin REF_CHARACTERISTIC EG_bFlgFalse_C EG_bFlgTrue_C /end REF_CHARACTERISTIC /begin REF_MEASUREMENT WM_bAcvErrComb3Rctn /end REF_MEASUREMENT /end GROUP
/begin GROUP S771_SetRstLtch "EcuIntgdSwGend/ControlSoftware/WarnMong/Warning-Reduction-Shutdown Functions/Reaction/Error List/Error Combinations/SetResetFaultReaction3/SetRstLtch" /begin REF_CHARACTERISTIC EG_bFlgFalse_C EG_bFlgTrue_C /end REF_CHARACTERISTIC /begin REF_MEASUREMENT WM_bAcvErrComb4Rctn /end REF_MEASUREMENT /end GROUP
/begin GROUP S772_SetRstLtch "EcuIntgdSwGend/ControlSoftware/WarnMong/Warning-Reduction-Shutdown Functions/Reaction/Error List/Error Combinations/SetResetFaultReaction4/SetRstLtch" /begin REF_CHARACTERISTIC EG_bFlgFalse_C EG_bFlgTrue_C /end REF_CHARACTERISTIC /begin REF_MEASUREMENT WM_bAcvErrComb5Rctn /end REF_MEASUREMENT /end GROUP
/end MODULE
/end PROJECT
