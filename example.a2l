ASAP2_VERSION 1 6
/begin PROJECT ECEMTAG_CR8 ""
/begin MODULE DIM ""
/begin MOD_COMMON "Mod Common Comment Here" DEPOSIT ABSOLUTE BYTE_ORDER MSB_FIRST /end MOD_COMMON
/begin COMPU_METHOD Duration_s_Scalex001_CM "Scale 0.001" RAT_FUNC "%20.0" "s" COEFFS 0 1 0 0 0 0.001 /end COMPU_METHOD
/begin COMPU_METHOD Duration_milli_s_CM "Scale 1" RAT_FUNC "%20.0" "ms" COEFFS 0 1 0 0 0 1 /end COMPU_METHOD
/begin COMPU_METHOD Current_mA_CM "Scale 1" RAT_FUNC "%20.0" "mA" COEFFS 0 1 0 0 0 1 /end COMPU_METHOD
/begin RECORD_LAYOUT FLOAT32_IEEE FNC_VALUES 1 FLOAT32_IEEE ROW_DIR DIRECT /end RECORD_LAYOUT
/begin RECORD_LAYOUT UBYTE FNC_VALUES 1 UBYTE ROW_DIR DIRECT /end RECORD_LAYOUT
/begin RECORD_LAYOUT SBYTE FNC_VALUES 1 SBYTE ROW_DIR DIRECT /end RECORD_LAYOUT
/******************************* From MATLAB ***************************************/ /* MATLAB_SECTION_START_1 */
/begin RECORD_LAYOUT Scalar_BOOLEAN FNC_VALUES 1 UBYTE ROW_DIR DIRECT /end RECORD_LAYOUT
/begin RECORD_LAYOUT Scalar_FLOAT32_IEEE FNC_VALUES 1 FLOAT32_IEEE ROW_DIR DIRECT /end RECORD_LAYOUT
/begin RECORD_LAYOUT Lookup1D_FLOAT32_IEEE FNC_VALUES 1 FLOAT32_IEEE ROW_DIR DIRECT /end RECORD_LAYOUT
/begin RECORD_LAYOUT Lookup1D_X_FLOAT32_IEEE AXIS_PTS_X 1 FLOAT32_IEEE INDEX_INCR DIRECT /end RECORD_LAYOUT
/begin RECORD_LAYOUT Lookup2D_FLOAT32_IEEE FNC_VALUES 1 FLOAT32_IEEE ROW_DIR DIRECT /end RECORD_LAYOUT
/begin RECORD_LAYOUT Lookup2D_X_FLOAT32_IEEE AXIS_PTS_X 1 FLOAT32_IEEE INDEX_INCR DIRECT /end RECORD_LAYOUT
/begin CHARACTERISTIC EOP_IRefPCV_M "Output Processing Current Reference Map for Pressure Control Valve" CURVE 0x40044C1C /* @ECU_Address@EOP_IRefPCV_M@ */ Lookup1D_FLOAT32_IEEE 0 EcuIntgdSwGend_CM_single_A 0.0 10000.0
 /begin AXIS_DESCR COM_AXIS RPG_PRailRefForPCV EcuIntgdSwGend_CM_single 10 0.0 3000.0 AXIS_PTS_REF EOP_PRailRefForPCV_A /end AXIS_DESCR
/end CHARACTERISTIC
/begin AXIS_PTS EOP_PRailRefForPCV_A "Output Processing Rail Pressure Reference Axis for Pressure Control Valve" 0x40044C74 /* @ECU_Address@EOP_PRailRefForPCV_A@ */ RPG_PRailRefForPCV Lookup1D_X_FLOAT32_IEEE 0 EcuIntgdSwGend_CM_single 10 0.0 3000.0 /end AXIS_PTS
/begin CHARACTERISTIC EOP_IRefVCV_M "Output Processing Current Reference Map for Volumetric Control Valve" CURVE 0x40044C44 /* @ECU_Address@EOP_IRefVCV_M@ */ Lookup1D_FLOAT32_IEEE 0 EcuIntgdSwGend_CM_single_A 0.0 10000.0
 /begin AXIS_DESCR COM_AXIS RPG_PercgVCVReq EcuIntgdSwGend_CM_single__ 10 0.0 100.0 AXIS_PTS_REF EOP_PercgVCVReq_A /end AXIS_DESCR
/end CHARACTERISTIC
/begin AXIS_PTS EOP_PercgVCVReq_A "Output Processing Pecentage Reqeust Axis of Volumetric Control Valve" 0x40044C9C /* @ECU_Address@EOP_PercgVCVReq_A@ */ RPG_PercgVCVReq Lookup1D_X_FLOAT32_IEEE 0 EcuIntgdSwGend_CM_single__ 10 0.0 100.0 /end AXIS_PTS
/begin CHARACTERISTIC IC_FuInTank_M "Fuel in Tank Map" CURVE 0x40044EE4 /* @ECU_Address@IC_FuInTank_M@ */ Lookup1D_FLOAT32_IEEE 0 EcuIntgdSwGend_CM_single_L 0.0 900.0
 /begin AXIS_DESCR COM_AXIS EIP_CanFuLvl1 EcuIntgdSwGend_CM_single__ 3 0.0 100.0 AXIS_PTS_REF IC_FuInTank_A /end AXIS_DESCR
/end CHARACTERISTIC
/begin AXIS_PTS IC_FuInTank_A "Fuel in Tank Axis" 0x40044ED8 /* @ECU_Address@IC_FuInTank_A@ */ EIP_CanFuLvl1 Lookup1D_X_FLOAT32_IEEE 0 EcuIntgdSwGend_CM_single__ 3 0.0 100.0 /end AXIS_PTS
/begin CHARACTERISTIC IC_OfsPlt2MaiInj_M "Pilot to Main Injection Offset Map" CURVE 0x40045D28 /* @ECU_Address@IC_OfsPlt2MaiInj_M@ */ Lookup1D_FLOAT32_IEEE 0 EcuIntgdSwGend_CM_single_deg 0.0 5000.0
 /begin AXIS_DESCR COM_AXIS EIP_NEng EcuIntgdSwGend_CM_single_rpm 5 0.0 3200.0 AXIS_PTS_REF IC_NEngForOfsPlt2MaiInj_A /end AXIS_DESCR
/end CHARACTERISTIC
/begin AXIS_PTS IC_NEngForOfsPlt2MaiInj_A "Engine Speed Map Axis for Pilot to Main Injection Offset Map" 0x40045BFC /* @ECU_Address@IC_NEngForOfsPlt2MaiInj_A@ */ EIP_NEng Lookup1D_X_FLOAT32_IEEE 0 EcuIntgdSwGend_CM_single_rpm 5 0.0 3200.0 /end AXIS_PTS
/begin CHARACTERISTIC PHC_TiAcvnGridHeatr_M "PreHeating Time Calculation Map After Start" MAP 0x400484F0 /* @ECU_Address@PHC_TiAcvnGridHeatr_M@ */ Lookup2D_FLOAT32_IEEE 0 EcuIntgdSwGend_CM_single_ms 0.0 50000.0
 /begin AXIS_DESCR COM_AXIS EIP_PAmbAir EcuIntgdSwGend_CM_single_mbar 4 0.0 1600.0 AXIS_PTS_REF PHC_PAmbAirForTiAcvnGridHeatr_A /end AXIS_DESCR
 /begin AXIS_DESCR COM_AXIS NO_INPUT_QUANTITY EcuIntgdSwGend_CM_single_degC 10 -50.0 200.0 AXIS_PTS_REF PHC_TiAcvnGridHeatr_A /end AXIS_DESCR
/end CHARACTERISTIC
/begin AXIS_PTS PHC_PAmbAirForTiAcvnGridHeatr_A "Ambient Air Pressure Map Axis for Grid Heater Timer Activation" 0x400484A4 /* @ECU_Address@PHC_PAmbAirForTiAcvnGridHeatr_A@ */ EIP_PAmbAir Lookup2D_X_FLOAT32_IEEE 0 EcuIntgdSwGend_CM_single_mbar 4 0.0 1600.0 /end AXIS_PTS
/begin AXIS_PTS PHC_TiAcvnGridHeatr_A "PreHeating Time Calculation Map Axis After Start" 0x400484C8 /* @ECU_Address@PHC_TiAcvnGridHeatr_A@ */ NO_INPUT_QUANTITY Lookup2D_X_FLOAT32_IEEE 0 EcuIntgdSwGend_CM_single_degC 10 -50.0 200.0 /end AXIS_PTS
/begin CHARACTERISTIC PHC_TiPreHeatg_M "PreHeating Time Calculation Map Before Start" MAP 0x400485C8 /* @ECU_Address@PHC_TiPreHeatg_M@ */ Lookup2D_FLOAT32_IEEE 0 EcuIntgdSwGend_CM_single_ms 0.0 500000.0
 /begin AXIS_DESCR COM_AXIS EIP_PAmbAir EcuIntgdSwGend_CM_single_mbar 4 0.0 1600.0 AXIS_PTS_REF PHC_PAmbAirForTiPreHeatgClcn_A /end AXIS_DESCR
 /begin AXIS_DESCR COM_AXIS NO_INPUT_QUANTITY EcuIntgdSwGend_CM_single_degC 10 -40.0 150.0 AXIS_PTS_REF PHC_TiPreHeatgClcn_A /end AXIS_DESCR
/end CHARACTERISTIC
/begin AXIS_PTS PHC_PAmbAirForTiPreHeatgClcn_A "Ambient Air Pressure Map Axis for Pre Grid Heater Timer Activation" 0x400484B4 /* @ECU_Address@PHC_PAmbAirForTiPreHeatgClcn_A@ */ EIP_PAmbAir Lookup2D_X_FLOAT32_IEEE 0 EcuIntgdSwGend_CM_single_mbar 4 0.0 1600.0 /end AXIS_PTS
/begin AXIS_PTS PHC_TiPreHeatgClcn_A "PreHeating Time Calculation Map Axis" 0x400485A0 /* @ECU_Address@PHC_TiPreHeatgClcn_A@ */ NO_INPUT_QUANTITY Lookup2D_X_FLOAT32_IEEE 0 EcuIntgdSwGend_CM_single_degC 10 -40.0 150.0 /end AXIS_PTS
/begin CHARACTERISTIC PtoCtrl_CoeffDForPto_M "Derivative Coefficient Map Out Signal for PTO Controller" MAP 0x40048688 /* @ECU_Address@PtoCtrl_CoeffDForPto_M@ */ Lookup2D_FLOAT32_IEEE 0 EcuIntgdSwGend_CM_single -10000.0 10000.0
 /begin AXIS_DESCR COM_AXIS PtoCtrl_ErrNEngRef EcuIntgdSwGend_CM_single_rpm 10 -100000.0 100000.0 AXIS_PTS_REF PtoCtrl_ErrNEngRef_A /end AXIS_DESCR
 /begin AXIS_DESCR COM_AXIS EIP_TCoolt EcuIntgdSwGend_CM_single_degC 10 -50.0 200.0 AXIS_PTS_REF PtoCtrl_TCooltForSpdCtl_A /end AXIS_DESCR
/end CHARACTERISTIC
/begin AXIS_PTS PtoCtrl_ErrNEngRef_A "Axis Values of Error Engine Speed for PID Coefficient Maps" 0x40048CC8 /* @ECU_Address@PtoCtrl_ErrNEngRef_A@ */ PtoCtrl_ErrNEngRef Lookup2D_X_FLOAT32_IEEE 0 EcuIntgdSwGend_CM_single_rpm 10 -100000.0 100000.0 /end AXIS_PTS
/begin AXIS_PTS PtoCtrl_TCooltForSpdCtl_A "Coolant Temperature PID X Axis" 0x40048F44 /* @ECU_Address@PtoCtrl_TCooltForSpdCtl_A@ */ EIP_TCoolt Lookup2D_X_FLOAT32_IEEE 0 EcuIntgdSwGend_CM_single_degC 10 -50.0 200.0 /end AXIS_PTS
/begin CHARACTERISTIC PtoCtrl_CoeffFiltForPto_M "Filter Coefficient Map for PTO Controller" MAP 0x40048818 /* @ECU_Address@PtoCtrl_CoeffFiltForPto_M@ */ Lookup2D_FLOAT32_IEEE 0 EcuIntgdSwGend_CM_single -100000.0 100000.0
 /begin AXIS_DESCR COM_AXIS PtoCtrl_ErrNEngRef EcuIntgdSwGend_CM_single_rpm 10 -100000.0 100000.0 AXIS_PTS_REF PtoCtrl_ErrNEngRef_A /end AXIS_DESCR
 /begin AXIS_DESCR COM_AXIS EIP_TCoolt EcuIntgdSwGend_CM_single_degC 10 -50.0 200.0 AXIS_PTS_REF PtoCtrl_TCooltForSpdCtl_A /end AXIS_DESCR
/end CHARACTERISTIC
/begin CHARACTERISTIC PtoCtrl_CoeffIForPto_M "Integrator Coefficient Map for PTO Controller" MAP 0x400489A8 /* @ECU_Address@PtoCtrl_CoeffIForPto_M@ */ Lookup2D_FLOAT32_IEEE 0 EcuIntgdSwGend_CM_single -100000.0 100000.0
 /begin AXIS_DESCR COM_AXIS PtoCtrl_ErrNEngRef EcuIntgdSwGend_CM_single_rpm 10 -100000.0 100000.0 AXIS_PTS_REF PtoCtrl_ErrNEngRef_A /end AXIS_DESCR
 /begin AXIS_DESCR COM_AXIS EIP_TCoolt EcuIntgdSwGend_CM_single_degC 10 -50.0 200.0 AXIS_PTS_REF PtoCtrl_TCooltForSpdCtl_A /end AXIS_DESCR
/end CHARACTERISTIC
/begin CHARACTERISTIC PtoCtrl_CoeffPForPto_M "PID Controller Proportional Map For PTO Controller" MAP 0x40048B38 /* @ECU_Address@PtoCtrl_CoeffPForPto_M@ */ Lookup2D_FLOAT32_IEEE 0 EcuIntgdSwGend_CM_single -100000.0 100000.0
 /begin AXIS_DESCR COM_AXIS PtoCtrl_ErrNEngRef EcuIntgdSwGend_CM_single_rpm 10 -100000.0 100000.0 AXIS_PTS_REF PtoCtrl_ErrNEngRef_A /end AXIS_DESCR
 /begin AXIS_DESCR COM_AXIS EIP_TCoolt EcuIntgdSwGend_CM_single_degC 10 -50.0 200.0 AXIS_PTS_REF PtoCtrl_TCooltForSpdCtl_A /end AXIS_DESCR
/end CHARACTERISTIC
/begin CHARACTERISTIC PtoCtrl_PtoCtrlFF_M "PID Feed Forward Map For PTO" MAP 0x40048D88 /* @ECU_Address@PtoCtrl_PtoCtrlFF_M@ */ Lookup2D_FLOAT32_IEEE 0 EcuIntgdSwGend_CM_single_N_m -100000.0 100000.0
 /begin AXIS_DESCR COM_AXIS EIP_TCoolt EcuIntgdSwGend_CM_single_degC 10 -50.0 200.0 AXIS_PTS_REF PtoCtrl_TCooltForPtoCtrlFF_A /end AXIS_DESCR
 /begin AXIS_DESCR COM_AXIS EIP_NEng EcuIntgdSwGend_CM_single_rpm 10 0.0 5000.0 AXIS_PTS_REF PtoCtrl_NEngForPtoCtrlFF_A /end AXIS_DESCR
/end CHARACTERISTIC
/begin AXIS_PTS PtoCtrl_TCooltForPtoCtrlFF_A "Coolant Temperature Feed Forward X Axis" 0x40048F1C /* @ECU_Address@PtoCtrl_TCooltForPtoCtrlFF_A@ */ EIP_TCoolt Lookup2D_X_FLOAT32_IEEE 0 EcuIntgdSwGend_CM_single_degC 10 -50.0 200.0 /end AXIS_PTS
/begin AXIS_PTS PtoCtrl_NEngForPtoCtrlFF_A "PID Feed Forward Engine Speed X Axis" 0x40048D0C /* @ECU_Address@PtoCtrl_NEngForPtoCtrlFF_A@ */ EIP_NEng Lookup2D_X_FLOAT32_IEEE 0 EcuIntgdSwGend_CM_single_rpm 10 0.0 5000.0 /end AXIS_PTS
/begin CHARACTERISTIC RPG_PercgVolCtrlVlvFFLeakg1_M "Percentage Volumetric Control Valve FeedForward Leakage Map 1" MAP 0x4004A430 /* @ECU_Address@RPG_PercgVolCtrlVlvFFLeakg1_M@ */ Lookup2D_FLOAT32_IEEE 0 EcuIntgdSwGend_CM_single__ 0.0 100.0
 /begin AXIS_DESCR COM_AXIS TL_TqIndcdLimd EcuIntgdSwGend_CM_single 15 0.0 5000.0 AXIS_PTS_REF RPG_TqIndcdLimdForFFLeakg1_A /end AXIS_DESCR
 /begin AXIS_DESCR COM_AXIS EIP_NEng EcuIntgdSwGend_CM_single_rpm 15 0.0 3500.0 AXIS_PTS_REF RPG_NEngQntyForFFLeakg1_A /end AXIS_DESCR
/end CHARACTERISTIC
/begin AXIS_PTS RPG_TqIndcdLimdForFFLeakg1_A "Indicated Torque Limitation Map1 Axis for FeedForward Leakage" 0x4004AF2C /* @ECU_Address@RPG_TqIndcdLimdForFFLeakg1_A@ */ TL_TqIndcdLimd Lookup2D_X_FLOAT32_IEEE 0 EcuIntgdSwGend_CM_single 15 0.0 5000.0 /end AXIS_PTS
/begin AXIS_PTS RPG_NEngQntyForFFLeakg1_A "Engine Speed Quantity Map 1 Axis for FeedForward Leakage" 0x400496C4 /* @ECU_Address@RPG_NEngQntyForFFLeakg1_A@ */ EIP_NEng Lookup2D_X_FLOAT32_IEEE 0 EcuIntgdSwGend_CM_single_rpm 15 0.0 3500.0 /end AXIS_PTS
/begin CHARACTERISTIC RPG_PercgVolCtrlVlvFFLeakg2_M "Percentage Volumetric Control Valve FeedForward Leakage Map 2" MAP 0x4004A7B4 /* @ECU_Address@RPG_PercgVolCtrlVlvFFLeakg2_M@ */ Lookup2D_FLOAT32_IEEE 0 EcuIntgdSwGend_CM_single__ 0.0 100.0
 /begin AXIS_DESCR COM_AXIS TL_TqIndcdLimd EcuIntgdSwGend_CM_single 15 0.0 5000.0 AXIS_PTS_REF RPG_TqIndcdLimdForFFLeakg2_A /end AXIS_DESCR
 /begin AXIS_DESCR COM_AXIS EIP_NEng EcuIntgdSwGend_CM_single_rpm 15 0.0 3500.0 AXIS_PTS_REF RPG_NEngQntyForFFLeakg2_A /end AXIS_DESCR
/end CHARACTERISTIC
/begin AXIS_PTS RPG_TqIndcdLimdForFFLeakg2_A "Indicated Torque Limitation Map2 Axis for FeedForward Leakage" 0x4004AF68 /* @ECU_Address@RPG_TqIndcdLimdForFFLeakg2_A@ */ TL_TqIndcdLimd Lookup2D_X_FLOAT32_IEEE 0 EcuIntgdSwGend_CM_single 15 0.0 5000.0 /end AXIS_PTS
/begin AXIS_PTS RPG_NEngQntyForFFLeakg2_A "Engine Speed Quantity Map 2 Axis for FeedForward Leakage" 0x40049700 /* @ECU_Address@RPG_NEngQntyForFFLeakg2_A@ */ EIP_NEng Lookup2D_X_FLOAT32_IEEE 0 EcuIntgdSwGend_CM_single_rpm 15 0.0 3500.0 /end AXIS_PTS
/begin CHARACTERISTIC RPG_PercgVolCtrlVlvFFLeakg3_M "Percentage Volumetric Control Valve FeedForward Leakage Map 3" MAP 0x4004AB38 /* @ECU_Address@RPG_PercgVolCtrlVlvFFLeakg3_M@ */ Lookup2D_FLOAT32_IEEE 0 EcuIntgdSwGend_CM_single__ 0.0 100.0
 /begin AXIS_DESCR COM_AXIS TL_TqIndcdLimd EcuIntgdSwGend_CM_single 15 0.0 5000.0 AXIS_PTS_REF RPG_TqIndcdLimdForFFLeakg3_A /end AXIS_DESCR
 /begin AXIS_DESCR COM_AXIS EIP_NEng EcuIntgdSwGend_CM_single_rpm 15 0.0 3500.0 AXIS_PTS_REF RPG_NEngQntyForFFLeakg3_A /end AXIS_DESCR
/end CHARACTERISTIC
/begin AXIS_PTS RPG_TqIndcdLimdForFFLeakg3_A "Indicated Torque Limitation Map3 Axis for FeedForward Leakage" 0x4004AFA4 /* @ECU_Address@RPG_TqIndcdLimdForFFLeakg3_A@ */ TL_TqIndcdLimd Lookup2D_X_FLOAT32_IEEE 0 EcuIntgdSwGend_CM_single 15 0.0 5000.0 /end AXIS_PTS
/begin AXIS_PTS RPG_NEngQntyForFFLeakg3_A "Engine Speed Quantity Map 3 Axis for FeedForward Leakage" 0x4004973C /* @ECU_Address@RPG_NEngQntyForFFLeakg3_A@ */ EIP_NEng Lookup2D_X_FLOAT32_IEEE 0 EcuIntgdSwGend_CM_single_rpm 15 0.0 3500.0 /end AXIS_PTS
/begin CHARACTERISTIC RPG_CoeffDForPRailCtl_M "Rail Pressure Controller D Coefficient Map" MAP 0x40048FB8 /* @ECU_Address@RPG_CoeffDForPRailCtl_M@ */ Lookup2D_FLOAT32_IEEE 0 EcuIntgdSwGend_CM_single -100000.0 100000.0
 /begin AXIS_DESCR COM_AXIS RPG_ErrPRail EcuIntgdSwGend_CM_single_bar 10 -500.0 500.0 AXIS_PTS_REF RPG_ErrPRail_A /end AXIS_DESCR
 /begin AXIS_DESCR COM_AXIS EIP_TFu EcuIntgdSwGend_CM_single_degC 10 -40.0 250.0 AXIS_PTS_REF RPG_TFuForPRailCtl_A /end AXIS_DESCR
/end CHARACTERISTIC
/begin AXIS_PTS RPG_ErrPRail_A "Rail Pressure Controller Rail Pressure Error Axis for PID Coefficient Calculation Maps" 0x400495F8 /* @ECU_Address@RPG_ErrPRail_A@ */ RPG_ErrPRail Lookup2D_X_FLOAT32_IEEE 0 EcuIntgdSwGend_CM_single_bar 10 -500.0 500.0 /end AXIS_PTS
/begin AXIS_PTS RPG_TFuForPRailCtl_A "Fuel Temperature Axis for PID Coefficient Calculation Maps" 0x4004AEFC /* @ECU_Address@RPG_TFuForPRailCtl_A@ */ EIP_TFu Lookup2D_X_FLOAT32_IEEE 0 EcuIntgdSwGend_CM_single_degC 10 -40.0 250.0 /end AXIS_PTS
/begin CHARACTERISTIC RPG_CoeffFiltForPRailCtl_M "Rail Pressure Controller D Filter Coefficient Map" MAP 0x40049148 /* @ECU_Address@RPG_CoeffFiltForPRailCtl_M@ */ Lookup2D_FLOAT32_IEEE 0 EcuIntgdSwGend_CM_single -100000.0 100000.0
 /begin AXIS_DESCR COM_AXIS RPG_ErrPRail EcuIntgdSwGend_CM_single_bar 10 -500.0 500.0 AXIS_PTS_REF RPG_ErrPRail_A /end AXIS_DESCR
 /begin AXIS_DESCR COM_AXIS EIP_TFu EcuIntgdSwGend_CM_single_degC 10 -40.0 250.0 AXIS_PTS_REF RPG_TFuForPRailCtl_A /end AXIS_DESCR
/end CHARACTERISTIC
/begin CHARACTERISTIC RPG_CoeffIForPRailCtl_M "Rail Pressure Controller I Coefficient Map" MAP 0x400492D8 /* @ECU_Address@RPG_CoeffIForPRailCtl_M@ */ Lookup2D_FLOAT32_IEEE 0 EcuIntgdSwGend_CM_single -100000.0 100000.0
 /begin AXIS_DESCR COM_AXIS RPG_ErrPRail EcuIntgdSwGend_CM_single_bar 10 -500.0 500.0 AXIS_PTS_REF RPG_ErrPRail_A /end AXIS_DESCR
 /begin AXIS_DESCR COM_AXIS EIP_TFu EcuIntgdSwGend_CM_single_degC 10 -40.0 250.0 AXIS_PTS_REF RPG_TFuForPRailCtl_A /end AXIS_DESCR
/end CHARACTERISTIC
/begin CHARACTERISTIC RPG_CoeffPForPRailCtl_M "Rail Pressure Controller P Coefficient Map" MAP 0x40049468 /* @ECU_Address@RPG_CoeffPForPRailCtl_M@ */ Lookup2D_FLOAT32_IEEE 0 EcuIntgdSwGend_CM_single -100000.0 100000.0
 /begin AXIS_DESCR COM_AXIS RPG_ErrPRail EcuIntgdSwGend_CM_single_bar 10 -500.0 500.0 AXIS_PTS_REF RPG_ErrPRail_A /end AXIS_DESCR
 /begin AXIS_DESCR COM_AXIS EIP_TFu EcuIntgdSwGend_CM_single_degC 10 -40.0 250.0 AXIS_PTS_REF RPG_TFuForPRailCtl_A /end AXIS_DESCR
/end CHARACTERISTIC
/begin CHARACTERISTIC RPG_PAmbAirCorrForPRail_M "Ambient Air Pressure Correction Map for Rail Pressure" CURVE 0x40049780 /* @ECU_Address@RPG_PAmbAirCorrForPRail_M@ */ Lookup1D_FLOAT32_IEEE 0 EcuIntgdSwGend_CM_single_bar 0.0 100.0
 /begin AXIS_DESCR COM_AXIS EIP_PAmbAir EcuIntgdSwGend_CM_single_bar 5 0.0 3000.0 AXIS_PTS_REF RPG_PAmbAirCorrPRail_A /end AXIS_DESCR
/end CHARACTERISTIC
/begin AXIS_PTS RPG_PAmbAirCorrPRail_A "Ambient Air Pressure Correction Map Axis for Rail Pressure" 0x40049794 /* @ECU_Address@RPG_PAmbAirCorrPRail_A@ */ EIP_PAmbAir Lookup1D_X_FLOAT32_IEEE 0 EcuIntgdSwGend_CM_single_bar 5 0.0 3000.0 /end AXIS_PTS
/begin CHARACTERISTIC RPG_PRailCorrPAmbAir_M "Rail Pressure Correction for Ambient Air Pressure Map" MAP 0x400497D0 /* @ECU_Address@RPG_PRailCorrPAmbAir_M@ */ Lookup2D_FLOAT32_IEEE 0 EcuIntgdSwGend_CM_single_bar 0.0 2500.0
 /begin AXIS_DESCR COM_AXIS TL_TqIndcdLimd EcuIntgdSwGend_CM_single_N_m 5 0.0 5000.0 AXIS_PTS_REF RPG_TqIndcdLimdForPAmbAirCorr_A /end AXIS_DESCR
 /begin AXIS_DESCR COM_AXIS EIP_NEng EcuIntgdSwGend_CM_single_rpm 20 0.0 3200.0 AXIS_PTS_REF RPG_NEngCorrForPAmbAirCorr_A /end AXIS_DESCR
/end CHARACTERISTIC
/begin AXIS_PTS RPG_TqIndcdLimdForPAmbAirCorr_A "Limited Indicated Torque Map Axis for Rail Pressure Correction wrt Ambient Air Pressure Map" 0x4004AFE0 /* @ECU_Address@RPG_TqIndcdLimdForPAmbAirCorr_A@ */ TL_TqIndcdLimd Lookup2D_X_FLOAT32_IEEE 0 EcuIntgdSwGend_CM_single_N_m 5 0.0 5000.0 /end AXIS_PTS
/begin AXIS_PTS RPG_NEngCorrForPAmbAirCorr_A "Engine Speed Correction Map Axis for Corrected Ambient Air Pressure" 0x40049638 /* @ECU_Address@RPG_NEngCorrForPAmbAirCorr_A@ */ EIP_NEng Lookup2D_X_FLOAT32_IEEE 0 EcuIntgdSwGend_CM_single_rpm 20 0.0 3200.0 /end AXIS_PTS
/begin CHARACTERISTIC RPG_TCorrForPRail_M "Rail Pressure Temperature Correction Map" CURVE 0x4004AEE8 /* @ECU_Address@RPG_TCorrForPRail_M@ */ Lookup1D_FLOAT32_IEEE 0 EcuIntgdSwGend_CM_single_bar 0.0 2500.0
 /begin AXIS_DESCR COM_AXIS NO_INPUT_QUANTITY EcuIntgdSwGend_CM_single_degC 5 -100.0 200.0 AXIS_PTS_REF RPG_TCorrForPRail_A /end AXIS_DESCR
/end CHARACTERISTIC
/begin AXIS_PTS RPG_TCorrForPRail_A "Rail Pressure Temperature Correction Map Axis" 0x4004AED4 /* @ECU_Address@RPG_TCorrForPRail_A@ */ NO_INPUT_QUANTITY Lookup1D_X_FLOAT32_IEEE 0 EcuIntgdSwGend_CM_single_degC 5 -100.0 200.0 /end AXIS_PTS
/begin CHARACTERISTIC SC_TiMaxAllwblCrnkg_M "Maximum Allowable Cranking Time Calculation Map" CURVE 0x4004B0A8 /* @ECU_Address@SC_TiMaxAllwblCrnkg_M@ */ Lookup1D_FLOAT32_IEEE 0 EcuIntgdSwGend_CM_single_ms 0.0 50000.0
 /begin AXIS_DESCR COM_AXIS NO_INPUT_QUANTITY EcuIntgdSwGend_CM_single_degC 5 -40.0 150.0 AXIS_PTS_REF SC_TiCrnkg_A /end AXIS_DESCR
/end CHARACTERISTIC
/begin AXIS_PTS SC_TiCrnkg_A "Cranking Time Map Axis" 0x4004B074 /* @ECU_Address@SC_TiCrnkg_A@ */ NO_INPUT_QUANTITY Lookup1D_X_FLOAT32_IEEE 0 EcuIntgdSwGend_CM_single_degC 5 -40.0 150.0 /end AXIS_PTS
/begin CHARACTERISTIC TrC_FuQntyToTq_M "Fuel Quantity To Torque Maps" MAP 0x4004C348 /* @ECU_Address@TrC_FuQntyToTq_M@ */ Lookup2D_FLOAT32_IEEE 0 EcuIntgdSwGend_CM_single_N_m 0.0 2000.0
 /begin AXIS_DESCR COM_AXIS TrC_MMaiFuQntyLimd EcuIntgdSwGend_CM_single_mm_3 20 0.0 300.0 AXIS_PTS_REF TrC_FuQntyForQntyCnvn_A /end AXIS_DESCR
 /begin AXIS_DESCR COM_AXIS EIP_NEng EcuIntgdSwGend_CM_single_rpm 25 0.0 3000.0 AXIS_PTS_REF TrC_NEngForQntyCnvn_A /end AXIS_DESCR
/end CHARACTERISTIC
/begin AXIS_PTS TrC_FuQntyForQntyCnvn_A "Fuel Quantity Axis Values for Quantity Conversion" 0x4004C2F8 /* @ECU_Address@TrC_FuQntyForQntyCnvn_A@ */ TrC_MMaiFuQntyLimd Lookup2D_X_FLOAT32_IEEE 0 EcuIntgdSwGend_CM_single_mm_3 20 0.0 300.0 /end AXIS_PTS
/begin AXIS_PTS TrC_NEngForQntyCnvn_A "Engine Speed Axis Values for Quantity Conversion" 0x4005041C /* @ECU_Address@TrC_NEngForQntyCnvn_A@ */ EIP_NEng Lookup2D_X_FLOAT32_IEEE 0 EcuIntgdSwGend_CM_single_rpm 25 0.0 3000.0 /end AXIS_PTS
/begin CHARACTERISTIC TrC_MaiFuPAmbAirCorr_M "Main Fuel Quantity - Ambient Air Pressure Correction" MAP 0x4004F9F4 /* @ECU_Address@TrC_MaiFuPAmbAirCorr_M@ */ Lookup2D_FLOAT32_IEEE 0 EcuIntgdSwGend_CM_single_mm_3_stk -500.0 1000.0
 /begin AXIS_DESCR COM_AXIS TL_TqIndcdLimd EcuIntgdSwGend_CM_single_N_m 10 0.0 4000.0 AXIS_PTS_REF TrC_TqIndcdLimdForMaiFuCorr_A /end AXIS_DESCR
 /begin AXIS_DESCR COM_AXIS EIP_PAmbAir EcuIntgdSwGend_CM_single_mbar 10 0.0 30000.0 AXIS_PTS_REF TrC_MaiFuPAmbAirCorr_A /end AXIS_DESCR
/end CHARACTERISTIC
/begin AXIS_PTS TrC_TqIndcdLimdForMaiFuCorr_A "Indicated Torque for Main Fuel Quantity Correction" 0x400506F0 /* @ECU_Address@TrC_TqIndcdLimdForMaiFuCorr_A@ */ TL_TqIndcdLimd Lookup2D_X_FLOAT32_IEEE 0 EcuIntgdSwGend_CM_single_N_m 10 0.0 4000.0 /end AXIS_PTS
/begin AXIS_PTS TrC_MaiFuPAmbAirCorr_A "Main Fuel Quantity - Axis of Ambient Air Pressure Correction" 0x4004F9CC /* @ECU_Address@TrC_MaiFuPAmbAirCorr_A@ */ EIP_PAmbAir Lookup2D_X_FLOAT32_IEEE 0 EcuIntgdSwGend_CM_single_mbar 10 0.0 30000.0 /end AXIS_PTS
/begin CHARACTERISTIC TrC_MaiFuTAirBoostCorr_M "Main Fuel Quantity - Airboost Temperature Correction" MAP 0x4004FBAC /* @ECU_Address@TrC_MaiFuTAirBoostCorr_M@ */ Lookup2D_FLOAT32_IEEE 0 EcuIntgdSwGend_CM_single_mm_3_stk -500.0 1000.0
 /begin AXIS_DESCR COM_AXIS TL_TqIndcdLimd EcuIntgdSwGend_CM_single_N_m 10 0.0 4000.0 AXIS_PTS_REF TrC_TqIndcdLimdForMaiFuCorr_A /end AXIS_DESCR
 /begin AXIS_DESCR COM_AXIS EIP_TAirBoost EcuIntgdSwGend_CM_single_degC 10 -50.0 250.0 AXIS_PTS_REF TrC_MaiFuTAirBoostCorr_A /end AXIS_DESCR
/end CHARACTERISTIC
/begin AXIS_PTS TrC_MaiFuTAirBoostCorr_A "Main Fuel Quantity - Axis of Airboost Temperature Correction" 0x4004FB84 /* @ECU_Address@TrC_MaiFuTAirBoostCorr_A@ */ EIP_TAirBoost Lookup2D_X_FLOAT32_IEEE 0 EcuIntgdSwGend_CM_single_degC 10 -50.0 250.0 /end AXIS_PTS
/begin CHARACTERISTIC TrC_MaiFuTAmbAirCorr_M "Main Fuel Quantity - Ambient Air Temperature Correction" MAP 0x4004FD64 /* @ECU_Address@TrC_MaiFuTAmbAirCorr_M@ */ Lookup2D_FLOAT32_IEEE 0 EcuIntgdSwGend_CM_single_mm_3_stk -500.0 1000.0
 /begin AXIS_DESCR COM_AXIS TL_TqIndcdLimd EcuIntgdSwGend_CM_single_N_m 10 0.0 4000.0 AXIS_PTS_REF TrC_TqIndcdLimdForMaiFuCorr_A /end AXIS_DESCR
 /begin AXIS_DESCR COM_AXIS EIP_TAmbAir EcuIntgdSwGend_CM_single_degC 10 -50.0 250.0 AXIS_PTS_REF TrC_MaiFuTAmbAirCorr_A /end AXIS_DESCR
/end CHARACTERISTIC
/begin AXIS_PTS TrC_MaiFuTAmbAirCorr_A "Main Fuel Quantity - Axis of Ambient Air Temperature Correction" 0x4004FD3C /* @ECU_Address@TrC_MaiFuTAmbAirCorr_A@ */ EIP_TAmbAir Lookup2D_X_FLOAT32_IEEE 0 EcuIntgdSwGend_CM_single_degC 10 -50.0 250.0 /end AXIS_PTS
/begin CHARACTERISTIC TrC_MaiFuTCooltCorr_M "Main Fuel Quantity - Coolant Temperature Correction" MAP 0x4004FF1C /* @ECU_Address@TrC_MaiFuTCooltCorr_M@ */ Lookup2D_FLOAT32_IEEE 0 EcuIntgdSwGend_CM_single_mm_3_stk -500.0 1000.0
 /begin AXIS_DESCR COM_AXIS TL_TqIndcdLimd EcuIntgdSwGend_CM_single_N_m 10 0.0 4000.0 AXIS_PTS_REF TrC_TqIndcdLimdForMaiFuCorr_A /end AXIS_DESCR
 /begin AXIS_DESCR COM_AXIS EIP_TCoolt EcuIntgdSwGend_CM_single_degC 10 -50.0 250.0 AXIS_PTS_REF TrC_MaiFuTCooltCorr_A /end AXIS_DESCR
/end CHARACTERISTIC
/begin AXIS_PTS TrC_MaiFuTCooltCorr_A "Main Fuel Quantity - Axis of Coolant Temperature Correction" 0x4004FEF4 /* @ECU_Address@TrC_MaiFuTCooltCorr_A@ */ EIP_TCoolt Lookup2D_X_FLOAT32_IEEE 0 EcuIntgdSwGend_CM_single_degC 10 -50.0 250.0 /end AXIS_PTS
/begin CHARACTERISTIC TrC_MaiFuTOilCorr_M "Main Fuel Quantity - Oil Temperature Correction" MAP 0x400500D4 /* @ECU_Address@TrC_MaiFuTOilCorr_M@ */ Lookup2D_FLOAT32_IEEE 0 EcuIntgdSwGend_CM_single_mm_3_stk -500.0 1000.0
 /begin AXIS_DESCR COM_AXIS TL_TqIndcdLimd EcuIntgdSwGend_CM_single_N_m 10 0.0 4000.0 AXIS_PTS_REF TrC_TqIndcdLimdForMaiFuCorr_A /end AXIS_DESCR
 /begin AXIS_DESCR COM_AXIS EIP_TOil EcuIntgdSwGend_CM_single_degC 10 -50.0 250.0 AXIS_PTS_REF TrC_MaiFuTOilCorr_A /end AXIS_DESCR
/end CHARACTERISTIC
/begin AXIS_PTS TrC_MaiFuTOilCorr_A "Main Fuel Quantity - Axis of Oil Temperature Correction" 0x400500AC /* @ECU_Address@TrC_MaiFuTOilCorr_A@ */ EIP_TOil Lookup2D_X_FLOAT32_IEEE 0 EcuIntgdSwGend_CM_single_degC 10 -50.0 250.0 /end AXIS_PTS
/begin CHARACTERISTIC TrC_MaiFuUClmp30Corr_M "Main Fuel Quantity - Battery Voltage Correction" MAP 0x4005028C /* @ECU_Address@TrC_MaiFuUClmp30Corr_M@ */ Lookup2D_FLOAT32_IEEE 0 EcuIntgdSwGend_CM_single_mm_3_stk -500.0 1000.0
 /begin AXIS_DESCR COM_AXIS TL_TqIndcdLimd EcuIntgdSwGend_CM_single_N_m 10 0.0 4000.0 AXIS_PTS_REF TrC_TqIndcdLimdForMaiFuCorr_A /end AXIS_DESCR
 /begin AXIS_DESCR COM_AXIS EIP_UClmp30 EcuIntgdSwGend_CM_single_V 10 0.0 50.0 AXIS_PTS_REF TrC_MaiFuUClmp30Corr_A /end AXIS_DESCR
/end CHARACTERISTIC
/begin AXIS_PTS TrC_MaiFuUClmp30Corr_A "Main Fuel Quantity - Axis of Battery Voltage Correction" 0x40050264 /* @ECU_Address@TrC_MaiFuUClmp30Corr_A@ */ EIP_UClmp30 Lookup2D_X_FLOAT32_IEEE 0 EcuIntgdSwGend_CM_single_V 10 0.0 50.0 /end AXIS_PTS
/begin CHARACTERISTIC TrC_MMaiFuQnty1_M "Main Quantity Value Interpolation Between Map 1 and 2" MAP 0x4004CB18 /* @ECU_Address@TrC_MMaiFuQnty1_M@ */ Lookup2D_FLOAT32_IEEE 0 EcuIntgdSwGend_CM_single_mm_3_stk 0.0 1000.0
 /begin AXIS_DESCR COM_AXIS TL_TqIndcdLimd EcuIntgdSwGend_CM_single_N_m 25 0.0 10000.0 AXIS_PTS_REF TrC_TqIndcdLimdMMaiFu_A /end AXIS_DESCR
 /begin AXIS_DESCR COM_AXIS EIP_NEng EcuIntgdSwGend_CM_single_rpm 25 0.0 5000.0 AXIS_PTS_REF TrC_NEngMMaiFu_A /end AXIS_DESCR
/end CHARACTERISTIC
/begin AXIS_PTS TrC_TqIndcdLimdMMaiFu_A "Axis of Indicated Torque for Main Fuel Map" 0x40050740 /* @ECU_Address@TrC_TqIndcdLimdMMaiFu_A@ */ TL_TqIndcdLimd Lookup2D_X_FLOAT32_IEEE 0 EcuIntgdSwGend_CM_single_N_m 25 0.0 10000.0 /end AXIS_PTS
/begin AXIS_PTS TrC_NEngMMaiFu_A "Axis Values of Engine Speed for Main Fuel Quantity Map" 0x40050480 /* @ECU_Address@TrC_NEngMMaiFu_A@ */ EIP_NEng Lookup2D_X_FLOAT32_IEEE 0 EcuIntgdSwGend_CM_single_rpm 25 0.0 5000.0 /end AXIS_PTS
/begin CHARACTERISTIC TrC_MMaiFuQnty2_M "Main Quantity Value Interpolation Between Map 2 and 3" MAP 0x4004D4DC /* @ECU_Address@TrC_MMaiFuQnty2_M@ */ Lookup2D_FLOAT32_IEEE 0 EcuIntgdSwGend_CM_single_mm_3_stk 0.0 1000.0
 /begin AXIS_DESCR COM_AXIS TL_TqIndcdLimd EcuIntgdSwGend_CM_single_N_m 25 0.0 10000.0 AXIS_PTS_REF TrC_TqIndcdLimdMMaiFu_A /end AXIS_DESCR
 /begin AXIS_DESCR COM_AXIS EIP_NEng EcuIntgdSwGend_CM_single_rpm 25 0.0 5000.0 AXIS_PTS_REF TrC_NEngMMaiFu_A /end AXIS_DESCR
/end CHARACTERISTIC
/begin CHARACTERISTIC TrC_MMaiFuQnty3_M "Main Quantity Map 2" MAP 0x4004DEA0 /* @ECU_Address@TrC_MMaiFuQnty3_M@ */ Lookup2D_FLOAT32_IEEE 0 EcuIntgdSwGend_CM_single_mm_3_stk 0.0 1000.0
 /begin AXIS_DESCR COM_AXIS TL_TqIndcdLimd EcuIntgdSwGend_CM_single_N_m 25 0.0 10000.0 AXIS_PTS_REF TrC_TqIndcdLimdMMaiFu_A /end AXIS_DESCR
 /begin AXIS_DESCR COM_AXIS EIP_NEng EcuIntgdSwGend_CM_single_rpm 25 0.0 5000.0 AXIS_PTS_REF TrC_NEngMMaiFu_A /end AXIS_DESCR
/end CHARACTERISTIC
/begin CHARACTERISTIC TrC_MPltFuQnty1_M "Pilot Quantity Map 1" MAP 0x4004EA24 /* @ECU_Address@TrC_MPltFuQnty1_M@ */ Lookup2D_FLOAT32_IEEE 0 EcuIntgdSwGend_CM_single_mm_3_stk 0.0 1000.0
 /begin AXIS_DESCR COM_AXIS TL_TqIndcdLimd EcuIntgdSwGend_CM_single_N_m 10 0.0 10000.0 AXIS_PTS_REF TrC_TqIndcdLimdMPreFu_A /end AXIS_DESCR
 /begin AXIS_DESCR COM_AXIS EIP_NEng EcuIntgdSwGend_CM_single_rpm 15 0.0 5000.0 AXIS_PTS_REF TrC_NEngMPreFu_A /end AXIS_DESCR
/end CHARACTERISTIC
/begin AXIS_PTS TrC_TqIndcdLimdMPreFu_A "Axis of Indicated Torque for Pilot Fuel Map" 0x400507A4 /* @ECU_Address@TrC_TqIndcdLimdMPreFu_A@ */ TL_TqIndcdLimd Lookup2D_X_FLOAT32_IEEE 0 EcuIntgdSwGend_CM_single_N_m 10 0.0 10000.0 /end AXIS_PTS
/begin AXIS_PTS TrC_NEngMPreFu_A "Axis Values of Engine Speed for Pilot Fuel Quantity Map" 0x400504E4 /* @ECU_Address@TrC_NEngMPreFu_A@ */ EIP_NEng Lookup2D_X_FLOAT32_IEEE 0 EcuIntgdSwGend_CM_single_rpm 15 0.0 5000.0 /end AXIS_PTS
/begin CHARACTERISTIC TrC_MPltFuQnty2_M "Pilot Quantity Map 2" MAP 0x4004EC7C /* @ECU_Address@TrC_MPltFuQnty2_M@ */ Lookup2D_FLOAT32_IEEE 0 EcuIntgdSwGend_CM_single_mm_3_stk 0.0 1000.0
 /begin AXIS_DESCR COM_AXIS TL_TqIndcdLimd EcuIntgdSwGend_CM_single_N_m 10 0.0 10000.0 AXIS_PTS_REF TrC_TqIndcdLimdMPreFu_A /end AXIS_DESCR
 /begin AXIS_DESCR COM_AXIS EIP_NEng EcuIntgdSwGend_CM_single_rpm 15 0.0 5000.0 AXIS_PTS_REF TrC_NEngMPreFu_A /end AXIS_DESCR
/end CHARACTERISTIC
/begin CHARACTERISTIC TrC_MPltFuQnty3_M "Pilot Quantity Map 3" MAP 0x4004EED4 /* @ECU_Address@TrC_MPltFuQnty3_M@ */ Lookup2D_FLOAT32_IEEE 0 EcuIntgdSwGend_CM_single_mm_3_stk 0.0 1000.0
 /begin AXIS_DESCR COM_AXIS TL_TqIndcdLimd EcuIntgdSwGend_CM_single_N_m 10 0.0 10000.0 AXIS_PTS_REF TrC_TqIndcdLimdMPreFu_A /end AXIS_DESCR
 /begin AXIS_DESCR COM_AXIS EIP_NEng EcuIntgdSwGend_CM_single_rpm 15 0.0 5000.0 AXIS_PTS_REF TrC_NEngMPreFu_A /end AXIS_DESCR
/end CHARACTERISTIC
/begin CHARACTERISTIC TrC_MPltFuPAmbAirCorr_M "Pilot Fuel Quantity - Ambient Air Pressure Correction" MAP 0x4004E894 /* @ECU_Address@TrC_MPltFuPAmbAirCorr_M@ */ Lookup2D_FLOAT32_IEEE 0 EcuIntgdSwGend_CM_single_mm_3_stk -500.0 500.0
 /begin AXIS_DESCR COM_AXIS TL_TqIndcdLimd EcuIntgdSwGend_CM_single_N_m 10 0.0 4000.0 AXIS_PTS_REF TrC_TqIndcdLimdForPltFuCorr_A /end AXIS_DESCR
 /begin AXIS_DESCR COM_AXIS EIP_PAmbAir EcuIntgdSwGend_CM_single_mbar 10 0.0 10000.0 AXIS_PTS_REF TrC_MPltFuPAmbAirCorr_A /end AXIS_DESCR
/end CHARACTERISTIC
/begin AXIS_PTS TrC_TqIndcdLimdForPltFuCorr_A "Indicated Torque for Pilot Fuel Quantity Correction" 0x40050718 /* @ECU_Address@TrC_TqIndcdLimdForPltFuCorr_A@ */ TL_TqIndcdLimd Lookup2D_X_FLOAT32_IEEE 0 EcuIntgdSwGend_CM_single_N_m 10 0.0 4000.0 /end AXIS_PTS
/begin AXIS_PTS TrC_MPltFuPAmbAirCorr_A "Pilot Fuel Quantity - Axis of Ambient Air Pressure Correction" 0x4004E86C /* @ECU_Address@TrC_MPltFuPAmbAirCorr_A@ */ EIP_PAmbAir Lookup2D_X_FLOAT32_IEEE 0 EcuIntgdSwGend_CM_single_mbar 10 0.0 10000.0 /end AXIS_PTS
/begin CHARACTERISTIC TrC_MPltFuTAirBoostCorr_M "Pilot Fuel Quantity - Airboost Temperature Correction" MAP 0x4004F15C /* @ECU_Address@TrC_MPltFuTAirBoostCorr_M@ */ Lookup2D_FLOAT32_IEEE 0 EcuIntgdSwGend_CM_single_mm_3_stk -500.0 500.0
 /begin AXIS_DESCR COM_AXIS TL_TqIndcdLimd EcuIntgdSwGend_CM_single_N_m 10 0.0 4000.0 AXIS_PTS_REF TrC_TqIndcdLimdForPltFuCorr_A /end AXIS_DESCR
 /begin AXIS_DESCR COM_AXIS EIP_TAirBoost EcuIntgdSwGend_CM_single_degC 10 -50.0 250.0 AXIS_PTS_REF TrC_MPltFuTAirBoostCorr_A /end AXIS_DESCR
/end CHARACTERISTIC
/begin AXIS_PTS TrC_MPltFuTAirBoostCorr_A "Pilot Fuel Quantity - Axis of Airboost Temperature Correction" 0x4004F134 /* @ECU_Address@TrC_MPltFuTAirBoostCorr_A@ */ EIP_TAirBoost Lookup2D_X_FLOAT32_IEEE 0 EcuIntgdSwGend_CM_single_degC 10 -50.0 250.0 /end AXIS_PTS
/begin CHARACTERISTIC TrC_MPltFuTAmbAirCorr_M "Pilot Fuel Quantity - Ambient Air Temperature Correction" MAP 0x4004F314 /* @ECU_Address@TrC_MPltFuTAmbAirCorr_M@ */ Lookup2D_FLOAT32_IEEE 0 EcuIntgdSwGend_CM_single_mm_3_stk -500.0 500.0
 /begin AXIS_DESCR COM_AXIS TL_TqIndcdLimd EcuIntgdSwGend_CM_single_N_m 10 0.0 4000.0 AXIS_PTS_REF TrC_TqIndcdLimdForPltFuCorr_A /end AXIS_DESCR
 /begin AXIS_DESCR COM_AXIS EIP_TAmbAir EcuIntgdSwGend_CM_single_degC 10 -50.0 250.0 AXIS_PTS_REF TrC_MPltFuTAmbAirCorr_A /end AXIS_DESCR
/end CHARACTERISTIC
/begin AXIS_PTS TrC_MPltFuTAmbAirCorr_A "Pilot Fuel Quantity - Axis of Ambient Air Temperature Correction" 0x4004F2EC /* @ECU_Address@TrC_MPltFuTAmbAirCorr_A@ */ EIP_TAmbAir Lookup2D_X_FLOAT32_IEEE 0 EcuIntgdSwGend_CM_single_degC 10 -50.0 250.0 /end AXIS_PTS
/begin CHARACTERISTIC TrC_MPltFuTCooltCorr_M "Pilot Fuel Quantity - Coolant Temperature Correction" MAP 0x4004F4CC /* @ECU_Address@TrC_MPltFuTCooltCorr_M@ */ Lookup2D_FLOAT32_IEEE 0 EcuIntgdSwGend_CM_single_mm_3_stk -500.0 500.0
 /begin AXIS_DESCR COM_AXIS TL_TqIndcdLimd EcuIntgdSwGend_CM_single_N_m 10 0.0 4000.0 AXIS_PTS_REF TrC_TqIndcdLimdForPltFuCorr_A /end AXIS_DESCR
 /begin AXIS_DESCR COM_AXIS EIP_TCoolt EcuIntgdSwGend_CM_single_degC 10 -50.0 250.0 AXIS_PTS_REF TrC_MPltFuTCooltCorr_A /end AXIS_DESCR
/end CHARACTERISTIC
/begin AXIS_PTS TrC_MPltFuTCooltCorr_A "Pilot Fuel Quantity - Axis of Coolant Temperature Correction" 0x4004F4A4 /* @ECU_Address@TrC_MPltFuTCooltCorr_A@ */ EIP_TCoolt Lookup2D_X_FLOAT32_IEEE 0 EcuIntgdSwGend_CM_single_degC 10 -50.0 250.0 /end AXIS_PTS
/begin CHARACTERISTIC TrC_MPltFuTOilCorr_M "Pilot Fuel Quantity - Oil Temperature Correction" MAP 0x4004F684 /* @ECU_Address@TrC_MPltFuTOilCorr_M@ */ Lookup2D_FLOAT32_IEEE 0 EcuIntgdSwGend_CM_single_mm_3_stk -500.0 500.0
 /begin AXIS_DESCR COM_AXIS TL_TqIndcdLimd EcuIntgdSwGend_CM_single_N_m 10 0.0 4000.0 AXIS_PTS_REF TrC_TqIndcdLimdForPltFuCorr_A /end AXIS_DESCR
 /begin AXIS_DESCR COM_AXIS EIP_TOil EcuIntgdSwGend_CM_single_degC 10 -50.0 250.0 AXIS_PTS_REF TrC_MPltFuTOilCorr_A /end AXIS_DESCR
/end CHARACTERISTIC
/begin AXIS_PTS TrC_MPltFuTOilCorr_A "Pilot Fuel Quantity - Axis of Oil Temperature Correction" 0x4004F65C /* @ECU_Address@TrC_MPltFuTOilCorr_A@ */ EIP_TOil Lookup2D_X_FLOAT32_IEEE 0 EcuIntgdSwGend_CM_single_degC 10 -50.0 250.0 /end AXIS_PTS
/begin CHARACTERISTIC TrC_MPltFuUClmp30Corr_M "Pilot Fuel Quantity - Battery Voltage Correction" MAP 0x4004F83C /* @ECU_Address@TrC_MPltFuUClmp30Corr_M@ */ Lookup2D_FLOAT32_IEEE 0 EcuIntgdSwGend_CM_single_mm_3_stk -500.0 500.0
 /begin AXIS_DESCR COM_AXIS TL_TqIndcdLimd EcuIntgdSwGend_CM_single_N_m 10 0.0 4000.0 AXIS_PTS_REF TrC_TqIndcdLimdForPltFuCorr_A /end AXIS_DESCR
 /begin AXIS_DESCR COM_AXIS EIP_UClmp30 EcuIntgdSwGend_CM_single_V 10 0.0 50.0 AXIS_PTS_REF TrC_MPltFuUClmp30Corr_A /end AXIS_DESCR
/end CHARACTERISTIC
/begin AXIS_PTS TrC_MPltFuUClmp30Corr_A "Pilot Fuel Quantity - Axis of Battery Voltage Correction" 0x4004F814 /* @ECU_Address@TrC_MPltFuUClmp30Corr_A@ */ EIP_UClmp30 Lookup2D_X_FLOAT32_IEEE 0 EcuIntgdSwGend_CM_single_V 10 0.0 50.0 /end AXIS_PTS
/begin CHARACTERISTIC TrC_RatAirFuSmokLim_M "Air Fuel Rate Smoke Limitation Map" MAP 0x40050550 /* @ECU_Address@TrC_RatAirFuSmokLim_M@ */ Lookup2D_FLOAT32_IEEE 0 EcuIntgdSwGend_CM_single 0.0 100.0
 /begin AXIS_DESCR COM_AXIS TL_TqIndcdLimd EcuIntgdSwGend_CM_single_N_m 10 0.0 30000.0 AXIS_PTS_REF TrC_TqIndcdLimdRatAirFu_A /end AXIS_DESCR
 /begin AXIS_DESCR COM_AXIS EIP_NEng EcuIntgdSwGend_CM_single_rpm 10 0.0 5000.0 AXIS_PTS_REF TrC_NEngRatAirFu_A /end AXIS_DESCR
/end CHARACTERISTIC
/begin AXIS_PTS TrC_TqIndcdLimdRatAirFu_A "Axis of Indicated Torque for Pilot Air Fuel Rate Map" 0x400507CC /* @ECU_Address@TrC_TqIndcdLimdRatAirFu_A@ */ TL_TqIndcdLimd Lookup2D_X_FLOAT32_IEEE 0 EcuIntgdSwGend_CM_single_N_m 10 0.0 30000.0 /end AXIS_PTS
/begin AXIS_PTS TrC_NEngRatAirFu_A "Axis Values of Engine Speed for Air Fuel Rate Map" 0x40050520 /* @ECU_Address@TrC_NEngRatAirFu_A@ */ EIP_NEng Lookup2D_X_FLOAT32_IEEE 0 EcuIntgdSwGend_CM_single_rpm 10 0.0 5000.0 /end AXIS_PTS
/begin CHARACTERISTIC TL_TqLimp_M "Limp Mode Map" CURVE 0x4004C284 /* @ECU_Address@TL_TqLimp_M@ */ Lookup1D_FLOAT32_IEEE 0 EcuIntgdSwGend_CM_single_N_m 0.0 10000.0
 /begin AXIS_DESCR COM_AXIS EIP_NEng EcuIntgdSwGend_CM_single_rpm 24 0.0 5000.0 AXIS_PTS_REF TL_NEngLimp_A /end AXIS_DESCR
/end CHARACTERISTIC
/begin AXIS_PTS TL_NEngLimp_A "Axis Values of Engine Speed for Limp Mode Curve" 0x4004B48C /* @ECU_Address@TL_NEngLimp_A@ */ EIP_NEng Lookup1D_X_FLOAT32_IEEE 0 EcuIntgdSwGend_CM_single_rpm 24 0.0 5000.0 /end AXIS_PTS
/begin CHARACTERISTIC WgC_DutyWgtVlvFF_M "Feedforward Wastegate Duty Valve Map" MAP 0x40051468 /* @ECU_Address@WgC_DutyWgtVlvFF_M@ */ Lookup2D_FLOAT32_IEEE 0 EcuIntgdSwGend_CM_single__ 0.0 100.0
 /begin AXIS_DESCR COM_AXIS NO_INPUT_QUANTITY EcuIntgdSwGend_CM_single_N_m 15 0.0 1000.0 AXIS_PTS_REF WgC_TqIndcdLimdForPAirBoostFF_A /end AXIS_DESCR
 /begin AXIS_DESCR COM_AXIS EIP_NEng EcuIntgdSwGend_CM_single_rpm 15 0.0 3200.0 AXIS_PTS_REF WgC_NEngForPAirBoostFF_A /end AXIS_DESCR
/end CHARACTERISTIC
/begin AXIS_PTS WgC_TqIndcdLimdForPAirBoostFF_A "Limited Indicated Torque for Air Boost Pressure Feedforward Map Axis" 0x40052684 /* @ECU_Address@WgC_TqIndcdLimdForPAirBoostFF_A@ */ NO_INPUT_QUANTITY Lookup2D_X_FLOAT32_IEEE 0 EcuIntgdSwGend_CM_single_N_m 15 0.0 1000.0 /end AXIS_PTS
/begin AXIS_PTS WgC_NEngForPAirBoostFF_A "Engine Speed for Air Boost Pressure Feedforward Map Axis" 0x40051D88 /* @ECU_Address@WgC_NEngForPAirBoostFF_A@ */ EIP_NEng Lookup2D_X_FLOAT32_IEEE 0 EcuIntgdSwGend_CM_single_rpm 15 0.0 3200.0 /end AXIS_PTS
/begin CHARACTERISTIC WgC_LimSigLo_M "Duty Valve Saturation Low Limit Signal Map" MAP 0x40051B88 /* @ECU_Address@WgC_LimSigLo_M@ */ Lookup2D_FLOAT32_IEEE 0 EcuIntgdSwGend_CM_single__ 0.0 100.0
 /begin AXIS_DESCR COM_AXIS NO_INPUT_QUANTITY EcuIntgdSwGend_CM_single_N_m 5 0.0 1000.0 AXIS_PTS_REF WgC_TqIndcdLimdForPAirBoostFFLimSigLo_A /end AXIS_DESCR
 /begin AXIS_DESCR COM_AXIS EIP_NEng EcuIntgdSwGend_CM_single_rpm 5 0.0 3200.0 AXIS_PTS_REF WgC_NEngForPAirBoostFFLimSigLo_A /end AXIS_DESCR
/end CHARACTERISTIC
/begin AXIS_PTS WgC_TqIndcdLimdForPAirBoostFFLimSigLo_A "Limited Indicated Torque for Air Boost Pressure Feedforward Limit Signal Low Map Axis" 0x4005265C /* @ECU_Address@WgC_TqIndcdLimdForPAirBoostFFLimSigLo_A@ */ NO_INPUT_QUANTITY Lookup2D_X_FLOAT32_IEEE 0 EcuIntgdSwGend_CM_single_N_m 5 0.0 1000.0 /end AXIS_PTS
/begin AXIS_PTS WgC_NEngForPAirBoostFFLimSigLo_A "Engine Speed for Air Boost Pressure Feedforward Saturation Low Limit Map Axis" 0x40051D60 /* @ECU_Address@WgC_NEngForPAirBoostFFLimSigLo_A@ */ EIP_NEng Lookup2D_X_FLOAT32_IEEE 0 EcuIntgdSwGend_CM_single_rpm 5 0.0 3200.0 /end AXIS_PTS
/begin CHARACTERISTIC WgC_LimSigUp_M "Duty Valve Saturation Up Limit Signal Map" MAP 0x40051BEC /* @ECU_Address@WgC_LimSigUp_M@ */ Lookup2D_FLOAT32_IEEE 0 EcuIntgdSwGend_CM_single__ 0.0 100.0
 /begin AXIS_DESCR COM_AXIS NO_INPUT_QUANTITY EcuIntgdSwGend_CM_single_N_m 5 0.0 1000.0 AXIS_PTS_REF WgC_TqIndcdLimdForPAirBoostFFLimSigUp_A /end AXIS_DESCR
 /begin AXIS_DESCR COM_AXIS EIP_NEng EcuIntgdSwGend_CM_single_rpm 5 0.0 3200.0 AXIS_PTS_REF WgC_NEngForPAirBoostFFLimSigUp_A /end AXIS_DESCR
/end CHARACTERISTIC
/begin AXIS_PTS WgC_TqIndcdLimdForPAirBoostFFLimSigUp_A "Limited Indicated Torque for Air Boost Pressure Feedforward Limit Signal Up Map Axis" 0x40052670 /* @ECU_Address@WgC_TqIndcdLimdForPAirBoostFFLimSigUp_A@ */ NO_INPUT_QUANTITY Lookup2D_X_FLOAT32_IEEE 0 EcuIntgdSwGend_CM_single_N_m 5 0.0 1000.0 /end AXIS_PTS
/begin AXIS_PTS WgC_NEngForPAirBoostFFLimSigUp_A "Engine Speed for Air Boost Pressure Feedforward Saturation Up Limit Map Axis" 0x40051D74 /* @ECU_Address@WgC_NEngForPAirBoostFFLimSigUp_A@ */ EIP_NEng Lookup2D_X_FLOAT32_IEEE 0 EcuIntgdSwGend_CM_single_rpm 5 0.0 3200.0 /end AXIS_PTS
/begin CHARACTERISTIC WgC_StWgtVlvCtrl_M "Wastegate Valve Control State Map" CURVE 0x4005249C /* @ECU_Address@WgC_StWgtVlvCtrl_M@ */ Lookup1D_FLOAT32_IEEE 0 EcuIntgdSwGend_CM_single 0.0 1.0
 /begin AXIS_DESCR COM_AXIS EIP_PAirBoost EcuIntgdSwGend_CM_single_mbar 8 -1000.0 3000.0 AXIS_PTS_REF WgC_PAirBoostForWgtVlvFF_A /end AXIS_DESCR
/end CHARACTERISTIC
/begin AXIS_PTS WgC_PAirBoostForWgtVlvFF_A "Air Boost Pressure for  Feedforward Wastegate Valve Map Axis" 0x40052204 /* @ECU_Address@WgC_PAirBoostForWgtVlvFF_A@ */ EIP_PAirBoost Lookup1D_X_FLOAT32_IEEE 0 EcuIntgdSwGend_CM_single_mbar 8 -1000.0 3000.0 /end AXIS_PTS
/begin CHARACTERISTIC EOP_DstTrvldInKmOvv_P "Output Processing Distance Travel In Kilometer Override Value Parameter" VALUE 0x40044B7C /* @ECU_Address@EOP_DstTrvldInKmOvv_P@ */ Scalar_FLOAT32_IEEE 0 EcuIntgdSwGend_CM_single_km 0.0 1.0E+6 /end CHARACTERISTIC
/begin CHARACTERISTIC EOP_DurMaiInj1Ovv_P "Output Processing Main Injection Duration for Cylinder 1 Override Value Parameter" VALUE 0x40044B84 /* @ECU_Address@EOP_DurMaiInj1Ovv_P@ */ Scalar_FLOAT32_IEEE 0 EcuIntgdSwGend_CM_single_us 0.0 10000.0 /end CHARACTERISTIC
/begin CHARACTERISTIC EOP_DurMaiInj2Ovv_P "Output Processing Main Injection Duration for Cylinder 2 Override Value Parameter" VALUE 0x40044B8C /* @ECU_Address@EOP_DurMaiInj2Ovv_P@ */ Scalar_FLOAT32_IEEE 0 EcuIntgdSwGend_CM_single_us 0.0 10000.0 /end CHARACTERISTIC
/begin CHARACTERISTIC EOP_DurMaiInj3Ovv_P "Output Processing Main Injection Duration for Cylinder 3 Override Value Parameter" VALUE 0x40044B94 /* @ECU_Address@EOP_DurMaiInj3Ovv_P@ */ Scalar_FLOAT32_IEEE 0 EcuIntgdSwGend_CM_single_us 0.0 10000.0 /end CHARACTERISTIC
/begin CHARACTERISTIC EOP_DurMaiInj4Ovv_P "Output Processing Main Injection Duration for Cylinder 4 Override Value Parameter" VALUE 0x40044B9C /* @ECU_Address@EOP_DurMaiInj4Ovv_P@ */ Scalar_FLOAT32_IEEE 0 EcuIntgdSwGend_CM_single_us 0.0 10000.0 /end CHARACTERISTIC
/begin CHARACTERISTIC EOP_DurMaiInj5Ovv_P "Output Processing Main Injection Duration for Cylinder 5 Override Value Parameter" VALUE 0x40044BA4 /* @ECU_Address@EOP_DurMaiInj5Ovv_P@ */ Scalar_FLOAT32_IEEE 0 EcuIntgdSwGend_CM_single_us 0.0 10000.0 /end CHARACTERISTIC
/begin CHARACTERISTIC EOP_DurMaiInj6Ovv_P "Output Processing Main Injection Duration for Cylinder 6 Override Value Parameter" VALUE 0x40044BAC /* @ECU_Address@EOP_DurMaiInj6Ovv_P@ */ Scalar_FLOAT32_IEEE 0 EcuIntgdSwGend_CM_single_us 0.0 10000.0 /end CHARACTERISTIC
/begin CHARACTERISTIC EOP_DurPltInj1Ovv_P "Output Processing Pre Pilot Injection Duration for Cylinder 1 Override Value Parameter" VALUE 0x40044BB4 /* @ECU_Address@EOP_DurPltInj1Ovv_P@ */ Scalar_FLOAT32_IEEE 0 EcuIntgdSwGend_CM_single_us 0.0 10000.0 /end CHARACTERISTIC
/begin CHARACTERISTIC EOP_DurPltInj2Ovv_P "Output Processing Pre Pilot Injection Duration for Cylinder 2 Override Value Parameter" VALUE 0x40044BBC /* @ECU_Address@EOP_DurPltInj2Ovv_P@ */ Scalar_FLOAT32_IEEE 0 EcuIntgdSwGend_CM_single_us 0.0 10000.0 /end CHARACTERISTIC
/begin CHARACTERISTIC EOP_DurPltInj3Ovv_P "Output Processing Pre Pilot Injection Duration for Cylinder 3 Override Value Parameter" VALUE 0x40044BC4 /* @ECU_Address@EOP_DurPltInj3Ovv_P@ */ Scalar_FLOAT32_IEEE 0 EcuIntgdSwGend_CM_single_us 0.0 10000.0 /end CHARACTERISTIC
/begin CHARACTERISTIC EOP_DurPltInj4Ovv_P "Output Processing Pre Pilot Injection Duration for Cylinder 4 Override Value Parameter" VALUE 0x40044BCC /* @ECU_Address@EOP_DurPltInj4Ovv_P@ */ Scalar_FLOAT32_IEEE 0 EcuIntgdSwGend_CM_single_us 0.0 10000.0 /end CHARACTERISTIC
/begin CHARACTERISTIC EOP_DurPltInj5Ovv_P "Output Processing Pre Pilot Injection Duration for Cylinder 5 Override Value Parameter" VALUE 0x40044BD4 /* @ECU_Address@EOP_DurPltInj5Ovv_P@ */ Scalar_FLOAT32_IEEE 0 EcuIntgdSwGend_CM_single_us 0.0 10000.0 /end CHARACTERISTIC
/begin CHARACTERISTIC EOP_DurPltInj6Ovv_P "Output Processing Pre Pilot Injection Duration for Cylinder 6 Override Value Parameter" VALUE 0x40044BDC /* @ECU_Address@EOP_DurPltInj6Ovv_P@ */ Scalar_FLOAT32_IEEE 0 EcuIntgdSwGend_CM_single_us 0.0 10000.0 /end CHARACTERISTIC
/begin CHARACTERISTIC EOP_DutyVlvReqOvv_P "Output Processing Duty Valve Request Override Value Parameter" VALUE 0x40044BE4 /* @ECU_Address@EOP_DutyVlvReqOvv_P@ */ Scalar_FLOAT32_IEEE 0 EcuIntgdSwGend_CM_single__ 0.0 100.0 /end CHARACTERISTIC
/begin CHARACTERISTIC EOP_DynRateVCVLoLim_P "Output Processing Dynamic Rate Limiter Low Limitation Parameter for Volumetric Control Valve" VALUE 0x40044BEC /* @ECU_Address@EOP_DynRateVCVLoLim_P@ */ Scalar_FLOAT32_IEEE 0 EcuIntgdSwGend_CM_single -1000.0 0.0 /end CHARACTERISTIC
/begin CHARACTERISTIC EOP_DynRateVCVUpLim_P "Output Processing Dynamic Rate Limiter Up Limitation Parameter for Volumetric Control Valve" VALUE 0x40044BF0 /* @ECU_Address@EOP_DynRateVCVUpLim_P@ */ Scalar_FLOAT32_IEEE 0 EcuIntgdSwGend_CM_single 0.0 1000.0 /end CHARACTERISTIC
/begin CHARACTERISTIC EOP_EngHrOvv_P "Output Processing Engine Hour Override Value Parameter" VALUE 0x40044BF8 /* @ECU_Address@EOP_EngHrOvv_P@ */ Scalar_FLOAT32_IEEE 0 EcuIntgdSwGend_CM_single_h 0.0 1.0E+6 /end CHARACTERISTIC
/begin CHARACTERISTIC EOP_FuCnsOvv_P "Output Processing Fuel Consumption Override Value Parameter" VALUE 0x40044C0C /* @ECU_Address@EOP_FuCnsOvv_P@ */ Scalar_FLOAT32_IEEE 0 EcuIntgdSwGend_CM_single_l_100km 0.0 100.0 /end CHARACTERISTIC
/begin CHARACTERISTIC EOP_IRefPCVOvv_P "Output Processing Current Reference for Pressure Control Valve Override Value Parameter" VALUE 0x40044C18 /* @ECU_Address@EOP_IRefPCVOvv_P@ */ Scalar_FLOAT32_IEEE 0 EcuIntgdSwGend_CM_single_A 0.0 10000.0 /end CHARACTERISTIC
/begin CHARACTERISTIC EOP_IVCVReqOvv_P "Output Processing Volumetric Control Valve Current Request Override Value Parameter" VALUE 0x40044C70 /* @ECU_Address@EOP_IVCVReqOvv_P@ */ Scalar_FLOAT32_IEEE 0 EcuIntgdSwGend_CM_single_A 0.0 10000.0 /end CHARACTERISTIC
/begin CHARACTERISTIC EOP_SoiMaiInj1Ovv_P "Output Processing Start of Main Injection 1 Override Value Parameter" VALUE 0x40044CD0 /* @ECU_Address@EOP_SoiMaiInj1Ovv_P@ */ Scalar_FLOAT32_IEEE 0 EcuIntgdSwGend_CM_single_deg -100.0 100.0 /end CHARACTERISTIC
/begin CHARACTERISTIC EOP_SoiMaiInj2Ovv_P "Output Processing Start of Main Injection 2 Override Value Parameter" VALUE 0x40044CD8 /* @ECU_Address@EOP_SoiMaiInj2Ovv_P@ */ Scalar_FLOAT32_IEEE 0 EcuIntgdSwGend_CM_single_deg -100.0 100.0 /end CHARACTERISTIC
/begin CHARACTERISTIC EOP_SoiMaiInj3Ovv_P "Output Processing Start of Main Injection 3 Override Value Parameter" VALUE 0x40044CE0 /* @ECU_Address@EOP_SoiMaiInj3Ovv_P@ */ Scalar_FLOAT32_IEEE 0 EcuIntgdSwGend_CM_single_deg -100.0 100.0 /end CHARACTERISTIC
/begin CHARACTERISTIC EOP_SoiMaiInj4Ovv_P "Output Processing Start of Main Injection 4 Override Value Parameter" VALUE 0x40044CE8 /* @ECU_Address@EOP_SoiMaiInj4Ovv_P@ */ Scalar_FLOAT32_IEEE 0 EcuIntgdSwGend_CM_single_deg -100.0 100.0 /end CHARACTERISTIC
/begin CHARACTERISTIC EOP_SoiMaiInj5Ovv_P "Output Processing Start of Main Injection 5 Override Value Parameter" VALUE 0x40044CF0 /* @ECU_Address@EOP_SoiMaiInj5Ovv_P@ */ Scalar_FLOAT32_IEEE 0 EcuIntgdSwGend_CM_single_deg -100.0 100.0 /end CHARACTERISTIC
/begin CHARACTERISTIC EOP_SoiMaiInj6Ovv_P "Output Processing Start of Main Injection 6 Override Value Parameter" VALUE 0x40044CF8 /* @ECU_Address@EOP_SoiMaiInj6Ovv_P@ */ Scalar_FLOAT32_IEEE 0 EcuIntgdSwGend_CM_single_deg -100.0 100.0 /end CHARACTERISTIC
/begin CHARACTERISTIC EOP_SoiPltInj1Ovv_P "Output Processing Start of Pilot Injection 1 Override Value Parameter" VALUE 0x40044D00 /* @ECU_Address@EOP_SoiPltInj1Ovv_P@ */ Scalar_FLOAT32_IEEE 0 EcuIntgdSwGend_CM_single_deg -100.0 100.0 /end CHARACTERISTIC
/begin CHARACTERISTIC EOP_SoiPltInj2Ovv_P "Output Processing Start of Pilot Injection 2 Override Value Parameter" VALUE 0x40044D08 /* @ECU_Address@EOP_SoiPltInj2Ovv_P@ */ Scalar_FLOAT32_IEEE 0 EcuIntgdSwGend_CM_single_deg -100.0 100.0 /end CHARACTERISTIC
/begin CHARACTERISTIC EOP_SoiPltInj3Ovv_P "Output Processing Start of Pilot Injection 3 Override Value Parameter" VALUE 0x40044D10 /* @ECU_Address@EOP_SoiPltInj3Ovv_P@ */ Scalar_FLOAT32_IEEE 0 EcuIntgdSwGend_CM_single_deg -100.0 100.0 /end CHARACTERISTIC
/begin CHARACTERISTIC EOP_SoiPltInj4Ovv_P "Output Processing Start of Pilot Injection 4 Override Value Parameter" VALUE 0x40044D18 /* @ECU_Address@EOP_SoiPltInj4Ovv_P@ */ Scalar_FLOAT32_IEEE 0 EcuIntgdSwGend_CM_single_deg -100.0 100.0 /end CHARACTERISTIC
/begin CHARACTERISTIC EOP_SoiPltInj5Ovv_P "Output Processing Start of Pilot Injection 5 Override Value Parameter" VALUE 0x40044D20 /* @ECU_Address@EOP_SoiPltInj5Ovv_P@ */ Scalar_FLOAT32_IEEE 0 EcuIntgdSwGend_CM_single_deg -100.0 100.0 /end CHARACTERISTIC
/begin CHARACTERISTIC EOP_SoiPltInj6Ovv_P "Output Processing Start of Pilot Injection 6 Override Value Parameter" VALUE 0x40044D28 /* @ECU_Address@EOP_SoiPltInj6Ovv_P@ */ Scalar_FLOAT32_IEEE 0 EcuIntgdSwGend_CM_single_deg -100.0 100.0 /end CHARACTERISTIC
/begin CHARACTERISTIC EOP_TripOvv_P "" VALUE 0x40044D30 /* @ECU_Address@EOP_TripOvv_P@ */ Scalar_FLOAT32_IEEE 0 EcuIntgdSwGend_CM_single_km 0.0 1.0E+6 /end CHARACTERISTIC
/begin CHARACTERISTIC IC_CnvnHtoSec_P "" VALUE 0x40044D7C /* @ECU_Address@IC_CnvnHtoSec_P@ */ Scalar_FLOAT32_IEEE 0 EcuIntgdSwGend_CM_single 3600.0 3600.0 /end CHARACTERISTIC
/begin CHARACTERISTIC IC_CnvnInstFuCnsLtPerHourToSec_P "" VALUE 0x40044D80 /* @ECU_Address@IC_CnvnInstFuCnsLtPerHourToSec_P@ */ Scalar_FLOAT32_IEEE 0 EcuIntgdSwGend_CM_single 3600.0 3600.0 /end CHARACTERISTIC
/begin CHARACTERISTIC IC_CnvnMTotFuQntyCorrdToInstFuCnsLtPerHour_P "Conversion Factor of Instant Fuel Consumption Per Hour" VALUE 0x40044D84 /* @ECU_Address@IC_CnvnMTotFuQntyCorrdToInstFuCnsLtPerHour_P@ */ Scalar_FLOAT32_IEEE 0 EcuIntgdSwGend_CM_single 0.0 10000.0 /end CHARACTERISTIC
/begin CHARACTERISTIC IC_DstToEmptyOvv_P "Distance to Empty - Override Value Parameter" VALUE 0x40044D8C /* @ECU_Address@IC_DstToEmptyOvv_P@ */ Scalar_FLOAT32_IEEE 0 EcuIntgdSwGend_CM_single_km 0.0 100.0 /end CHARACTERISTIC
/begin CHARACTERISTIC IC_DurMaiCyl1BalOvv_P "Main Injection Duration Balance for Cylinder 1 - Override Value Parameter" VALUE 0x40044D94 /* @ECU_Address@IC_DurMaiCyl1BalOvv_P@ */ Scalar_FLOAT32_IEEE 0 EcuIntgdSwGend_CM_single_us 0.0 10000.0 /end CHARACTERISTIC
/begin CHARACTERISTIC IC_DurMaiCyl2BalOvv_P "Main Injection Duration Balance for Cylinder 2 - Override Value Parameter" VALUE 0x40044DA0 /* @ECU_Address@IC_DurMaiCyl2BalOvv_P@ */ Scalar_FLOAT32_IEEE 0 EcuIntgdSwGend_CM_single_us 0.0 10000.0 /end CHARACTERISTIC
/begin CHARACTERISTIC IC_DurMaiCyl3BalOvv_P "Main Injection Duration Balance for Cylinder 3 - Override Value Parameter" VALUE 0x40044DAC /* @ECU_Address@IC_DurMaiCyl3BalOvv_P@ */ Scalar_FLOAT32_IEEE 0 EcuIntgdSwGend_CM_single_us 0.0 10000.0 /end CHARACTERISTIC
/begin CHARACTERISTIC IC_DurMaiCyl4BalOvv_P "Main Injection Duration Balance for Cylinder 4 - Override Value Parameter" VALUE 0x40044DB8 /* @ECU_Address@IC_DurMaiCyl4BalOvv_P@ */ Scalar_FLOAT32_IEEE 0 EcuIntgdSwGend_CM_single_us 0.0 10000.0 /end CHARACTERISTIC
/begin CHARACTERISTIC IC_DurMaiCyl5BalOvv_P "Main Injection Duration Balance for Cylinder 5 - Override Value Parameter" VALUE 0x40044DC4 /* @ECU_Address@IC_DurMaiCyl5BalOvv_P@ */ Scalar_FLOAT32_IEEE 0 EcuIntgdSwGend_CM_single_us 0.0 10000.0 /end CHARACTERISTIC
/begin CHARACTERISTIC IC_DurMaiCyl6BalOvv_P "Main Injection Duration Balance for Cylinder 6 - Override Value Parameter" VALUE 0x40044DD0 /* @ECU_Address@IC_DurMaiCyl6BalOvv_P@ */ Scalar_FLOAT32_IEEE 0 EcuIntgdSwGend_CM_single_us 0.0 10000.0 /end CHARACTERISTIC
/begin CHARACTERISTIC IC_DurMaiLimdHi_P "High Limited Main Injection Duration Parameter" VALUE 0x40044DD8 /* @ECU_Address@IC_DurMaiLimdHi_P@ */ Scalar_FLOAT32_IEEE 0 EcuIntgdSwGend_CM_single_us 0.0 5000.0 /end CHARACTERISTIC
/begin CHARACTERISTIC IC_DurMaiLimdLo_P "Low Limited Main Injection Duration Parameter" VALUE 0x40044DDC /* @ECU_Address@IC_DurMaiLimdLo_P@ */ Scalar_FLOAT32_IEEE 0 EcuIntgdSwGend_CM_single_us 0.0 1000.0 /end CHARACTERISTIC
/begin CHARACTERISTIC IC_DurPltInj1PreOvv_P "Pre Pilot Injection Duration for Cylinder 1 - Override Value Parameter" VALUE 0x40044E24 /* @ECU_Address@IC_DurPltInj1PreOvv_P@ */ Scalar_FLOAT32_IEEE 0 EcuIntgdSwGend_CM_single_us 0.0 10000.0 /end CHARACTERISTIC
/begin CHARACTERISTIC IC_DurPltInj2PreOvv_P "Pre Pilot Injection Duration for Cylinder 2 - Override Value Parameter" VALUE 0x40044E2C /* @ECU_Address@IC_DurPltInj2PreOvv_P@ */ Scalar_FLOAT32_IEEE 0 EcuIntgdSwGend_CM_single_us 0.0 10000.0 /end CHARACTERISTIC
/begin CHARACTERISTIC IC_DurPltInj3PreOvv_P "Pre Pilot Injection Duration for Cylinder 3 - Override Value Parameter" VALUE 0x40044E34 /* @ECU_Address@IC_DurPltInj3PreOvv_P@ */ Scalar_FLOAT32_IEEE 0 EcuIntgdSwGend_CM_single_us 0.0 10000.0 /end CHARACTERISTIC
/begin CHARACTERISTIC IC_DurPltInj4PreOvv_P "Pre Pilot Injection Duration for Cylinder 4 - Override Value Parameter" VALUE 0x40044E3C /* @ECU_Address@IC_DurPltInj4PreOvv_P@ */ Scalar_FLOAT32_IEEE 0 EcuIntgdSwGend_CM_single_us 0.0 10000.0 /end CHARACTERISTIC
/begin CHARACTERISTIC IC_DurPltInj5PreOvv_P "Pre Pilot Injection Duration for Cylinder 5 - Override Value Parameter" VALUE 0x40044E44 /* @ECU_Address@IC_DurPltInj5PreOvv_P@ */ Scalar_FLOAT32_IEEE 0 EcuIntgdSwGend_CM_single_us 0.0 10000.0 /end CHARACTERISTIC
/begin CHARACTERISTIC IC_DurPltInj6PreOvv_P "Pre Pilot Injection Duration for Cylinder 6 - Override Value Parameter" VALUE 0x40044E4C /* @ECU_Address@IC_DurPltInj6PreOvv_P@ */ Scalar_FLOAT32_IEEE 0 EcuIntgdSwGend_CM_single_us 0.0 10000.0 /end CHARACTERISTIC
/begin CHARACTERISTIC IC_DurPltLimdHi_P "High Limited Pilot Injection Duration Parameter" VALUE 0x40044E50 /* @ECU_Address@IC_DurPltLimdHi_P@ */ Scalar_FLOAT32_IEEE 0 EcuIntgdSwGend_CM_single_us 0.0 5000.0 /end CHARACTERISTIC
/begin CHARACTERISTIC IC_DurPltLimdLo_P "Low Limited Pilot Injection Duration Parameter" VALUE 0x40044E54 /* @ECU_Address@IC_DurPltLimdLo_P@ */ Scalar_FLOAT32_IEEE 0 EcuIntgdSwGend_CM_single_us 0.0 1000.0 /end CHARACTERISTIC
/begin CHARACTERISTIC IC_FuCnsAveOvv_P "Fuel Consumption Average Override Value Parameter" VALUE 0x40044ECC /* @ECU_Address@IC_FuCnsAveOvv_P@ */ Scalar_FLOAT32_IEEE 0 EcuIntgdSwGend_CM_single_L_100km 0.0 1.0 /end CHARACTERISTIC
/begin CHARACTERISTIC IC_FuCnsOvv_P "Fuel Consumption - Override Value Parameter" VALUE 0x40044ED4 /* @ECU_Address@IC_FuCnsOvv_P@ */ Scalar_FLOAT32_IEEE 0 EcuIntgdSwGend_CM_single_L_100km 0.0 1000.0 /end CHARACTERISTIC
/begin CHARACTERISTIC IC_IntglRst_P "" VALUE 0x40045AA8 /* @ECU_Address@IC_IntglRst_P@ */ Scalar_FLOAT32_IEEE 0 EcuIntgdSwGend_CM_single 0.0 1.0 /end CHARACTERISTIC
/begin CHARACTERISTIC IC_MMaiFuQntyCorrdOvv_P "Corrected Main Fuel Quantity Mass - Override Value Parameter" VALUE 0x40045BD8 /* @ECU_Address@IC_MMaiFuQntyCorrdOvv_P@ */ Scalar_FLOAT32_IEEE 0 EcuIntgdSwGend_CM_single_mm_3_stk 0.0 5000.0 /end CHARACTERISTIC
/begin CHARACTERISTIC IC_MMaiLimdHi_P "High Limited Main Fuel Quantity Mass Parameter" VALUE 0x40045BDC /* @ECU_Address@IC_MMaiLimdHi_P@ */ Scalar_FLOAT32_IEEE 0 EcuIntgdSwGend_CM_single_mm_3_stk 0.0 1000.0 /end CHARACTERISTIC
/begin CHARACTERISTIC IC_MMaiLimdLo_P "Low Limited Main Fuel Quantity Mass Parameter" VALUE 0x40045BE0 /* @ECU_Address@IC_MMaiLimdLo_P@ */ Scalar_FLOAT32_IEEE 0 EcuIntgdSwGend_CM_single_mm_3_stk 0.0 1000.0 /end CHARACTERISTIC
/begin CHARACTERISTIC IC_MPltFuQntyCorrdOvv_P "Corrected Pilot Fuel Quantity Mass - Override Value Parameter" VALUE 0x40045BE8 /* @ECU_Address@IC_MPltFuQntyCorrdOvv_P@ */ Scalar_FLOAT32_IEEE 0 EcuIntgdSwGend_CM_single_mm_3_stk 0.0 5000.0 /end CHARACTERISTIC
/begin CHARACTERISTIC IC_MPltLimdHi_P "High Limited Pilot Fuel Quantity Mass Parameter" VALUE 0x40045BEC /* @ECU_Address@IC_MPltLimdHi_P@ */ Scalar_FLOAT32_IEEE 0 EcuIntgdSwGend_CM_single_mm_3_stk 0.0 1000.0 /end CHARACTERISTIC
/begin CHARACTERISTIC IC_MPltLimdLo_P "Low Limited Pilot Fuel Quantity Mass Parameter" VALUE 0x40045BF0 /* @ECU_Address@IC_MPltLimdLo_P@ */ Scalar_FLOAT32_IEEE 0 EcuIntgdSwGend_CM_single_mm_3_stk 0.0 1000.0 /end CHARACTERISTIC
/begin CHARACTERISTIC IC_NoInjCodeForInj1_P "Injection Code Number For Injector 1 Parameter" VALUE 0x40045D10 /* @ECU_Address@IC_NoInjCodeForInj1_P@ */ Scalar_FLOAT32_IEEE 0 EcuIntgdSwGend_CM_single 1.0 5.0 /end CHARACTERISTIC
/begin CHARACTERISTIC IC_NoInjCodeForInj2_P "Injection Code Number For Injector 2 Parameter" VALUE 0x40045D14 /* @ECU_Address@IC_NoInjCodeForInj2_P@ */ Scalar_FLOAT32_IEEE 0 EcuIntgdSwGend_CM_single 1.0 5.0 /end CHARACTERISTIC
/begin CHARACTERISTIC IC_NoInjCodeForInj3_P "Injection Code Number For Injector 3 Parameter" VALUE 0x40045D18 /* @ECU_Address@IC_NoInjCodeForInj3_P@ */ Scalar_FLOAT32_IEEE 0 EcuIntgdSwGend_CM_single 1.0 5.0 /end CHARACTERISTIC
/begin CHARACTERISTIC IC_NoInjCodeForInj4_P "Injection Code Number For Injector 4 Parameter" VALUE 0x40045D1C /* @ECU_Address@IC_NoInjCodeForInj4_P@ */ Scalar_FLOAT32_IEEE 0 EcuIntgdSwGend_CM_single 1.0 5.0 /end CHARACTERISTIC
/begin CHARACTERISTIC IC_NoInjCodeForInj5_P "Injection Code Number For Injector 5 Parameter" VALUE 0x40045D20 /* @ECU_Address@IC_NoInjCodeForInj5_P@ */ Scalar_FLOAT32_IEEE 0 EcuIntgdSwGend_CM_single 1.0 5.0 /end CHARACTERISTIC
/begin CHARACTERISTIC IC_NoInjCodeForInj6_P "Injection Code Number For Injector 6 Parameter" VALUE 0x40045D24 /* @ECU_Address@IC_NoInjCodeForInj6_P@ */ Scalar_FLOAT32_IEEE 0 EcuIntgdSwGend_CM_single 1.0 5.0 /end CHARACTERISTIC
/begin CHARACTERISTIC IC_PercgAccrForFuCns_P "" VALUE 0x40045DF4 /* @ECU_Address@IC_PercgAccrForFuCns_P@ */ Scalar_FLOAT32_IEEE 0 EcuIntgdSwGend_CM_single__ 0.0 100.0 /end CHARACTERISTIC
/begin CHARACTERISTIC IC_TcDstToEmptyFil_P "" VALUE 0x40048480 /* @ECU_Address@IC_TcDstToEmptyFil_P@ */ Scalar_FLOAT32_IEEE 0 EcuIntgdSwGend_CM_single_ms 0.0 50000.0 /end CHARACTERISTIC
/begin CHARACTERISTIC IC_TcFuCnsAveFil_P "" VALUE 0x40048484 /* @ECU_Address@IC_TcFuCnsAveFil_P@ */ Scalar_FLOAT32_IEEE 0 EcuIntgdSwGend_CM_single_ms 0.0 50000.0 /end CHARACTERISTIC
/begin CHARACTERISTIC IC_TcFuCnsFil_P "" VALUE 0x40048488 /* @ECU_Address@IC_TcFuCnsFil_P@ */ Scalar_FLOAT32_IEEE 0 EcuIntgdSwGend_CM_single_ms 0.0 50000.0 /end CHARACTERISTIC
/begin CHARACTERISTIC IC_VehVThdForFuCns_P "" VALUE 0x4004848C /* @ECU_Address@IC_VehVThdForFuCns_P@ */ Scalar_FLOAT32_IEEE 0 EcuIntgdSwGend_CM_single_km 0.0 200.0 /end CHARACTERISTIC
/begin CHARACTERISTIC PHC_GridHeatrRlyFbOffStsThd_P "Grid Heater Relay Feedback Off Status Threshold Parameter" VALUE 0x40048498 /* @ECU_Address@PHC_GridHeatrRlyFbOffStsThd_P@ */ Scalar_FLOAT32_IEEE 0 EcuIntgdSwGend_CM_single_V 0.0 50.0 /end CHARACTERISTIC
/begin CHARACTERISTIC PHC_GridHeatrRlyFbOnStsThd_P "Grid Heater Relay Feedback On Status Threshold Parameter" VALUE 0x4004849C /* @ECU_Address@PHC_GridHeatrRlyFbOnStsThd_P@ */ Scalar_FLOAT32_IEEE 0 EcuIntgdSwGend_CM_single_V 0.0 50.0 /end CHARACTERISTIC
/begin CHARACTERISTIC PHC_NEngPostAcvnGridHeatr_P "Engine Speed Threshold for Grid Heater After Starter Activation" VALUE 0x400484A0 /* @ECU_Address@PHC_NEngPostAcvnGridHeatr_P@ */ Scalar_FLOAT32_IEEE 0 EcuIntgdSwGend_CM_single_rpm 0.0 4500.0 /end CHARACTERISTIC
/begin CHARACTERISTIC PHC_StUsrForTiPreHeatg_P "User State for Parameter of Timer PreHeating Before Starter" VALUE 0x400484C4 /* @ECU_Address@PHC_StUsrForTiPreHeatg_P@ */ Scalar_FLOAT32_IEEE 0 EcuIntgdSwGend_CM_single 0.0 2.0 /end CHARACTERISTIC
/begin CHARACTERISTIC PHC_TiAftrAcvnGridHeatrForSnsrErr_P "Default Timer Value of Grid Heater After Starter Activation for Sensor Error" VALUE 0x40048590 /* @ECU_Address@PHC_TiAftrAcvnGridHeatrForSnsrErr_P@ */ Scalar_FLOAT32_IEEE 0 EcuIntgdSwGend_CM_single_ms 0.0 100000.0 /end CHARACTERISTIC
/begin CHARACTERISTIC PHC_TiGridHeatErrOfStsDeb_P "Default Debounce Time Parameter of Error Grid Heater Off Status" VALUE 0x40048594 /* @ECU_Address@PHC_TiGridHeatErrOfStsDeb_P@ */ Scalar_FLOAT32_IEEE 0 EcuIntgdSwGend_CM_single_ms 0.0 100000.0 /end CHARACTERISTIC
/begin CHARACTERISTIC PHC_TiGridHeatErrOnStsDeb_P "Default Debounce Time Parameter of Error Grid Heater On Status" VALUE 0x40048598 /* @ECU_Address@PHC_TiGridHeatErrOnStsDeb_P@ */ Scalar_FLOAT32_IEEE 0 EcuIntgdSwGend_CM_single_ms 0.0 100000.0 /end CHARACTERISTIC
/begin CHARACTERISTIC PHC_TiPreAcvnGridHeatrForSnsrErr_P "Default Timer Value of Grid Heater Before Starter Activation for Sensor Error" VALUE 0x4004859C /* @ECU_Address@PHC_TiPreAcvnGridHeatrForSnsrErr_P@ */ Scalar_FLOAT32_IEEE 0 EcuIntgdSwGend_CM_single_ms 0.0 100000.0 /end CHARACTERISTIC
/begin CHARACTERISTIC PtoCtrl_FacSclPIDCoeff_P "Factor Scaling Parameter for PID" VALUE 0x40048CF0 /* @ECU_Address@PtoCtrl_FacSclPIDCoeff_P@ */ Scalar_FLOAT32_IEEE 0 EcuIntgdSwGend_CM_single 1.0 10000.0 /end CHARACTERISTIC
/begin CHARACTERISTIC PtoCtrl_LongPsdTiThd_P "PTO Long Pressed Timer Threshold" VALUE 0x40048CF4 /* @ECU_Address@PtoCtrl_LongPsdTiThd_P@ */ Scalar_FLOAT32_IEEE 0 EcuIntgdSwGend_CM_single_ms 0.0 50000.0 /end CHARACTERISTIC
/begin CHARACTERISTIC PtoCtrl_LowrNEngThdForCabPto_P "Engine Speed Lower Threshold for Cabin PTO Activation" VALUE 0x40048CF8 /* @ECU_Address@PtoCtrl_LowrNEngThdForCabPto_P@ */ Scalar_FLOAT32_IEEE 0 EcuIntgdSwGend_CM_single_rpm 0.0 2000.0 /end CHARACTERISTIC
/begin CHARACTERISTIC PtoCtrl_LowrNEngThdForRemPto_P "Engine Speed Lower Threshold for Remote PTO Activation" VALUE 0x40048CFC /* @ECU_Address@PtoCtrl_LowrNEngThdForRemPto_P@ */ Scalar_FLOAT32_IEEE 0 EcuIntgdSwGend_CM_single_rpm 0.0 2000.0 /end CHARACTERISTIC
/begin CHARACTERISTIC PtoCtrl_LowrVehVForCabPto_P "Vehicle Speed Lower Threshold for Cabin PTO Activation" VALUE 0x40048D00 /* @ECU_Address@PtoCtrl_LowrVehVForCabPto_P@ */ Scalar_FLOAT32_IEEE 0 EcuIntgdSwGend_CM_single_km_h 0.0 50.0 /end CHARACTERISTIC
/begin CHARACTERISTIC PtoCtrl_LowrVehVForRemPto_P "Vehicle Speed Lower Threshold for Remote PTO Activation" VALUE 0x40048D04 /* @ECU_Address@PtoCtrl_LowrVehVForRemPto_P@ */ Scalar_FLOAT32_IEEE 0 EcuIntgdSwGend_CM_single_km_h 0.0 50.0 /end CHARACTERISTIC
/begin CHARACTERISTIC PtoCtrl_NEngForCabPto_P "Engine Speed Parameter for Cabin PTO" VALUE 0x40048D08 /* @ECU_Address@PtoCtrl_NEngForCabPto_P@ */ Scalar_FLOAT32_IEEE 0 EcuIntgdSwGend_CM_single_rpm 0.0 2000.0 /end CHARACTERISTIC
/begin CHARACTERISTIC PtoCtrl_NEngLongPsd_P "Engine Speed Long Time Parameter" VALUE 0x40048D34 /* @ECU_Address@PtoCtrl_NEngLongPsd_P@ */ Scalar_FLOAT32_IEEE 0 EcuIntgdSwGend_CM_single_rpm 0.0 2000.0 /end CHARACTERISTIC
/begin CHARACTERISTIC PtoCtrl_NEngMaxSpd_P "Maximum Engine Speed Parameter" VALUE 0x40048D38 /* @ECU_Address@PtoCtrl_NEngMaxSpd_P@ */ Scalar_FLOAT32_IEEE 0 EcuIntgdSwGend_CM_single_rpm 0.0 2000.0 /end CHARACTERISTIC
/begin CHARACTERISTIC PtoCtrl_NEngSetSpd1_P "Engine Set Speed 1 Parameter for Remote PTO" VALUE 0x40048D3C /* @ECU_Address@PtoCtrl_NEngSetSpd1_P@ */ Scalar_FLOAT32_IEEE 0 EcuIntgdSwGend_CM_single_rpm 0.0 2000.0 /end CHARACTERISTIC
/begin CHARACTERISTIC PtoCtrl_NEngSetSpd2_P "Engine Set Speed 2 Parameter for Remote PTO" VALUE 0x40048D40 /* @ECU_Address@PtoCtrl_NEngSetSpd2_P@ */ Scalar_FLOAT32_IEEE 0 EcuIntgdSwGend_CM_single_rpm 0.0 2000.0 /end CHARACTERISTIC
/begin CHARACTERISTIC PtoCtrl_NEngSetSpd3_P "Engine Set Speed 3 Parameter for Remote PTO" VALUE 0x40048D44 /* @ECU_Address@PtoCtrl_NEngSetSpd3_P@ */ Scalar_FLOAT32_IEEE 0 EcuIntgdSwGend_CM_single_rpm 0.0 2000.0 /end CHARACTERISTIC
/begin CHARACTERISTIC PtoCtrl_NEngSetSpd4_P "Engine Set Speed 4 Parameter for Remote PTO" VALUE 0x40048D48 /* @ECU_Address@PtoCtrl_NEngSetSpd4_P@ */ Scalar_FLOAT32_IEEE 0 EcuIntgdSwGend_CM_single_rpm 0.0 2000.0 /end CHARACTERISTIC
/begin CHARACTERISTIC PtoCtrl_NEngSetSpd5_P "Engine Set Speed 5 Parameter for Remote PTO" VALUE 0x40048D4C /* @ECU_Address@PtoCtrl_NEngSetSpd5_P@ */ Scalar_FLOAT32_IEEE 0 EcuIntgdSwGend_CM_single_rpm 0.0 2000.0 /end CHARACTERISTIC
/begin CHARACTERISTIC PtoCtrl_NEngShoPsd_P "Engine speed short press increase amount" VALUE 0x40048D50 /* @ECU_Address@PtoCtrl_NEngShoPsd_P@ */ Scalar_FLOAT32_IEEE 0 EcuIntgdSwGend_CM_single_rpm 0.0 2000.0 /end CHARACTERISTIC
/begin CHARACTERISTIC PtoCtrl_PIDCoeffDOvv_P "PID Derivative Coefficient for PTO Controller - Override Value" VALUE 0x40048D5C /* @ECU_Address@PtoCtrl_PIDCoeffDOvv_P@ */ Scalar_FLOAT32_IEEE 0 EcuIntgdSwGend_CM_single -10000.0 10000.0 /end CHARACTERISTIC
/begin CHARACTERISTIC PtoCtrl_PIDCoeffFiltOvv_P "PID Filter Coefficient for PTO Controller - Override Value" VALUE 0x40048D64 /* @ECU_Address@PtoCtrl_PIDCoeffFiltOvv_P@ */ Scalar_FLOAT32_IEEE 0 EcuIntgdSwGend_CM_single -10000.0 10000.0 /end CHARACTERISTIC
/begin CHARACTERISTIC PtoCtrl_PIDCoeffIOvv_P "PID Integrator Coefficient for PTO Controller - Override Value" VALUE 0x40048D6C /* @ECU_Address@PtoCtrl_PIDCoeffIOvv_P@ */ Scalar_FLOAT32_IEEE 0 EcuIntgdSwGend_CM_single -10000.0 10000.0 /end CHARACTERISTIC
/begin CHARACTERISTIC PtoCtrl_PIDCoeffPOvv_P "PID Proportional Coefficient for PTO Controller - Override Value" VALUE 0x40048D74 /* @ECU_Address@PtoCtrl_PIDCoeffPOvv_P@ */ Scalar_FLOAT32_IEEE 0 EcuIntgdSwGend_CM_single -10000.0 10000.0 /end CHARACTERISTIC
/begin CHARACTERISTIC PtoCtrl_PIDMaxForCabPto_P "PID Max Value For Cabin PTO" VALUE 0x40048D78 /* @ECU_Address@PtoCtrl_PIDMaxForCabPto_P@ */ Scalar_FLOAT32_IEEE 0 EcuIntgdSwGend_CM_single_N_m -10000.0 10000.0 /end CHARACTERISTIC
/begin CHARACTERISTIC PtoCtrl_PIDMaxForRemPto_P "PID Max Value For Remote PTO" VALUE 0x40048D7C /* @ECU_Address@PtoCtrl_PIDMaxForRemPto_P@ */ Scalar_FLOAT32_IEEE 0 EcuIntgdSwGend_CM_single_N_m -10000.0 10000.0 /end CHARACTERISTIC
/begin CHARACTERISTIC PtoCtrl_PIDMinForCabPto_P "PID Min Value for Cabin PTO" VALUE 0x40048D80 /* @ECU_Address@PtoCtrl_PIDMinForCabPto_P@ */ Scalar_FLOAT32_IEEE 0 EcuIntgdSwGend_CM_single_N_m -10000.0 10000.0 /end CHARACTERISTIC
/begin CHARACTERISTIC PtoCtrl_PIDMinForRemPto_P "PID Min Value for Remote PTO" VALUE 0x40048D84 /* @ECU_Address@PtoCtrl_PIDMinForRemPto_P@ */ Scalar_FLOAT32_IEEE 0 EcuIntgdSwGend_CM_single_N_m -10000.0 10000.0 /end CHARACTERISTIC
/begin CHARACTERISTIC PtoCtrl_ShoPsdTiThd_P "PTO Short Pressed Timer Threshold Value" VALUE 0x40048F18 /* @ECU_Address@PtoCtrl_ShoPsdTiThd_P@ */ Scalar_FLOAT32_IEEE 0 EcuIntgdSwGend_CM_single_ms 0.0 50000.0 /end CHARACTERISTIC
/begin CHARACTERISTIC PtoCtrl_UpprNEngThdForCabPto_P "Engine Speed Upper Threshold for Cabin PTO" VALUE 0x40048F78 /* @ECU_Address@PtoCtrl_UpprNEngThdForCabPto_P@ */ Scalar_FLOAT32_IEEE 0 EcuIntgdSwGend_CM_single_rpm 0.0 2500.0 /end CHARACTERISTIC
/begin CHARACTERISTIC PtoCtrl_UpprNEngThdForRemPto_P "Engine Speed Upper Threshold for Remote PTO" VALUE 0x40048F7C /* @ECU_Address@PtoCtrl_UpprNEngThdForRemPto_P@ */ Scalar_FLOAT32_IEEE 0 EcuIntgdSwGend_CM_single_rpm 0.0 2500.0 /end CHARACTERISTIC
/begin CHARACTERISTIC PtoCtrl_UpprVehVForCabPto_P "Vehicle Speed Upper Threshold for Cabin PTO" VALUE 0x40048F80 /* @ECU_Address@PtoCtrl_UpprVehVForCabPto_P@ */ Scalar_FLOAT32_IEEE 0 EcuIntgdSwGend_CM_single_km_h 0.0 50.0 /end CHARACTERISTIC
/begin CHARACTERISTIC PtoCtrl_UpprVehVForRemPto_P "Vehicle Speed Upper Threshold for Remote PTO" VALUE 0x40048F84 /* @ECU_Address@PtoCtrl_UpprVehVForRemPto_P@ */ Scalar_FLOAT32_IEEE 0 EcuIntgdSwGend_CM_single_km_h 0.0 50.0 /end CHARACTERISTIC
/begin CHARACTERISTIC RPG_FFLeakgSetPointOvv_P "FeedForward Leakage Set Point Override Value Parameter" VALUE 0x40049624 /* @ECU_Address@RPG_FFLeakgSetPointOvv_P@ */ Scalar_FLOAT32_IEEE 0 EcuIntgdSwGend_CM_single__ 0.0 5000.0 /end CHARACTERISTIC
/begin CHARACTERISTIC RPG_FacSclPIDCoeff_P "Rail Pressure Controller PID Coefficients Scaling Factor Parameter" VALUE 0x40049628 /* @ECU_Address@RPG_FacSclPIDCoeff_P@ */ Scalar_FLOAT32_IEEE 0 EcuIntgdSwGend_CM_single 1000.0 1000.0 /end CHARACTERISTIC
/begin CHARACTERISTIC RPG_NEngThdAcvnPRailCorr_P "Engine Speed Threshold for Rail Pressure Correction Activation Parameter" VALUE 0x40049778 /* @ECU_Address@RPG_NEngThdAcvnPRailCorr_P@ */ Scalar_FLOAT32_IEEE 0 EcuIntgdSwGend_CM_single_rpm 0.0 3200.0 /end CHARACTERISTIC
/begin CHARACTERISTIC RPG_OfsPRailRefForPCV_P "Rail Pressure Reference Offset for Pressure Control Valve 1 Parameter" VALUE 0x4004977C /* @ECU_Address@RPG_OfsPRailRefForPCV_P@ */ Scalar_FLOAT32_IEEE 0 EcuIntgdSwGend_CM_single_bar 0.0 2500.0 /end CHARACTERISTIC
/begin CHARACTERISTIC RPG_PIDCoeffDOvv_P "Low Limited Rail Pressure Threshold Parameter" VALUE 0x400497AC /* @ECU_Address@RPG_PIDCoeffDOvv_P@ */ Scalar_FLOAT32_IEEE 0 EcuIntgdSwGend_CM_single -100.0 100.0 /end CHARACTERISTIC
/begin CHARACTERISTIC RPG_PIDCoeffFiltOvv_P "Rail Pressure Controller D Filter Coefficient - Override Value Parameter" VALUE 0x400497B4 /* @ECU_Address@RPG_PIDCoeffFiltOvv_P@ */ Scalar_FLOAT32_IEEE 0 EcuIntgdSwGend_CM_single -100.0 100.0 /end CHARACTERISTIC
/begin CHARACTERISTIC RPG_PIDCoeffIOvv_P "Rail Pressure Controller I Coefficient - Override Value Parameter" VALUE 0x400497BC /* @ECU_Address@RPG_PIDCoeffIOvv_P@ */ Scalar_FLOAT32_IEEE 0 EcuIntgdSwGend_CM_single -100.0 100.0 /end CHARACTERISTIC
/begin CHARACTERISTIC RPG_PIDCoeffPOvv_P "Rail Pressure Controller P Coefficient - Override Value Parameter" VALUE 0x400497C4 /* @ECU_Address@RPG_PIDCoeffPOvv_P@ */ Scalar_FLOAT32_IEEE 0 EcuIntgdSwGend_CM_single -100.0 100.0 /end CHARACTERISTIC
/begin CHARACTERISTIC RPG_PIDMax_P "Rail Pressure Controller Maximum Saturation Percentage Parameter" VALUE 0x400497C8 /* @ECU_Address@RPG_PIDMax_P@ */ Scalar_FLOAT32_IEEE 0 EcuIntgdSwGend_CM_single__ -1000.0 1000.0 /end CHARACTERISTIC
/begin CHARACTERISTIC RPG_PIDMin_P "Rail Pressure Controller Minimum Saturation Percentage Parameter" VALUE 0x400497CC /* @ECU_Address@RPG_PIDMin_P@ */ Scalar_FLOAT32_IEEE 0 EcuIntgdSwGend_CM_single__ -1000.0 1000.0 /end CHARACTERISTIC
/begin CHARACTERISTIC RPG_PRailLimdHi_P "High Limit Rail Pressure Threshold Parameter" VALUE 0x40049960 /* @ECU_Address@RPG_PRailLimdHi_P@ */ Scalar_FLOAT32_IEEE 0 EcuIntgdSwGend_CM_single_bar 0.0 5000.0 /end CHARACTERISTIC
/begin CHARACTERISTIC RPG_PRailLimdLo_P "Low Limited Rail Pressure Threshold Parameter" VALUE 0x40049964 /* @ECU_Address@RPG_PRailLimdLo_P@ */ Scalar_FLOAT32_IEEE 0 EcuIntgdSwGend_CM_single_bar 0.0 2500.0 /end CHARACTERISTIC
/begin CHARACTERISTIC RPG_PRailRefForPCVOvv_P "Reference Rail Pressure for Pressure Control Valve 1 - Override Value Parameter" VALUE 0x4004996C /* @ECU_Address@RPG_PRailRefForPCVOvv_P@ */ Scalar_FLOAT32_IEEE 0 EcuIntgdSwGend_CM_single_bar 0.0 2500.0 /end CHARACTERISTIC
/begin CHARACTERISTIC RPG_PRailRefForPCVPwrOnCtlMod_P "Reference Rail Pressure for Pressure Control Valve 1 for Power On Control Mode Parameter" VALUE 0x40049970 /* @ECU_Address@RPG_PRailRefForPCVPwrOnCtlMod_P@ */ Scalar_FLOAT32_IEEE 0 EcuIntgdSwGend_CM_single_bar 0.0 2500.0 /end CHARACTERISTIC
/begin CHARACTERISTIC RPG_PRailRefForPCVStpCtlMod_P "Reference Rail Pressure for Pressure Control Valve 1 for Stop Control Mode Parameter" VALUE 0x40049974 /* @ECU_Address@RPG_PRailRefForPCVStpCtlMod_P@ */ Scalar_FLOAT32_IEEE 0 EcuIntgdSwGend_CM_single_bar 0.0 2500.0 /end CHARACTERISTIC
/begin CHARACTERISTIC RPG_PercgLowrLim_P "Fuel Metering Unit Valve Lower Limit Percentage Parameter" VALUE 0x4004A418 /* @ECU_Address@RPG_PercgLowrLim_P@ */ Scalar_FLOAT32_IEEE 0 EcuIntgdSwGend_CM_single__ 0.0 100.0 /end CHARACTERISTIC
/begin CHARACTERISTIC RPG_PercgUpprLim_P "Fuel Metering Unit Valve Upper Limit Percentage Parameter" VALUE 0x4004A41C /* @ECU_Address@RPG_PercgUpprLim_P@ */ Scalar_FLOAT32_IEEE 0 EcuIntgdSwGend_CM_single__ 0.0 100.0 /end CHARACTERISTIC
/begin CHARACTERISTIC RPG_PercgVCVPwrOnCtlMod_P "FMU Valve Percentage for Power On Control Mode Parameter" VALUE 0x4004A420 /* @ECU_Address@RPG_PercgVCVPwrOnCtlMod_P@ */ Scalar_FLOAT32_IEEE 0 EcuIntgdSwGend_CM_single__ 0.0 100.0 /end CHARACTERISTIC
/begin CHARACTERISTIC RPG_PercgVCVReqOvv_P "FMU Valve 1 Percentage Request - Override Value Parameter" VALUE 0x4004A428 /* @ECU_Address@RPG_PercgVCVReqOvv_P@ */ Scalar_FLOAT32_IEEE 0 EcuIntgdSwGend_CM_single__ 0.0 100.0 /end CHARACTERISTIC
/begin CHARACTERISTIC RPG_PercgVCVStpCtlMod_P "FMU Valve Percentage for Stop Control Mode Parameter" VALUE 0x4004A42C /* @ECU_Address@RPG_PercgVCVStpCtlMod_P@ */ Scalar_FLOAT32_IEEE 0 EcuIntgdSwGend_CM_single__ 0.0 100.0 /end CHARACTERISTIC
/begin CHARACTERISTIC RPG_TCooltFFLeakgMap1Thd_P "Coolant Temperature Threshold Parameter for FeedForward Leakage Map1" VALUE 0x4004AEBC /* @ECU_Address@RPG_TCooltFFLeakgMap1Thd_P@ */ Scalar_FLOAT32_IEEE 0 EcuIntgdSwGend_CM_single_degC -40.0 250.0 /end CHARACTERISTIC
/begin CHARACTERISTIC RPG_TCooltFFLeakgMap2Thd_P "Coolant Temperature Threshold Parameter for FeedForward Leakage Map2" VALUE 0x4004AEC0 /* @ECU_Address@RPG_TCooltFFLeakgMap2Thd_P@ */ Scalar_FLOAT32_IEEE 0 EcuIntgdSwGend_CM_single_degC -40.0 250.0 /end CHARACTERISTIC
/begin CHARACTERISTIC RPG_TCooltFFLeakgMap3Thd_P "Coolant Temperature Threshold Parameter for FeedForward Leakage Map3" VALUE 0x4004AEC4 /* @ECU_Address@RPG_TCooltFFLeakgMap3Thd_P@ */ Scalar_FLOAT32_IEEE 0 EcuIntgdSwGend_CM_single_degC -40.0 250.0 /end CHARACTERISTIC
/begin CHARACTERISTIC RPG_TiDebAcvnPRailCorr_P "Debouncer Timer Value for Rail Pressure Correction Activation Parameter" VALUE 0x4004AF24 /* @ECU_Address@RPG_TiDebAcvnPRailCorr_P@ */ Scalar_FLOAT32_IEEE 0 EcuIntgdSwGend_CM_single_ms 0.0 50000.0 /end CHARACTERISTIC
/begin CHARACTERISTIC SC_NEngAcvStrtLock_P "Starter Locking Engine Speed Threshold Parameter" VALUE 0x4004B04C /* @ECU_Address@SC_NEngAcvStrtLock_P@ */ Scalar_FLOAT32_IEEE 0 EcuIntgdSwGend_CM_single_rpm 0.0 3200.0 /end CHARACTERISTIC
/begin CHARACTERISTIC SC_NEngRunDeacThd_P "Deactivation Running Engine Speed Threshold Value Parameter" VALUE 0x4004B050 /* @ECU_Address@SC_NEngRunDeacThd_P@ */ Scalar_FLOAT32_IEEE 0 EcuIntgdSwGend_CM_single_rpm 0.0 3200.0 /end CHARACTERISTIC
/begin CHARACTERISTIC SC_NEngStrtrInhThd_P "Start Inhibition Engine Speed Threshold Value Parameter" VALUE 0x4004B054 /* @ECU_Address@SC_NEngStrtrInhThd_P@ */ Scalar_FLOAT32_IEEE 0 EcuIntgdSwGend_CM_single_rpm 0.0 3200.0 /end CHARACTERISTIC
/begin CHARACTERISTIC SC_TiDebEngAlrdyRunngThd_P "Engine Running Activation Debouncer for Engine Already Running" VALUE 0x4004B088 /* @ECU_Address@SC_TiDebEngAlrdyRunngThd_P@ */ Scalar_FLOAT32_IEEE 0 EcuIntgdSwGend_CM_single_ms 0.0 100000.0 /end CHARACTERISTIC
/begin CHARACTERISTIC SC_TiDebNEngAcvStrtLock_P "Debouncer Timer Value for Engine Speed Threshold to Active Starter Locking Parameter" VALUE 0x4004B08C /* @ECU_Address@SC_TiDebNEngAcvStrtLock_P@ */ Scalar_FLOAT32_IEEE 0 EcuIntgdSwGend_CM_single_ms 0.0 50000.0 /end CHARACTERISTIC
/begin CHARACTERISTIC SC_TiDebNEngRunAcvn_P "Debouncer Timer Value for Activation Running Engine Speed Parameter" VALUE 0x4004B090 /* @ECU_Address@SC_TiDebNEngRunAcvn_P@ */ Scalar_FLOAT32_IEEE 0 EcuIntgdSwGend_CM_single_ms 0.0 50000.0 /end CHARACTERISTIC
/begin CHARACTERISTIC SC_TiDebNEngRunDeac_P "Debouncer Timer Value for Deactivation Running Engine Speed Parameter" VALUE 0x4004B094 /* @ECU_Address@SC_TiDebNEngRunDeac_P@ */ Scalar_FLOAT32_IEEE 0 EcuIntgdSwGend_CM_single_ms 0.0 50000.0 /end CHARACTERISTIC
/begin CHARACTERISTIC SC_TiMaxAllwblCrnkgOvv_P "Maximum Allowable Cranking Time Calculation Map - Override Value Parameter" VALUE 0x4004B0A4 /* @ECU_Address@SC_TiMaxAllwblCrnkgOvv_P@ */ Scalar_FLOAT32_IEEE 0 EcuIntgdSwGend_CM_single_ms 0.0 100000.0 /end CHARACTERISTIC
/begin CHARACTERISTIC SpdLimr_EngBrkLvl1ActvnThd_P "Engine Brake Level 1 Activaiton Threshold Parameter" VALUE 0x4004B248 /* @ECU_Address@SpdLimr_EngBrkLvl1ActvnThd_P@ */ Scalar_FLOAT32_IEEE 0 EcuIntgdSwGend_CM_single_km_h -300.0 300.0 /end CHARACTERISTIC
/begin CHARACTERISTIC SpdLimr_EngBrkLvl1DeactvnThd_P "Engine Brake Level 1 Deactivation Threshold Parameter" VALUE 0x4004B24C /* @ECU_Address@SpdLimr_EngBrkLvl1DeactvnThd_P@ */ Scalar_FLOAT32_IEEE 0 EcuIntgdSwGend_CM_single_km_h -300.0 300.0 /end CHARACTERISTIC
/begin CHARACTERISTIC SpdLimr_EngBrkLvl2ActvnThd_P "Engine Brake Level 2 Activation Threshold Parameter" VALUE 0x4004B250 /* @ECU_Address@SpdLimr_EngBrkLvl2ActvnThd_P@ */ Scalar_FLOAT32_IEEE 0 EcuIntgdSwGend_CM_single_km_h -300.0 300.0 /end CHARACTERISTIC
/begin CHARACTERISTIC SpdLimr_EngBrkLvl2DeactvnThd_P "Engine Brake Level 2 Deactivation Threshold Parameter" VALUE 0x4004B254 /* @ECU_Address@SpdLimr_EngBrkLvl2DeactvnThd_P@ */ Scalar_FLOAT32_IEEE 0 EcuIntgdSwGend_CM_single_km_h -300.0 300.0 /end CHARACTERISTIC
/begin CHARACTERISTIC SpdLimr_LongPsdTiThd_P "Long Pressed Time Threahold Parameter" VALUE 0x4004B2B0 /* @ECU_Address@SpdLimr_LongPsdTiThd_P@ */ Scalar_FLOAT32_IEEE 0 EcuIntgdSwGend_CM_single_ms 0.0 10000.0 /end CHARACTERISTIC
/begin CHARACTERISTIC SpdLimr_MaxTarSpd_P "Maximum Target Speed Parameter" VALUE 0x4004B2B4 /* @ECU_Address@SpdLimr_MaxTarSpd_P@ */ Scalar_FLOAT32_IEEE 0 EcuIntgdSwGend_CM_single_km_h 0.0 300.0 /end CHARACTERISTIC
/begin CHARACTERISTIC SpdLimr_MaxVehSpdHys_P "Max Vehicle Speed Deactivation Hysteresis" VALUE 0x4004B2B8 /* @ECU_Address@SpdLimr_MaxVehSpdHys_P@ */ Scalar_FLOAT32_IEEE 0 EcuIntgdSwGend_CM_single_km_h 0.0 300.0 /end CHARACTERISTIC
/begin CHARACTERISTIC SpdLimr_MaxVehSpd_P "Max Vehicle Speed" VALUE 0x4004B2BC /* @ECU_Address@SpdLimr_MaxVehSpd_P@ */ Scalar_FLOAT32_IEEE 0 EcuIntgdSwGend_CM_single_km_h 0.0 300.0 /end CHARACTERISTIC
/begin CHARACTERISTIC SpdLimr_MinTarSpd_P "Minimum Target Speed Parameter" VALUE 0x4004B2C0 /* @ECU_Address@SpdLimr_MinTarSpd_P@ */ Scalar_FLOAT32_IEEE 0 EcuIntgdSwGend_CM_single_km_h 0.0 300.0 /end CHARACTERISTIC
/begin CHARACTERISTIC SpdLimr_ShoPsdTiThd_P "Short Pressed Time Threshold Parameter" VALUE 0x4004B390 /* @ECU_Address@SpdLimr_ShoPsdTiThd_P@ */ Scalar_FLOAT32_IEEE 0 EcuIntgdSwGend_CM_single_ms 0.0 10000.0 /end CHARACTERISTIC
/begin CHARACTERISTIC SpdLimr_SpdLimrTq_P "Speed Limiter Torque Parameter" VALUE 0x4004B394 /* @ECU_Address@SpdLimr_SpdLimrTq_P@ */ Scalar_FLOAT32_IEEE 0 EcuIntgdSwGend_CM_single_N_m -1000.0 10000.0 /end CHARACTERISTIC
/begin CHARACTERISTIC SpdLimr_TiEngBrkLvl1ActvnDeb_P "Elapsed Time Engine Brake Level 1 Activation Debouncer Parameter" VALUE 0x4004B398 /* @ECU_Address@SpdLimr_TiEngBrkLvl1ActvnDeb_P@ */ Scalar_FLOAT32_IEEE 0 EcuIntgdSwGend_CM_single_ms 0.0 10000.0 /end CHARACTERISTIC
/begin CHARACTERISTIC SpdLimr_TiEngBrkLvl2ActvnDeb_P "Elapsed Time Engine Brake Level 2 Activation Debouncer Parameter" VALUE 0x4004B39C /* @ECU_Address@SpdLimr_TiEngBrkLvl2ActvnDeb_P@ */ Scalar_FLOAT32_IEEE 0 EcuIntgdSwGend_CM_single_ms 0.0 10000.0 /end CHARACTERISTIC
/begin CHARACTERISTIC SpdLimr_VehVLongPsd_P "Speed Limiter Long Pressed Vehicle Speed Parameter" VALUE 0x4004B420 /* @ECU_Address@SpdLimr_VehVLongPsd_P@ */ Scalar_FLOAT32_IEEE 0 EcuIntgdSwGend_CM_single_km_h 0.0 300.0 /end CHARACTERISTIC
/begin CHARACTERISTIC SpdLimr_VehVShoPsd_P "Speed Limiter Short Pressed Vehicle Speed Parameter" VALUE 0x4004B424 /* @ECU_Address@SpdLimr_VehVShoPsd_P@ */ Scalar_FLOAT32_IEEE 0 EcuIntgdSwGend_CM_single_km_h 0.0 300.0 /end CHARACTERISTIC
/begin CHARACTERISTIC TL_DynRateLoLim_P "Dynamic Rate Limiter Low Limit Parameter" VALUE 0x4004B448 /* @ECU_Address@TL_DynRateLoLim_P@ */ Scalar_FLOAT32_IEEE 0 EcuIntgdSwGend_CM_single -10000.0 0.0 /end CHARACTERISTIC
/begin CHARACTERISTIC TL_DynRateUpLim_P "Dynamic Rate Limiter Up Limit Parameter" VALUE 0x4004B44C /* @ECU_Address@TL_DynRateUpLim_P@ */ Scalar_FLOAT32_IEEE 0 EcuIntgdSwGend_CM_single 0.0 10000.0 /end CHARACTERISTIC
/begin CHARACTERISTIC TL_TqLimdForNExhTrbChrgOvv_P "Limited Torque Value of Turbo Charger Speed - Override Value" VALUE 0x4004C248 /* @ECU_Address@TL_TqLimdForNExhTrbChrgOvv_P@ */ Scalar_FLOAT32_IEEE 0 EcuIntgdSwGend_CM_single_N_m 0.0 5000.0 /end CHARACTERISTIC
/begin CHARACTERISTIC TL_TqLimdForPAirAmbOvv_P "Limited Torque Value of Ambient Air Pressure - Override Value" VALUE 0x4004C250 /* @ECU_Address@TL_TqLimdForPAirAmbOvv_P@ */ Scalar_FLOAT32_IEEE 0 EcuIntgdSwGend_CM_single_N_m 0.0 5000.0 /end CHARACTERISTIC
/begin CHARACTERISTIC TL_TqLimdForPAirBoostOvv_P "Limited Torque Value of Air Boost Pressure - Override Value" VALUE 0x4004C258 /* @ECU_Address@TL_TqLimdForPAirBoostOvv_P@ */ Scalar_FLOAT32_IEEE 0 EcuIntgdSwGend_CM_single_N_m 0.0 5000.0 /end CHARACTERISTIC
/begin CHARACTERISTIC TL_TqLimdForSurgeOvv_P "Limited Torque Value of Surge Protection - Override Value" VALUE 0x4004C260 /* @ECU_Address@TL_TqLimdForSurgeOvv_P@ */ Scalar_FLOAT32_IEEE 0 EcuIntgdSwGend_CM_single_N_m 0.0 10000.0 /end CHARACTERISTIC
/begin CHARACTERISTIC TL_TqLimdForTAirOvv_P "Limited Torque Value of Air Boost Temperature - Override Value" VALUE 0x4004C268 /* @ECU_Address@TL_TqLimdForTAirOvv_P@ */ Scalar_FLOAT32_IEEE 0 EcuIntgdSwGend_CM_single_N_m 0.0 5000.0 /end CHARACTERISTIC
/begin CHARACTERISTIC TL_TqLimdForTCooltOvv_P "Limited Torque Value of Coolant High Temperature - Override Value" VALUE 0x4004C270 /* @ECU_Address@TL_TqLimdForTCooltOvv_P@ */ Scalar_FLOAT32_IEEE 0 EcuIntgdSwGend_CM_single_N_m 0.0 5000.0 /end CHARACTERISTIC
/begin CHARACTERISTIC TL_TqLimdForTFuOvv_P "Limited Torque Value of Fuel Temperature - Override Value" VALUE 0x4004C278 /* @ECU_Address@TL_TqLimdForTFuOvv_P@ */ Scalar_FLOAT32_IEEE 0 EcuIntgdSwGend_CM_single_N_m 0.0 5000.0 /end CHARACTERISTIC
/begin CHARACTERISTIC TL_TqLimdForTOilOvv_P "Limited Torque Value of Oil Temperature - Override Value" VALUE 0x4004C280 /* @ECU_Address@TL_TqLimdForTOilOvv_P@ */ Scalar_FLOAT32_IEEE 0 EcuIntgdSwGend_CM_single_N_m 0.0 5000.0 /end CHARACTERISTIC
/begin CHARACTERISTIC TL_TqMapLimdEngProtnOvv_P "Map Based Torque Limitation - Override Value" VALUE 0x4004C2E8 /* @ECU_Address@TL_TqMapLimdEngProtnOvv_P@ */ Scalar_FLOAT32_IEEE 0 EcuIntgdSwGend_CM_single_N_m 0.0 5000.0 /end CHARACTERISTIC
/begin CHARACTERISTIC TL_TqRednLvL1_P "Reduction Factor For Level 1 " VALUE 0x4004C2EC /* @ECU_Address@TL_TqRednLvL1_P@ */ Scalar_FLOAT32_IEEE 0 EcuIntgdSwGend_CM_single 0.0 1.0 /end CHARACTERISTIC
/begin CHARACTERISTIC TL_TqRednLvl2_P "Reduction Factor For Level 2" VALUE 0x4004C2F0 /* @ECU_Address@TL_TqRednLvl2_P@ */ Scalar_FLOAT32_IEEE 0 EcuIntgdSwGend_CM_single 0.0 1.0 /end CHARACTERISTIC
/begin CHARACTERISTIC TrC_MMaiFuQntyOvv_P "Main Fuel Quantity - Override Value" VALUE 0x4004E868 /* @ECU_Address@TrC_MMaiFuQntyOvv_P@ */ Scalar_FLOAT32_IEEE 0 EcuIntgdSwGend_CM_single_mm_3_stk 0.0 1000.0 /end CHARACTERISTIC
/begin CHARACTERISTIC TrC_MPltFuQntyOvv_P "Pilot Fuel Quantity - Override Value" VALUE 0x4004F130 /* @ECU_Address@TrC_MPltFuQntyOvv_P@ */ Scalar_FLOAT32_IEEE 0 EcuIntgdSwGend_CM_single_mm_3_stk 0.0 1000.0 /end CHARACTERISTIC
/begin CHARACTERISTIC TrC_RatAirFuMax_P "Air Fuel Rate Max Threshold" VALUE 0x40050548 /* @ECU_Address@TrC_RatAirFuMax_P@ */ Scalar_FLOAT32_IEEE 0 EcuIntgdSwGend_CM_single 0.0 100.0 /end CHARACTERISTIC
/begin CHARACTERISTIC TrC_RatAirFuMin_P "Air Fuel Rate Min Threshold" VALUE 0x4005054C /* @ECU_Address@TrC_RatAirFuMin_P@ */ Scalar_FLOAT32_IEEE 0 EcuIntgdSwGend_CM_single 0.0 100.0 /end CHARACTERISTIC
/begin CHARACTERISTIC TrC_TCooltMap1Thd_P "Coolant High Temperature Threshold for Quantity Map 1" VALUE 0x400506E4 /* @ECU_Address@TrC_TCooltMap1Thd_P@ */ Scalar_FLOAT32_IEEE 0 EcuIntgdSwGend_CM_single_degC -40.0 250.0 /end CHARACTERISTIC
/begin CHARACTERISTIC TrC_TCooltMap2Thd_P "Coolant High Temperature Threshold for Quantity Map 2" VALUE 0x400506E8 /* @ECU_Address@TrC_TCooltMap2Thd_P@ */ Scalar_FLOAT32_IEEE 0 EcuIntgdSwGend_CM_single_degC -40.0 250.0 /end CHARACTERISTIC
/begin CHARACTERISTIC TrC_TCooltMap3Thd_P "Coolant High Temperature Threshold for Quantity Map 3" VALUE 0x400506EC /* @ECU_Address@TrC_TCooltMap3Thd_P@ */ Scalar_FLOAT32_IEEE 0 EcuIntgdSwGend_CM_single_degC -40.0 250.0 /end CHARACTERISTIC
/begin CHARACTERISTIC WgC_DutyVlvOvv_P "Duty Valve - Override Value Parameter" VALUE 0x40051464 /* @ECU_Address@WgC_DutyVlvOvv_P@ */ Scalar_FLOAT32_IEEE 0 EcuIntgdSwGend_CM_single__ 0.0 100.0 /end CHARACTERISTIC
/begin CHARACTERISTIC EOP_DstTrvldInKmOvs_P "Output Processing Distance Travel In Kilometer Override Switch Parameter" VALUE 0x40044B78 /* @ECU_Address@EOP_DstTrvldInKmOvs_P@ */ Scalar_BOOLEAN 0 EcuIntgdSwGend_CM_boolean 0.0 1.0 /end CHARACTERISTIC
/begin CHARACTERISTIC EOP_DurMaiInj1Ovs_P "Output Processing Main Injection Duration for Cylinder 1 Override Switch Parameter" VALUE 0x40044B80 /* @ECU_Address@EOP_DurMaiInj1Ovs_P@ */ Scalar_BOOLEAN 0 EcuIntgdSwGend_CM_boolean 0.0 1.0 /end CHARACTERISTIC
/begin CHARACTERISTIC EOP_DurMaiInj2Ovs_P "Output Processing Main Injection Duration for Cylinder 2 Override Switch Parameter" VALUE 0x40044B88 /* @ECU_Address@EOP_DurMaiInj2Ovs_P@ */ Scalar_BOOLEAN 0 EcuIntgdSwGend_CM_boolean 0.0 1.0 /end CHARACTERISTIC
/begin CHARACTERISTIC EOP_DurMaiInj3Ovs_P "Output Processing Main Injection Duration for Cylinder 3 Override Switch Parameter" VALUE 0x40044B90 /* @ECU_Address@EOP_DurMaiInj3Ovs_P@ */ Scalar_BOOLEAN 0 EcuIntgdSwGend_CM_boolean 0.0 1.0 /end CHARACTERISTIC
/begin CHARACTERISTIC EOP_DurMaiInj4Ovs_P "Output Processing Main Injection Duration for Cylinder 4 Override Switch Parameter" VALUE 0x40044B98 /* @ECU_Address@EOP_DurMaiInj4Ovs_P@ */ Scalar_BOOLEAN 0 EcuIntgdSwGend_CM_boolean 0.0 1.0 /end CHARACTERISTIC
/begin CHARACTERISTIC EOP_DurMaiInj5Ovs_P "Output Processing Main Injection Duration for Cylinder 5 Override Switch Parameter" VALUE 0x40044BA0 /* @ECU_Address@EOP_DurMaiInj5Ovs_P@ */ Scalar_BOOLEAN 0 EcuIntgdSwGend_CM_boolean 0.0 1.0 /end CHARACTERISTIC
/begin CHARACTERISTIC EOP_DurMaiInj6Ovs_P "Output Processing Main Injection Duration for Cylinder 6 Override Switch Parameter" VALUE 0x40044BA8 /* @ECU_Address@EOP_DurMaiInj6Ovs_P@ */ Scalar_BOOLEAN 0 EcuIntgdSwGend_CM_boolean 0.0 1.0 /end CHARACTERISTIC
/begin CHARACTERISTIC EOP_DurPltInj1Ovs_P "Output Processing Pre Pilot Injection Duration for Cylinder 1 Override Switch Parameter" VALUE 0x40044BB0 /* @ECU_Address@EOP_DurPltInj1Ovs_P@ */ Scalar_BOOLEAN 0 EcuIntgdSwGend_CM_boolean 0.0 1.0 /end CHARACTERISTIC
/begin CHARACTERISTIC EOP_DurPltInj2Ovs_P "Output Processing Pre Pilot Injection Duration for Cylinder 2 Override Switch Parameter" VALUE 0x40044BB8 /* @ECU_Address@EOP_DurPltInj2Ovs_P@ */ Scalar_BOOLEAN 0 EcuIntgdSwGend_CM_boolean 0.0 1.0 /end CHARACTERISTIC
/begin CHARACTERISTIC EOP_DurPltInj3Ovs_P "Output Processing Pre Pilot Injection Duration for Cylinder 3 Override Switch Parameter" VALUE 0x40044BC0 /* @ECU_Address@EOP_DurPltInj3Ovs_P@ */ Scalar_BOOLEAN 0 EcuIntgdSwGend_CM_boolean 0.0 1.0 /end CHARACTERISTIC
/begin CHARACTERISTIC EOP_DurPltInj4Ovs_P "Output Processing Pre Pilot Injection Duration for Cylinder 4 Override Switch Parameter" VALUE 0x40044BC8 /* @ECU_Address@EOP_DurPltInj4Ovs_P@ */ Scalar_BOOLEAN 0 EcuIntgdSwGend_CM_boolean 0.0 1.0 /end CHARACTERISTIC
/begin CHARACTERISTIC EOP_DurPltInj5Ovs_P "Output Processing Pre Pilot Injection Duration for Cylinder 5 Override Switch Parameter" VALUE 0x40044BD0 /* @ECU_Address@EOP_DurPltInj5Ovs_P@ */ Scalar_BOOLEAN 0 EcuIntgdSwGend_CM_boolean 0.0 1.0 /end CHARACTERISTIC
/begin CHARACTERISTIC EOP_DurPltInj6Ovs_P "Output Processing Pre Pilot Injection Duration for Cylinder 6 Override Switch Parameter" VALUE 0x40044BD8 /* @ECU_Address@EOP_DurPltInj6Ovs_P@ */ Scalar_BOOLEAN 0 EcuIntgdSwGend_CM_boolean 0.0 1.0 /end CHARACTERISTIC
/begin CHARACTERISTIC EOP_DutyVlvReqOvs_P "Output Processing Duty Valve Request Override Switch Parameter" VALUE 0x40044BE0 /* @ECU_Address@EOP_DutyVlvReqOvs_P@ */ Scalar_BOOLEAN 0 EcuIntgdSwGend_CM_boolean 0.0 1.0 /end CHARACTERISTIC
/begin CHARACTERISTIC EOP_DynRateVCVActvnSwt_P "Output Processing Dynamic Rate Limiter Activation Parameter for Volumetric Control Valve" VALUE 0x40044BE8 /* @ECU_Address@EOP_DynRateVCVActvnSwt_P@ */ Scalar_BOOLEAN 0 EcuIntgdSwGend_CM_boolean 0.0 1.0 /end CHARACTERISTIC
/begin CHARACTERISTIC EOP_EngHrOvs_P "Output Processing Engine Hour Override Switch Parameter" VALUE 0x40044BF4 /* @ECU_Address@EOP_EngHrOvs_P@ */ Scalar_BOOLEAN 0 EcuIntgdSwGend_CM_boolean 0.0 1.0 /end CHARACTERISTIC
/begin CHARACTERISTIC EOP_FuCnsOvs_P "Output Processing Fuel Consumption Override Switch Parameter" VALUE 0x40044C08 /* @ECU_Address@EOP_FuCnsOvs_P@ */ Scalar_BOOLEAN 0 EcuIntgdSwGend_CM_boolean 0.0 1.0 /end CHARACTERISTIC
/begin CHARACTERISTIC EOP_IRefPCVOvs_P "Output Processing Current Reference for Pressure Control Valve Override Switch Parameter" VALUE 0x40044C14 /* @ECU_Address@EOP_IRefPCVOvs_P@ */ Scalar_BOOLEAN 0 EcuIntgdSwGend_CM_boolean 0.0 1.0 /end CHARACTERISTIC
/begin CHARACTERISTIC EOP_IVCVReqOvs_P "Output Processing Volumetric Control Valve Current Request Override Switch Parameter" VALUE 0x40044C6C /* @ECU_Address@EOP_IVCVReqOvs_P@ */ Scalar_BOOLEAN 0 EcuIntgdSwGend_CM_boolean 0.0 1.0 /end CHARACTERISTIC
/begin CHARACTERISTIC EOP_SoiMaiInj1Ovs_P "Output Processing Start of Main Injection 1 Override Switch Parameter" VALUE 0x40044CCC /* @ECU_Address@EOP_SoiMaiInj1Ovs_P@ */ Scalar_BOOLEAN 0 EcuIntgdSwGend_CM_boolean 0.0 1.0 /end CHARACTERISTIC
/begin CHARACTERISTIC EOP_SoiMaiInj2Ovs_P "Output Processing Start of Main Injection 2 Override Switch Parameter" VALUE 0x40044CD4 /* @ECU_Address@EOP_SoiMaiInj2Ovs_P@ */ Scalar_BOOLEAN 0 EcuIntgdSwGend_CM_boolean 0.0 1.0 /end CHARACTERISTIC
/begin CHARACTERISTIC EOP_SoiMaiInj3Ovs_P "Output Processing Start of Main Injection 3 Override Switch Parameter" VALUE 0x40044CDC /* @ECU_Address@EOP_SoiMaiInj3Ovs_P@ */ Scalar_BOOLEAN 0 EcuIntgdSwGend_CM_boolean 0.0 1.0 /end CHARACTERISTIC
/begin CHARACTERISTIC EOP_SoiMaiInj4Ovs_P "Output Processing Start of Main Injection 4 Override Switch Parameter" VALUE 0x40044CE4 /* @ECU_Address@EOP_SoiMaiInj4Ovs_P@ */ Scalar_BOOLEAN 0 EcuIntgdSwGend_CM_boolean 0.0 1.0 /end CHARACTERISTIC
/begin CHARACTERISTIC EOP_SoiMaiInj5Ovs_P "Output Processing Start of Main Injection 5 Override Switch Parameter" VALUE 0x40044CEC /* @ECU_Address@EOP_SoiMaiInj5Ovs_P@ */ Scalar_BOOLEAN 0 EcuIntgdSwGend_CM_boolean 0.0 1.0 /end CHARACTERISTIC
/begin CHARACTERISTIC EOP_SoiMaiInj6Ovs_P "Output Processing Start of Main Injection 6 Override Switch Parameter" VALUE 0x40044CF4 /* @ECU_Address@EOP_SoiMaiInj6Ovs_P@ */ Scalar_BOOLEAN 0 EcuIntgdSwGend_CM_boolean 0.0 1.0 /end CHARACTERISTIC
/begin CHARACTERISTIC EOP_SoiPltInj1Ovs_P "Output Processing Start of Pilot Injection 1 Override Switch Parameter" VALUE 0x40044CFC /* @ECU_Address@EOP_SoiPltInj1Ovs_P@ */ Scalar_BOOLEAN 0 EcuIntgdSwGend_CM_boolean 0.0 1.0 /end CHARACTERISTIC
/begin CHARACTERISTIC EOP_SoiPltInj2Ovs_P "Output Processing Start of Pilot Injection 2 Override Switch Parameter" VALUE 0x40044D04 /* @ECU_Address@EOP_SoiPltInj2Ovs_P@ */ Scalar_BOOLEAN 0 EcuIntgdSwGend_CM_boolean 0.0 1.0 /end CHARACTERISTIC
/begin CHARACTERISTIC EOP_SoiPltInj3Ovs_P "Output Processing Start of Pilot Injection 3 Override Switch Parameter" VALUE 0x40044D0C /* @ECU_Address@EOP_SoiPltInj3Ovs_P@ */ Scalar_BOOLEAN 0 EcuIntgdSwGend_CM_boolean 0.0 1.0 /end CHARACTERISTIC
/begin CHARACTERISTIC EOP_SoiPltInj4Ovs_P "Output Processing Start of Pilot Injection 4 Override Switch Parameter" VALUE 0x40044D14 /* @ECU_Address@EOP_SoiPltInj4Ovs_P@ */ Scalar_BOOLEAN 0 EcuIntgdSwGend_CM_boolean 0.0 1.0 /end CHARACTERISTIC
/begin CHARACTERISTIC EOP_SoiPltInj5Ovs_P "Output Processing Start of Pilot Injection 5 Override Switch Parameter" VALUE 0x40044D1C /* @ECU_Address@EOP_SoiPltInj5Ovs_P@ */ Scalar_BOOLEAN 0 EcuIntgdSwGend_CM_boolean 0.0 1.0 /end CHARACTERISTIC
/begin CHARACTERISTIC EOP_SoiPltInj6Ovs_P "Output Processing Start of Pilot Injection 6 Override Switch Parameter" VALUE 0x40044D24 /* @ECU_Address@EOP_SoiPltInj6Ovs_P@ */ Scalar_BOOLEAN 0 EcuIntgdSwGend_CM_boolean 0.0 1.0 /end CHARACTERISTIC
/begin CHARACTERISTIC EOP_TripOvs_P "" VALUE 0x40044D2C /* @ECU_Address@EOP_TripOvs_P@ */ Scalar_BOOLEAN 0 EcuIntgdSwGend_CM_boolean 0.0 1.0 /end CHARACTERISTIC
/begin CHARACTERISTIC EOP_bAcvStrtrOvs_P "Output Processing Starter Activaiton Override Switch Parameter" VALUE 0x40044D3C /* @ECU_Address@EOP_bAcvStrtrOvs_P@ */ Scalar_BOOLEAN 0 EcuIntgdSwGend_CM_boolean 0.0 1.0 /end CHARACTERISTIC
/begin CHARACTERISTIC EOP_bAcvStrtrOvv_P "Output Processing Starter Activaiton Override Value Parameter" VALUE 0x40044D40 /* @ECU_Address@EOP_bAcvStrtrOvv_P@ */ Scalar_BOOLEAN 0 EcuIntgdSwGend_CM_boolean 0.0 1.0 /end CHARACTERISTIC
/begin CHARACTERISTIC IC_DstToEmptyOvs_P "Distance to Empty - Override Switch Parameter" VALUE 0x40044D88 /* @ECU_Address@IC_DstToEmptyOvs_P@ */ Scalar_BOOLEAN 0 EcuIntgdSwGend_CM_boolean 0.0 1.0 /end CHARACTERISTIC
/begin CHARACTERISTIC IC_DurMaiCyl1BalOvs_P "Main Injection Duration Balance for Cylinder 1 - Override Switch Parameter" VALUE 0x40044D90 /* @ECU_Address@IC_DurMaiCyl1BalOvs_P@ */ Scalar_BOOLEAN 0 EcuIntgdSwGend_CM_boolean 0.0 1.0 /end CHARACTERISTIC
/begin CHARACTERISTIC IC_DurMaiCyl2BalOvs_P "Main Injection Duration Balance for Cylinder 2 - Override Switch Parameter" VALUE 0x40044D9C /* @ECU_Address@IC_DurMaiCyl2BalOvs_P@ */ Scalar_BOOLEAN 0 EcuIntgdSwGend_CM_boolean 0.0 1.0 /end CHARACTERISTIC
/begin CHARACTERISTIC IC_DurMaiCyl3BalOvs_P "Main Injection Duration Balance for Cylinder 3 - Override Switch Parameter" VALUE 0x40044DA8 /* @ECU_Address@IC_DurMaiCyl3BalOvs_P@ */ Scalar_BOOLEAN 0 EcuIntgdSwGend_CM_boolean 0.0 1.0 /end CHARACTERISTIC
/begin CHARACTERISTIC IC_DurMaiCyl4BalOvs_P "Main Injection Duration Balance for Cylinder 4 - Override Switch Parameter" VALUE 0x40044DB4 /* @ECU_Address@IC_DurMaiCyl4BalOvs_P@ */ Scalar_BOOLEAN 0 EcuIntgdSwGend_CM_boolean 0.0 1.0 /end CHARACTERISTIC
/begin CHARACTERISTIC IC_DurMaiCyl5BalOvs_P "Main Injection Duration Balance for Cylinder 5 - Override Switch Parameter" VALUE 0x40044DC0 /* @ECU_Address@IC_DurMaiCyl5BalOvs_P@ */ Scalar_BOOLEAN 0 EcuIntgdSwGend_CM_boolean 0.0 1.0 /end CHARACTERISTIC
/begin CHARACTERISTIC IC_DurMaiCyl6BalOvs_P "Main Injection Duration Balance for Cylinder 6 - Override Switch Parameter" VALUE 0x40044DCC /* @ECU_Address@IC_DurMaiCyl6BalOvs_P@ */ Scalar_BOOLEAN 0 EcuIntgdSwGend_CM_boolean 0.0 1.0 /end CHARACTERISTIC
/begin CHARACTERISTIC IC_DurPltInj1PreOvs_P "Pre Pilot Injection Duration for Cylinder 1 - Override Switch Parameter" VALUE 0x40044E20 /* @ECU_Address@IC_DurPltInj1PreOvs_P@ */ Scalar_BOOLEAN 0 EcuIntgdSwGend_CM_boolean 0.0 1.0 /end CHARACTERISTIC
/begin CHARACTERISTIC IC_DurPltInj2PreOvs_P "Pre Pilot Injection Duration for Cylinder 2 - Override Switch Parameter" VALUE 0x40044E28 /* @ECU_Address@IC_DurPltInj2PreOvs_P@ */ Scalar_BOOLEAN 0 EcuIntgdSwGend_CM_boolean 0.0 1.0 /end CHARACTERISTIC
/begin CHARACTERISTIC IC_DurPltInj3PreOvs_P "Pre Pilot Injection Duration for Cylinder 3 - Override Switch Parameter" VALUE 0x40044E30 /* @ECU_Address@IC_DurPltInj3PreOvs_P@ */ Scalar_BOOLEAN 0 EcuIntgdSwGend_CM_boolean 0.0 1.0 /end CHARACTERISTIC
/begin CHARACTERISTIC IC_DurPltInj4PreOvs_P "Pre Pilot Injection Duration for Cylinder 4 - Override Switch Parameter" VALUE 0x40044E38 /* @ECU_Address@IC_DurPltInj4PreOvs_P@ */ Scalar_BOOLEAN 0 EcuIntgdSwGend_CM_boolean 0.0 1.0 /end CHARACTERISTIC
/begin CHARACTERISTIC IC_DurPltInj5PreOvs_P "Pre Pilot Injection Duration for Cylinder 5 - Override Switch Parameter" VALUE 0x40044E40 /* @ECU_Address@IC_DurPltInj5PreOvs_P@ */ Scalar_BOOLEAN 0 EcuIntgdSwGend_CM_boolean 0.0 1.0 /end CHARACTERISTIC
/begin CHARACTERISTIC IC_DurPltInj6PreOvs_P "Pre Pilot Injection Duration for Cylinder 6 - Override Switch Parameter" VALUE 0x40044E48 /* @ECU_Address@IC_DurPltInj6PreOvs_P@ */ Scalar_BOOLEAN 0 EcuIntgdSwGend_CM_boolean 0.0 1.0 /end CHARACTERISTIC
/begin CHARACTERISTIC IC_FuCnsAveOvs_P "Fuel Consumption Average Override Switch Parameter" VALUE 0x40044EC8 /* @ECU_Address@IC_FuCnsAveOvs_P@ */ Scalar_BOOLEAN 0 EcuIntgdSwGend_CM_boolean 0.0 1.0 /end CHARACTERISTIC
/begin CHARACTERISTIC IC_FuCnsOvs_P "Fuel Consumption - Override Switch Parameter" VALUE 0x40044ED0 /* @ECU_Address@IC_FuCnsOvs_P@ */ Scalar_BOOLEAN 0 EcuIntgdSwGend_CM_boolean 0.0 1.0 /end CHARACTERISTIC
/begin CHARACTERISTIC IC_MMaiFuQntyCorrdOvs_P "Corrected Main Fuel Quantity Mass - Override Switch Parameter" VALUE 0x40045BD4 /* @ECU_Address@IC_MMaiFuQntyCorrdOvs_P@ */ Scalar_BOOLEAN 0 EcuIntgdSwGend_CM_boolean 0.0 1.0 /end CHARACTERISTIC
/begin CHARACTERISTIC IC_MPltFuQntyCorrdOvs_P "Corrected Pilot Fuel Quantity Mass - Override Switch Parameter" VALUE 0x40045BE4 /* @ECU_Address@IC_MPltFuQntyCorrdOvs_P@ */ Scalar_BOOLEAN 0 EcuIntgdSwGend_CM_boolean 0.0 1.0 /end CHARACTERISTIC
/begin CHARACTERISTIC IC_bAcvPltAllwdOvs_P "Pilot Injection Allowance Flag - Override Switch Parameter" VALUE 0x40048490 /* @ECU_Address@IC_bAcvPltAllwdOvs_P@ */ Scalar_BOOLEAN 0 EcuIntgdSwGend_CM_boolean 0.0 1.0 /end CHARACTERISTIC
/begin CHARACTERISTIC IC_bAcvPltAllwdOvv_P "Pilot Injection Allowance Flag - Override Value Parameter" VALUE 0x40048494 /* @ECU_Address@IC_bAcvPltAllwdOvv_P@ */ Scalar_BOOLEAN 0 EcuIntgdSwGend_CM_boolean 0.0 1.0 /end CHARACTERISTIC
/begin CHARACTERISTIC PHC_bAcvGridHeatrOvs_P "Grid Heater is Active Flag - Override Switch Parameter" VALUE 0x40048668 /* @ECU_Address@PHC_bAcvGridHeatrOvs_P@ */ Scalar_BOOLEAN 0 EcuIntgdSwGend_CM_boolean 0.0 1.0 /end CHARACTERISTIC
/begin CHARACTERISTIC PHC_bAcvGridHeatrOvv_P "Grid Heater is Active Flag - Override Value Parameter" VALUE 0x4004866C /* @ECU_Address@PHC_bAcvGridHeatrOvv_P@ */ Scalar_BOOLEAN 0 EcuIntgdSwGend_CM_boolean 0.0 1.0 /end CHARACTERISTIC
/begin CHARACTERISTIC PHC_bAcvPostGridHeatrOvs_P "Grid Heater Activation with After Starter - Override Switch Parameter" VALUE 0x40048670 /* @ECU_Address@PHC_bAcvPostGridHeatrOvs_P@ */ Scalar_BOOLEAN 0 EcuIntgdSwGend_CM_boolean 0.0 1.0 /end CHARACTERISTIC
/begin CHARACTERISTIC PHC_bAcvPostGridHeatrOvv_P "Grid Heater Activation with After Starter - Override Value Parameter" VALUE 0x40048674 /* @ECU_Address@PHC_bAcvPostGridHeatrOvv_P@ */ Scalar_BOOLEAN 0 EcuIntgdSwGend_CM_boolean 0.0 1.0 /end CHARACTERISTIC
/begin CHARACTERISTIC PHC_bAcvPreAcvnGridHeatrOvs_P "Grid Heater is Active Flag Before Starter - Override Switch Parameter" VALUE 0x40048678 /* @ECU_Address@PHC_bAcvPreAcvnGridHeatrOvs_P@ */ Scalar_BOOLEAN 0 EcuIntgdSwGend_CM_boolean 0.0 1.0 /end CHARACTERISTIC
/begin CHARACTERISTIC PHC_bAcvPreAcvnGridHeatrOvv_P "Grid Heater is Active Flag Before Starter - Override Value Parameter" VALUE 0x4004867C /* @ECU_Address@PHC_bAcvPreAcvnGridHeatrOvv_P@ */ Scalar_BOOLEAN 0 EcuIntgdSwGend_CM_boolean 0.0 1.0 /end CHARACTERISTIC
/begin CHARACTERISTIC PHC_bErrAcvGridHeatrOvs_P "Grid Heater Error Override Switch Parameter" VALUE 0x40048680 /* @ECU_Address@PHC_bErrAcvGridHeatrOvs_P@ */ Scalar_BOOLEAN 0 EcuIntgdSwGend_CM_boolean 0.0 1.0 /end CHARACTERISTIC
/begin CHARACTERISTIC PHC_bErrAcvGridHeatrOvv_P "Grid Heater Error Override Value Parameter" VALUE 0x40048684 /* @ECU_Address@PHC_bErrAcvGridHeatrOvv_P@ */ Scalar_BOOLEAN 0 EcuIntgdSwGend_CM_boolean 0.0 1.0 /end CHARACTERISTIC
/begin CHARACTERISTIC PtoCtrl_NotAvlAcv_P "PTO Governer State Not Available" VALUE 0x40048D54 /* @ECU_Address@PtoCtrl_NotAvlAcv_P@ */ Scalar_BOOLEAN 0 EcuIntgdSwGend_CM_boolean 0.0 1.0 /end CHARACTERISTIC
/begin CHARACTERISTIC PtoCtrl_PIDCoeffDOvs_P "PID Derivative Coefficient for PTO Controller - Override Switch" VALUE 0x40048D58 /* @ECU_Address@PtoCtrl_PIDCoeffDOvs_P@ */ Scalar_BOOLEAN 0 EcuIntgdSwGend_CM_boolean 0.0 1.0 /end CHARACTERISTIC
/begin CHARACTERISTIC PtoCtrl_PIDCoeffFiltOvs_P "PID Filter Coefficient for PTO Controller - Override Switch" VALUE 0x40048D60 /* @ECU_Address@PtoCtrl_PIDCoeffFiltOvs_P@ */ Scalar_BOOLEAN 0 EcuIntgdSwGend_CM_boolean 0.0 1.0 /end CHARACTERISTIC
/begin CHARACTERISTIC PtoCtrl_PIDCoeffIOvs_P "PID Integrator Coefficient for PTO Controller - Override Switch" VALUE 0x40048D68 /* @ECU_Address@PtoCtrl_PIDCoeffIOvs_P@ */ Scalar_BOOLEAN 0 EcuIntgdSwGend_CM_boolean 0.0 1.0 /end CHARACTERISTIC
/begin CHARACTERISTIC PtoCtrl_PIDCoeffPOvs_P "PID Proportional Coefficient for PTO Controller - Override Switch" VALUE 0x40048D70 /* @ECU_Address@PtoCtrl_PIDCoeffPOvs_P@ */ Scalar_BOOLEAN 0 EcuIntgdSwGend_CM_boolean 0.0 1.0 /end CHARACTERISTIC
/begin CHARACTERISTIC PtoCtrl_bAcvCabPtoCanOrDigInpOvs_P "Cabin PTO Can Or Digital Input Select Parameter" VALUE 0x40048F88 /* @ECU_Address@PtoCtrl_bAcvCabPtoCanOrDigInpOvs_P@ */ Scalar_BOOLEAN 0 EcuIntgdSwGend_CM_boolean 0.0 1.0 /end CHARACTERISTIC
/begin CHARACTERISTIC PtoCtrl_bAcvCabPtoOvs_P "Cabin PTO Activation Override Switch Parameter" VALUE 0x40048F8C /* @ECU_Address@PtoCtrl_bAcvCabPtoOvs_P@ */ Scalar_BOOLEAN 0 EcuIntgdSwGend_CM_boolean 0.0 1.0 /end CHARACTERISTIC
/begin CHARACTERISTIC PtoCtrl_bAcvCabPtoOvv_P "Cabin PTO Activation Override Value Parameter" VALUE 0x40048F90 /* @ECU_Address@PtoCtrl_bAcvCabPtoOvv_P@ */ Scalar_BOOLEAN 0 EcuIntgdSwGend_CM_boolean 0.0 1.0 /end CHARACTERISTIC
/begin CHARACTERISTIC PtoCtrl_bAcvHndBrkPrkgForRemPto_P "Hand Brake Parking Active Parameter For Remote PTO" VALUE 0x40048F94 /* @ECU_Address@PtoCtrl_bAcvHndBrkPrkgForRemPto_P@ */ Scalar_BOOLEAN 0 EcuIntgdSwGend_CM_boolean 0.0 1.0 /end CHARACTERISTIC
/begin CHARACTERISTIC PtoCtrl_bAcvHndBrkPrkg_P "Hand Brake Parking Active Parameter" VALUE 0x40048F98 /* @ECU_Address@PtoCtrl_bAcvHndBrkPrkg_P@ */ Scalar_BOOLEAN 0 EcuIntgdSwGend_CM_boolean 0.0 1.0 /end CHARACTERISTIC
/begin CHARACTERISTIC PtoCtrl_bAcvRemPtoOvs_P "Remote PTO Activation Override Switch Parameter" VALUE 0x40048FA8 /* @ECU_Address@PtoCtrl_bAcvRemPtoOvs_P@ */ Scalar_BOOLEAN 0 EcuIntgdSwGend_CM_boolean 0.0 1.0 /end CHARACTERISTIC
/begin CHARACTERISTIC PtoCtrl_bAcvRemPtoOvv_P "Remote PTO Activation Override Value Parameter" VALUE 0x40048FAC /* @ECU_Address@PtoCtrl_bAcvRemPtoOvv_P@ */ Scalar_BOOLEAN 0 EcuIntgdSwGend_CM_boolean 0.0 1.0 /end CHARACTERISTIC
/begin CHARACTERISTIC PtoCtrl_bAcvTrsmCurrentGearForRemPto_P "Transmission Current Gear Neutral For Remote PTO" VALUE 0x40048FB0 /* @ECU_Address@PtoCtrl_bAcvTrsmCurrentGearForRemPto_P@ */ Scalar_BOOLEAN 0 EcuIntgdSwGend_CM_boolean 0.0 1.0 /end CHARACTERISTIC
/begin CHARACTERISTIC PtoCtrl_bAcvTrsmCurrentGear_P "Transmission Current Gear - Override Switch" VALUE 0x40048FB4 /* @ECU_Address@PtoCtrl_bAcvTrsmCurrentGear_P@ */ Scalar_BOOLEAN 0 EcuIntgdSwGend_CM_boolean 0.0 1.0 /end CHARACTERISTIC
/begin CHARACTERISTIC RPG_FFLeakgSetPointOvs_P "FeedForward Leakage Set Point Override Switch Parameter" VALUE 0x40049620 /* @ECU_Address@RPG_FFLeakgSetPointOvs_P@ */ Scalar_BOOLEAN 0 EcuIntgdSwGend_CM_boolean 0.0 1.0 /end CHARACTERISTIC
/begin CHARACTERISTIC RPG_PIDCoeffDOvs_P "Rail Pressure Controller D Coefficient - Override Switch Parameter" VALUE 0x400497A8 /* @ECU_Address@RPG_PIDCoeffDOvs_P@ */ Scalar_BOOLEAN 0 EcuIntgdSwGend_CM_boolean 0.0 1.0 /end CHARACTERISTIC
/begin CHARACTERISTIC RPG_PIDCoeffFiltOvs_P "Rail Pressure Controller D Filter Coefficient - Override Switch Parameter" VALUE 0x400497B0 /* @ECU_Address@RPG_PIDCoeffFiltOvs_P@ */ Scalar_BOOLEAN 0 EcuIntgdSwGend_CM_boolean 0.0 1.0 /end CHARACTERISTIC
/begin CHARACTERISTIC RPG_PIDCoeffIOvs_P "Rail Pressure Controller I Coefficient - Override Switch Parameter" VALUE 0x400497B8 /* @ECU_Address@RPG_PIDCoeffIOvs_P@ */ Scalar_BOOLEAN 0 EcuIntgdSwGend_CM_boolean 0.0 1.0 /end CHARACTERISTIC
/begin CHARACTERISTIC RPG_PIDCoeffPOvs_P "Rail Pressure Controller P Coefficient - Override Switch Parameter" VALUE 0x400497C0 /* @ECU_Address@RPG_PIDCoeffPOvs_P@ */ Scalar_BOOLEAN 0 EcuIntgdSwGend_CM_boolean 0.0 1.0 /end CHARACTERISTIC
/begin CHARACTERISTIC RPG_PRailRefForPCVOvs_P "Reference Rail Pressure for Pressure Control Valve 1 - Override Switch Parameter" VALUE 0x40049968 /* @ECU_Address@RPG_PRailRefForPCVOvs_P@ */ Scalar_BOOLEAN 0 EcuIntgdSwGend_CM_boolean 0.0 1.0 /end CHARACTERISTIC
/begin CHARACTERISTIC RPG_PRailRefNotCorrdOvs_P "Reference Rail Pressure is Not Corrected - Override Switch Parameter" VALUE 0x40049978 /* @ECU_Address@RPG_PRailRefNotCorrdOvs_P@ */ Scalar_BOOLEAN 0 EcuIntgdSwGend_CM_boolean 0.0 1.0 /end CHARACTERISTIC
/begin CHARACTERISTIC RPG_PercgVCVReqOvs_P "FMU Valve 1 Percentage Request - Override Switch Parameter" VALUE 0x4004A424 /* @ECU_Address@RPG_PercgVCVReqOvs_P@ */ Scalar_BOOLEAN 0 EcuIntgdSwGend_CM_boolean 0.0 1.0 /end CHARACTERISTIC
/begin CHARACTERISTIC RPG_bAcvTCorrForPRail_P "Temperature Correction is Active for Rail Pressure Parameter" VALUE 0x4004B030 /* @ECU_Address@RPG_bAcvTCorrForPRail_P@ */ Scalar_BOOLEAN 0 EcuIntgdSwGend_CM_boolean 0.0 1.0 /end CHARACTERISTIC
/begin CHARACTERISTIC SC_StUsrForAllwblCrnkg_P "User State Parameter of Allowable Cranking Time" VALUE 0x4004B060 /* @ECU_Address@SC_StUsrForAllwblCrnkg_P@ */ Scalar_BOOLEAN 0 EcuIntgdSwGend_CM_boolean 0.0 1.0 /end CHARACTERISTIC
/begin CHARACTERISTIC SC_TiMaxAllwblCrnkgOvs_P "Maximum Allowable Cranking Time Calculation Map - Override Switch Parameter" VALUE 0x4004B0A0 /* @ECU_Address@SC_TiMaxAllwblCrnkgOvs_P@ */ Scalar_BOOLEAN 0 EcuIntgdSwGend_CM_boolean 0.0 1.0 /end CHARACTERISTIC
/begin CHARACTERISTIC SC_bAcvDisStrtOvs_P "Starter is Disabled Flag - Override Switch Parameter" VALUE 0x4004B0BC /* @ECU_Address@SC_bAcvDisStrtOvs_P@ */ Scalar_BOOLEAN 0 EcuIntgdSwGend_CM_boolean 0.0 1.0 /end CHARACTERISTIC
/begin CHARACTERISTIC SC_bAcvDisStrtOvv_P "Starter is Disabled Flag - Override Value Parameter" VALUE 0x4004B0C0 /* @ECU_Address@SC_bAcvDisStrtOvv_P@ */ Scalar_BOOLEAN 0 EcuIntgdSwGend_CM_boolean 0.0 1.0 /end CHARACTERISTIC
/begin CHARACTERISTIC SC_bAcvStrtrLockOvs_P "Starter Locking is Active Flag - Override Switch Parameter" VALUE 0x4004B0C4 /* @ECU_Address@SC_bAcvStrtrLockOvs_P@ */ Scalar_BOOLEAN 0 EcuIntgdSwGend_CM_boolean 0.0 1.0 /end CHARACTERISTIC
/begin CHARACTERISTIC SC_bAcvStrtrLockOvv_P "Starter Locking is Active Flag - Override Value Parameter" VALUE 0x4004B0C8 /* @ECU_Address@SC_bAcvStrtrLockOvv_P@ */ Scalar_BOOLEAN 0 EcuIntgdSwGend_CM_boolean 0.0 1.0 /end CHARACTERISTIC
/begin CHARACTERISTIC SC_bAcvStrtrOvs_P "Starter is Active Flag - Override Switch Parameter" VALUE 0x4004B0D4 /* @ECU_Address@SC_bAcvStrtrOvs_P@ */ Scalar_BOOLEAN 0 EcuIntgdSwGend_CM_boolean 0.0 1.0 /end CHARACTERISTIC
/begin CHARACTERISTIC SC_bAcvStrtrOvv_P "Starter is Active Flag - Override Value Parameter" VALUE 0x4004B0D8 /* @ECU_Address@SC_bAcvStrtrOvv_P@ */ Scalar_BOOLEAN 0 EcuIntgdSwGend_CM_boolean 0.0 1.0 /end CHARACTERISTIC
/begin CHARACTERISTIC SC_bInhEngStrtOvs_P "Inhibition Engine Start - Override Switch" VALUE 0x4004B0E4 /* @ECU_Address@SC_bInhEngStrtOvs_P@ */ Scalar_BOOLEAN 0 EcuIntgdSwGend_CM_boolean 0.0 1.0 /end CHARACTERISTIC
/begin CHARACTERISTIC SC_bInhEngStrtOvv_P "Inhibition Engine Start - Override Value" VALUE 0x4004B0E8 /* @ECU_Address@SC_bInhEngStrtOvv_P@ */ Scalar_BOOLEAN 0 EcuIntgdSwGend_CM_boolean 0.0 1.0 /end CHARACTERISTIC
/begin CHARACTERISTIC SpdLimr_ActvCanOrDigInEva_P "Activaiton for Can or Digital Input Evaluation Parameter" VALUE 0x4004B0EC /* @ECU_Address@SpdLimr_ActvCanOrDigInEva_P@ */ Scalar_BOOLEAN 0 EcuIntgdSwGend_CM_boolean 0.0 1.0 /end CHARACTERISTIC
/begin CHARACTERISTIC SpdLimr_ErrVehVEva_P "Error Vehicle Speed Evaluation Parameter" VALUE 0x4004B258 /* @ECU_Address@SpdLimr_ErrVehVEva_P@ */ Scalar_BOOLEAN 0 EcuIntgdSwGend_CM_boolean 0.0 1.0 /end CHARACTERISTIC
/begin CHARACTERISTIC TL_TqLimdForNExhTrbChrgOvs_P "Limited Torque Value of Turbo Charger Speed - Override Switch" VALUE 0x4004C244 /* @ECU_Address@TL_TqLimdForNExhTrbChrgOvs_P@ */ Scalar_BOOLEAN 0 EcuIntgdSwGend_CM_boolean 0.0 1.0 /end CHARACTERISTIC
/begin CHARACTERISTIC TL_TqLimdForPAirAmbOvs_P "Limited Torque Value of Ambient Air Pressure - Override Switch" VALUE 0x4004C24C /* @ECU_Address@TL_TqLimdForPAirAmbOvs_P@ */ Scalar_BOOLEAN 0 EcuIntgdSwGend_CM_boolean 0.0 1.0 /end CHARACTERISTIC
/begin CHARACTERISTIC TL_TqLimdForPAirBoostOvs_P "Limited Torque Value of Air Boost Pressure - Override Switch" VALUE 0x4004C254 /* @ECU_Address@TL_TqLimdForPAirBoostOvs_P@ */ Scalar_BOOLEAN 0 EcuIntgdSwGend_CM_boolean 0.0 1.0 /end CHARACTERISTIC
/begin CHARACTERISTIC TL_TqLimdForSurgeOvs_P "Limited Torque Value of Surge Protection - Override Switch" VALUE 0x4004C25C /* @ECU_Address@TL_TqLimdForSurgeOvs_P@ */ Scalar_BOOLEAN 0 EcuIntgdSwGend_CM_boolean 0.0 1.0 /end CHARACTERISTIC
/begin CHARACTERISTIC TL_TqLimdForTAirOvs_P "Limited Torque Value of Air Boost Temperature - Override Switch" VALUE 0x4004C264 /* @ECU_Address@TL_TqLimdForTAirOvs_P@ */ Scalar_BOOLEAN 0 EcuIntgdSwGend_CM_boolean 0.0 1.0 /end CHARACTERISTIC
/begin CHARACTERISTIC TL_TqLimdForTCooltOvs_P "Limited Torque Value of Coolant High Temperature - Override Switch" VALUE 0x4004C26C /* @ECU_Address@TL_TqLimdForTCooltOvs_P@ */ Scalar_BOOLEAN 0 EcuIntgdSwGend_CM_boolean 0.0 1.0 /end CHARACTERISTIC
/begin CHARACTERISTIC TL_TqLimdForTFuOvs_P "Limited Torque Value of Fuel Temperature - Override Switch" VALUE 0x4004C274 /* @ECU_Address@TL_TqLimdForTFuOvs_P@ */ Scalar_BOOLEAN 0 EcuIntgdSwGend_CM_boolean 0.0 1.0 /end CHARACTERISTIC
/begin CHARACTERISTIC TL_TqLimdForTOilOvs_P "Limited Torque Value of Oil Temperature - Override Switch" VALUE 0x4004C27C /* @ECU_Address@TL_TqLimdForTOilOvs_P@ */ Scalar_BOOLEAN 0 EcuIntgdSwGend_CM_boolean 0.0 1.0 /end CHARACTERISTIC
/begin CHARACTERISTIC TL_TqMapLimdEngProtnOvs_P "Map Based Torque Limitation - Override Switch" VALUE 0x4004C2E4 /* @ECU_Address@TL_TqMapLimdEngProtnOvs_P@ */ Scalar_BOOLEAN 0 EcuIntgdSwGend_CM_boolean 0.0 1.0 /end CHARACTERISTIC
/begin CHARACTERISTIC TL_bDeacvRateLimOvs_P "Dynamic Rate Limiter Activation - Override Switch" VALUE 0x4004C2F4 /* @ECU_Address@TL_bDeacvRateLimOvs_P@ */ Scalar_BOOLEAN 0 EcuIntgdSwGend_CM_boolean 0.0 1.0 /end CHARACTERISTIC
/begin CHARACTERISTIC TrC_MMaiFuQntyOvs_P "Main Fuel Quantity - Override Switch" VALUE 0x4004E864 /* @ECU_Address@TrC_MMaiFuQntyOvs_P@ */ Scalar_BOOLEAN 0 EcuIntgdSwGend_CM_boolean 0.0 1.0 /end CHARACTERISTIC
/begin CHARACTERISTIC TrC_MPltFuQntyOvs_P "Pilot Fuel Quantity - Override Switch" VALUE 0x4004F12C /* @ECU_Address@TrC_MPltFuQntyOvs_P@ */ Scalar_BOOLEAN 0 EcuIntgdSwGend_CM_boolean 0.0 1.0 /end CHARACTERISTIC
/begin CHARACTERISTIC TrC_SmokeLimOvs_P "Smoke Limitation Activation - Override Switch" VALUE 0x400506E0 /* @ECU_Address@TrC_SmokeLimOvs_P@ */ Scalar_BOOLEAN 0 EcuIntgdSwGend_CM_boolean 0.0 1.0 /end CHARACTERISTIC
/begin CHARACTERISTIC WgC_DutyVlvOvs_P "Duty Valve - Override Switch Parameter" VALUE 0x40051460 /* @ECU_Address@WgC_DutyVlvOvs_P@ */ Scalar_BOOLEAN 0 EcuIntgdSwGend_CM_boolean 0.0 1.0 /end CHARACTERISTIC
/begin MEASUREMENT WgC_DutyWgtVlvFF "Feedforward Wastegate Duty Valve" FLOAT32_IEEE EcuIntgdSwGend_CM_single__ 0 0 0.0 100.0 ECU_ADDRESS 0x4000E430 /* @ECU_Address@WgC_DutyWgtVlvFF@ */ /end MEASUREMENT
/begin MEASUREMENT WgC_DutyWgtVlv "Wastegate Duty Valve" FLOAT32_IEEE EcuIntgdSwGend_CM_single__ 0 0 0.0 100.0 ECU_ADDRESS 0x4000DC7C /* @ECU_Address@WgC_DutyWgtVlv@ */ /end MEASUREMENT
/begin MEASUREMENT WgC_DutyWgtVlvBefSat "Wastegate Duty Valve Before Saturation" FLOAT32_IEEE EcuIntgdSwGend_CM_single__ 0 0 0.0 100.0 ECU_ADDRESS 0x4000E498 /* @ECU_Address@WgC_DutyWgtVlvBefSat@ */ /end MEASUREMENT
/begin MEASUREMENT WgC_LimSigUp "Duty Valve Saturation Up Limit Signal" FLOAT32_IEEE EcuIntgdSwGend_CM_single__ 0 0 0.0 100.0 ECU_ADDRESS 0x4000D888 /* @ECU_Address@WgC_LimSigUp@ */ /end MEASUREMENT
/begin MEASUREMENT WgC_LimSigLo "Duty Valve Saturation Low Limit Signal" FLOAT32_IEEE EcuIntgdSwGend_CM_single__ 0 0 0.0 100.0 ECU_ADDRESS 0x4000D854 /* @ECU_Address@WgC_LimSigLo@ */ /end MEASUREMENT
/begin MEASUREMENT WgC_DutyVlvReq "Duty Valve Request" FLOAT32_IEEE EcuIntgdSwGend_CM_single__ 0 0 0.0 100.0 ECU_ADDRESS 0x4000E034 /* @ECU_Address@WgC_DutyVlvReq@ */ /end MEASUREMENT
/begin MEASUREMENT TL_TqLimdForTCoolt "Limited Torque Value of Coolant High Temperature" FLOAT32_IEEE EcuIntgdSwGend_CM_single_N_m 0 0 0.0 10000.0 ECU_ADDRESS 0x4000DDCC /* @ECU_Address@TL_TqLimdForTCoolt@ */ /end MEASUREMENT
/begin MEASUREMENT TL_TqLimdForTFu "Limited Torque Value of Fuel Temperature" FLOAT32_IEEE EcuIntgdSwGend_CM_single_N_m 0 0 0.0 10000.0 ECU_ADDRESS 0x4000E3FC /* @ECU_Address@TL_TqLimdForTFu@ */ /end MEASUREMENT
/begin MEASUREMENT TL_TqLimdForNExhTrbChrg "Limited Torque Value of Turbo Charger Speed" FLOAT32_IEEE EcuIntgdSwGend_CM_single_N_m 0 0 0.0 10000.0 ECU_ADDRESS 0x4000DC30 /* @ECU_Address@TL_TqLimdForNExhTrbChrg@ */ /end MEASUREMENT
/begin MEASUREMENT TL_TqLimdForPAirBoost "Limited Torque Value of Air Boost Pressure" FLOAT32_IEEE EcuIntgdSwGend_CM_single_N_m 0 0 0.0 10000.0 ECU_ADDRESS 0x4000E690 /* @ECU_Address@TL_TqLimdForPAirBoost@ */ /end MEASUREMENT
/begin MEASUREMENT TL_TqLimdForTAir "Limited Torque Value of Air Boost Temperature" FLOAT32_IEEE EcuIntgdSwGend_CM_single_N_m 0 0 0.0 10000.0 ECU_ADDRESS 0x4000DEE8 /* @ECU_Address@TL_TqLimdForTAir@ */ /end MEASUREMENT
/begin MEASUREMENT TL_TqLimdForPAirAmb "Limited Torque Value of Ambient Air Pressure" FLOAT32_IEEE EcuIntgdSwGend_CM_single_N_m 0 0 0.0 10000.0 ECU_ADDRESS 0x4000D9D8 /* @ECU_Address@TL_TqLimdForPAirAmb@ */ /end MEASUREMENT
/begin MEASUREMENT TL_TqLimdForTOil "Limited Torque Value of Oil Temperature" FLOAT32_IEEE EcuIntgdSwGend_CM_single_N_m 0 0 0.0 10000.0 ECU_ADDRESS 0x4000E73C /* @ECU_Address@TL_TqLimdForTOil@ */ /end MEASUREMENT
/begin MEASUREMENT TL_TqLimdForSurge "Limited Torque Value of Surge Protection" FLOAT32_IEEE EcuIntgdSwGend_CM_single_N_m 0 0 0.0 10000.0 ECU_ADDRESS 0x4000DDD4 /* @ECU_Address@TL_TqLimdForSurge@ */ /end MEASUREMENT
/begin MEASUREMENT TL_TqMapLimdEngProtn "Map Based Torque Limitation Value" FLOAT32_IEEE EcuIntgdSwGend_CM_single_N_m 0 0 0.0 10000.0 ECU_ADDRESS 0x4000DB9C /* @ECU_Address@TL_TqMapLimdEngProtn@ */ /end MEASUREMENT
/begin MEASUREMENT TL_TqLimnRednLvl1 "Torque Limitation Reduction Level 1 " FLOAT32_IEEE EcuIntgdSwGend_CM_single_N_m 0 0 0.0 10000.0 ECU_ADDRESS 0x4000DA90 /* @ECU_Address@TL_TqLimnRednLvl1@ */ /end MEASUREMENT
/begin MEASUREMENT TL_TqLimnRednLvl2 "Torque Limitation Reduction Level 2" FLOAT32_IEEE EcuIntgdSwGend_CM_single_N_m 0 0 0.0 10000.0 ECU_ADDRESS 0x4000E56C /* @ECU_Address@TL_TqLimnRednLvl2@ */ /end MEASUREMENT
/begin MEASUREMENT TL_TqLimpMapOut "Limited Torque According to Limp Mode" FLOAT32_IEEE EcuIntgdSwGend_CM_single_N_m 0 0 0.0 10000.0 ECU_ADDRESS 0x4000DC50 /* @ECU_Address@TL_TqLimpMapOut@ */ /end MEASUREMENT
/begin MEASUREMENT TL_TqLimnLimp "Limp Mode Torque Limitation" FLOAT32_IEEE EcuIntgdSwGend_CM_single_N_m 0 0 0.0 10000.0 ECU_ADDRESS 0x4000D754 /* @ECU_Address@TL_TqLimnLimp@ */ /end MEASUREMENT
/begin MEASUREMENT TL_DynRateLimr "Dynamic Rate Limiter Out Signal" FLOAT32_IEEE EcuIntgdSwGend_CM_single_N_m 0 0 0.0 10000.0 ECU_ADDRESS 0x4000DBC4 /* @ECU_Address@TL_DynRateLimr@ */ /end MEASUREMENT
/begin MEASUREMENT TL_TqIndcdLimdPre "Indicated Pre Limited Torque Value" FLOAT32_IEEE EcuIntgdSwGend_CM_single_N_m 0 0 0.0 10000.0 ECU_ADDRESS 0x4000E068 /* @ECU_Address@TL_TqIndcdLimdPre@ */ /end MEASUREMENT
/begin MEASUREMENT TL_TqIndcdLimdPre2 "Indicated Pre Limited Torque Value 2" FLOAT32_IEEE EcuIntgdSwGend_CM_single_N_m 0 0 0.0 10000.0 ECU_ADDRESS 0x4000DDD8 /* @ECU_Address@TL_TqIndcdLimdPre2@ */ /end MEASUREMENT
/begin MEASUREMENT TL_TqIndcdLimdSwtOut "Indicated Torque Limitation Switch Out" FLOAT32_IEEE EcuIntgdSwGend_CM_single_N_m 0 0 0.0 10000.0 ECU_ADDRESS 0x4000DAE4 /* @ECU_Address@TL_TqIndcdLimdSwtOut@ */ /end MEASUREMENT
/begin MEASUREMENT TL_TqIndcdLimdSwtOut2 "Indicated Limited Torque Value After Limp Activation Switch Out" FLOAT32_IEEE EcuIntgdSwGend_CM_single_N_m 0 0 0.0 10000.0 ECU_ADDRESS 0x4000DA20 /* @ECU_Address@TL_TqIndcdLimdSwtOut2@ */ /end MEASUREMENT
/begin MEASUREMENT TL_TqIndcdLimd "Indicated Limited Torque Value" FLOAT32_IEEE EcuIntgdSwGend_CM_single_N_m 0 0 0.0 100000.0 ECU_ADDRESS 0x4000DD08 /* @ECU_Address@TL_TqIndcdLimd@ */ /end MEASUREMENT
/begin MEASUREMENT TrC_MMaiFuQntyFromMap1 "Main Quantity Map 1 Out" FLOAT32_IEEE EcuIntgdSwGend_CM_single_mm_3_stk 0 0 0.0 1000.0 ECU_ADDRESS 0x4000E724 /* @ECU_Address@TrC_MMaiFuQntyFromMap1@ */ /end MEASUREMENT
/begin MEASUREMENT TrC_MMaiFuQntyFromMap2 "Main Quantity Map 2 Out" FLOAT32_IEEE EcuIntgdSwGend_CM_single_mm_3_stk 0 0 0.0 1000.0 ECU_ADDRESS 0x4000E728 /* @ECU_Address@TrC_MMaiFuQntyFromMap2@ */ /end MEASUREMENT
/begin MEASUREMENT TrC_MMaiFuQnty1To2Intp "Main Fuel Quantity Value" FLOAT32_IEEE EcuIntgdSwGend_CM_single_mm_3_stk 0 0 0.0 10000.0 ECU_ADDRESS 0x4000D708 /* @ECU_Address@TrC_MMaiFuQnty1To2Intp@ */ /end MEASUREMENT
/begin MEASUREMENT TrC_MMaiFuQntyFromMap3 "Main Quantity Map 3 Out" FLOAT32_IEEE EcuIntgdSwGend_CM_single_mm_3_stk 0 0 0.0 1000.0 ECU_ADDRESS 0x4000DB50 /* @ECU_Address@TrC_MMaiFuQntyFromMap3@ */ /end MEASUREMENT
/begin MEASUREMENT TrC_MMaiFuQnty2To3Intp "Main Quantity Map 1" FLOAT32_IEEE EcuIntgdSwGend_CM_single_mm_3_stk 0 0 0.0 10000.0 ECU_ADDRESS 0x4000E0CC /* @ECU_Address@TrC_MMaiFuQnty2To3Intp@ */ /end MEASUREMENT
/begin MEASUREMENT TrC_MMaiFuQntyPre "Pre Main Fuel Quantity " FLOAT32_IEEE EcuIntgdSwGend_CM_single_mm_3_stk 0 0 0.0 1000.0 ECU_ADDRESS 0x4000D6E0 /* @ECU_Address@TrC_MMaiFuQntyPre@ */ /end MEASUREMENT
/begin MEASUREMENT TrC_MMaiFuQntyCorrTCoolt "" FLOAT32_IEEE EcuIntgdSwGend_CM_single_mm_3_stk 0 0 -500.0 1000.0 ECU_ADDRESS 0x4000D738 /* @ECU_Address@TrC_MMaiFuQntyCorrTCoolt@ */ /end MEASUREMENT
/begin MEASUREMENT TrC_MMaiFuQntyCorrPAmbAir "Main Fuel Quantity Ambient Pressure Correction" FLOAT32_IEEE EcuIntgdSwGend_CM_single_mm_3_stk 0 0 0.0 1000.0 ECU_ADDRESS 0x4000E46C /* @ECU_Address@TrC_MMaiFuQntyCorrPAmbAir@ */ /end MEASUREMENT
/begin MEASUREMENT TrC_MMaiFuQntyCorrTAmbAir "" FLOAT32_IEEE EcuIntgdSwGend_CM_single_mm_3_stk 0 0 -500.0 1000.0 ECU_ADDRESS 0x4000E314 /* @ECU_Address@TrC_MMaiFuQntyCorrTAmbAir@ */ /end MEASUREMENT
/begin MEASUREMENT TrC_MMaiFuQntyCorrTOil "" FLOAT32_IEEE EcuIntgdSwGend_CM_single_mm_3_stk 0 0 -500.0 1000.0 ECU_ADDRESS 0x4000D714 /* @ECU_Address@TrC_MMaiFuQntyCorrTOil@ */ /end MEASUREMENT
/begin MEASUREMENT TrC_MMaiFuQntyCorrTAirBoost "" FLOAT32_IEEE EcuIntgdSwGend_CM_single_mm_3_stk 0 0 -500.0 1000.0 ECU_ADDRESS 0x4000E23C /* @ECU_Address@TrC_MMaiFuQntyCorrTAirBoost@ */ /end MEASUREMENT
/begin MEASUREMENT TrC_MMaiFuQntyCorrUClmp30 "" FLOAT32_IEEE EcuIntgdSwGend_CM_single_mm_3_stk 0 0 -500.0 1000.0 ECU_ADDRESS 0x4000DD70 /* @ECU_Address@TrC_MMaiFuQntyCorrUClmp30@ */ /end MEASUREMENT
/begin MEASUREMENT TrC_MMaiFuQntyCorrd "Corrected Main Fuel Quantity" FLOAT32_IEEE EcuIntgdSwGend_CM_single_mm_3_stk 0 0 0.0 1000.0 ECU_ADDRESS 0x4000E798 /* @ECU_Address@TrC_MMaiFuQntyCorrd@ */ /end MEASUREMENT
/begin MEASUREMENT TrC_MAirPerStr "Limited Main Quantity Activation - Override Switch" FLOAT32_IEEE EcuIntgdSwGend_CM_single_mg_stk 0 0 0.0 1000.0 ECU_ADDRESS 0x4000E404 /* @ECU_Address@TrC_MAirPerStr@ */ /end MEASUREMENT
/begin MEASUREMENT TrC_MPltFuQntyFromMap1 "Pilot Quantity Map 1 Out" FLOAT32_IEEE EcuIntgdSwGend_CM_single_mm_3_stk 0 0 0.0 1000.0 ECU_ADDRESS 0x4000E510 /* @ECU_Address@TrC_MPltFuQntyFromMap1@ */ /end MEASUREMENT
/begin MEASUREMENT TrC_MPltFuQntyFromMap2 "Pilot Quantity Map 2 Out" FLOAT32_IEEE EcuIntgdSwGend_CM_single_mm_3_stk 0 0 0.0 1000.0 ECU_ADDRESS 0x4000DA74 /* @ECU_Address@TrC_MPltFuQntyFromMap2@ */ /end MEASUREMENT
/begin MEASUREMENT TrC_MPltFuQnty1To2Intp "Pilot Quantity Value Interpolation Between Map 1 and 2" FLOAT32_IEEE EcuIntgdSwGend_CM_single_mm_3_stk 0 0 0.0 10000.0 ECU_ADDRESS 0x4000DB64 /* @ECU_Address@TrC_MPltFuQnty1To2Intp@ */ /end MEASUREMENT
/begin MEASUREMENT TrC_MPltFuQntyFromMap3 "Pilot Quantity Map 3 Out" FLOAT32_IEEE EcuIntgdSwGend_CM_single_mm_3_stk 0 0 0.0 1000.0 ECU_ADDRESS 0x4000E518 /* @ECU_Address@TrC_MPltFuQntyFromMap3@ */ /end MEASUREMENT
/begin MEASUREMENT TrC_MPltFuQnty2To3Intp "Pilot Quantity Value Interpolation Between Map 2 and 3" FLOAT32_IEEE EcuIntgdSwGend_CM_single_mm_3_stk 0 0 0.0 10000.0 ECU_ADDRESS 0x4000E378 /* @ECU_Address@TrC_MPltFuQnty2To3Intp@ */ /end MEASUREMENT
/begin MEASUREMENT TrC_MPltFuQnty "Pilot Fuel Quantity" FLOAT32_IEEE EcuIntgdSwGend_CM_single_mm_3_stk 0 0 0.0 1000.0 ECU_ADDRESS 0x4000E0C4 /* @ECU_Address@TrC_MPltFuQnty@ */ /end MEASUREMENT
/begin MEASUREMENT TrC_MPltFuQntyCorrTCoolt "" FLOAT32_IEEE EcuIntgdSwGend_CM_single_mm_3_stk 0 0 -500.0 1000.0 ECU_ADDRESS 0x4000E50C /* @ECU_Address@TrC_MPltFuQntyCorrTCoolt@ */ /end MEASUREMENT
/begin MEASUREMENT TrC_MPltFuQntyCorrPAmbAir "Pilot Fuel Quantity Mass Correction wrt Ambient Air Pressure" FLOAT32_IEEE EcuIntgdSwGend_CM_single_mm_3_stk 0 0 0.0 1000.0 ECU_ADDRESS 0x4000E1A0 /* @ECU_Address@TrC_MPltFuQntyCorrPAmbAir@ */ /end MEASUREMENT
/begin MEASUREMENT TrC_MPltFuQntyCorrTAmbAir "" FLOAT32_IEEE EcuIntgdSwGend_CM_single_mm_3_stk 0 0 -500.0 1000.0 ECU_ADDRESS 0x4000E084 /* @ECU_Address@TrC_MPltFuQntyCorrTAmbAir@ */ /end MEASUREMENT
/begin MEASUREMENT TrC_MPltFuQntyCorrTOil "" FLOAT32_IEEE EcuIntgdSwGend_CM_single_mm_3_stk 0 0 -500.0 1000.0 ECU_ADDRESS 0x4000E384 /* @ECU_Address@TrC_MPltFuQntyCorrTOil@ */ /end MEASUREMENT
/begin MEASUREMENT TrC_MPltFuQntyCorrTAirBoost "" FLOAT32_IEEE EcuIntgdSwGend_CM_single_mm_3_stk 0 0 -500.0 1000.0 ECU_ADDRESS 0x4000DFF0 /* @ECU_Address@TrC_MPltFuQntyCorrTAirBoost@ */ /end MEASUREMENT
/begin MEASUREMENT TrC_MPltFuQntyCorrUClmp30 "" FLOAT32_IEEE EcuIntgdSwGend_CM_single_mm_3_stk 0 0 -500.0 1000.0 ECU_ADDRESS 0x4000DDA4 /* @ECU_Address@TrC_MPltFuQntyCorrUClmp30@ */ /end MEASUREMENT
/begin MEASUREMENT TrC_MPltFuQntyCorr "Pilot Fuel Quantity Correction Signal" FLOAT32_IEEE EcuIntgdSwGend_CM_single_mm_3_stk 0 0 0.0 1000.0 ECU_ADDRESS 0x4000D760 /* @ECU_Address@TrC_MPltFuQntyCorr@ */ /end MEASUREMENT
/begin MEASUREMENT TrC_RatAirFuSmokLim "Air Fuel Rate Smoke Limitation" FLOAT32_IEEE EcuIntgdSwGend_CM_single 0 0 0.0 100.0 ECU_ADDRESS 0x4000DCEC /* @ECU_Address@TrC_RatAirFuSmokLim@ */ /end MEASUREMENT
/begin MEASUREMENT TrC_MMaiFuQntySmokLimd "Smoke Limited Main Fuel Quantity" FLOAT32_IEEE EcuIntgdSwGend_CM_single_mm_3_stk 0 0 0.0 1000.0 ECU_ADDRESS 0x4000DD0C /* @ECU_Address@TrC_MMaiFuQntySmokLimd@ */ /end MEASUREMENT
/begin MEASUREMENT TrC_MMaiFuQntyLimd "Limited Main Fuel Quantity" FLOAT32_IEEE EcuIntgdSwGend_CM_single_mm_3_stk 0 0 0.0 1000.0 ECU_ADDRESS 0x4000E434 /* @ECU_Address@TrC_MMaiFuQntyLimd@ */ /end MEASUREMENT
/begin MEASUREMENT TrC_ActEngTq "Actual Engine Torque" FLOAT32_IEEE EcuIntgdSwGend_CM_single_N_m 0 0 0.0 2000.0 ECU_ADDRESS 0x4000D9A4 /* @ECU_Address@TrC_ActEngTq@ */ /end MEASUREMENT
/begin MEASUREMENT TrC_ActEngPercTq "Actual Engine - Percent Torque" FLOAT32_IEEE EcuIntgdSwGend_CM_single__ 0 0 0.0 125.0 ECU_ADDRESS 0x4000DA2C /* @ECU_Address@TrC_ActEngPercTq@ */ /end MEASUREMENT
/begin MEASUREMENT SC_TiMaxAllwblCrnkg "Timer Value for Maximum Allowable Cranking Time" FLOAT32_IEEE EcuIntgdSwGend_CM_single_ms 0 0 0.0 50000.0 ECU_ADDRESS 0x4000E478 /* @ECU_Address@SC_TiMaxAllwblCrnkg@ */ /end MEASUREMENT
/begin MEASUREMENT SpdLimr_ErrVehVRef "Vehicle Speed Reference Error" FLOAT32_IEEE EcuIntgdSwGend_CM_single_km_h 0 0 -200.0 200.0 ECU_ADDRESS 0x4000E138 /* @ECU_Address@SpdLimr_ErrVehVRef@ */ /end MEASUREMENT
/begin MEASUREMENT SpdLimr_EngBrkLvl "Engine Brake Level via Speed Limiter" FLOAT32_IEEE EcuIntgdSwGend_CM_single 0 0 0.0 2.0 ECU_ADDRESS 0x4000DB34 /* @ECU_Address@SpdLimr_EngBrkLvl@ */ /end MEASUREMENT
/begin MEASUREMENT SpdLimr_SpdLimrTq "Speed Limiter Torque" FLOAT32_IEEE EcuIntgdSwGend_CM_single_N_m 0 0 0.0 10000.0 ECU_ADDRESS 0x4000E5CC /* @ECU_Address@SpdLimr_SpdLimrTq@ */ /end MEASUREMENT
/begin MEASUREMENT SpdLimr_TarSpd "Speed Limiter Target Speed" FLOAT32_IEEE EcuIntgdSwGend_CM_single_km_h 0 0 0.0 300.0 ECU_ADDRESS 0x4000E218 /* @ECU_Address@SpdLimr_TarSpd@ */ /end MEASUREMENT
/begin MEASUREMENT SpdLimr_ActvSpdLimr "Speed Limiter Activation" FLOAT32_IEEE EcuIntgdSwGend_CM_single 0 0 0.0 3.0 ECU_ADDRESS 0x4000D8FC /* @ECU_Address@SpdLimr_ActvSpdLimr@ */ /end MEASUREMENT
/begin MEASUREMENT SpdLimr_TarSpdPre "Speed Limiter Target Speed Pre" FLOAT32_IEEE EcuIntgdSwGend_CM_single_km_h 0 0 0.0 300.0 ECU_ADDRESS 0x4000DD54 /* @ECU_Address@SpdLimr_TarSpdPre@ */ /end MEASUREMENT
/begin MEASUREMENT RPG_TCorrForPRail "Rail Pressure Temperature Correction" FLOAT32_IEEE EcuIntgdSwGend_CM_single_bar 0 0 0.0 2500.0 ECU_ADDRESS 0x4000E450 /* @ECU_Address@RPG_TCorrForPRail@ */ /end MEASUREMENT
/begin MEASUREMENT RPG_PRailCorrPAmbAir "Rail Pressure Correction for Ambient Air Pressure" FLOAT32_IEEE EcuIntgdSwGend_CM_single_bar 0 0 0.0 2500.0 ECU_ADDRESS 0x4000E604 /* @ECU_Address@RPG_PRailCorrPAmbAir@ */ /end MEASUREMENT
/begin MEASUREMENT RPG_PRailSetpointCorr "Rail Pressure Set Point Correction" FLOAT32_IEEE EcuIntgdSwGend_CM_single_bar 0 0 0.0 5000.0 ECU_ADDRESS 0x4000E204 /* @ECU_Address@RPG_PRailSetpointCorr@ */ /end MEASUREMENT
/begin MEASUREMENT RPG_PRailRefNotCorrd "Reference Rail Pressure is Not Corrected" FLOAT32_IEEE EcuIntgdSwGend_CM_single_bar 0 0 0.0 10000.0 ECU_ADDRESS 0x4000DB28 /* @ECU_Address@RPG_PRailRefNotCorrd@ */ /end MEASUREMENT
/begin MEASUREMENT RPG_ErrPRail "Rail Pressure Controller Rail Pressure Error" FLOAT32_IEEE EcuIntgdSwGend_CM_single_bar 0 0 -1000.0 1000.0 ECU_ADDRESS 0x4000E2F8 /* @ECU_Address@RPG_ErrPRail@ */ /end MEASUREMENT
/begin MEASUREMENT RPG_CoeffPForPRailCtlMapOut "Rail Pressure Controller P Coefficient Map Out" FLOAT32_IEEE EcuIntgdSwGend_CM_single 0 0 -100000.0 100000.0 ECU_ADDRESS 0x4000DDB0 /* @ECU_Address@RPG_CoeffPForPRailCtlMapOut@ */ /end MEASUREMENT
/begin MEASUREMENT RPG_PIDCoeffP "Rail Pressure Controller P Coefficient" FLOAT32_IEEE EcuIntgdSwGend_CM_single 0 0 -100.0 100.0 ECU_ADDRESS 0x4000D790 /* @ECU_Address@RPG_PIDCoeffP@ */ /end MEASUREMENT
/begin MEASUREMENT RPG_CoeffDForPRailCtlMapOut "Rail Pressure Controller D Coefficient Map Out" FLOAT32_IEEE EcuIntgdSwGend_CM_single 0 0 -100000.0 100000.0 ECU_ADDRESS 0x4000E58C /* @ECU_Address@RPG_CoeffDForPRailCtlMapOut@ */ /end MEASUREMENT
/begin MEASUREMENT RPG_PIDCoeffD "Rail Pressure Controller D Coefficient" FLOAT32_IEEE EcuIntgdSwGend_CM_single 0 0 -100.0 100.0 ECU_ADDRESS 0x4000D774 /* @ECU_Address@RPG_PIDCoeffD@ */ /end MEASUREMENT
/begin MEASUREMENT RPG_CoeffFiltForPRailCtlMapOut "Rail Pressure Controller D Filter Coefficient Map Out" FLOAT32_IEEE EcuIntgdSwGend_CM_single 0 0 -100000.0 100000.0 ECU_ADDRESS 0x4000D75C /* @ECU_Address@RPG_CoeffFiltForPRailCtlMapOut@ */ /end MEASUREMENT
/begin MEASUREMENT RPG_PIDCoeffFilt "Rail Pressure Controller D Filter Coefficient" FLOAT32_IEEE EcuIntgdSwGend_CM_single 0 0 -100.0 100.0 ECU_ADDRESS 0x4000D7E4 /* @ECU_Address@RPG_PIDCoeffFilt@ */ /end MEASUREMENT
/begin MEASUREMENT RPG_PercgVolCtrlVlvFFLeakgMap1 "Percentage Volumetric Control Valve FeedForward Leakage Map 1 Out" FLOAT32_IEEE EcuIntgdSwGend_CM_single__ 0 0 0.0 100.0 ECU_ADDRESS 0x4000D894 /* @ECU_Address@RPG_PercgVolCtrlVlvFFLeakgMap1@ */ /end MEASUREMENT
/begin MEASUREMENT RPG_PercgVolCtrlVlvFFLeakgMap2 "Percentage Volumetric Control Valve FeedForward Leakage Map 2 Out" FLOAT32_IEEE EcuIntgdSwGend_CM_single__ 0 0 0.0 100.0 ECU_ADDRESS 0x4000D898 /* @ECU_Address@RPG_PercgVolCtrlVlvFFLeakgMap2@ */ /end MEASUREMENT
/begin MEASUREMENT RPG_FFLeakgSetPoint1to2Intp "FeedForward Leakage Set Point Interpolation Between Map 2 and 3" FLOAT32_IEEE EcuIntgdSwGend_CM_single__ 0 0 0.0 5000.0 ECU_ADDRESS 0x4000E3C8 /* @ECU_Address@RPG_FFLeakgSetPoint1to2Intp@ */ /end MEASUREMENT
/begin MEASUREMENT RPG_PercgVolCtrlVlvFFLeakgMap3 "Percentage Volumetric Control Valve FeedForward Leakage Map 3 Out" FLOAT32_IEEE EcuIntgdSwGend_CM_single__ 0 0 0.0 100.0 ECU_ADDRESS 0x4000D978 /* @ECU_Address@RPG_PercgVolCtrlVlvFFLeakgMap3@ */ /end MEASUREMENT
/begin MEASUREMENT RPG_FFLeakgSetPoint2to3Intp "FeedForward Leakage Set Point Interpolation Between Map 1 and 2" FLOAT32_IEEE EcuIntgdSwGend_CM_single__ 0 0 0.0 5000.0 ECU_ADDRESS 0x4000DB84 /* @ECU_Address@RPG_FFLeakgSetPoint2to3Intp@ */ /end MEASUREMENT
/begin MEASUREMENT RPG_FFLeakgSetPoint "FeedForward Leakage Set Point" FLOAT32_IEEE EcuIntgdSwGend_CM_single__ 0 0 0.0 5000.0 ECU_ADDRESS 0x4000E738 /* @ECU_Address@RPG_FFLeakgSetPoint@ */ /end MEASUREMENT
/begin MEASUREMENT RPG_PercgVCVReqPreSat "FMU Valve Percentage Request Before Saturation" FLOAT32_IEEE EcuIntgdSwGend_CM_single__ 0 0 0.0 100.0 ECU_ADDRESS 0x4000DC0C /* @ECU_Address@RPG_PercgVCVReqPreSat@ */ /end MEASUREMENT
/begin MEASUREMENT RPG_PercgVCVReq "FMU Valve 1 Percentage Request" FLOAT32_IEEE EcuIntgdSwGend_CM_single__ 0 0 0.0 100.0 ECU_ADDRESS 0x4000E71C /* @ECU_Address@RPG_PercgVCVReq@ */ /end MEASUREMENT
/begin MEASUREMENT RPG_PRailRefForPCV "Reference Rail Pressure for Pressure Control Valve 1" FLOAT32_IEEE EcuIntgdSwGend_CM_single_bar 0 0 0.0 2500.0 ECU_ADDRESS 0x4000DDBC /* @ECU_Address@RPG_PRailRefForPCV@ */ /end MEASUREMENT
/begin MEASUREMENT RPG_CoeffIForPRailCtlMapOut "Rail Pressure Controller I Coefficient Map Out" FLOAT32_IEEE EcuIntgdSwGend_CM_single 0 0 -100000.0 100000.0 ECU_ADDRESS 0x4000E0E8 /* @ECU_Address@RPG_CoeffIForPRailCtlMapOut@ */ /end MEASUREMENT
/begin MEASUREMENT RPG_PIDCoeffI "Rail Pressure Controller I Coefficient" FLOAT32_IEEE EcuIntgdSwGend_CM_single 0 0 -100.0 100.0 ECU_ADDRESS 0x4000DB58 /* @ECU_Address@RPG_PIDCoeffI@ */ /end MEASUREMENT
/begin MEASUREMENT PtoCtrl_NEngTargetSpdRemPto "Remote PTO Engine Target Speed " FLOAT32_IEEE EcuIntgdSwGend_CM_single_rpm 0 0 0.0 2000.0 ECU_ADDRESS 0x4000DC44 /* @ECU_Address@PtoCtrl_NEngTargetSpdRemPto@ */ /end MEASUREMENT
/begin MEASUREMENT PtoCtrl_StTargetSpdForPtoGovr "Target Speed State For Remote PTO" FLOAT32_IEEE EcuIntgdSwGend_CM_single 0 0 1.0 5.0 ECU_ADDRESS 0x4000E40C /* @ECU_Address@PtoCtrl_StTargetSpdForPtoGovr@ */ /end MEASUREMENT
/begin MEASUREMENT PtoCtrl_ErrNEngRef "Engine Reference Error" FLOAT32_IEEE EcuIntgdSwGend_CM_single_rpm 0 0 -100000.0 100000.0 ECU_ADDRESS 0x4000E574 /* @ECU_Address@PtoCtrl_ErrNEngRef@ */ /end MEASUREMENT
/begin MEASUREMENT PtoCtrl_CoeffPMapOut "PID Controller Proportional Map Out For PTO Controller" FLOAT32_IEEE EcuIntgdSwGend_CM_single 0 0 -100000.0 100000.0 ECU_ADDRESS 0x4000DBA4 /* @ECU_Address@PtoCtrl_CoeffPMapOut@ */ /end MEASUREMENT
/begin MEASUREMENT PtoCtrl_PIDCoeffP "PID Proportional Coefficient for PTO Controller" FLOAT32_IEEE EcuIntgdSwGend_CM_single 0 0 -10000.0 10000.0 ECU_ADDRESS 0x4000DC10 /* @ECU_Address@PtoCtrl_PIDCoeffP@ */ /end MEASUREMENT
/begin MEASUREMENT PtoCtrl_CoeffDMapOut "Derivative Coefficient Map Out Signal for PTO Controller" FLOAT32_IEEE EcuIntgdSwGend_CM_single 0 0 -100000.0 100000.0 ECU_ADDRESS 0x4000D940 /* @ECU_Address@PtoCtrl_CoeffDMapOut@ */ /end MEASUREMENT
/begin MEASUREMENT PtoCtrl_PIDCoeffD "PID Derivative Coefficient for PTO Controller" FLOAT32_IEEE EcuIntgdSwGend_CM_single 0 0 -10000.0 10000.0 ECU_ADDRESS 0x4000DBEC /* @ECU_Address@PtoCtrl_PIDCoeffD@ */ /end MEASUREMENT
/begin MEASUREMENT PtoCtrl_CoeffFiltMapOut "Filter Coefficient Map Out  for PTO Controller" FLOAT32_IEEE EcuIntgdSwGend_CM_single 0 0 -100000.0 100000.0 ECU_ADDRESS 0x4000D6FC /* @ECU_Address@PtoCtrl_CoeffFiltMapOut@ */ /end MEASUREMENT
/begin MEASUREMENT PtoCtrl_PIDCoeffFilt "PID Filter Coefficient for PTO Controller" FLOAT32_IEEE EcuIntgdSwGend_CM_single 0 0 -10000.0 10000.0 ECU_ADDRESS 0x4000DE5C /* @ECU_Address@PtoCtrl_PIDCoeffFilt@ */ /end MEASUREMENT
/begin MEASUREMENT PtoCtrl_PIDMax "PID Max Signal" FLOAT32_IEEE EcuIntgdSwGend_CM_single_N_m 0 0 -10000.0 10000.0 ECU_ADDRESS 0x4000E22C /* @ECU_Address@PtoCtrl_PIDMax@ */ /end MEASUREMENT
/begin MEASUREMENT PtoCtrl_PIDMin "PID Min Signal" FLOAT32_IEEE EcuIntgdSwGend_CM_single_N_m 0 0 -10000.0 10000.0 ECU_ADDRESS 0x4000E6B8 /* @ECU_Address@PtoCtrl_PIDMin@ */ /end MEASUREMENT
/begin MEASUREMENT PtoCtrl_PtoCtrlFF "PTO Control PID Feed Forward Signal" FLOAT32_IEEE EcuIntgdSwGend_CM_single_N_m 0 0 -5000.0 5000.0 ECU_ADDRESS 0x4000DCAC /* @ECU_Address@PtoCtrl_PtoCtrlFF@ */ /end MEASUREMENT
/begin MEASUREMENT PtoCtrl_CoeffIMapOut "Integrator Coefficient Map Out for PTO Controller" FLOAT32_IEEE EcuIntgdSwGend_CM_single 0 0 -100000.0 100000.0 ECU_ADDRESS 0x4000E21C /* @ECU_Address@PtoCtrl_CoeffIMapOut@ */ /end MEASUREMENT
/begin MEASUREMENT PtoCtrl_PIDCoeffI "PID Integrator Coefficient for PTO Controller" FLOAT32_IEEE EcuIntgdSwGend_CM_single 0 0 -10000.0 10000.0 ECU_ADDRESS 0x4000DBF8 /* @ECU_Address@PtoCtrl_PIDCoeffI@ */ /end MEASUREMENT
/begin MEASUREMENT PtoCtrl_NEngTargetSpd "Engine Target Speed for Cabin PTO" FLOAT32_IEEE EcuIntgdSwGend_CM_single_rpm 0 0 0.0 2000.0 ECU_ADDRESS 0x4000DEB0 /* @ECU_Address@PtoCtrl_NEngTargetSpd@ */ /end MEASUREMENT
/begin MEASUREMENT PHC_TiTCooltPreHeatrCorr "Coolant Temperature Grid Heater Timer Corrected " FLOAT32_IEEE EcuIntgdSwGend_CM_single_ms 0 0 0.0 500000.0 ECU_ADDRESS 0x4000D798 /* @ECU_Address@PHC_TiTCooltPreHeatrCorr@ */ /end MEASUREMENT
/begin MEASUREMENT PHC_TiMaxAftrStrtr "Timer Value for Grid Heater Activation After Starter Parameter" FLOAT32_IEEE EcuIntgdSwGend_CM_single_ms 0 0 0.0 500000.0 ECU_ADDRESS 0x4000DF28 /* @ECU_Address@PHC_TiMaxAftrStrtr@ */ /end MEASUREMENT
/begin MEASUREMENT PHC_TiPreHeatg "PreHeating Time Calculation Before Start" FLOAT32_IEEE EcuIntgdSwGend_CM_single_ms 0 0 0.0 500000.0 ECU_ADDRESS 0x4000DCD0 /* @ECU_Address@PHC_TiPreHeatg@ */ /end MEASUREMENT
/begin MEASUREMENT PHC_TiMaxBfrStrtr "Timer Value for Grid Heater Activation Before Starter Parameter" FLOAT32_IEEE EcuIntgdSwGend_CM_single_ms 0 0 0.0 500000.0 ECU_ADDRESS 0x4000DD28 /* @ECU_Address@PHC_TiMaxBfrStrtr@ */ /end MEASUREMENT
/begin MEASUREMENT IC_MMaiFuQntyCorrd "Corrected Main Fuel Quantity Mass" FLOAT32_IEEE EcuIntgdSwGend_CM_single_mm_3_stk 0 0 0.0 5000.0 ECU_ADDRESS 0x4000DC68 /* @ECU_Address@IC_MMaiFuQntyCorrd@ */ /end MEASUREMENT
/begin MEASUREMENT IC_MMaiFuQntyCorrdCyl1 "Corrected Main Fuel Quantity Mass for Cylinder 1" FLOAT32_IEEE EcuIntgdSwGend_CM_single_mm_3_stk 0 0 0.0 1000.0 ECU_ADDRESS 0x4000DA04 /* @ECU_Address@IC_MMaiFuQntyCorrdCyl1@ */ /end MEASUREMENT
/begin MEASUREMENT IC_MMaiFuQntyCorrdCyl2 "Corrected Main Fuel Quantity Mass for Cylinder 2" FLOAT32_IEEE EcuIntgdSwGend_CM_single_mm_3_stk 0 0 0.0 1000.0 ECU_ADDRESS 0x4000E5C8 /* @ECU_Address@IC_MMaiFuQntyCorrdCyl2@ */ /end MEASUREMENT
/begin MEASUREMENT IC_MMaiFuQntyCorrdCyl3 "Corrected Main Fuel Quantity Mass for Cylinder 3" FLOAT32_IEEE EcuIntgdSwGend_CM_single_mm_3_stk 0 0 0.0 1000.0 ECU_ADDRESS 0x4000DF40 /* @ECU_Address@IC_MMaiFuQntyCorrdCyl3@ */ /end MEASUREMENT
/begin MEASUREMENT IC_MMaiFuQntyCorrdCyl4 "Corrected Main Fuel Quantity Mass for Cylinder 4" FLOAT32_IEEE EcuIntgdSwGend_CM_single_mm_3_stk 0 0 0.0 1000.0 ECU_ADDRESS 0x4000E5D0 /* @ECU_Address@IC_MMaiFuQntyCorrdCyl4@ */ /end MEASUREMENT
/begin MEASUREMENT IC_MPltFuQntyCorrd "Corrected Pilot Fuel Quantity Mass" FLOAT32_IEEE EcuIntgdSwGend_CM_single_mm_3_stk 0 0 0.0 1000.0 ECU_ADDRESS 0x4000DEF8 /* @ECU_Address@IC_MPltFuQntyCorrd@ */ /end MEASUREMENT
/begin MEASUREMENT IC_MaxDurPltInjPre "Maximum Pre Pilot Injection Duration" FLOAT32_IEEE EcuIntgdSwGend_CM_single_us 0 0 0.0 10000.0 ECU_ADDRESS 0x4000E3A4 /* @ECU_Address@IC_MaxDurPltInjPre@ */ /end MEASUREMENT
/begin MEASUREMENT IC_DegPltInj "Pilot Injection Duration to Degree Signal" FLOAT32_IEEE EcuIntgdSwGend_CM_single_deg 0 0 -360.0 360.0 ECU_ADDRESS 0x4000D8D8 /* @ECU_Address@IC_DegPltInj@ */ /end MEASUREMENT
/begin MEASUREMENT IC_SoiPltInjForPltAllwd "Start of Pilot Injection for Allowed Pilot Injection" FLOAT32_IEEE EcuIntgdSwGend_CM_single_deg 0 0 -360.0 360.0 ECU_ADDRESS 0x4000D734 /* @ECU_Address@IC_SoiPltInjForPltAllwd@ */ /end MEASUREMENT
/begin MEASUREMENT IC_InstFuCnsLtPerHour "Corrected Total Fuel Quantity Mass Total Cylinder" FLOAT32_IEEE EcuIntgdSwGend_CM_single_L_h 0 0 0.0 1.0E+8 ECU_ADDRESS 0x4000DDB8 /* @ECU_Address@IC_InstFuCnsLtPerHour@ */ /end MEASUREMENT
/begin MEASUREMENT IC_CnvnInstFuCnsLtPerHourToSec "" FLOAT32_IEEE EcuIntgdSwGend_CM_single 0 0 0.0 100.0 ECU_ADDRESS 0x4000DCA8 /* @ECU_Address@IC_CnvnInstFuCnsLtPerHourToSec@ */ /end MEASUREMENT
/begin MEASUREMENT IC_InstLtPerKm "" FLOAT32_IEEE EcuIntgdSwGend_CM_single_L_km 0 0 0.0 1000.0 ECU_ADDRESS 0x4000D6C4 /* @ECU_Address@IC_InstLtPerKm@ */ /end MEASUREMENT
/begin MEASUREMENT IC_InstFuCnsLtPerHundKm "" FLOAT32_IEEE EcuIntgdSwGend_CM_single_L_100km 0 0 0.0 10000.0 ECU_ADDRESS 0x4000DA5C /* @ECU_Address@IC_InstFuCnsLtPerHundKm@ */ /end MEASUREMENT
/begin MEASUREMENT IC_FuCns "Fuel Consumption" FLOAT32_IEEE EcuIntgdSwGend_CM_single_L_100km 0 0 0.0 1000.0 ECU_ADDRESS 0x4000D844 /* @ECU_Address@IC_FuCns@ */ /end MEASUREMENT
/begin MEASUREMENT IC_DstCalcn "Distance Calculation" FLOAT32_IEEE EcuIntgdSwGend_CM_single_m 0 0 0.0 100000.0 ECU_ADDRESS 0x4000DA80 /* @ECU_Address@IC_DstCalcn@ */ /end MEASUREMENT
/begin MEASUREMENT IC_CnvnDstMtoKm "" FLOAT32_IEEE EcuIntgdSwGend_CM_single_km 0 0 0.0 1.0E+6 ECU_ADDRESS 0x4000D7D4 /* @ECU_Address@IC_CnvnDstMtoKm@ */ /end MEASUREMENT
/begin MEASUREMENT IC_Trip "" FLOAT32_IEEE EcuIntgdSwGend_CM_single_km 0 0 0.0 1.0E+6 ECU_ADDRESS 0x4000E11C /* @ECU_Address@IC_Trip@ */ /end MEASUREMENT
/begin MEASUREMENT IC_KmPerLt "" FLOAT32_IEEE EcuIntgdSwGend_CM_single_km_L 0 0 0.0 10000.0 ECU_ADDRESS 0x4000E254 /* @ECU_Address@IC_KmPerLt@ */ /end MEASUREMENT
/begin MEASUREMENT IC_LtPerKm "Liter Per Kilometer" FLOAT32_IEEE EcuIntgdSwGend_CM_single_L_km 0 0 0.0 10000.0 ECU_ADDRESS 0x4000E1E8 /* @ECU_Address@IC_LtPerKm@ */ /end MEASUREMENT
/begin MEASUREMENT IC_FuCnsAve "Fuel Consumption Average" FLOAT32_IEEE EcuIntgdSwGend_CM_single_L_100km 0 0 0.0 10000.0 ECU_ADDRESS 0x4000E6F4 /* @ECU_Address@IC_FuCnsAve@ */ /end MEASUREMENT
/begin MEASUREMENT IC_FuInTank "Fuel in Tank" FLOAT32_IEEE EcuIntgdSwGend_CM_single_L 0 0 0.0 1000.0 ECU_ADDRESS 0x4000E4C0 /* @ECU_Address@IC_FuInTank@ */ /end MEASUREMENT
/begin MEASUREMENT IC_DstToEmpty "Distance to Empty" FLOAT32_IEEE EcuIntgdSwGend_CM_single_km 0 0 -1000.0 1000.0 ECU_ADDRESS 0x4000DEE4 /* @ECU_Address@IC_DstToEmpty@ */ /end MEASUREMENT
/begin MEASUREMENT IC_DurMaiInjCyl6 "Main Injection Duration for Cylinder 8" FLOAT32_IEEE EcuIntgdSwGend_CM_single_us 0 0 0.0 10000.0 ECU_ADDRESS 0x4000DF8C /* @ECU_Address@IC_DurMaiInjCyl6@ */ /end MEASUREMENT
/begin MEASUREMENT IC_DurMaiInjCyl5 "Main Injection Duration for Cylinder 8" FLOAT32_IEEE EcuIntgdSwGend_CM_single_us 0 0 0.0 10000.0 ECU_ADDRESS 0x4000DF88 /* @ECU_Address@IC_DurMaiInjCyl5@ */ /end MEASUREMENT
/begin MEASUREMENT IC_DurMaiInjCyl1 "Main Injection Duration for Cylinder 8" FLOAT32_IEEE EcuIntgdSwGend_CM_single_us 0 0 0.0 10000.0 ECU_ADDRESS 0x4000DF78 /* @ECU_Address@IC_DurMaiInjCyl1@ */ /end MEASUREMENT
/begin MEASUREMENT IC_DurMaiInjCyl2 "Main Injection Duration for Cylinder 8" FLOAT32_IEEE EcuIntgdSwGend_CM_single_us 0 0 0.0 10000.0 ECU_ADDRESS 0x4000E0E4 /* @ECU_Address@IC_DurMaiInjCyl2@ */ /end MEASUREMENT
/begin MEASUREMENT IC_DurMaiInjCyl3 "Main Injection Duration for Cylinder 8" FLOAT32_IEEE EcuIntgdSwGend_CM_single_us 0 0 0.0 10000.0 ECU_ADDRESS 0x4000E24C /* @ECU_Address@IC_DurMaiInjCyl3@ */ /end MEASUREMENT
/begin MEASUREMENT IC_DurMaiInjCyl4 "Main Injection Duration for Cylinder 8" FLOAT32_IEEE EcuIntgdSwGend_CM_single_us 0 0 0.0 10000.0 ECU_ADDRESS 0x4000DF84 /* @ECU_Address@IC_DurMaiInjCyl4@ */ /end MEASUREMENT
/begin MEASUREMENT IC_CnvnKmtoM "" FLOAT32_IEEE EcuIntgdSwGend_CM_single_m 0 0 0.0 100000.0 ECU_ADDRESS 0x4000D97C /* @ECU_Address@IC_CnvnKmtoM@ */ /end MEASUREMENT
/begin MEASUREMENT IC_CnvnKmHtoMSec "" FLOAT32_IEEE EcuIntgdSwGend_CM_single_m_sec 0 0 0.0 10000.0 ECU_ADDRESS 0x4000DDFC /* @ECU_Address@IC_CnvnKmHtoMSec@ */ /end MEASUREMENT
/begin MEASUREMENT IC_MMaiFuQntyCorrdCyl6 "Corrected Main Fuel Quantity Mass for Cylinder 6" FLOAT32_IEEE EcuIntgdSwGend_CM_single_mm_3_stk 0 0 0.0 1000.0 ECU_ADDRESS 0x4000E5D8 /* @ECU_Address@IC_MMaiFuQntyCorrdCyl6@ */ /end MEASUREMENT
/begin MEASUREMENT IC_MMaiFuQntyCorrdCyl5 "Corrected Main Fuel Quantity Mass for Cylinder 5" FLOAT32_IEEE EcuIntgdSwGend_CM_single_mm_3_stk 0 0 0.0 1000.0 ECU_ADDRESS 0x4000E5D4 /* @ECU_Address@IC_MMaiFuQntyCorrdCyl5@ */ /end MEASUREMENT
/begin MEASUREMENT EOP_SoiPltInj1 "Output Processing Start of Pilot Injection 1" FLOAT32_IEEE EcuIntgdSwGend_CM_single_deg 0 0 -100.0 100.0 ECU_ADDRESS 0x4000DC28 /* @ECU_Address@EOP_SoiPltInj1@ */ /end MEASUREMENT
/begin MEASUREMENT EOP_SoiPltInj2 "Output Processing Start of Pilot Injection 2" FLOAT32_IEEE EcuIntgdSwGend_CM_single_deg 0 0 -100.0 100.0 ECU_ADDRESS 0x4000E6A0 /* @ECU_Address@EOP_SoiPltInj2@ */ /end MEASUREMENT
/begin MEASUREMENT EOP_SoiPltInj3 "Output Processing Start of Pilot Injection 3" FLOAT32_IEEE EcuIntgdSwGend_CM_single_deg 0 0 -100.0 100.0 ECU_ADDRESS 0x4000E6A4 /* @ECU_Address@EOP_SoiPltInj3@ */ /end MEASUREMENT
/begin MEASUREMENT EOP_SoiPltInj4 "Output Processing Start of Pilot Injection 4" FLOAT32_IEEE EcuIntgdSwGend_CM_single_deg 0 0 -100.0 100.0 ECU_ADDRESS 0x4000E6A8 /* @ECU_Address@EOP_SoiPltInj4@ */ /end MEASUREMENT
/begin MEASUREMENT EOP_SoiPltInj5 "Output Processing Start of Pilot Injection 5" FLOAT32_IEEE EcuIntgdSwGend_CM_single_deg 0 0 -100.0 100.0 ECU_ADDRESS 0x4000E6AC /* @ECU_Address@EOP_SoiPltInj5@ */ /end MEASUREMENT
/begin MEASUREMENT EOP_SoiPltInj6 "Output Processing Start of Pilot Injection 6" FLOAT32_IEEE EcuIntgdSwGend_CM_single_deg 0 0 -100.0 100.0 ECU_ADDRESS 0x4000E6B0 /* @ECU_Address@EOP_SoiPltInj6@ */ /end MEASUREMENT
/begin MEASUREMENT EOP_SoiMaiInj1 "Output Processing Start of Main Injection 1" FLOAT32_IEEE EcuIntgdSwGend_CM_single_deg 0 0 -100.0 100.0 ECU_ADDRESS 0x4000E348 /* @ECU_Address@EOP_SoiMaiInj1@ */ /end MEASUREMENT
/begin MEASUREMENT EOP_SoiMaiInj2 "Output Processing Start of Main Injection 2" FLOAT32_IEEE EcuIntgdSwGend_CM_single_deg 0 0 -100.0 100.0 ECU_ADDRESS 0x4000E484 /* @ECU_Address@EOP_SoiMaiInj2@ */ /end MEASUREMENT
/begin MEASUREMENT EOP_SoiMaiInj3 "Output Processing Start of Main Injection 3" FLOAT32_IEEE EcuIntgdSwGend_CM_single_deg 0 0 -100.0 100.0 ECU_ADDRESS 0x4000E350 /* @ECU_Address@EOP_SoiMaiInj3@ */ /end MEASUREMENT
/begin MEASUREMENT EOP_SoiMaiInj4 "Output Processing Start of Main Injection 4" FLOAT32_IEEE EcuIntgdSwGend_CM_single_deg 0 0 -100.0 100.0 ECU_ADDRESS 0x4000E354 /* @ECU_Address@EOP_SoiMaiInj4@ */ /end MEASUREMENT
/begin MEASUREMENT EOP_SoiMaiInj5 "Output Processing Start of Main Injection 5" FLOAT32_IEEE EcuIntgdSwGend_CM_single_deg 0 0 -100.0 100.0 ECU_ADDRESS 0x4000E358 /* @ECU_Address@EOP_SoiMaiInj5@ */ /end MEASUREMENT
/begin MEASUREMENT EOP_SoiMaiInj6 "Output Processing Start of Main Injection 6" FLOAT32_IEEE EcuIntgdSwGend_CM_single_deg 0 0 -100.0 100.0 ECU_ADDRESS 0x4000E35C /* @ECU_Address@EOP_SoiMaiInj6@ */ /end MEASUREMENT
/begin MEASUREMENT EOP_DurPltInj1 "Output Processing Pre Pilot Injection Duration for Cylinder 1" FLOAT32_IEEE EcuIntgdSwGend_CM_single_us 0 0 0.0 10000.0 ECU_ADDRESS 0x4000D724 /* @ECU_Address@EOP_DurPltInj1@ */ /end MEASUREMENT
/begin MEASUREMENT EOP_DurPltInj2 "Output Processing Pre Pilot Injection Duration for Cylinder 2" FLOAT32_IEEE EcuIntgdSwGend_CM_single_us 0 0 0.0 10000.0 ECU_ADDRESS 0x4000E1D0 /* @ECU_Address@EOP_DurPltInj2@ */ /end MEASUREMENT
/begin MEASUREMENT EOP_DurPltInj3 "Output Processing Pre Pilot Injection Duration for Cylinder 3" FLOAT32_IEEE EcuIntgdSwGend_CM_single_us 0 0 0.0 10000.0 ECU_ADDRESS 0x4000E1D4 /* @ECU_Address@EOP_DurPltInj3@ */ /end MEASUREMENT
/begin MEASUREMENT EOP_DurPltInj4 "Output Processing Pre Pilot Injection Duration for Cylinder 4" FLOAT32_IEEE EcuIntgdSwGend_CM_single_us 0 0 0.0 10000.0 ECU_ADDRESS 0x4000E1D8 /* @ECU_Address@EOP_DurPltInj4@ */ /end MEASUREMENT
/begin MEASUREMENT EOP_DurPltInj5 "Output Processing Pre Pilot Injection Duration for Cylinder 5" FLOAT32_IEEE EcuIntgdSwGend_CM_single_us 0 0 0.0 10000.0 ECU_ADDRESS 0x4000D744 /* @ECU_Address@EOP_DurPltInj5@ */ /end MEASUREMENT
/begin MEASUREMENT EOP_DurPltInj6 "Output Processing Pre Pilot Injection Duration for Cylinder 6" FLOAT32_IEEE EcuIntgdSwGend_CM_single_us 0 0 0.0 10000.0 ECU_ADDRESS 0x4000D8C0 /* @ECU_Address@EOP_DurPltInj6@ */ /end MEASUREMENT
/begin MEASUREMENT EOP_DurMaiInj1 "Output Processing Main Injection Duration for Cylinder 1" FLOAT32_IEEE EcuIntgdSwGend_CM_single_us 0 0 0.0 10000.0 ECU_ADDRESS 0x4000D94C /* @ECU_Address@EOP_DurMaiInj1@ */ /end MEASUREMENT
/begin MEASUREMENT EOP_DurMaiInj2 "Output Processing Main Injection Duration for Cylinder 2" FLOAT32_IEEE EcuIntgdSwGend_CM_single_us 0 0 0.0 10000.0 ECU_ADDRESS 0x4000D8C8 /* @ECU_Address@EOP_DurMaiInj2@ */ /end MEASUREMENT
/begin MEASUREMENT EOP_DurMaiInj3 "Output Processing Main Injection Duration for Cylinder 3" FLOAT32_IEEE EcuIntgdSwGend_CM_single_us 0 0 0.0 10000.0 ECU_ADDRESS 0x4000D8CC /* @ECU_Address@EOP_DurMaiInj3@ */ /end MEASUREMENT
/begin MEASUREMENT EOP_DurMaiInj4 "Output Processing Main Injection Duration for Cylinder 4" FLOAT32_IEEE EcuIntgdSwGend_CM_single_us 0 0 0.0 10000.0 ECU_ADDRESS 0x4000D954 /* @ECU_Address@EOP_DurMaiInj4@ */ /end MEASUREMENT
/begin MEASUREMENT EOP_DurMaiInj5 "Output Processing Main Injection Duration for Cylinder 5" FLOAT32_IEEE EcuIntgdSwGend_CM_single_us 0 0 0.0 10000.0 ECU_ADDRESS 0x4000D958 /* @ECU_Address@EOP_DurMaiInj5@ */ /end MEASUREMENT
/begin MEASUREMENT EOP_DurMaiInj6 "Output Processing Main Injection Duration for Cylinder 6" FLOAT32_IEEE EcuIntgdSwGend_CM_single_us 0 0 0.0 10000.0 ECU_ADDRESS 0x4000D95C /* @ECU_Address@EOP_DurMaiInj6@ */ /end MEASUREMENT
/begin MEASUREMENT EOP_FuCns "Output Processing Fuel Consumption" FLOAT32_IEEE EcuIntgdSwGend_CM_single_l_100km 0 0 0.0 100.0 ECU_ADDRESS 0x4000E3A8 /* @ECU_Address@EOP_FuCns@ */ /end MEASUREMENT
/begin MEASUREMENT EOP_Trip "" FLOAT32_IEEE EcuIntgdSwGend_CM_single_km 0 0 0.0 1.0E+6 ECU_ADDRESS 0x4000DED0 /* @ECU_Address@EOP_Trip@ */ /end MEASUREMENT
/begin MEASUREMENT EOP_EngHr "Output Processing Engine Hour" FLOAT32_IEEE EcuIntgdSwGend_CM_single_h 0 0 0.0 1.0E+6 ECU_ADDRESS 0x4000DBC0 /* @ECU_Address@EOP_EngHr@ */ /end MEASUREMENT
/begin MEASUREMENT EOP_DstTrvldInKm "Output Processing Distance Travel In Kilometer" FLOAT32_IEEE EcuIntgdSwGend_CM_single_km 0 0 0.0 1.0E+6 ECU_ADDRESS 0x4000E010 /* @ECU_Address@EOP_DstTrvldInKm@ */ /end MEASUREMENT
/begin MEASUREMENT EOP_VCVReq "Output Processing Volumetric Control Valve Request" FLOAT32_IEEE EcuIntgdSwGend_CM_single_A 0 0 0.0 10000.0 ECU_ADDRESS 0x4000E070 /* @ECU_Address@EOP_VCVReq@ */ /end MEASUREMENT
/begin MEASUREMENT EOP_VCVDynRateLimr "Output Processing Volumetric Control Valve Dynamic Rate Limiter" FLOAT32_IEEE EcuIntgdSwGend_CM_single 0 0 0.0 10000.0 ECU_ADDRESS 0x4000DE2C /* @ECU_Address@EOP_VCVDynRateLimr@ */ /end MEASUREMENT
/begin MEASUREMENT EOP_IRefVCV "Output Processing Current Reference for Volumetric Control Valve" FLOAT32_IEEE EcuIntgdSwGend_CM_single_A 0 0 0.0 3000.0 ECU_ADDRESS 0x4000E540 /* @ECU_Address@EOP_IRefVCV@ */ /end MEASUREMENT
/begin MEASUREMENT EOP_IRefPCV "Output Processing Current Reference for Pressure Control Valve" FLOAT32_IEEE EcuIntgdSwGend_CM_single_A 0 0 0.0 10000.0 ECU_ADDRESS 0x4000E088 /* @ECU_Address@EOP_IRefPCV@ */ /end MEASUREMENT
/begin MEASUREMENT EOP_DutyVlvReq "Output Processing Duty Valve Request" FLOAT32_IEEE EcuIntgdSwGend_CM_single__ 0 0 0.0 100.0 ECU_ADDRESS 0x4000DD80 /* @ECU_Address@EOP_DutyVlvReq@ */ /end MEASUREMENT
/begin MEASUREMENT SpdLimr_SpdLimrModSt "" SLONG EcuIntgdSwGend_CM_SpeedLimiterMode 0 0 0 3 ECU_ADDRESS 0x4000DD5C /* @ECU_Address@SpdLimr_SpdLimrModSt@ */ /end MEASUREMENT
/begin MEASUREMENT PtoCtrl_CanPtoGovrSt "Power Take Off Governor State " SBYTE EcuIntgdSwGend_CM_int8 0 0 0.0 31.0 ECU_ADDRESS 0x4000D8E1 /* @ECU_Address@PtoCtrl_CanPtoGovrSt@ */ /end MEASUREMENT
/begin MEASUREMENT TrC_CdnSmokeLim "Smoke Limitation Condition Signal" UBYTE EcuIntgdSwGend_CM_boolean 0 0 0.0 1.0 ECU_ADDRESS 0x4000DA35 /* @ECU_Address@TrC_CdnSmokeLim@ */ /end MEASUREMENT
/begin MEASUREMENT SC_NEngRunDeacThd "Debouncer Activation for Deactivation Running Engine Speed Threshold Value" UBYTE EcuIntgdSwGend_CM_boolean 0 0 0.0 1.0 ECU_ADDRESS 0x4000E109 /* @ECU_Address@SC_NEngRunDeacThd@ */ /end MEASUREMENT
/begin MEASUREMENT SC_NEngStrtrInhThd "Debouncer Activation for Start Inhibition Engine Speed Threshold" UBYTE EcuIntgdSwGend_CM_boolean 0 0 0.0 1.0 ECU_ADDRESS 0x4000D874 /* @ECU_Address@SC_NEngStrtrInhThd@ */ /end MEASUREMENT
/begin MEASUREMENT SC_bAcvStrtr "Starter is Active Flag" UBYTE EcuIntgdSwGend_CM_boolean 0 0 0.0 1.0 ECU_ADDRESS 0x4000DF07 /* @ECU_Address@SC_bAcvStrtr@ */ /end MEASUREMENT
/begin MEASUREMENT SC_bAcvDisStrt "Starter is Disabled Flag" UBYTE EcuIntgdSwGend_CM_boolean 0 0 0.0 1.0 ECU_ADDRESS 0x4000DC87 /* @ECU_Address@SC_bAcvDisStrt@ */ /end MEASUREMENT
/begin MEASUREMENT SC_NEngAcvStrtLock "Debouncer Activation for Starter Locking Engine Speed Threshold" UBYTE EcuIntgdSwGend_CM_boolean 0 0 0.0 1.0 ECU_ADDRESS 0x4000E640 /* @ECU_Address@SC_NEngAcvStrtLock@ */ /end MEASUREMENT
/begin MEASUREMENT SC_bAcvStrtrLock "Starter Locking is Active Flag" UBYTE EcuIntgdSwGend_CM_boolean 0 0 0.0 1.0 ECU_ADDRESS 0x4000E4F8 /* @ECU_Address@SC_bAcvStrtrLock@ */ /end MEASUREMENT
/begin MEASUREMENT SC_bEnaAcvnStrtr "Enable Starter Activation" UBYTE EcuIntgdSwGend_CM_boolean 0 0 0.0 1.0 ECU_ADDRESS 0x4000DC84 /* @ECU_Address@SC_bEnaAcvnStrtr@ */ /end MEASUREMENT
/begin MEASUREMENT SC_bEnaAcvnStrtrTiEna "Engine Not Turn Finish Time" UBYTE EcuIntgdSwGend_CM_boolean 0 0 0.0 1.0 ECU_ADDRESS 0x4000DCB2 /* @ECU_Address@SC_bEnaAcvnStrtrTiEna@ */ /end MEASUREMENT
/begin MEASUREMENT SC_bAcvEngAlrdyRunng "Engine is Already Running Flag" UBYTE EcuIntgdSwGend_CM_boolean 0 0 0.0 1.0 ECU_ADDRESS 0x4000DDDD /* @ECU_Address@SC_bAcvEngAlrdyRunng@ */ /end MEASUREMENT
/begin MEASUREMENT SC_bInhEngStrt "Inhibition Engine Start" UBYTE EcuIntgdSwGend_CM_boolean 0 0 0.0 1.0 ECU_ADDRESS 0x4000E380 /* @ECU_Address@SC_bInhEngStrt@ */ /end MEASUREMENT
/begin MEASUREMENT SpdLimr_ErrSpdLimrOnOffBtn "Speed Limiter On-Off Button Error Signal" UBYTE EcuIntgdSwGend_CM_boolean 0 0 0.0 1.0 ECU_ADDRESS 0x4000D758 /* @ECU_Address@SpdLimr_ErrSpdLimrOnOffBtn@ */ /end MEASUREMENT
/begin MEASUREMENT SpdLimr_ErrSpdLimrInctBtn "Speed Limiter Increment Button Error Signal" UBYTE EcuIntgdSwGend_CM_boolean 0 0 0.0 1.0 ECU_ADDRESS 0x4000DA00 /* @ECU_Address@SpdLimr_ErrSpdLimrInctBtn@ */ /end MEASUREMENT
/begin MEASUREMENT SpdLimr_ErrSpdLimrDecBtn "Speed Limiter Decrement Button Error Signal" UBYTE EcuIntgdSwGend_CM_boolean 0 0 0.0 1.0 ECU_ADDRESS 0x4000E2D0 /* @ECU_Address@SpdLimr_ErrSpdLimrDecBtn@ */ /end MEASUREMENT
/begin MEASUREMENT SpdLimr_ErrSpdLimrBtn "Speed Limiter Button Error " UBYTE EcuIntgdSwGend_CM_boolean 0 0 0.0 1.0 ECU_ADDRESS 0x4000DFD8 /* @ECU_Address@SpdLimr_ErrSpdLimrBtn@ */ /end MEASUREMENT
/begin MEASUREMENT SpdLimr_ActvSpdLimrInctBtn "Activation Speed Limiter Increment Button" UBYTE EcuIntgdSwGend_CM_boolean 0 0 0.0 1.0 ECU_ADDRESS 0x4000E250 /* @ECU_Address@SpdLimr_ActvSpdLimrInctBtn@ */ /end MEASUREMENT
/begin MEASUREMENT SpdLimr_ActvSpdLimrOnOffBtn "Activation Speed Limiter On-Off Button" UBYTE EcuIntgdSwGend_CM_boolean 0 0 0.0 1.0 ECU_ADDRESS 0x4000E45C /* @ECU_Address@SpdLimr_ActvSpdLimrOnOffBtn@ */ /end MEASUREMENT
/begin MEASUREMENT SpdLimr_ErrVehV "Vehicle Speed Error Signal" UBYTE EcuIntgdSwGend_CM_boolean 0 0 0.0 1.0 ECU_ADDRESS 0x4000D859 /* @ECU_Address@SpdLimr_ErrVehV@ */ /end MEASUREMENT
/begin MEASUREMENT SpdLimr_ActvSpdLimrDecBtn "Activation Speed Limiter Decrement Button" UBYTE EcuIntgdSwGend_CM_boolean 0 0 0.0 1.0 ECU_ADDRESS 0x4000E0BC /* @ECU_Address@SpdLimr_ActvSpdLimrDecBtn@ */ /end MEASUREMENT
/begin MEASUREMENT RPG_bNEngThdAcvnPRail "Debouncer Activation for Rail Pressure Correction Activation wrt Comparision with Engine Speed" UBYTE EcuIntgdSwGend_CM_boolean 0 0 0.0 1.0 ECU_ADDRESS 0x4000DBF4 /* @ECU_Address@RPG_bNEngThdAcvnPRail@ */ /end MEASUREMENT
/begin MEASUREMENT PtoCtrl_bErrCabPtoOnOff "Cabin PTO Switch Error" UBYTE EcuIntgdSwGend_CM_boolean 0 0 0.0 1.0 ECU_ADDRESS 0x4000E615 /* @ECU_Address@PtoCtrl_bErrCabPtoOnOff@ */ /end MEASUREMENT
/begin MEASUREMENT PtoCtrl_TrsmCurrentGear "Transmission Gear Neutral" UBYTE EcuIntgdSwGend_CM_boolean 0 0 0.0 1.0 ECU_ADDRESS 0x4000DD91 /* @ECU_Address@PtoCtrl_TrsmCurrentGear@ */ /end MEASUREMENT
/begin MEASUREMENT PtoCtrl_HndBrkPrkg "Hand Brake Parking Active Signal" UBYTE EcuIntgdSwGend_CM_boolean 0 0 0.0 1.0 ECU_ADDRESS 0x4000E252 /* @ECU_Address@PtoCtrl_HndBrkPrkg@ */ /end MEASUREMENT
/begin MEASUREMENT PtoCtrl_bAcvCabPtoOnOff "Cabin PTO On-Off Switch" UBYTE EcuIntgdSwGend_CM_boolean 0 0 0.0 1.0 ECU_ADDRESS 0x4000E1A5 /* @ECU_Address@PtoCtrl_bAcvCabPtoOnOff@ */ /end MEASUREMENT
/begin MEASUREMENT PtoCtrl_bErrCabPtoAccrSwt "Cabin PTO Accelerate Switch Error" UBYTE EcuIntgdSwGend_CM_boolean 0 0 0.0 1.0 ECU_ADDRESS 0x4000E2FC /* @ECU_Address@PtoCtrl_bErrCabPtoAccrSwt@ */ /end MEASUREMENT
/begin MEASUREMENT PtoCtrl_bErrCabPtoCoastSwt "Cabin PTO Coast Switch Error" UBYTE EcuIntgdSwGend_CM_boolean 0 0 0.0 1.0 ECU_ADDRESS 0x4000DCE1 /* @ECU_Address@PtoCtrl_bErrCabPtoCoastSwt@ */ /end MEASUREMENT
/begin MEASUREMENT PtoCtrl_bAcvCabPto "Cabin PTO Activation" UBYTE EcuIntgdSwGend_CM_boolean 0 0 0.0 1.0 ECU_ADDRESS 0x4000E13C /* @ECU_Address@PtoCtrl_bAcvCabPto@ */ /end MEASUREMENT
/begin MEASUREMENT PtoCtrl_bAcvCabPtoCoastSwt "Cabin PTO Coast Switch" UBYTE EcuIntgdSwGend_CM_boolean 0 0 0.0 1.0 ECU_ADDRESS 0x4000E239 /* @ECU_Address@PtoCtrl_bAcvCabPtoCoastSwt@ */ /end MEASUREMENT
/begin MEASUREMENT PtoCtrl_bAcvCabPtoAccrSwt "Cabin PTO Accelerate Switch" UBYTE EcuIntgdSwGend_CM_boolean 0 0 0.0 1.0 ECU_ADDRESS 0x4000D861 /* @ECU_Address@PtoCtrl_bAcvCabPtoAccrSwt@ */ /end MEASUREMENT
/begin MEASUREMENT PtoCtrl_bErrRemPtoSpdCtrlSwt "Remote PTO Speed Control Switch Error" UBYTE EcuIntgdSwGend_CM_boolean 0 0 0.0 1.0 ECU_ADDRESS 0x4000D764 /* @ECU_Address@PtoCtrl_bErrRemPtoSpdCtrlSwt@ */ /end MEASUREMENT
/begin MEASUREMENT PtoCtrl_bErrRemPtoAccrSwt "Remote PTO Accelerate Switch Error" UBYTE EcuIntgdSwGend_CM_boolean 0 0 0.0 1.0 ECU_ADDRESS 0x4000D841 /* @ECU_Address@PtoCtrl_bErrRemPtoAccrSwt@ */ /end MEASUREMENT
/begin MEASUREMENT PtoCtrl_TrsmCurrentGearForRemPto "Transmission Gear Neutral For Remote PTO" UBYTE EcuIntgdSwGend_CM_boolean 0 0 0.0 1.0 ECU_ADDRESS 0x4000E3F0 /* @ECU_Address@PtoCtrl_TrsmCurrentGearForRemPto@ */ /end MEASUREMENT
/begin MEASUREMENT PtoCtrl_HndBrkPrkgForRemPto "Hand Brake Parking Active For Remote PTO" UBYTE EcuIntgdSwGend_CM_boolean 0 0 0.0 1.0 ECU_ADDRESS 0x4000DB3D /* @ECU_Address@PtoCtrl_HndBrkPrkgForRemPto@ */ /end MEASUREMENT
/begin MEASUREMENT PtoCtrl_bAcvRemPtoSpdCtrlSwt "Remote PTO Speed Control Switch" UBYTE EcuIntgdSwGend_CM_boolean 0 0 0.0 1.0 ECU_ADDRESS 0x4000DCBE /* @ECU_Address@PtoCtrl_bAcvRemPtoSpdCtrlSwt@ */ /end MEASUREMENT
/begin MEASUREMENT PtoCtrl_bAcvRemPto "Remote PTO Activation" UBYTE EcuIntgdSwGend_CM_boolean 0 0 0.0 1.0 ECU_ADDRESS 0x4000DDC8 /* @ECU_Address@PtoCtrl_bAcvRemPto@ */ /end MEASUREMENT
/begin MEASUREMENT PtoCtrl_bAcvRemPtoAccrSwt "Remote PTO Accelerate Switch" UBYTE EcuIntgdSwGend_CM_boolean 0 0 0.0 1.0 ECU_ADDRESS 0x4000DE04 /* @ECU_Address@PtoCtrl_bAcvRemPtoAccrSwt@ */ /end MEASUREMENT
/begin MEASUREMENT PtoCtrl_bErrRemPtoCoastSwt "Remote PTO Coast Switch Error" UBYTE EcuIntgdSwGend_CM_boolean 0 0 0.0 1.0 ECU_ADDRESS 0x4000D7C4 /* @ECU_Address@PtoCtrl_bErrRemPtoCoastSwt@ */ /end MEASUREMENT
/begin MEASUREMENT PtoCtrl_bAcvRemPtoCoastSwt "Remote PTO Coast Switch" UBYTE EcuIntgdSwGend_CM_boolean 0 0 0.0 1.0 ECU_ADDRESS 0x4000DD64 /* @ECU_Address@PtoCtrl_bAcvRemPtoCoastSwt@ */ /end MEASUREMENT
/begin MEASUREMENT PHC_bAcvPreAcvnGridHeatr "Grid Heater is Active Flag Before Starter" UBYTE EcuIntgdSwGend_CM_boolean 0 0 0.0 1.0 ECU_ADDRESS 0x4000DE61 /* @ECU_Address@PHC_bAcvPreAcvnGridHeatr@ */ /end MEASUREMENT
/begin MEASUREMENT PHC_bAcvPostAcvnGridHeatr "Grid Heater Activation with After Starter" UBYTE EcuIntgdSwGend_CM_boolean 0 0 0.0 1.0 ECU_ADDRESS 0x4000DA97 /* @ECU_Address@PHC_bAcvPostAcvnGridHeatr@ */ /end MEASUREMENT
/begin MEASUREMENT PHC_bAcvGridHeatr "Grid Heater is Active Flag " UBYTE EcuIntgdSwGend_CM_boolean 0 0 0.0 1.0 ECU_ADDRESS 0x4000DDAC /* @ECU_Address@PHC_bAcvGridHeatr@ */ /end MEASUREMENT
/begin MEASUREMENT PHC_bErrAcvGridHeatr "Grid Heater Error Detection" UBYTE EcuIntgdSwGend_CM_boolean 0 0 0.0 1.0 ECU_ADDRESS 0x4000E6C5 /* @ECU_Address@PHC_bErrAcvGridHeatr@ */ /end MEASUREMENT
/begin MEASUREMENT PHC_bAcvPostAcvnGridHeatrTiEna "Timer Elapsed Time Finish for Activation After Start" UBYTE EcuIntgdSwGend_CM_boolean 0 0 0.0 1.0 ECU_ADDRESS 0x4000E5C4 /* @ECU_Address@PHC_bAcvPostAcvnGridHeatrTiEna@ */ /end MEASUREMENT
/begin MEASUREMENT PHC_bTiDisaPreAcvnGridHeatr "Grid Heater Before Starter Deactivation Timer Enable" UBYTE EcuIntgdSwGend_CM_boolean 0 0 0.0 1.0 ECU_ADDRESS 0x4000E559 /* @ECU_Address@PHC_bTiDisaPreAcvnGridHeatr@ */ /end MEASUREMENT
/begin MEASUREMENT PHC_bAcvPreAcvnGridHeatrTiEna "Timer Elapsed Time Finish for Activation Before Start" UBYTE EcuIntgdSwGend_CM_boolean 0 0 0.0 1.0 ECU_ADDRESS 0x4000D9B2 /* @ECU_Address@PHC_bAcvPreAcvnGridHeatrTiEna@ */ /end MEASUREMENT
/begin MEASUREMENT IC_bAcvPltAllwd "Pilot Injection Allowance Flag" UBYTE EcuIntgdSwGend_CM_boolean 0 0 0.0 1.0 ECU_ADDRESS 0x4000E382 /* @ECU_Address@IC_bAcvPltAllwd@ */ /end MEASUREMENT
/begin MEASUREMENT EOP_bAcvStrtr "Output Processing Starter Activaiton" UBYTE EcuIntgdSwGend_CM_boolean 0 0 0.0 1.0 ECU_ADDRESS 0x4000DF5C /* @ECU_Address@EOP_bAcvStrtr@ */ /end MEASUREMENT
/begin MEASUREMENT EcuIntgdSwGend_DW.tp_ButtonIdle "" UBYTE EcuIntgdSwGend_CM_uint8 0 0 0 255 ECU_ADDRESS 0x40010C9C /* @ECU_Address@EcuIntgdSwGend_DW.tp_ButtonIdle@ */ /end MEASUREMENT
/begin COMPU_METHOD EcuIntgdSwGend_CM_single_N_m "Q = V" RAT_FUNC "%8.6" "N*m" COEFFS 0 1 0 0 0 1 /end COMPU_METHOD
/begin COMPU_METHOD EcuIntgdSwGend_CM_single_rpm "Q = V" RAT_FUNC "%8.6" "rpm" COEFFS 0 1 0 0 0 1 /end COMPU_METHOD
/begin COMPU_METHOD EcuIntgdSwGend_CM_single_degC "Q = V" RAT_FUNC "%8.6" "degC" COEFFS 0 1 0 0 0 1 /end COMPU_METHOD
/begin COMPU_METHOD EcuIntgdSwGend_CM_single_A "Q = V" RAT_FUNC "%8.6" "A" COEFFS 0 1 0 0 0 1 /end COMPU_METHOD
/begin COMPU_METHOD EcuIntgdSwGend_CM_single "Q = V" RAT_FUNC "%8.6" "" COEFFS 0 1 0 0 0 1 /end COMPU_METHOD
/begin COMPU_METHOD EcuIntgdSwGend_CM_single__ "Q = V" RAT_FUNC "%8.6" "%" COEFFS 0 1 0 0 0 1 /end COMPU_METHOD
/begin COMPU_METHOD EcuIntgdSwGend_CM_single_L "Q = V" RAT_FUNC "%8.6" "L" COEFFS 0 1 0 0 0 1 /end COMPU_METHOD
/begin COMPU_METHOD EcuIntgdSwGend_CM_single_deg "Q = V" RAT_FUNC "%8.6" "deg" COEFFS 0 1 0 0 0 1 /end COMPU_METHOD
/begin COMPU_METHOD EcuIntgdSwGend_CM_single_ms "Q = V" RAT_FUNC "%8.6" "ms" COEFFS 0 1 0 0 0 1 /end COMPU_METHOD
/begin COMPU_METHOD EcuIntgdSwGend_CM_single_mbar "Q = V" RAT_FUNC "%8.6" "mbar" COEFFS 0 1 0 0 0 1 /end COMPU_METHOD
/begin COMPU_METHOD EcuIntgdSwGend_CM_single_bar "Q = V" RAT_FUNC "%8.6" "bar" COEFFS 0 1 0 0 0 1 /end COMPU_METHOD
/begin COMPU_METHOD EcuIntgdSwGend_CM_single_mm_3 "Q = V" RAT_FUNC "%8.6" "mm^3" COEFFS 0 1 0 0 0 1 /end COMPU_METHOD
/begin COMPU_METHOD EcuIntgdSwGend_CM_single_mm_3_stk "Q = V" RAT_FUNC "%8.6" "mm^3/stk" COEFFS 0 1 0 0 0 1 /end COMPU_METHOD
/begin COMPU_METHOD EcuIntgdSwGend_CM_single_V "Q = V" RAT_FUNC "%8.6" "V" COEFFS 0 1 0 0 0 1 /end COMPU_METHOD
/begin COMPU_METHOD EcuIntgdSwGend_CM_single_km_h "Q = V" RAT_FUNC "%8.6" "km/h" COEFFS 0 1 0 0 0 1 /end COMPU_METHOD
/begin COMPU_METHOD EcuIntgdSwGend_CM_single_us "Q = V" RAT_FUNC "%8.6" "us" COEFFS 0 1 0 0 0 1 /end COMPU_METHOD
/begin COMPU_METHOD EcuIntgdSwGend_CM_single_km "Q = V" RAT_FUNC "%8.6" "km" COEFFS 0 1 0 0 0 1 /end COMPU_METHOD
/begin COMPU_METHOD EcuIntgdSwGend_CM_single_h "Q = V" RAT_FUNC "%8.6" "h" COEFFS 0 1 0 0 0 1 /end COMPU_METHOD
/begin COMPU_METHOD EcuIntgdSwGend_CM_single_l_100km "Q = V" RAT_FUNC "%8.6" "l/100km" COEFFS 0 1 0 0 0 1 /end COMPU_METHOD
/begin COMPU_METHOD EcuIntgdSwGend_CM_single_L_h "Q = V" RAT_FUNC "%8.6" "L/h" COEFFS 0 1 0 0 0 1 /end COMPU_METHOD
/begin COMPU_METHOD EcuIntgdSwGend_CM_single_L_100km "Q = V" RAT_FUNC "%8.6" "L/100km" COEFFS 0 1 0 0 0 1 /end COMPU_METHOD
/begin COMPU_METHOD EcuIntgdSwGend_CM_boolean "Q = V" RAT_FUNC "%1.0" "" COEFFS 0 1 0 0 0 1 /end COMPU_METHOD
/begin COMPU_METHOD EcuIntgdSwGend_CM_int8 "Q = V" RAT_FUNC "%3.0" "" COEFFS 0 1 0 0 0 1 /end COMPU_METHOD
/begin COMPU_METHOD EcuIntgdSwGend_CM_uint8 "Q = V" RAT_FUNC "%3.0" "" COEFFS 0 1 0 0 0 1 /end COMPU_METHOD
/begin COMPU_METHOD EcuIntgdSwGend_CM_single_mg_stk "Q = V" RAT_FUNC "%8.6" "mg/stk" COEFFS 0 1 0 0 0 1 /end COMPU_METHOD
/begin COMPU_METHOD EcuIntgdSwGend_CM_single_L_km "Q = V" RAT_FUNC "%8.6" "L/km" COEFFS 0 1 0 0 0 1 /end COMPU_METHOD
/begin COMPU_METHOD EcuIntgdSwGend_CM_single_m "Q = V" RAT_FUNC "%8.6" "m" COEFFS 0 1 0 0 0 1 /end COMPU_METHOD
/begin COMPU_METHOD EcuIntgdSwGend_CM_single_km_L "Q = V" RAT_FUNC "%8.6" "km/L" COEFFS 0 1 0 0 0 1 /end COMPU_METHOD
/begin COMPU_METHOD EcuIntgdSwGend_CM_single_m_sec "Q = V" RAT_FUNC "%8.6" "m/sec" COEFFS 0 1 0 0 0 1 /end COMPU_METHOD
/begin COMPU_METHOD EcuIntgdSwGend_CM_SpeedLimiterMode "Enumerated data type: SpeedLimiterMode" TAB_VERB "%0.6" "" COMPU_TAB_REF VTAB_FOR_EcuIntgdSwGend_CM_SpeedLimiterMode /end COMPU_METHOD
/begin COMPU_VTAB VTAB_FOR_EcuIntgdSwGend_CM_SpeedLimiterMode "Enumerated data type: SpeedLimiterMode" TAB_VERB 4 0 "SpeedLimiterOff" 1 "SpeedLimiterIdle" 2 "SpeedLimiterOn" 3 "SpeedLimiterOnMaxSpeed" /end COMPU_VTAB
/begin GROUP S6_InjectionOutputs "EcuIntgdSwGend/ControlSoftware/EcuOutpPrcsg/InjectionOutputs"
 /begin REF_CHARACTERISTIC EOP_DurMaiInj1Ovs_P EOP_DurMaiInj1Ovv_P EOP_DurMaiInj2Ovs_P EOP_DurMaiInj2Ovv_P EOP_DurMaiInj3Ovs_P EOP_DurMaiInj3Ovv_P EOP_DurMaiInj4Ovs_P EOP_DurMaiInj4Ovv_P EOP_DurMaiInj5Ovs_P EOP_DurMaiInj5Ovv_P EOP_DurMaiInj6Ovs_P EOP_DurMaiInj6Ovv_P EOP_DurPltInj1Ovs_P EOP_DurPltInj1Ovv_P EOP_DurPltInj2Ovs_P EOP_DurPltInj2Ovv_P EOP_DurPltInj3Ovs_P EOP_DurPltInj3Ovv_P EOP_DurPltInj4Ovs_P EOP_DurPltInj4Ovv_P EOP_DurPltInj5Ovs_P EOP_DurPltInj5Ovv_P EOP_DurPltInj6Ovs_P EOP_DurPltInj6Ovv_P EOP_SoiMaiInj1Ovs_P EOP_SoiMaiInj1Ovv_P EOP_SoiMaiInj2Ovs_P EOP_SoiMaiInj2Ovv_P EOP_SoiMaiInj3Ovs_P EOP_SoiMaiInj3Ovv_P EOP_SoiMaiInj4Ovs_P EOP_SoiMaiInj4Ovv_P EOP_SoiMaiInj5Ovs_P EOP_SoiMaiInj5Ovv_P EOP_SoiMaiInj6Ovs_P EOP_SoiMaiInj6Ovv_P EOP_SoiPltInj1Ovs_P EOP_SoiPltInj1Ovv_P EOP_SoiPltInj2Ovs_P EOP_SoiPltInj2Ovv_P EOP_SoiPltInj3Ovs_P EOP_SoiPltInj3Ovv_P EOP_SoiPltInj4Ovs_P EOP_SoiPltInj4Ovv_P EOP_SoiPltInj5Ovs_P EOP_SoiPltInj5Ovv_P EOP_SoiPltInj6Ovs_P EOP_SoiPltInj6Ovv_P /end REF_CHARACTERISTIC
 /begin REF_MEASUREMENT EOP_DurMaiInj1 EOP_DurMaiInj2 EOP_DurMaiInj3 EOP_DurMaiInj4 EOP_DurMaiInj5 EOP_DurMaiInj6 EOP_DurPltInj1 EOP_DurPltInj2 EOP_DurPltInj3 EOP_DurPltInj4 EOP_DurPltInj5 EOP_DurPltInj6 EOP_SoiMaiInj1 EOP_SoiMaiInj2 EOP_SoiMaiInj3 EOP_SoiMaiInj4 EOP_SoiMaiInj5 EOP_SoiMaiInj6 EOP_SoiPltInj1 EOP_SoiPltInj2 EOP_SoiPltInj3 EOP_SoiPltInj4 EOP_SoiPltInj5 EOP_SoiPltInj6 /end REF_MEASUREMENT
/end GROUP
/begin GROUP S6_NvM_Signals_to_BSW "EcuIntgdSwGend/ControlSoftware/EcuOutpPrcsg/NvM Signals to BSW"
 /begin REF_CHARACTERISTIC EOP_DstTrvldInKmOvs_P EOP_DstTrvldInKmOvv_P EOP_EngHrOvs_P EOP_EngHrOvv_P EOP_FuCnsOvs_P EOP_FuCnsOvv_P EOP_TripOvs_P EOP_TripOvv_P /end REF_CHARACTERISTIC
 /begin REF_MEASUREMENT EOP_DstTrvldInKm EOP_EngHr EOP_FuCns EOP_Trip /end REF_MEASUREMENT
/end GROUP
/begin GROUP S6_Starter_Digital_Output "EcuIntgdSwGend/ControlSoftware/EcuOutpPrcsg/Starter Digital Output" /begin REF_CHARACTERISTIC EOP_bAcvStrtrOvs_P EOP_bAcvStrtrOvv_P /end REF_CHARACTERISTIC /begin REF_MEASUREMENT EOP_bAcvStrtr /end REF_MEASUREMENT /end GROUP
/begin GROUP S6_ValveOutputs "EcuIntgdSwGend/ControlSoftware/EcuOutpPrcsg/ValveOutputs"
 /begin REF_CHARACTERISTIC EG_NmrSng0_C EOP_DutyVlvReqOvs_P EOP_DutyVlvReqOvv_P EOP_DynRateVCVActvnSwt_P EOP_DynRateVCVLoLim_P EOP_DynRateVCVUpLim_P EOP_IRefPCVOvs_P EOP_IRefPCVOvv_P EOP_IRefPCV_M EOP_IRefVCV_M EOP_IVCVReqOvs_P EOP_IVCVReqOvv_P /end REF_CHARACTERISTIC
 /begin REF_MEASUREMENT EOP_DutyVlvReq EOP_IRefPCV EOP_IRefVCV EOP_VCVDynRateLimr EOP_VCVReq /end REF_MEASUREMENT
/end GROUP
/begin GROUP S7_Engine_Brake_Control "EcuIntgdSwGend/ControlSoftware/EngBrk/Engine Brake Control"
 /begin SUB_GROUP S396_Can_Message_and_Hardware_Check S396_Enable_Conditionals S396_Engine_Brake_Active S396_For_Calibration /end SUB_GROUP
/end GROUP
/begin GROUP S8_Calibration_Purpose "EcuIntgdSwGend/ControlSoftware/InjCtl/Calibration Purpose"
 /begin REF_CHARACTERISTIC IC_MMaiFuQntyCorrdOvs_P IC_MMaiFuQntyCorrdOvv_P IC_MMaiLimdHi_P IC_MMaiLimdLo_P IC_MPltFuQntyCorrdOvs_P IC_MPltFuQntyCorrdOvv_P IC_MPltLimdHi_P IC_MPltLimdLo_P /end REF_CHARACTERISTIC
 /begin REF_MEASUREMENT IC_MMaiFuQntyCorrd IC_MPltFuQntyCorrd /end REF_MEASUREMENT
/end GROUP
/begin GROUP S8_Cylinder_1 "EcuIntgdSwGend/ControlSoftware/InjCtl/Cylinder 1" /begin REF_MEASUREMENT IC_MMaiFuQntyCorrdCyl1 /end REF_MEASUREMENT /end GROUP
/begin GROUP S8_Cylinder_2 "EcuIntgdSwGend/ControlSoftware/InjCtl/Cylinder 2" /begin REF_MEASUREMENT IC_MMaiFuQntyCorrdCyl2 /end REF_MEASUREMENT /end GROUP
/begin GROUP S8_Cylinder_3 "EcuIntgdSwGend/ControlSoftware/InjCtl/Cylinder 3" /begin REF_MEASUREMENT IC_MMaiFuQntyCorrdCyl3 /end REF_MEASUREMENT /end GROUP
/begin GROUP S8_Cylinder_4 "EcuIntgdSwGend/ControlSoftware/InjCtl/Cylinder 4" /begin REF_MEASUREMENT IC_MMaiFuQntyCorrdCyl4 /end REF_MEASUREMENT /end GROUP
/begin GROUP S8_Cylinder_5 "EcuIntgdSwGend/ControlSoftware/InjCtl/Cylinder 5" /begin REF_MEASUREMENT IC_MMaiFuQntyCorrdCyl5 /end REF_MEASUREMENT /end GROUP
/begin GROUP S8_Cylinder_6 "EcuIntgdSwGend/ControlSoftware/InjCtl/Cylinder 6" /begin REF_MEASUREMENT IC_MMaiFuQntyCorrdCyl6 /end REF_MEASUREMENT /end GROUP
/begin GROUP S8_Cylinder_Balancing "EcuIntgdSwGend/ControlSoftware/InjCtl/Cylinder Balancing"
 /begin SUB_GROUP S409_Cylinder_Balancing_For_Cylinder_1 S409_Cylinder_Balancing_For_Cylinder_2 S409_Cylinder_Balancing_For_Cylinder_3 S409_Cylinder_Balancing_For_Cylinder_4 S409_Cylinder_Balancing_For_Cylinder_5 S409_Cylinder_Balancing_For_Cylinder_6 S409_Cylinder_Balancing_PID_Controllers_ /end SUB_GROUP
 /begin REF_CHARACTERISTIC EG_NmrSng1_C /end REF_CHARACTERISTIC
/end GROUP
/begin GROUP S8_Fuel_Consumption_Calculation "EcuIntgdSwGend/ControlSoftware/InjCtl/Fuel Consumption Calculation"
 /begin SUB_GROUP S410_LowPassFilter S410_LowPassFilter1 S410_LowPassFilter2 S410_avoidzerodivision_single3 S410_avoidzerodivision_single4 S410_avoidzerodivision_single5 /end SUB_GROUP
 /begin REF_CHARACTERISTIC EG_NmrSng0_C EG_NmrSng1_C EG_TsSw_C IC_CnvnHtoSec_P IC_CnvnInstFuCnsLtPerHourToSec_P IC_CnvnKmtoM_C IC_CnvnMTotFuQntyCorrdToInstFuCnsLtPerHour_P IC_CnvnMtoKm_C IC_DstToEmptyOvs_P IC_DstToEmptyOvv_P IC_FuCnsAveOvs_P IC_FuCnsAveOvv_P IC_FuCnsOvs_P IC_FuCnsOvv_P IC_FuInTank_M IC_HundKm_C IC_IntglRst_P IC_PercgAccrForFuCns_P IC_TcDstToEmptyFil_P IC_TcFuCnsAveFil_P IC_TcFuCnsFil_P IC_VehVThdForFuCns_P /end REF_CHARACTERISTIC
 /begin REF_MEASUREMENT IC_CnvnDstMtoKm IC_CnvnInstFuCnsLtPerHourToSec IC_CnvnKmHtoMSec IC_CnvnKmtoM IC_DstCalcn IC_DstToEmpty IC_FuCns IC_FuCnsAve IC_FuInTank IC_InstFuCnsLtPerHour IC_InstFuCnsLtPerHundKm IC_InstLtPerKm IC_KmPerLt IC_LtPerKm IC_Trip /end REF_MEASUREMENT
/end GROUP
/begin GROUP S8_Main_Injector_Characteristic_Maps "EcuIntgdSwGend/ControlSoftware/InjCtl/Main Injector Characteristic Maps"
 /begin SUB_GROUP S412_Injector_1_Characteristic S412_Injector_1_Characteristic_Calibration_ S412_Injector_2_Characteristic S412_Injector_2_Characteristic_Calibration_ S412_Injector_3_Characteristic S412_Injector_3_Characteristic_Calibration_ S412_Injector_4_Characteristic S412_Injector_4_Characteristic_Calibration_ S412_Injector_5_Characteristic S412_Injector_5_Characteristic_Calibration_ S412_Injector_6_Characteristic S412_Injector_6_Characteristic_Calibration /end SUB_GROUP
 /begin REF_CHARACTERISTIC IC_DurMaiCyl1BalOvs_P IC_DurMaiCyl1BalOvv_P IC_DurMaiCyl2BalOvs_P IC_DurMaiCyl2BalOvv_P IC_DurMaiCyl3BalOvs_P IC_DurMaiCyl3BalOvv_P IC_DurMaiCyl4BalOvs_P IC_DurMaiCyl4BalOvv_P IC_DurMaiCyl5BalOvs_P IC_DurMaiCyl5BalOvv_P IC_DurMaiCyl6BalOvs_P IC_DurMaiCyl6BalOvv_P IC_DurMaiLimdHi_P IC_DurMaiLimdLo_P IC_NoInjCodeForInj1_P IC_NoInjCodeForInj2_P IC_NoInjCodeForInj3_P IC_NoInjCodeForInj4_P IC_NoInjCodeForInj5_P IC_NoInjCodeForInj6_P /end REF_CHARACTERISTIC
 /begin REF_MEASUREMENT IC_DurMaiInjCyl1 IC_DurMaiInjCyl2 IC_DurMaiInjCyl3 IC_DurMaiInjCyl4 IC_DurMaiInjCyl5 IC_DurMaiInjCyl6 /end REF_MEASUREMENT
/end GROUP
/begin GROUP S8_Pilot_Injector_Characteristic_Maps "EcuIntgdSwGend/ControlSoftware/InjCtl/Pilot Injector Characteristic Maps"
 /begin SUB_GROUP S413_Duration_Injection_1_Pre S413_Duration_Injection_2_Pre S413_Duration_Injection_3_Pre S413_Duration_Injection_4_Pre S413_Duration_Injection_5_Pre S413_Duration_Injection_6_Pre S413__Injector_1_Characteristic S413__Injector_1_Characteristic_Calibration S413__Injector_2_Characteristic S413__Injector_2_Characteristic_Calibration S413__Injector_3_Characteristic S413__Injector_3_Characteristic_Calibration S413__Injector_4_Characteristic S413__Injector_4_Characteristic_Calibration S413__Injector_5_Characteristic S413__Injector_5_Characteristic_Calibration S413__Injector_6_Characteristic S413__Injector_6_Characteristic_Calibration /end SUB_GROUP
 /begin REF_CHARACTERISTIC EG_NmrSng0_C IC_DurPltInj1PreOvs_P IC_DurPltInj1PreOvv_P IC_DurPltInj2PreOvs_P IC_DurPltInj2PreOvv_P IC_DurPltInj3PreOvs_P IC_DurPltInj3PreOvv_P IC_DurPltInj4PreOvs_P IC_DurPltInj4PreOvv_P IC_DurPltInj5PreOvs_P IC_DurPltInj5PreOvv_P IC_DurPltInj6PreOvs_P IC_DurPltInj6PreOvv_P IC_DurPltLimdHi_P IC_DurPltLimdLo_P IC_NoInjCodeForInj1_P IC_NoInjCodeForInj2_P IC_NoInjCodeForInj3_P IC_NoInjCodeForInj4_P IC_NoInjCodeForInj5_P IC_NoInjCodeForInj6_P /end REF_CHARACTERISTIC
 /begin REF_MEASUREMENT IC_MaxDurPltInjPre /end REF_MEASUREMENT
/end GROUP
/begin GROUP S8_Pre_Injection_Shadowing "EcuIntgdSwGend/ControlSoftware/InjCtl/Pre Injection Shadowing"
 /begin REF_CHARACTERISTIC EG_CnvRpm2SecPerDeg_C EG_CnvnFromMicrosToSec_C IC_OfsPlt2MaiInj_M IC_bAcvPltAllwdOvs_P IC_bAcvPltAllwdOvv_P /end REF_CHARACTERISTIC
 /begin REF_MEASUREMENT IC_DegPltInj IC_SoiPltInjForPltAllwd IC_bAcvPltAllwd /end REF_MEASUREMENT
/end GROUP
/begin GROUP S8_Start_of_Injection_Angle_for_Pilot_and_Main_Injection "EcuIntgdSwGend/ControlSoftware/InjCtl/Start of Injection Angle for Pilot and Main Injection"
 /begin SUB_GROUP S415_Main_SOI_Reference_Calculation S415_Pilot_SOI_Reference_Calculation /end SUB_GROUP
/end GROUP
/begin GROUP S9_Grid_Heater_Activation "EcuIntgdSwGend/ControlSoftware/PrhtgCtl/Grid Heater Activation" /begin SUB_GROUP S545_SetRstLtch /end SUB_GROUP
 /begin REF_CHARACTERISTIC PHC_NmrSng0_C PHC_bAcvGridHeatrOvs_P PHC_bAcvGridHeatrOvv_P /end REF_CHARACTERISTIC
 /begin REF_MEASUREMENT PHC_bAcvGridHeatr /end REF_MEASUREMENT
/end GROUP
/begin GROUP S9_Grid_Heater_Activation_After_Starter "EcuIntgdSwGend/ControlSoftware/PrhtgCtl/Grid Heater Activation After Starter"
 /begin SUB_GROUP S546_CompRstTmr S546_Neg_Edge S546_Pos_Edge S546_SetRstLtch /end SUB_GROUP
 /begin REF_CHARACTERISTIC EG_NmrSng0_C EG_TsSw_C PHC_NEngPostAcvnGridHeatr_P PHC_StUsrForTiPreHeatg_P PHC_TiAcvnGridHeatr_M PHC_TiAftrAcvnGridHeatrForSnsrErr_P PHC_bAcvPostGridHeatrOvs_P PHC_bAcvPostGridHeatrOvv_P /end REF_CHARACTERISTIC
 /begin REF_MEASUREMENT PHC_TiMaxAftrStrtr PHC_TiTCooltPreHeatrCorr PHC_bAcvPostAcvnGridHeatr PHC_bAcvPostAcvnGridHeatrTiEna /end REF_MEASUREMENT
/end GROUP
/begin GROUP S9_Grid_Heater_Activation_Before_Starter "EcuIntgdSwGend/ControlSoftware/PrhtgCtl/Grid Heater Activation Before Starter"
 /begin SUB_GROUP S547_CompRstTmr S547_Neg_Edge1 S547_Neg_Edge2 S547_Pos_Edge S547_SetRstLtch /end SUB_GROUP
 /begin REF_CHARACTERISTIC EG_NmrSng0_C EG_TsSw_C PHC_StUsrForTiPreHeatg_P PHC_TiPreAcvnGridHeatrForSnsrErr_P PHC_TiPreHeatg_M PHC_bAcvPreAcvnGridHeatrOvs_P PHC_bAcvPreAcvnGridHeatrOvv_P /end REF_CHARACTERISTIC
 /begin REF_MEASUREMENT PHC_TiMaxBfrStrtr PHC_TiPreHeatg PHC_bAcvPreAcvnGridHeatr PHC_bAcvPreAcvnGridHeatrTiEna PHC_bTiDisaPreAcvnGridHeatr /end REF_MEASUREMENT
/end GROUP
/begin GROUP S9_Grid_Heater_Fault "EcuIntgdSwGend/ControlSoftware/PrhtgCtl/Grid Heater Fault"
 /begin SUB_GROUP S548_Debouncer S548_Debouncer1 S548_SetRstLtch1 S548_SetRstLtch2 /end SUB_GROUP
 /begin REF_CHARACTERISTIC EG_NmrSng0_C EG_TsSw_C PHC_GridHeatrRlyFbOffStsThd_P PHC_GridHeatrRlyFbOnStsThd_P PHC_TiGridHeatErrOfStsDeb_P PHC_TiGridHeatErrOnStsDeb_P PHC_bErrAcvGridHeatrOvs_P PHC_bErrAcvGridHeatrOvv_P /end REF_CHARACTERISTIC
 /begin REF_MEASUREMENT PHC_bErrAcvGridHeatr /end REF_MEASUREMENT
/end GROUP
/begin GROUP S10_Cabin_PTO "EcuIntgdSwGend/ControlSoftware/PtoCtrl/Cabin PTO" /begin SUB_GROUP S563_Pos_Edge /end SUB_GROUP
 /begin REF_CHARACTERISTIC EG_TsSw_C EG_bFlgFalse_C EG_bFlgTrue_C PtoCtrl_HndBrkPrkgActv_C PtoCtrl_IdxGearNeut_C PtoCtrl_LongPsdTiThd_P PtoCtrl_LowrNEngThdForCabPto_P PtoCtrl_LowrVehVForCabPto_P PtoCtrl_NEngForCabPto_P PtoCtrl_NEngLongPsd_P PtoCtrl_NEngMaxSpd_P PtoCtrl_NEngShoPsd_P PtoCtrl_ShoPsdTiThd_P PtoCtrl_UpprNEngThdForCabPto_P PtoCtrl_UpprVehVForCabPto_P PtoCtrl_bAcvCabPtoOvs_P PtoCtrl_bAcvCabPtoOvv_P PtoCtrl_bAcvHndBrkPrkg_P PtoCtrl_bAcvTrsmCurrentGear_P /end REF_CHARACTERISTIC
 /begin REF_MEASUREMENT PtoCtrl_HndBrkPrkg PtoCtrl_NEngTargetSpd PtoCtrl_TrsmCurrentGear PtoCtrl_bAcvCabPto /end REF_MEASUREMENT
/end GROUP
/begin GROUP S10_Can_Message_and_Hardware_Check "EcuIntgdSwGend/ControlSoftware/PtoCtrl/Can Message and Hardware Check"
 /begin REF_CHARACTERISTIC EG_VldInpSt_C PtoCtrl_ActvCanEngPtoGovrAccrSwt_C PtoCtrl_ActvCanEngPtoGovrCoastSwt_C PtoCtrl_ActvCanEngPtoGovrEnaSwt_C PtoCtrl_ActvCanEngRemPtoGovrProgdSpdCtrlSwt_C PtoCtrl_bAcvCabPtoCanOrDigInpOvs_P /end REF_CHARACTERISTIC
 /begin REF_MEASUREMENT PtoCtrl_bAcvCabPtoAccrSwt PtoCtrl_bAcvCabPtoCoastSwt PtoCtrl_bAcvCabPtoOnOff PtoCtrl_bAcvRemPtoAccrSwt PtoCtrl_bAcvRemPtoCoastSwt PtoCtrl_bAcvRemPtoSpdCtrlSwt PtoCtrl_bErrCabPtoAccrSwt PtoCtrl_bErrCabPtoCoastSwt PtoCtrl_bErrCabPtoOnOff PtoCtrl_bErrRemPtoAccrSwt PtoCtrl_bErrRemPtoCoastSwt PtoCtrl_bErrRemPtoSpdCtrlSwt /end REF_MEASUREMENT
/end GROUP
/begin GROUP S10_PTO_Governor_State "EcuIntgdSwGend/ControlSoftware/PtoCtrl/PTO Governor State" /begin REF_CHARACTERISTIC PtoCtrl_NotAvlAcv_P /end REF_CHARACTERISTIC /begin REF_MEASUREMENT PtoCtrl_CanPtoGovrSt /end REF_MEASUREMENT /end GROUP
/begin GROUP S10_PTO_PID "EcuIntgdSwGend/ControlSoftware/PtoCtrl/PTO PID" /begin SUB_GROUP S566_PID_Controller /end SUB_GROUP
 /begin REF_CHARACTERISTIC PtoCtrl_CoeffDForPto_M PtoCtrl_CoeffFiltForPto_M PtoCtrl_CoeffIForPto_M PtoCtrl_CoeffPForPto_M PtoCtrl_FacSclPIDCoeff_P PtoCtrl_PIDCoeffDOvs_P PtoCtrl_PIDCoeffDOvv_P PtoCtrl_PIDCoeffFiltOvs_P PtoCtrl_PIDCoeffFiltOvv_P PtoCtrl_PIDCoeffIOvs_P PtoCtrl_PIDCoeffIOvv_P PtoCtrl_PIDCoeffPOvs_P PtoCtrl_PIDCoeffPOvv_P PtoCtrl_PIDMaxForCabPto_P PtoCtrl_PIDMaxForRemPto_P PtoCtrl_PIDMinForCabPto_P PtoCtrl_PIDMinForRemPto_P PtoCtrl_PtoCtrlFF_M /end REF_CHARACTERISTIC
 /begin REF_MEASUREMENT PtoCtrl_CoeffDMapOut PtoCtrl_CoeffFiltMapOut PtoCtrl_CoeffIMapOut PtoCtrl_CoeffPMapOut PtoCtrl_ErrNEngRef PtoCtrl_PIDCoeffD PtoCtrl_PIDCoeffFilt PtoCtrl_PIDCoeffI PtoCtrl_PIDCoeffP PtoCtrl_PIDMax PtoCtrl_PIDMin PtoCtrl_PtoCtrlFF /end REF_MEASUREMENT
/end GROUP
/begin GROUP S10_Remote_PTO "EcuIntgdSwGend/ControlSoftware/PtoCtrl/Remote PTO" /begin SUB_GROUP S568_Pos_Edge1 S568_Pos_Edge3 /end SUB_GROUP
 /begin REF_CHARACTERISTIC EG_bFlgFalse_C EG_bFlgTrue_C PtoCtrl_HndBrkPrkgActv_C PtoCtrl_IdxGearNeut_C PtoCtrl_LowrNEngThdForRemPto_P PtoCtrl_LowrVehVForRemPto_P PtoCtrl_NEngSetSpd1_P PtoCtrl_NEngSetSpd2_P PtoCtrl_NEngSetSpd3_P PtoCtrl_NEngSetSpd4_P PtoCtrl_NEngSetSpd5_P PtoCtrl_UpprNEngThdForRemPto_P PtoCtrl_UpprVehVForRemPto_P PtoCtrl_bAcvHndBrkPrkgForRemPto_P PtoCtrl_bAcvRemPtoOvs_P PtoCtrl_bAcvRemPtoOvv_P PtoCtrl_bAcvTrsmCurrentGearForRemPto_P /end REF_CHARACTERISTIC
 /begin REF_MEASUREMENT PtoCtrl_HndBrkPrkgForRemPto PtoCtrl_NEngTargetSpdRemPto PtoCtrl_StTargetSpdForPtoGovr PtoCtrl_TrsmCurrentGearForRemPto PtoCtrl_bAcvRemPto /end REF_MEASUREMENT
/end GROUP
/begin GROUP S11_Pressure_Control_Valve "EcuIntgdSwGend/ControlSoftware/RailPGovr/Pressure Control Valve"
 /begin REF_CHARACTERISTIC RPG_OfsPRailRefForPCV_P RPG_PRailRefForPCVOvs_P RPG_PRailRefForPCVOvv_P RPG_PRailRefForPCVPwrOnCtlMod_P RPG_PRailRefForPCVStpCtlMod_P /end REF_CHARACTERISTIC
 /begin REF_MEASUREMENT RPG_PRailRefForPCV /end REF_MEASUREMENT
/end GROUP
/begin GROUP S11_Rail_Pressure_Control_FeedForward_Map_ "EcuIntgdSwGend/ControlSoftware/RailPGovr/Rail Pressure Control FeedForward Map "
 /begin SUB_GROUP S582_avoidzerodivision_single S582_avoidzerodivision_single1 /end SUB_GROUP
 /begin REF_CHARACTERISTIC RPG_FFLeakgSetPointOvs_P RPG_FFLeakgSetPointOvv_P RPG_PercgVolCtrlVlvFFLeakg1_M RPG_PercgVolCtrlVlvFFLeakg2_M RPG_PercgVolCtrlVlvFFLeakg3_M RPG_TCooltFFLeakgMap1Thd_P RPG_TCooltFFLeakgMap2Thd_P RPG_TCooltFFLeakgMap3Thd_P /end REF_CHARACTERISTIC
 /begin REF_MEASUREMENT RPG_FFLeakgSetPoint RPG_FFLeakgSetPoint1to2Intp RPG_FFLeakgSetPoint2to3Intp RPG_PercgVolCtrlVlvFFLeakgMap1 RPG_PercgVolCtrlVlvFFLeakgMap2 RPG_PercgVolCtrlVlvFFLeakgMap3 /end REF_MEASUREMENT
/end GROUP
/begin GROUP S11_Rail_Pressure_PID_Controller "EcuIntgdSwGend/ControlSoftware/RailPGovr/Rail Pressure PID Controller" /begin SUB_GROUP S583_VCV_Opening_Percentage_PID_Controller /end SUB_GROUP
 /begin REF_CHARACTERISTIC RPG_CoeffDForPRailCtl_M RPG_CoeffFiltForPRailCtl_M RPG_CoeffIForPRailCtl_M RPG_CoeffPForPRailCtl_M RPG_FacSclPIDCoeff_P RPG_PIDCoeffDOvs_P RPG_PIDCoeffDOvv_P RPG_PIDCoeffFiltOvs_P RPG_PIDCoeffFiltOvv_P RPG_PIDCoeffIOvs_P RPG_PIDCoeffIOvv_P RPG_PIDCoeffPOvs_P RPG_PIDCoeffPOvv_P RPG_PIDMax_P RPG_PIDMin_P /end REF_CHARACTERISTIC
 /begin REF_MEASUREMENT RPG_CoeffDForPRailCtlMapOut RPG_CoeffFiltForPRailCtlMapOut RPG_CoeffIForPRailCtlMapOut RPG_CoeffPForPRailCtlMapOut RPG_ErrPRail RPG_PIDCoeffD RPG_PIDCoeffFilt RPG_PIDCoeffI RPG_PIDCoeffP /end REF_MEASUREMENT
/end GROUP
/begin GROUP S11_Rail_Pressure_Reference_Calculation "EcuIntgdSwGend/ControlSoftware/RailPGovr/Rail Pressure Reference Calculation"
 /begin SUB_GROUP S584_Debouncer S584_N_Map_Interpolation_for_Rail_Pressure_Reference /end SUB_GROUP
 /begin REF_CHARACTERISTIC EG_NmrSng0_C EG_TsSw_C RPG_NEngThdAcvnPRailCorr_P RPG_PAmbAirCorrForPRail_M RPG_PRailCorrPAmbAir_M RPG_PRailLimdHi_P RPG_PRailLimdLo_P RPG_PRailRefNotCorrdOvs_P RPG_TCorrForPRail_M RPG_TiDebAcvnPRailCorr_P RPG_bAcvTCorrForPRail_P /end REF_CHARACTERISTIC
 /begin REF_MEASUREMENT RPG_PRailCorrPAmbAir RPG_PRailRefNotCorrd RPG_PRailSetpointCorr RPG_TCorrForPRail RPG_bNEngThdAcvnPRail /end REF_MEASUREMENT
/end GROUP
/begin GROUP S11_VCV_Valve_Control "EcuIntgdSwGend/ControlSoftware/RailPGovr/VCV Valve Control"
 /begin REF_CHARACTERISTIC RPG_PercgLowrLim_P RPG_PercgUpprLim_P RPG_PercgVCVPwrOnCtlMod_P RPG_PercgVCVReqOvs_P RPG_PercgVCVReqOvv_P RPG_PercgVCVStpCtlMod_P /end REF_CHARACTERISTIC
 /begin REF_MEASUREMENT RPG_PercgVCVReq RPG_PercgVCVReqPreSat /end REF_MEASUREMENT
/end GROUP
/begin GROUP S12_Can_Message_and_Hardware_Check "EcuIntgdSwGend/ControlSoftware/SpdLimr/Can Message and Hardware Check"
 /begin REF_CHARACTERISTIC EG_VldInpSt_C SpdLimr_ActvCanOrDigInEva_P SpdLimr_ActvCanSpdLimrEnaSwt_C SpdLimr_ActvCanSpdLimrResuSwt_C SpdLimr_ActvCanSpdLimrSetSwt_C /end REF_CHARACTERISTIC
 /begin REF_MEASUREMENT SpdLimr_ActvSpdLimrDecBtn SpdLimr_ActvSpdLimrInctBtn SpdLimr_ActvSpdLimrOnOffBtn SpdLimr_ErrSpdLimrDecBtn SpdLimr_ErrSpdLimrInctBtn SpdLimr_ErrSpdLimrOnOffBtn /end REF_MEASUREMENT
/end GROUP
/begin GROUP S12_Engine_Brake_Activation_Via_Speed_Limiter "EcuIntgdSwGend/ControlSoftware/SpdLimr/Engine Brake Activation Via Speed Limiter"
 /begin SUB_GROUP S599_Debouncer S599_Debouncer1 S599_SetRstLtch1 S599_SetRstLtch2 /end SUB_GROUP
 /begin REF_CHARACTERISTIC EG_NmrSng0_C EG_TsSw_C SpdLimr_EngBrkLvl0_C SpdLimr_EngBrkLvl1ActvnThd_P SpdLimr_EngBrkLvl1DeactvnThd_P SpdLimr_EngBrkLvl1_C SpdLimr_EngBrkLvl2ActvnThd_P SpdLimr_EngBrkLvl2DeactvnThd_P SpdLimr_EngBrkLvl2_C SpdLimr_TiEngBrkLvl1ActvnDeb_P SpdLimr_TiEngBrkLvl2ActvnDeb_P /end REF_CHARACTERISTIC
 /begin REF_MEASUREMENT SpdLimr_EngBrkLvl /end REF_MEASUREMENT
/end GROUP
/begin GROUP S12_Speed_Limiter "EcuIntgdSwGend/ControlSoftware/SpdLimr/Speed Limiter" /begin SUB_GROUP S600_Pos_Edge /end SUB_GROUP
 /begin REF_CHARACTERISTIC EG_TsSw_C SpdLimr_ErrVehVEva_P SpdLimr_ErrVehVNotActv_C SpdLimr_LongPsdTiThd_P SpdLimr_MaxTarSpd_P SpdLimr_MaxVehSpdHys_P SpdLimr_MaxVehSpd_P SpdLimr_MinTarSpd_P SpdLimr_ShoPsdTiThd_P SpdLimr_VehVLongPsd_P SpdLimr_VehVShoPsd_P /end REF_CHARACTERISTIC
 /begin REF_MEASUREMENT EcuIntgdSwGend_DW.tp_ButtonIdle SpdLimr_ActvSpdLimr SpdLimr_ErrSpdLimrBtn SpdLimr_ErrVehV SpdLimr_SpdLimrModSt SpdLimr_TarSpd SpdLimr_TarSpdPre /end REF_MEASUREMENT
/end GROUP
/begin GROUP S12_Speed_Limiter_PID "EcuIntgdSwGend/ControlSoftware/SpdLimr/Speed Limiter PID" /begin SUB_GROUP S601_SpeedLimiterPIDController /end SUB_GROUP
 /begin REF_CHARACTERISTIC SpdLimr_SpdLimrOnMaxSpd_C SpdLimr_SpdLimrOn_C SpdLimr_SpdLimrTq_P /end REF_CHARACTERISTIC
 /begin REF_MEASUREMENT SpdLimr_ErrVehVRef SpdLimr_SpdLimrTq /end REF_MEASUREMENT
/end GROUP
/begin GROUP S13_Enabling___Disabling_Starter "EcuIntgdSwGend/ControlSoftware/StrtrCtl/Enabling & Disabling Starter"
 /begin SUB_GROUP S613_Debouncer S613_Debouncer1 S613_Debouncer2 S613_SetRstLtch /end SUB_GROUP
 /begin REF_CHARACTERISTIC EG_NmrSng0_C EG_TsSw_C SC_NEngRunDeacThd_P SC_NEngStrtrInhThd_P SC_TiDebEngAlrdyRunngThd_P SC_TiDebNEngRunAcvn_P SC_TiDebNEngRunDeac_P /end REF_CHARACTERISTIC
 /begin REF_MEASUREMENT SC_NEngRunDeacThd SC_NEngStrtrInhThd SC_bAcvEngAlrdyRunng SC_bEnaAcvnStrtr /end REF_MEASUREMENT
/end GROUP
/begin GROUP S13_Maximum_Allowable_Cranking_Time_Calculation "EcuIntgdSwGend/ControlSoftware/StrtrCtl/Maximum Allowable Cranking Time Calculation" /begin SUB_GROUP S614_CompRstTmr S614_Neg_Edge /end SUB_GROUP
 /begin REF_CHARACTERISTIC SC_StUsrForAllwblCrnkg_P SC_TiMaxAllwblCrnkgOvs_P SC_TiMaxAllwblCrnkgOvv_P SC_TiMaxAllwblCrnkg_M SC_bAcvStrtrOvs_P SC_bAcvStrtrOvv_P /end REF_CHARACTERISTIC
 /begin REF_MEASUREMENT SC_TiMaxAllwblCrnkg SC_bAcvStrtr SC_bEnaAcvnStrtrTiEna /end REF_MEASUREMENT
/end GROUP
/begin GROUP S13_Start_Error_Detect_Algorithms_ "EcuIntgdSwGend/ControlSoftware/StrtrCtl/Start Error Detect Algorithms " /begin SUB_GROUP S615_Engine_Not_Turn S615_Engine_Over_Heating_Protection /end SUB_GROUP /begin REF_CHARACTERISTIC SC_bAcvDisStrtOvs_P SC_bAcvDisStrtOvv_P /end REF_CHARACTERISTIC /begin REF_MEASUREMENT SC_bAcvDisStrt /end REF_MEASUREMENT /end GROUP
/begin GROUP S13_StartInhibitor "EcuIntgdSwGend/ControlSoftware/StrtrCtl/StartInhibitor"
 /begin SUB_GROUP S616_Electrical_Failure_Dependent_Sensor_Inhibitor S616_Sensor_Inhibitor /end SUB_GROUP
 /begin REF_CHARACTERISTIC EG_bFlgFalse_C SC_bInhEngStrtOvs_P SC_bInhEngStrtOvv_P /end REF_CHARACTERISTIC
 /begin REF_MEASUREMENT SC_bInhEngStrt /end REF_MEASUREMENT
/end GROUP
/begin GROUP S13_Starter_Locking "EcuIntgdSwGend/ControlSoftware/StrtrCtl/Starter Locking" /begin SUB_GROUP S617_Debouncer S617_Neg_Edge S617_SetRstLtch /end SUB_GROUP
 /begin REF_CHARACTERISTIC EG_NmrSng0_C EG_TsSw_C SC_NEngAcvStrtLock_P SC_TiDebNEngAcvStrtLock_P SC_bAcvStrtrLockOvs_P SC_bAcvStrtrLockOvv_P /end REF_CHARACTERISTIC
 /begin REF_MEASUREMENT SC_NEngAcvStrtLock SC_bAcvStrtrLock /end REF_MEASUREMENT
/end GROUP
/begin GROUP S14_Desired_Torque_Calculation_CAN_Signals "EcuIntgdSwGend/ControlSoftware/TqCnvn/Desired Torque Calculation CAN Signals" /begin REF_CHARACTERISTIC EG_NmrSng100_C TrC_FuQntyToTq_M /end REF_CHARACTERISTIC /begin REF_MEASUREMENT TrC_ActEngPercTq TrC_ActEngTq /end REF_MEASUREMENT /end GROUP
/begin GROUP S14_Main_Quantity_Correction "EcuIntgdSwGend/ControlSoftware/TqCnvn/Main Quantity Correction"
 /begin REF_CHARACTERISTIC TrC_MaiFuPAmbAirCorr_M TrC_MaiFuTAirBoostCorr_M TrC_MaiFuTAmbAirCorr_M TrC_MaiFuTCooltCorr_M TrC_MaiFuTOilCorr_M TrC_MaiFuUClmp30Corr_M /end REF_CHARACTERISTIC
 /begin REF_MEASUREMENT TrC_MMaiFuQntyCorrPAmbAir TrC_MMaiFuQntyCorrTAirBoost TrC_MMaiFuQntyCorrTAmbAir TrC_MMaiFuQntyCorrTCoolt TrC_MMaiFuQntyCorrTOil TrC_MMaiFuQntyCorrUClmp30 TrC_MMaiFuQntyCorrd /end REF_MEASUREMENT
/end GROUP
/begin GROUP S14_N_Map_Interpolation_for_Main_Quantity "EcuIntgdSwGend/ControlSoftware/TqCnvn/N-Map Interpolation for Main Quantity"
 /begin SUB_GROUP S643_avoidzerodivision_single S643_avoidzerodivision_single1 /end SUB_GROUP
 /begin REF_CHARACTERISTIC TrC_MMaiFuQnty1_M TrC_MMaiFuQnty2_M TrC_MMaiFuQnty3_M TrC_MMaiFuQntyOvs_P TrC_MMaiFuQntyOvv_P TrC_TCooltMap1Thd_P TrC_TCooltMap2Thd_P TrC_TCooltMap3Thd_P /end REF_CHARACTERISTIC
 /begin REF_MEASUREMENT TrC_MMaiFuQnty1To2Intp TrC_MMaiFuQnty2To3Intp TrC_MMaiFuQntyFromMap1 TrC_MMaiFuQntyFromMap2 TrC_MMaiFuQntyFromMap3 TrC_MMaiFuQntyPre /end REF_MEASUREMENT
/end GROUP
/begin GROUP S14_N_Map_Interpolation_for_Pre_Quantity "EcuIntgdSwGend/ControlSoftware/TqCnvn/N-Map Interpolation for Pre Quantity"
 /begin SUB_GROUP S644_avoidzerodivision_single S644_avoidzerodivision_single1 /end SUB_GROUP
 /begin REF_CHARACTERISTIC TrC_MPltFuQnty1_M TrC_MPltFuQnty2_M TrC_MPltFuQnty3_M TrC_MPltFuQntyOvs_P TrC_MPltFuQntyOvv_P TrC_TCooltMap1Thd_P TrC_TCooltMap2Thd_P TrC_TCooltMap3Thd_P /end REF_CHARACTERISTIC
 /begin REF_MEASUREMENT TrC_MPltFuQnty TrC_MPltFuQnty1To2Intp TrC_MPltFuQnty2To3Intp TrC_MPltFuQntyFromMap1 TrC_MPltFuQntyFromMap2 TrC_MPltFuQntyFromMap3 /end REF_MEASUREMENT
/end GROUP
/begin GROUP S14_Pilot_Quantity_Correction "EcuIntgdSwGend/ControlSoftware/TqCnvn/Pilot Quantity Correction"
 /begin REF_CHARACTERISTIC TrC_MPltFuPAmbAirCorr_M TrC_MPltFuTAirBoostCorr_M TrC_MPltFuTAmbAirCorr_M TrC_MPltFuTCooltCorr_M TrC_MPltFuTOilCorr_M TrC_MPltFuUClmp30Corr_M /end REF_CHARACTERISTIC
 /begin REF_MEASUREMENT TrC_MPltFuQntyCorr TrC_MPltFuQntyCorrPAmbAir TrC_MPltFuQntyCorrTAirBoost TrC_MPltFuQntyCorrTAmbAir TrC_MPltFuQntyCorrTCoolt TrC_MPltFuQntyCorrTOil TrC_MPltFuQntyCorrUClmp30 /end REF_MEASUREMENT
/end GROUP
/begin GROUP S14_Smoke_Limitation "EcuIntgdSwGend/ControlSoftware/TqCnvn/Smoke Limitation"
 /begin SUB_GROUP S646_avoidzerodivision_single S646_avoidzerodivision_single1 S646_avoidzerodivision_single2 S646_saturation /end SUB_GROUP
 /begin REF_CHARACTERISTIC EG_CnvnMm3ToMg_C EG_NmrSng2_C TrC_CnvnKgDivideSecToMgDivideMin_C TrC_InjrCfg4Cyl_C TrC_InjrCfg6Cyl_C TrC_RatAirFuMax_P TrC_RatAirFuMin_P TrC_RatAirFuSmokLim_M TrC_SmokeLimOvs_P /end REF_CHARACTERISTIC
 /begin REF_MEASUREMENT TrC_CdnSmokeLim TrC_MAirPerStr TrC_MMaiFuQntyLimd TrC_MMaiFuQntySmokLimd TrC_RatAirFuSmokLim /end REF_MEASUREMENT
/end GROUP
/begin GROUP S15_Engine_Protection "EcuIntgdSwGend/ControlSoftware/TqLim/Engine Protection"
 /begin SUB_GROUP S655_Torque_Limitation_For_Fuel_Temperature S655_Torque_Limitation_for_Air_Temperature S655_Torque_Limitation_for_Ambient_Air_Pressure S655_Torque_Limitation_for_Coolant_Temperature S655_Torque_Limitation_for_Intake_Air_Pressure S655_Torque_Limitation_for_Oil_Temperature S655_Torque_Limitation_for_Surge_Protection S655_Torque_Limitation_for_Turbo_Charge_Speed /end SUB_GROUP
 /begin REF_CHARACTERISTIC TL_TqLimdForNExhTrbChrgOvs_P TL_TqLimdForNExhTrbChrgOvv_P TL_TqLimdForPAirAmbOvs_P TL_TqLimdForPAirAmbOvv_P TL_TqLimdForPAirBoostOvs_P TL_TqLimdForPAirBoostOvv_P TL_TqLimdForSurgeOvs_P TL_TqLimdForSurgeOvv_P TL_TqLimdForTAirOvs_P TL_TqLimdForTAirOvv_P TL_TqLimdForTCooltOvs_P TL_TqLimdForTCooltOvv_P TL_TqLimdForTFuOvs_P TL_TqLimdForTFuOvv_P TL_TqLimdForTOilOvs_P TL_TqLimdForTOilOvv_P TL_TqMapLimdEngProtnOvs_P TL_TqMapLimdEngProtnOvv_P /end REF_CHARACTERISTIC
 /begin REF_MEASUREMENT TL_TqLimdForNExhTrbChrg TL_TqLimdForPAirAmb TL_TqLimdForPAirBoost TL_TqLimdForSurge TL_TqLimdForTAir TL_TqLimdForTCoolt TL_TqLimdForTFu TL_TqLimdForTOil TL_TqMapLimdEngProtn /end REF_MEASUREMENT
/end GROUP
/begin GROUP S15_Indicated_Torque_Limitation "EcuIntgdSwGend/ControlSoftware/TqLim/Indicated Torque Limitation"
 /begin REF_CHARACTERISTIC EG_ModEngCtlIdleSpd_C EG_ModEngCtlStrt_C TL_TqActvEngBrk_C TL_TqShtdwn_C /end REF_CHARACTERISTIC
 /begin REF_MEASUREMENT TL_TqIndcdLimd TL_TqIndcdLimdSwtOut TL_TqIndcdLimdSwtOut2 /end REF_MEASUREMENT
/end GROUP
/begin GROUP S15_Limp_Mode_Limitation "EcuIntgdSwGend/ControlSoftware/TqLim/Limp Mode Limitation" /begin REF_CHARACTERISTIC TL_TqLimp_M /end REF_CHARACTERISTIC /begin REF_MEASUREMENT TL_TqLimnLimp TL_TqLimpMapOut /end REF_MEASUREMENT /end GROUP
/begin GROUP S15_Rate_Limiter_for_Factor_Limitation "EcuIntgdSwGend/ControlSoftware/TqLim/Rate Limiter for Factor Limitation" /begin REF_CHARACTERISTIC TL_DynRateLoLim_P TL_DynRateUpLim_P TL_bDeacvRateLimOvs_P /end REF_CHARACTERISTIC /begin REF_MEASUREMENT TL_DynRateLimr TL_TqIndcdLimdPre /end REF_MEASUREMENT /end GROUP
/begin GROUP S15_Reduction_Limitation_Level_1 "EcuIntgdSwGend/ControlSoftware/TqLim/Reduction Limitation Level 1" /begin REF_CHARACTERISTIC TL_TqRednLvL1_P /end REF_CHARACTERISTIC /begin REF_MEASUREMENT TL_TqLimnRednLvl1 /end REF_MEASUREMENT /end GROUP
/begin GROUP S15_Reduction_Limitation_Level_2 "EcuIntgdSwGend/ControlSoftware/TqLim/Reduction Limitation Level 2" /begin REF_CHARACTERISTIC TL_TqRednLvl2_P /end REF_CHARACTERISTIC /begin REF_MEASUREMENT TL_TqLimnRednLvl2 /end REF_MEASUREMENT /end GROUP
/begin GROUP S15_Torque_Based_Limitation "EcuIntgdSwGend/ControlSoftware/TqLim/Torque Based Limitation" /begin REF_MEASUREMENT TL_TqIndcdLimdPre2 /end REF_MEASUREMENT /end GROUP
/begin GROUP S16_Warning_Reduction_Shutdown_Functions "EcuIntgdSwGend/ControlSoftware/WarnMong/Warning-Reduction-Shutdown Functions"
 /begin SUB_GROUP S680_Global_Enable S680_Internal S680_Limp S680_Pressure S680_Reaction S680_Return_To_Normal S680_Temperature /end SUB_GROUP
/end GROUP
/begin GROUP S17_TurbochargerSpeedEstimation "EcuIntgdSwGend/ControlSoftware/WgtCtl/TurbochargerSpeedEstimation"
 /begin SUB_GROUP S841_AirMassFlowCalc S841_CalculatedCompressorInletPressure S841_CalculatedCompressorOutletPressure S841_CompressorEfficiency S841_CompressorPressureRatio S841_CorrectedAirMassFlow S841_SurgeCheck S841_TurbochargerSpeed S841_VolumetricEfficiency /end SUB_GROUP
/end GROUP
/begin GROUP S17_Wastegate_Control "EcuIntgdSwGend/ControlSoftware/WgtCtl/Wastegate Control"
 /begin SUB_GROUP S842_BoostPressurePID S842_BoostPressureRefSelector S842_saturation /end SUB_GROUP
 /begin REF_CHARACTERISTIC WgC_DutyVlvOvs_P WgC_DutyVlvOvv_P WgC_DutyWgtVlvFF_M WgC_LimSigLo_M WgC_LimSigUp_M WgC_StWgtVlvCtrl_M /end REF_CHARACTERISTIC
 /begin REF_MEASUREMENT WgC_DutyVlvReq WgC_DutyWgtVlv WgC_DutyWgtVlvBefSat WgC_DutyWgtVlvFF WgC_LimSigLo WgC_LimSigUp /end REF_MEASUREMENT
/end GROUP
/end MODULE
/end PROJECT
