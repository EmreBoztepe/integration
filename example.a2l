ASAP2_VERSION 1 6
/begin PROJECT ECEMTAG_CR8 ""
/begin MODULE DIM ""
/begin MOD_COMMON "Mod Common Comment Here" DEPOSIT ABSOLUTE BYTE_ORDER MSB_FIRST /end MOD_COMMON
/begin MEASUREMENT FF_MTotFuQntyCorr "Total Fuel Quantity Correction" UWORD mm3_CM 1 100 0 65535 FORMAT "%20.0" ECU_ADDRESS 0x4000B248 /* @ECU_Address@A2L_FF_DM4.total_fuel_quantity_correction@ */ /end MEASUREMENT
/begin MEASUREMENT FF_EngHr "Engine Hour" FLOAT32_IEEE hour_CM 1 100 0 4000000000 FORMAT "%20.2" ECU_ADDRESS 0x4000B24C /* @ECU_Address@A2L_FF_DM4.engine_hour@ */ /end MEASUREMENT
/***************************************** FF END *******************************************/ /*****************************************raw_value START*******************************************/ /* PRESSURE RAW VALUE*/
/begin MEASUREMENT PAmbAir_RawValU "PAmbAir_RawValU" FLOAT32_IEEE Voltage_CM 1 100 0 5 FORMAT "%20.2" ECU_ADDRESS 0x4000AF00 /* @ECU_Address@sVoltage[57].sVoltageValue.voltage@ */ /end MEASUREMENT
/begin MEASUREMENT PRail_RawValU "PRail_RawValU" FLOAT32_IEEE Voltage_CM 1 100 0 5 FORMAT "%20.2" ECU_ADDRESS 0x4000A9B0 /* @ECU_Address@sVoltage[23].sVoltageValue.voltage@ */ /end MEASUREMENT
/begin MEASUREMENT POil_RawValU "POil_RawValU" FLOAT32_IEEE Voltage_CM 1 100 0 5 FORMAT "%20.2" ECU_ADDRESS 0x4000A910 /* @ECU_Address@sVoltage[19].sVoltageValue.voltage@ */ /end MEASUREMENT
/begin MEASUREMENT PFu_RawValU "PFu_RawValU" FLOAT32_IEEE Voltage_CM 1 100 0 5 FORMAT "%20.2" ECU_ADDRESS 0x4000A938 /* @ECU_Address@sVoltage[20].sVoltageValue.voltage@ */ /end MEASUREMENT
/begin MEASUREMENT PAirBoost_RawValU "PAirBoost_RawValU" FLOAT32_IEEE Voltage_CM 1 100 0 5 FORMAT "%20.2" ECU_ADDRESS 0x4000A988 /* @ECU_Address@sVoltage[22].sVoltageValue.voltage@ */ /end MEASUREMENT
/begin MEASUREMENT LvlOil_RawValU "LvlOil_RawValU" FLOAT32_IEEE Voltage_CM 1 100 0 5 FORMAT "%20.2" ECU_ADDRESS 0x4000A960 /* @ECU_Address@sVoltage[21].sVoltageValue.voltage@ */ /end MEASUREMENT
/begin MEASUREMENT AccrPedl1_RawValU "AccrPedl1_RawValU" FLOAT32_IEEE Voltage_CM 1 100 0 5 FORMAT "%20.2" ECU_ADDRESS 0x4000A9D8 /* @ECU_Address@sVoltage[24].sVoltageValue.voltage@ */ /end MEASUREMENT
/begin MEASUREMENT AccrPedl2_RawValU "AccrPedl2_RawValU" FLOAT32_IEEE Voltage_CM 1 100 0 5 FORMAT "%20.2" ECU_ADDRESS 0x4000AA00 /* @ECU_Address@sVoltage[25].sVoltageValue.voltage@ */ /end MEASUREMENT
/* TEMPERATURE RAW VALUE*/
/begin MEASUREMENT TEcu_RawValU "TEcu_RawValU" FLOAT32_IEEE Voltage_CM 1 100 0 50000 FORMAT "%20.2" ECU_ADDRESS 0x4000AED8 /* @ECU_Address@sVoltage[56].sVoltageValue.voltage@ */ /end MEASUREMENT
/begin MEASUREMENT TOil_RawValR "TOil_RawValR" FLOAT32_IEEE Resistor_CM 1 100 0 50000 FORMAT "%20.2" ECU_ADDRESS 0x4000A6BC /* @ECU_Address@sVoltage[4].sVoltageValue.resistance@ */ /end MEASUREMENT
/begin MEASUREMENT TCoolt_RawValR "TCoolt_RawValR" FLOAT32_IEEE Resistor_CM 1 100 0 50000 FORMAT "%20.2" ECU_ADDRESS 0x4000A7D4 /* @ECU_Address@sVoltage[11].sVoltageValue.resistance@ */ /end MEASUREMENT
/begin MEASUREMENT TAirBoost_RawValR "TAirBoost_RawValR" FLOAT32_IEEE Resistor_CM 1 100 0 50000 FORMAT "%20.2" ECU_ADDRESS 0x4000A7FC /* @ECU_Address@sVoltage[12].sVoltageValue.resistance@ */ /end MEASUREMENT
/begin MEASUREMENT TAmbAir_RawValR "TAmbAir_RawValR" FLOAT32_IEEE Resistor_CM 1 100 0 50000 FORMAT "%20.2" ECU_ADDRESS 0x4000A734 /* @ECU_Address@sVoltage[7].sVoltageValue.resistance@ */ /end MEASUREMENT
/begin MEASUREMENT TFu_RawValR "TFu_RawValR" FLOAT32_IEEE Resistor_CM 1 100 0 50000 FORMAT "%20.2" ECU_ADDRESS 0x4000A6E4 /* @ECU_Address@sVoltage[5].sVoltageValue.resistance@ */ /end MEASUREMENT
/begin MEASUREMENT TOil_RawValU "TOil_RawValU" FLOAT32_IEEE Voltage_CM 1 100 0 50 FORMAT "%20.2" ECU_ADDRESS 0x4000A6B8 /* @ECU_Address@sVoltage[4].sVoltageValue.voltage@ */ /end MEASUREMENT
/begin MEASUREMENT TCoolt_RawValU "TCoolt_RawValU" FLOAT32_IEEE Voltage_CM 1 100 0 50 FORMAT "%20.2" ECU_ADDRESS 0x4000A7D0 /* @ECU_Address@sVoltage[11].sVoltageValue.voltage@ */ /end MEASUREMENT
/begin MEASUREMENT TAirBoost_RawValU "TAirBoost_RawValU" FLOAT32_IEEE Voltage_CM 1 100 0 50 FORMAT "%20.2" ECU_ADDRESS 0x4000A7F8 /* @ECU_Address@sVoltage[12].sVoltageValue.voltage@ */ /end MEASUREMENT
/begin MEASUREMENT TAmbAir_RawValU "TAmbAir_RawValU" FLOAT32_IEEE Voltage_CM 1 100 0 50 FORMAT "%20.2" ECU_ADDRESS 0x4000A730 /* @ECU_Address@sVoltage[7].sVoltageValue.voltage@ */ /end MEASUREMENT
/begin MEASUREMENT TFu_RawValU "TFu_RawValU" FLOAT32_IEEE Voltage_CM 1 100 0 50 FORMAT "%20.2" ECU_ADDRESS 0x4000A6E0 /* @ECU_Address@sVoltage[5].sVoltageValue.voltage@ */ /end MEASUREMENT
/* BATTERY RAW VALUE */
/begin MEASUREMENT V48_Boost_RawValU "V48_Boost_RawValU" FLOAT32_IEEE Voltage_CM 1 100 0 50 FORMAT "%20.2" ECU_ADDRESS 0x4000AD50 /* @ECU_Address@sVoltage[46].sVoltageValue.phy_value@ */ /end MEASUREMENT
/begin MEASUREMENT Batt_RawValU "Batt_RawValU" FLOAT32_IEEE Voltage_CM 1 100 0 50 FORMAT "%20.2" ECU_ADDRESS 0x4000AD78 /* @ECU_Address@sVoltage[47].sVoltageValue.phy_value@ */ /end MEASUREMENT
/begin MEASUREMENT V12_RawValU "V12_RawValU" FLOAT32_IEEE Voltage_CM 1 100 0 50 FORMAT "%20.2" ECU_ADDRESS 0x4000ADA0 /* @ECU_Address@sVoltage[48].sVoltageValue.phy_value@ */ /end MEASUREMENT
/begin MEASUREMENT V5_Ref_RawValU "V5_Ref_RawValU" FLOAT32_IEEE Voltage_CM 1 100 0 50 FORMAT "%20.2" ECU_ADDRESS 0x4000ADF0 /* @ECU_Address@sVoltage[50].sVoltageValue.phy_value@ */ /end MEASUREMENT
/begin MEASUREMENT V5_RawValU "V5_RawValU" FLOAT32_IEEE Voltage_CM 1 100 0 50 FORMAT "%20.2" ECU_ADDRESS 0x4000ADC8 /* @ECU_Address@sVoltage[49].sVoltageValue.phy_value@ */ /end MEASUREMENT
/begin MEASUREMENT V3_3_RawValU "V3_3_RawValU" FLOAT32_IEEE Voltage_CM 1 100 0 50 FORMAT "%20.2" ECU_ADDRESS 0x4000AE18 /* @ECU_Address@sVoltage[51].sVoltageValue.phy_value@ */ /end MEASUREMENT
/begin MEASUREMENT V1_25_RawValU "V1_25_RawValU" FLOAT32_IEEE Voltage_CM 1 100 0 50 FORMAT "%20.2" ECU_ADDRESS 0x4000AE40 /* @ECU_Address@sVoltage[52].sVoltageValue.phy_value@ */ /end MEASUREMENT
/begin MEASUREMENT V12_Ref_Cam_RawValU "V12_Ref_Cam_RawValU" FLOAT32_IEEE Voltage_CM 1 100 0 50 FORMAT "%20.2" ECU_ADDRESS 0x4000AE68 /* @ECU_Address@sVoltage[53].sVoltageValue.phy_value@ */ /end MEASUREMENT
/begin MEASUREMENT V12_Ref_Crk_RawValU "V12_Ref_Crk_RawValU" FLOAT32_IEEE Voltage_CM 1 100 0 50 FORMAT "%20.2" ECU_ADDRESS 0x4000AE90 /* @ECU_Address@sVoltage[54].sVoltageValue.phy_value@ */ /end MEASUREMENT
/begin MEASUREMENT NTC_1_Diag_RawValU "NTC_1_Diag_RawValU" FLOAT32_IEEE Voltage_CM 1 100 0 50 FORMAT "%20.2" ECU_ADDRESS 0x4000A870 /* @ECU_Address@sVoltage[15].sVoltageValue.voltage@ */ /end MEASUREMENT
/begin MEASUREMENT NTC_2_Diag_RawValU "NTC_2_Diag_RawValU" FLOAT32_IEEE Voltage_CM 1 100 0 50 FORMAT "%20.2" ECU_ADDRESS 0x4000A898 /* @ECU_Address@sVoltage[16].sVoltageValue.voltage@ */ /end MEASUREMENT
/begin MEASUREMENT NTC_3_Diag_RawValU "NTC_3_Diag_RawValU" FLOAT32_IEEE Voltage_CM 1 100 0 50 FORMAT "%20.2" ECU_ADDRESS 0x4000A8C0 /* @ECU_Address@sVoltage[17].sVoltageValue.voltage@ */ /end MEASUREMENT
/begin MEASUREMENT NTC_4_Diag_RawValU "NTC_4_Diag_RawValU" FLOAT32_IEEE Voltage_CM 1 100 0 50 FORMAT "%20.2" ECU_ADDRESS 0x4000A8E8 /* @ECU_Address@sVoltage[18].sVoltageValue.voltage@ */ /end MEASUREMENT
/begin MEASUREMENT DO6_Diag_RawValU "DO6_Diag_RawValU" FLOAT32_IEEE Voltage_CM 1 100 0 50 FORMAT "%20.2" ECU_ADDRESS 0x4000ACA8 /* @ECU_Address@sVoltage[42].sVoltageValue.voltage@ */ /end MEASUREMENT
/begin MEASUREMENT DO7_Diag_RawValU "DO7_Diag_RawValU" FLOAT32_IEEE Voltage_CM 1 100 0 50 FORMAT "%20.2" ECU_ADDRESS 0x4000ACD0 /* @ECU_Address@sVoltage[43].sVoltageValue.voltage@ */ /end MEASUREMENT
/begin MEASUREMENT DO8_Diag_RawValU "DO8_Diag_RawValU" FLOAT32_IEEE Voltage_CM 1 100 0 50 FORMAT "%20.2" ECU_ADDRESS 0x4000ACF8 /* @ECU_Address@sVoltage[44].sVoltageValue.voltage@ */ /end MEASUREMENT
/begin MEASUREMENT DO9_Diag_RawValU "DO9_Diag_RawValU" FLOAT32_IEEE Voltage_CM 1 100 0 50 FORMAT "%20.2" ECU_ADDRESS 0x4000AD20 /* @ECU_Address@sVoltage[45].sVoltageValue.voltage@ */ /end MEASUREMENT
/begin MEASUREMENT V12_Ref_Cam_Diag_RawValU "V12_Ref_Cam_Diag_RawValU" FLOAT32_IEEE Voltage_CM 1 100 0 50 FORMAT "%20.2" ECU_ADDRESS 0x4000AE60 /* @ECU_Address@sVoltage[53].sVoltageValue.voltage@ */ /end MEASUREMENT
/begin MEASUREMENT V12_Ref_Crk_Diag_RawValU "V12_Ref_Crk_Diag_RawValU" FLOAT32_IEEE Voltage_CM 1 100 0 50 FORMAT "%20.2" ECU_ADDRESS 0x4000AE88 /* @ECU_Address@sVoltage[54].sVoltageValue.voltage@ */ /end MEASUREMENT
/begin MEASUREMENT V5_Ref_MCU_Diag_RawValU "V5_Ref_MCU_Diag_RawValU" FLOAT32_IEEE Voltage_CM 1 100 0 50 FORMAT "%20.2" ECU_ADDRESS 0x4000AF50 /* @ECU_Address@sVoltage[59].sVoltageValue.voltage@ */ /end MEASUREMENT
/begin MEASUREMENT V5_Ref_1_Diag_RawValU "V5_Ref_1_Diag_RawValU" FLOAT32_IEEE Voltage_CM 1 100 0 50 FORMAT "%20.2" ECU_ADDRESS 0x4000AEB0 /* @ECU_Address@sVoltage[55].sVoltageValue.voltage@ */ /end MEASUREMENT
/begin MEASUREMENT V5_Ref_2_Diag_RawValU "V5_Ref_2_Diag_RawValU" FLOAT32_IEEE Voltage_CM 1 100 0 50 FORMAT "%20.2" ECU_ADDRESS 0x4000AED8 /* @ECU_Address@sVoltage[56].sVoltageValue.voltage@ */ /end MEASUREMENT
/* CURRENT RAW VALUE*/
/begin MEASUREMENT Fb_IRefVCV "Current Feedback VCV" FLOAT32_IEEE Current_A_CM 1 100 0 3000 FORMAT "%20.2" ECU_ADDRESS 0x40011928 /* @ECU_Address@TLE9246_File[0].Chan_FB_Avg_Current[0]@ */ /end MEASUREMENT
/begin MEASUREMENT Fb_IRefPCV "Current Feedback PCV" FLOAT32_IEEE Current_A_CM 1 100 0 3000 FORMAT "%20.2" ECU_ADDRESS 0x4001192C /* @ECU_Address@TLE9246_File[0].Chan_FB_Avg_Current[1]@ */ /end MEASUREMENT
/*****************************************raw_value END*********************************************/ /*****************************************CURVE START*********************************************/ /* MAPS CURVES */
/begin CHARACTERISTIC PRailSnsr_Curve "rail pressure curve" CURVE 0x40040114 /* @ECU_Address@crv_CRPressUy@ */ FLOAT32_IEEE 2850 PressSensor_CM 0 2850
 /begin AXIS_DESCR COM_AXIS PRail_RawValU Voltage_CM 4 0 5 FORMAT "%20.2" AXIS_PTS_REF PRailU /end AXIS_DESCR
 FORMAT "%20.2" /end CHARACTERISTIC
/begin AXIS_PTS PRailU "rail pressure voltage" 0x40040104 /* @ECU_Address@crv_CRPressUx@ */ PRail_RawValU RL_X_FLOAT32_IEEE 5 NO_COMPU_METHOD 4 0 5 DEPOSIT ABSOLUTE /end AXIS_PTS
/begin CHARACTERISTIC PAirBoostSnsr_Curve "air boost pressure curve" CURVE 0x40040134 /* @ECU_Address@crv_BoostPressUy@ */ FLOAT32_IEEE 10 PressSensor_CM 0 10
 /begin AXIS_DESCR COM_AXIS PAirBoost_RawValU Voltage_CM 4 0 5 FORMAT "%20.2" AXIS_PTS_REF PAirBoostU /end AXIS_DESCR
 FORMAT "%20.2" /end CHARACTERISTIC
/begin AXIS_PTS PAirBoostU "air boost pressure voltage" 0x40040124 /* @ECU_Address@crv_BoostPressUx@ */ PAirBoost_RawValU RL_X_FLOAT32_IEEE 5 NO_COMPU_METHOD 4 0 5 DEPOSIT ABSOLUTE /end AXIS_PTS
/begin CHARACTERISTIC AccrPedlSensr1_Curve "accelerator pedal curve" CURVE 0x400401AC /* @ECU_Address@crv_Pedal1PosY@ */ FLOAT32_IEEE 100 LevelSensor_CM 0 100
 /begin AXIS_DESCR COM_AXIS AccrPedl1_RawValU Voltage_CM 2 0 5 FORMAT "%20.2" AXIS_PTS_REF AccrPedl1U /end AXIS_DESCR
 FORMAT "%20.2" /end CHARACTERISTIC
/begin AXIS_PTS AccrPedl1U "accelerator pedal voltage" 0x400401A4 /* @ECU_Address@crv_Pedal1PosX@ */ AccrPedl1_RawValU RL_X_FLOAT32_IEEE 5 NO_COMPU_METHOD 2 0 5 DEPOSIT ABSOLUTE /end AXIS_PTS
/begin CHARACTERISTIC AccrPedlSensr2_Curve "accelerator pedal 2 curve" CURVE 0x400401BC /* @ECU_Address@crv_Pedal2PosY@ */ FLOAT32_IEEE 100 LevelSensor_CM 0 100
 /begin AXIS_DESCR COM_AXIS AccrPedl2_RawValU Voltage_CM 2 0 5 FORMAT "%20.2" AXIS_PTS_REF AccrPedl2U /end AXIS_DESCR
 FORMAT "%20.2" /end CHARACTERISTIC
/begin AXIS_PTS AccrPedl2U "accelerator pedal 2 voltage" 0x400401B4 /* @ECU_Address@crv_Pedal2PosX@ */ AccrPedl2_RawValU RL_X_FLOAT32_IEEE 5 NO_COMPU_METHOD 2 0 5 DEPOSIT ABSOLUTE /end AXIS_PTS
/begin CHARACTERISTIC PFuSnsr_Curve "fuel pressure curve" CURVE 0x40040174 /* @ECU_Address@crv_FuelPressY@ */ /* mta:3338 */ FLOAT32_IEEE 10 PressSensor_CM 0 10
 /begin AXIS_DESCR COM_AXIS PFu_RawValU Voltage_CM 4 0 5 FORMAT "%20.2" AXIS_PTS_REF PFuU /end AXIS_DESCR
 FORMAT "%20.2" /end CHARACTERISTIC
/begin AXIS_PTS PFuU "fuel pressure voltage" 0x40040164 /* @ECU_Address@crv_FuelPressX@ */ /* mta:3338 */ PFu_RawValU RL_X_FLOAT32_IEEE 5 NO_COMPU_METHOD 4 0 5 DEPOSIT ABSOLUTE /end AXIS_PTS
/begin CHARACTERISTIC LvlOilSnsr_Curve "oil level curve" CURVE 0x40040194 /* @ECU_Address@crv_OilLevelUy@ */ /* mta:3341 */ FLOAT32_IEEE 100 LevelSensor_CM 0 100
 /begin AXIS_DESCR COM_AXIS LvlOil_RawValU Voltage_CM 4 0 5 FORMAT "%20.2" AXIS_PTS_REF LvlOilU /end AXIS_DESCR
 FORMAT "%20.2" /end CHARACTERISTIC
/begin AXIS_PTS LvlOilU "oil level voltage" 0x40040184 /* @ECU_Address@crv_OilLevelUx@ */ /* mta:3341 */ LvlOil_RawValU RL_X_FLOAT32_IEEE 5 NO_COMPU_METHOD 4 0 5 DEPOSIT ABSOLUTE /end AXIS_PTS
/begin CHARACTERISTIC POilSnsr_Curve "oil pressure curve" CURVE 0x40040154 /* @ECU_Address@crv_OilPressUy@ */ /* mta:3334 */ FLOAT32_IEEE 10 PressSensor_CM 0 10
 /begin AXIS_DESCR COM_AXIS POil_RawValU Voltage_CM 4 0 5 FORMAT "%20.2" AXIS_PTS_REF POilU /end AXIS_DESCR
 FORMAT "%20.2" /end CHARACTERISTIC
/begin AXIS_PTS POilU "oil pressure voltage" 0x40040144 /* @ECU_Address@crv_OilPressUx@ */ /* mta:3334 */ POil_RawValU RL_X_FLOAT32_IEEE 5 NO_COMPU_METHOD 4 0 5 DEPOSIT ABSOLUTE /end AXIS_PTS
/begin CHARACTERISTIC TOilSnsr_Curve "oil temperature sensor curve" CURVE 0x400401F8 /* @ECU_Address@crv_PT1000y_TOil@ */ FLOAT32_IEEE 0 NO_COMPU_METHOD -50.0 150
 /begin AXIS_DESCR COM_AXIS TOil_RawValR NO_COMPU_METHOD 5 0 2000 AXIS_PTS_REF TOilR /end AXIS_DESCR
/end CHARACTERISTIC
/begin AXIS_PTS TOilR "oil temperature resistance" 0x400401E4 /* @ECU_Address@crv_PT1000x_TOil@ */ TOil_RawValR RL_X_FLOAT32_IEEE 0 NO_COMPU_METHOD 5 0 2000 /end AXIS_PTS
/begin CHARACTERISTIC TCooltSnsr_Curve "coolant temperature sensor curve" CURVE 0x4004025C /* @ECU_Address@crv_NTCy_TCoolt@ */ FLOAT32_IEEE 0 NO_COMPU_METHOD -50.0 150
 /begin AXIS_DESCR COM_AXIS TCoolt_RawValR NO_COMPU_METHOD 20 0 50000 AXIS_PTS_REF TCooltR /end AXIS_DESCR
/end CHARACTERISTIC
/begin AXIS_PTS TCooltR "coolant temperature resistance" 0x4004020C /* @ECU_Address@crv_NTCx_TCoolt@ */ TCoolt_RawValR RL_X_FLOAT32_IEEE 0 NO_COMPU_METHOD 20 0 50000 /end AXIS_PTS
/begin CHARACTERISTIC TAirBoostSnsr_Curve "air boost temperature sensor curve" CURVE 0x40040310 /* @ECU_Address@crv_NTCy_TAirBoost@ */ FLOAT32_IEEE 0 NO_COMPU_METHOD -50.0 150
 /begin AXIS_DESCR COM_AXIS TAirBoost_RawValR NO_COMPU_METHOD 20 0 50000 AXIS_PTS_REF TAirBoostR /end AXIS_DESCR
/end CHARACTERISTIC
/begin AXIS_PTS TAirBoostR "air boost temperature resistance" 0x400402C0 /* @ECU_Address@crv_NTCx_TAirBoost@ */ TAirBoost_RawValR RL_X_FLOAT32_IEEE 0 NO_COMPU_METHOD 20 0 50000 /end AXIS_PTS
/begin CHARACTERISTIC TAmbAirSnsr_Curve "ambient air temperature sensor curve" CURVE 0x40040374 /* @ECU_Address@crv_PT1000y_TAmbAir@ */ FLOAT32_IEEE 0 NO_COMPU_METHOD -50.0 150
 /begin AXIS_DESCR COM_AXIS TAmbAir_RawValR NO_COMPU_METHOD 5 0 2000 AXIS_PTS_REF TAmbAirR /end AXIS_DESCR
/end CHARACTERISTIC
/begin AXIS_PTS TAmbAirR "ambient air temperature resistance" 0x40040360 /* @ECU_Address@crv_PT1000x_TAmbAir@ */ TAmbAir_RawValR RL_X_FLOAT32_IEEE 0 NO_COMPU_METHOD 5 0 2000 /end AXIS_PTS
/begin CHARACTERISTIC TFuSnsr_Curve "fuel temperature sensor curve" CURVE 0x4004039C /* @ECU_Address@crv_PT1000y_TFu@ */ FLOAT32_IEEE 0 NO_COMPU_METHOD -50.0 150
 /begin AXIS_DESCR COM_AXIS TFu_RawValR NO_COMPU_METHOD 5 0 2000 AXIS_PTS_REF TFuR /end AXIS_DESCR
/end CHARACTERISTIC
/begin AXIS_PTS TFuR "fuel temperature resistance" 0x40040388 /* @ECU_Address@crv_PT1000x_TFu@ */ TFu_RawValR RL_X_FLOAT32_IEEE 0 NO_COMPU_METHOD 5 0 2000 /end AXIS_PTS
/*****************************************CURVE END*********************************************/ /* INJECTOR */
/begin CHARACTERISTIC boost_current "injector" VALUE 0x40040090 /* @ECU_Address@cnst_BoostCurrent@ */ /* mta: 4031 */ FLOAT32_IEEE 20 Current_CM 0 20 /end CHARACTERISTIC
/begin CHARACTERISTIC hold_current "injector" VALUE 0x4004008C /* @ECU_Address@cnst_HoldCurrent@ */ /* mta: 4030 */ FLOAT32_IEEE 20 Current_CM 0 20 /end CHARACTERISTIC
/begin CHARACTERISTIC boost_voltage "injector" VALUE 0x40040094 /* @ECU_Address@cnst_BoostVoltage@ */ /* mta: 4032 */ FLOAT32_IEEE 50 Voltage_CM 0 50 /end CHARACTERISTIC
/begin CHARACTERISTIC boost_voltage_duration "injector" VALUE 0x40040060 /* @ECU_Address@stDefaultInjBankTiming.UBoost@ */ /* mta: 4034 */ FLOAT32_IEEE 30000 Duration_ms_Scale1000000_CM 0 30000 FORMAT "%20.6" /end CHARACTERISTIC
/begin CHARACTERISTIC boost_current_duration "injector" VALUE 0x40040064 /* @ECU_Address@stDefaultInjBankTiming.IBoost@ */ /* mta: 4033 */ FLOAT32_IEEE 30000 Duration_ms_Scale1000000_CM 0 30000 FORMAT "%20.6" /end CHARACTERISTIC
/begin CHARACTERISTIC boost_current_max1_pulse_duration "injector" VALUE 0x40040068 /* @ECU_Address@stDefaultInjBankTiming.FirstPuls@ */ /* mta: 4036 */ FLOAT32_IEEE 30000 Duration_ms_Scale1000000_CM -1000 30000 FORMAT "%20.6" /end CHARACTERISTIC
/begin CHARACTERISTIC boost_current_min_pulse_duration "injector" VALUE 0x4004006C /* @ECU_Address@stDefaultInjBankTiming.BoostPuls@ */ /* mta: 4037 */ FLOAT32_IEEE 30000 Duration_ms_Scale1000000_CM 0 30000 /end CHARACTERISTIC
/begin CHARACTERISTIC boost_current_max_pulse_duration "injector" VALUE 0x40040070 /* @ECU_Address@stDefaultInjBankTiming.BoostLimit@ */ /* mta: 4041 */ FLOAT32_IEEE 30000 Duration_ms_Scale1000000_CM 0 30000 FORMAT "%20.6" /end CHARACTERISTIC
/begin CHARACTERISTIC boost_current_pause_duration "injector" VALUE 0x40040074 /* @ECU_Address@stDefaultInjBankTiming.BoostPause@ */ /* mta: 4038 */ FLOAT32_IEEE 30000 Duration_ms_Scale1000000_CM 0 30000 /end CHARACTERISTIC
/begin CHARACTERISTIC min_switch_time_boost_holdcur "injector" VALUE 0x40040078 /* @ECU_Address@stDefaultInjBankTiming.Unload@ */ /* mta: 4035 */ FLOAT32_IEEE 1000 Duration_ms_Scale1000000_CM 0 1000 /end CHARACTERISTIC
/begin CHARACTERISTIC max_switch_time_boost_holdcur "injector" VALUE 0x4004007C /* @ECU_Address@stDefaultInjBankTiming.UnloadLimit@ */ /* mta: 4043 */ FLOAT32_IEEE 1000 Duration_ms_Scale1000000_CM 0 1000 /end CHARACTERISTIC
/begin CHARACTERISTIC hold_current_min_pulse_duration "injector" VALUE 0x40040080 /* @ECU_Address@stDefaultInjBankTiming.HoldPuls@ */ /* mta: 4039 */ FLOAT32_IEEE 30000 Duration_ms_Scale1000000_CM 0 30000 /end CHARACTERISTIC
/begin CHARACTERISTIC hold_current_max_pulse_duration "injector" VALUE 0x40040084 /* @ECU_Address@stDefaultInjBankTiming.HoldLimit@ */ /* mta: 4042 */ FLOAT32_IEEE 30000 Duration_ms_Scale1000000_CM 0 30000 FORMAT "%20.6" /end CHARACTERISTIC
/begin CHARACTERISTIC hold_current_pause_duration "injector" VALUE 0x40040088 /* @ECU_Address@stDefaultInjBankTiming.HoldPause@ */ /* mta: 4040 */ FLOAT32_IEEE 30000 Duration_ms_Scale1000000_CM 0 30000 /end CHARACTERISTIC
/begin CHARACTERISTIC Crksft_Tooth_Nr "teeth on crankshaft gear" VALUE 0x40040024 /* @ECU_Address@gkSpeedconfig.ZaehnezahlKW@ */ UWORD 65535 NO_COMPU_METHOD 1 360 FORMAT "%20.0" /end CHARACTERISTIC
/begin CHARACTERISTIC Crksft_Gap_Nr "gap on crankshaft gear" VALUE 0x40040026 /* @ECU_Address@gkSpeedconfig.FehlZaehneKW@ */ UBYTE 65535 NO_COMPU_METHOD 0 2 FORMAT "%20.0" /end CHARACTERISTIC
/begin CHARACTERISTIC First_TDC_To_First_Crksft_Tooth_Fall_Edge_Aft_Gap "first firing TDC to first crankshaft tooth falling edge after gap" VALUE 0x4004002C /* @ECU_Address@gkSpeedconfig.WinkelKW@ */ FLOAT32_IEEE 65535 Angle_CM 0 720 FORMAT "%20.6" /end CHARACTERISTIC
/begin CHARACTERISTIC First_TDC_To_Camsft_Plus_Tooth_Fall_Edge "first firing TDC to first camshaft plus tooth falling edge as crankshaft degree" VALUE 0x40040030 /* @ECU_Address@gkSpeedconfig.WinkelNW@ */ FLOAT32_IEEE 65535 Angle_CM 0 720 FORMAT "%20.6" /end CHARACTERISTIC
/begin CHARACTERISTIC Min_Crnkshft_Angle_For_Camsft_Plus_Tooth_Search_Zone "min distance from tooth before camshaft plus tooth falling edge" VALUE 0x40040034 /* @ECU_Address@gkSpeedconfig.WinkelKW1@ */ FLOAT32_IEEE 65535 Angle_CM 0 100 /end CHARACTERISTIC
/begin CHARACTERISTIC Max_Crnkshft_Angle_For_Camsft_Plus_Tooth_Search_Zone "max distance from tooth before camshaft plus tooth falling edge" VALUE 0x40040038 /* @ECU_Address@gkSpeedconfig.WinkelNW1@ */ FLOAT32_IEEE 65535 Angle_CM 0 720 /end CHARACTERISTIC
/begin CHARACTERISTIC Eng_Cyl_Nr "engine cylinder number" VALUE 0x40040052 /* @ECU_Address@cnst_CylinderNumber@ */ UWORD 65535 NO_COMPU_METHOD 0 6 FORMAT "%20.0" /end CHARACTERISTIC
/begin CHARACTERISTIC Injr_Bnk_Nr "injector bank number" VALUE 0x40040054 /* @ECU_Address@cnst_BankNumber@ */ UWORD 65535 NO_COMPU_METHOD 0 3 FORMAT "%20.0" /end CHARACTERISTIC
/begin CHARACTERISTIC Ag_Cyl1_To_Cyl2 "angle between cylinder 1 to cylinder 2" VALUE 0x4004005C /* @ECU_Address@cnst_VAngle@ */ FLOAT32_IEEE 65535 NO_COMPU_METHOD 0 720 FORMAT "%20.0" /end CHARACTERISTIC
/begin MEASUREMENT Crksft_Sts "Implies Status of Crankshaft" UBYTE CM_Sft_Sts 1 100 0 255 FORMAT "%20.0" ECU_ADDRESS 0x4001072E /* @ECU_Address@gucCrankStatus@ */ /end MEASUREMENT
/begin MEASUREMENT Camsft_Sts "Implies Status of Camshaft" UBYTE CM_Sft_Sts 1 100 0 255 FORMAT "%20.0" ECU_ADDRESS 0x4001075E /* @ECU_Address@gucCamStatus@ */ /end MEASUREMENT
/begin COMPU_METHOD CM_Sft_Sts "" TAB_VERB "%0.0" "" COMPU_TAB_REF CT_Sft_Sts /end COMPU_METHOD
/begin COMPU_VTAB CT_Sft_Sts "" TAB_VERB 7 0 "STALL" 1 "WAITING GAP" 2 "HALF SYNCHRONIZATION" 3 "FULL SYNCHRONIZATION" 4 "ERROR" 5 "WRONG GAP" 5 "MISSING GAP" /end COMPU_VTAB
/begin CHARACTERISTIC N_stroke_engine "configuration 1 - engine type" VALUE 0x40040028 /* @ECU_Address@gkSpeedconfig.Typ@ */ UBYTE 4 NO_COMPU_METHOD 0 4 FORMAT "%20.0" /end CHARACTERISTIC
/begin CHARACTERISTIC Crksft_Gap_Miss_Tooth_Nr "Enables 2 teeth gap search: 1: 2 teeth in the gap, 0: 1 tooth in the gap" VALUE 0x40040027 /* @ECU_Address@gkSpeedconfig.Gap@ */ UBYTE 1 NO_COMPU_METHOD 0 1 FORMAT "%20.0" /end CHARACTERISTIC
/begin MEASUREMENT First_TDC_To_Camsft_Plus_Tooth_Fall_Edge_Measd "first firing TDC to camshaft plus tooth falling edge measured by ETPU as crankshaft degree" FLOAT32_IEEE Angle_CM 1 100 0 720 FORMAT "%20.2" ECU_ADDRESS 0x40010798 /* @ECU_Address@gfCamAngle@ */ /end MEASUREMENT
/begin MEASUREMENT First_TDC_To_First_Crksft_Tooth_Fall_Edge_Aft_Gap_Measd "first firing TDC to first crankshaft tooth falling edge after gap measured by ETPU" UWORD Angle_CM 1 100 0 1000 FORMAT "%20.2" ECU_ADDRESS 0x40010744 /* @ECU_Address@gusTPUFirstToothAngle@ */ /end MEASUREMENT
/begin CHARACTERISTIC Injection_Duration_Low_Limit "Injection_Duration_Low_Limit" VALUE 0x40040018 /* @ECU_Address@gfInjectionDurationLowLimit@ */ FLOAT32_IEEE 1000 Duration_us_Scale_CM 0 1000 /end CHARACTERISTIC
/begin CHARACTERISTIC Injection_Duration_Under_Low_Limit "Injection_Duration_Under_Low_Limit" VALUE 0x40040014 /* @ECU_Address@gfInjectionDurationUnderLowLimit@ */ FLOAT32_IEEE 1000 Duration_us_Scale_CM 0 1000 /end CHARACTERISTIC
/*****************************************J1939 PARAMS START*********************************************/
/begin CHARACTERISTIC CCVS1_J1939_Src_Adr "CCVS1 Source Address" VALUE 0x4000AF7C /* @ECU_Address@j1939_handle_entry[0].sa@ */ UBYTE 255 NO_COMPU_METHOD 0 255 FORMAT "%20.0" /end CHARACTERISTIC
/begin CHARACTERISTIC CM1_J1939_Src_Adr "CM1 Source Address" VALUE 0x4000AF98 /* @ECU_Address@j1939_handle_entry[1].sa@ */ UBYTE 255 NO_COMPU_METHOD 0 255 FORMAT "%20.0" /end CHARACTERISTIC
/begin CHARACTERISTIC CM3_J1939_Src_Adr "CM3 Source Address" VALUE 0x4000AFB4 /* @ECU_Address@j1939_handle_entry[2].sa@ */ UBYTE 255 NO_COMPU_METHOD 0 255 FORMAT "%20.0" /end CHARACTERISTIC
/begin CHARACTERISTIC CTL_J1939_Src_Adr "CTL Source Address" VALUE 0x4000AFD0 /* @ECU_Address@j1939_handle_entry[3].sa@ */ UBYTE 255 NO_COMPU_METHOD 0 255 FORMAT "%20.0" /end CHARACTERISTIC
/begin CHARACTERISTIC DLCC1COC_J1939_Src_Adr "DLCC1COC Source Address" VALUE 0x4000AFEC /* @ECU_Address@j1939_handle_entry[4].sa@ */ UBYTE 255 NO_COMPU_METHOD 0 255 FORMAT "%20.0" /end CHARACTERISTIC
/begin CHARACTERISTIC EBC1_J1939_Src_Adr "EBC1 Source Address" VALUE 0x4000B008 /* @ECU_Address@j1939_handle_entry[5].sa@ */ UBYTE 255 NO_COMPU_METHOD 0 255 FORMAT "%20.0" /end CHARACTERISTIC
/begin CHARACTERISTIC ETC7_J1939_Src_Adr "ETC7 Source Address" VALUE 0x4000B024 /* @ECU_Address@j1939_handle_entry[6].sa@ */ UBYTE 255 NO_COMPU_METHOD 0 255 FORMAT "%20.0" /end CHARACTERISTIC
/begin CHARACTERISTIC EEC3_RX_J1939_Src_Adr "EEC3_RX Source Address" VALUE 0x4000B040 /* @ECU_Address@j1939_handle_entry[7].sa@ */ UBYTE 255 NO_COMPU_METHOD 0 255 FORMAT "%20.0" /end CHARACTERISTIC
/begin CHARACTERISTIC ERC1_RX_J1939_Src_Adr "ERC1_RX Source Address" VALUE 0x4000B05C /* @ECU_Address@j1939_handle_entry[8].sa@ */ UBYTE 255 NO_COMPU_METHOD 0 255 FORMAT "%20.0" /end CHARACTERISTIC
/begin CHARACTERISTIC ETC1_J1939_Src_Adr "ETC1 Source Address" VALUE 0x4000B078 /* @ECU_Address@j1939_handle_entry[9].sa@ */ UBYTE 255 NO_COMPU_METHOD 0 255 FORMAT "%20.0" /end CHARACTERISTIC
/begin CHARACTERISTIC ETC2_J1939_Src_Adr "ETC2 Source Address" VALUE 0x4000B094 /* @ECU_Address@j1939_handle_entry[10].sa@ */ UBYTE 255 NO_COMPU_METHOD 0 255 FORMAT "%20.0" /end CHARACTERISTIC
/begin CHARACTERISTIC ETC8_J1939_Src_Adr "ETC8 Source Address" VALUE 0x4000B0B0 /* @ECU_Address@j1939_handle_entry[11].sa@ */ UBYTE 255 NO_COMPU_METHOD 0 255 FORMAT "%20.0" /end CHARACTERISTIC
/begin CHARACTERISTIC FD1_J1939_Src_Adr "FD1 Source Address" VALUE 0x4000B0CC /* @ECU_Address@j1939_handle_entry[12].sa@ */ UBYTE 255 NO_COMPU_METHOD 0 255 FORMAT "%20.0" /end CHARACTERISTIC
/begin CHARACTERISTIC IDFF33_J1939_Src_Adr "IDFF33 Source Address" VALUE 0x4000B0E8 /* @ECU_Address@j1939_handle_entry[13].sa@ */ UBYTE 255 NO_COMPU_METHOD 0 255 FORMAT "%20.0" /end CHARACTERISTIC
/begin CHARACTERISTIC M2E46_J1939_Src_Adr "M2E46 Source Address" VALUE 0x4000B104 /* @ECU_Address@j1939_handle_entry[14].sa@ */ UBYTE 255 NO_COMPU_METHOD 0 255 FORMAT "%20.0" /end CHARACTERISTIC
/begin CHARACTERISTIC M2E47_J1939_Src_Adr "M2E47 Source Address" VALUE 0x4000B120 /* @ECU_Address@j1939_handle_entry[15].sa@ */ UBYTE 255 NO_COMPU_METHOD 0 255 FORMAT "%20.0" /end CHARACTERISTIC
/begin CHARACTERISTIC M2E48_J1939_Src_Adr "M2E48 Source Address" VALUE 0x4000B13C /* @ECU_Address@j1939_handle_entry[16].sa@ */ UBYTE 255 NO_COMPU_METHOD 0 255 FORMAT "%20.0" /end CHARACTERISTIC
/begin CHARACTERISTIC M2E49_J1939_Src_Adr "M2E49 Source Address" VALUE 0x4000B158 /* @ECU_Address@j1939_handle_entry[17].sa@ */ UBYTE 255 NO_COMPU_METHOD 0 255 FORMAT "%20.0" /end CHARACTERISTIC
/begin CHARACTERISTIC PropVehT_J1939_Src_Adr "PropVehT Source Address" VALUE 0x4000B174 /* @ECU_Address@j1939_handle_entry[18].sa@ */ UBYTE 255 NO_COMPU_METHOD 0 255 FORMAT "%20.0" /end CHARACTERISTIC
/begin CHARACTERISTIC TCI_J1939_Src_Adr "TCI Source Address" VALUE 0x4000B190 /* @ECU_Address@j1939_handle_entry[19].sa@ */ UBYTE 255 NO_COMPU_METHOD 0 255 FORMAT "%20.0" /end CHARACTERISTIC
/begin CHARACTERISTIC TD_J1939_Src_Adr "TD Source Address" VALUE 0x4000B1AC /* @ECU_Address@j1939_handle_entry[20].sa@ */ UBYTE 255 NO_COMPU_METHOD 0 255 FORMAT "%20.0" /end CHARACTERISTIC
/begin CHARACTERISTIC TSC1_J1939_Src_Adr "TSC1 Source Address" VALUE 0x4000B1C8 /* @ECU_Address@j1939_handle_entry[21].sa@ */ UBYTE 255 NO_COMPU_METHOD 0 255 FORMAT "%20.0" /end CHARACTERISTIC
/*****************************************J1939 PARAMS END*********************************************/ /* HW_SPECIFIC_ALARM_LIST_START */
/begin MEASUREMENT DiagInfoList_0 "DTC Info" ULONG CM_DiagList 1 100 0 65535 FORMAT "%20.0" ECU_ADDRESS 0x40019910 /* @ECU_Address@sDTC_FaultList.HistoryList.sHistory[0].uDTC.DTC@ */ /end MEASUREMENT
/begin MEASUREMENT DiagInfoList_1 "DTC Info" ULONG CM_DiagList 1 100 0 65535 FORMAT "%20.0" ECU_ADDRESS 0x40019920 /* @ECU_Address@sDTC_FaultList.HistoryList.sHistory[1].uDTC.DTC@ */ /end MEASUREMENT
/begin MEASUREMENT DiagInfoList_2 "DTC Info" ULONG CM_DiagList 1 100 0 65535 FORMAT "%20.0" ECU_ADDRESS 0x40019930 /* @ECU_Address@sDTC_FaultList.HistoryList.sHistory[2].uDTC.DTC@ */ /end MEASUREMENT
/begin MEASUREMENT DiagInfoList_3 "DTC Info" ULONG CM_DiagList 1 100 0 65535 FORMAT "%20.0" ECU_ADDRESS 0x40019940 /* @ECU_Address@sDTC_FaultList.HistoryList.sHistory[3].uDTC.DTC@ */ /end MEASUREMENT
/begin MEASUREMENT DiagInfoList_4 "DTC Info" ULONG CM_DiagList 1 100 0 65535 FORMAT "%20.0" ECU_ADDRESS 0x40019950 /* @ECU_Address@sDTC_FaultList.HistoryList.sHistory[4].uDTC.DTC@ */ /end MEASUREMENT
/begin MEASUREMENT DiagInfoList_5 "DTC Info" ULONG CM_DiagList 1 100 0 65535 FORMAT "%20.0" ECU_ADDRESS 0x40019960 /* @ECU_Address@sDTC_FaultList.HistoryList.sHistory[5].uDTC.DTC@ */ /end MEASUREMENT
/begin MEASUREMENT DiagInfoList_6 "DTC Info" ULONG CM_DiagList 1 100 0 65535 FORMAT "%20.0" ECU_ADDRESS 0x40019970 /* @ECU_Address@sDTC_FaultList.HistoryList.sHistory[6].uDTC.DTC@ */ /end MEASUREMENT
/begin MEASUREMENT DiagInfoList_7 "DTC Info" ULONG CM_DiagList 1 100 0 65535 FORMAT "%20.0" ECU_ADDRESS 0x40019980 /* @ECU_Address@sDTC_FaultList.HistoryList.sHistory[7].uDTC.DTC@ */ /end MEASUREMENT
/begin MEASUREMENT DiagInfoList_8 "DTC Info" ULONG CM_DiagList 1 100 0 65535 FORMAT "%20.0" ECU_ADDRESS 0x40019990 /* @ECU_Address@sDTC_FaultList.HistoryList.sHistory[8].uDTC.DTC@ */ /end MEASUREMENT
/begin MEASUREMENT DiagInfoList_9 "DTC Info" ULONG CM_DiagList 1 100 0 65535 FORMAT "%20.0" ECU_ADDRESS 0x400199A0 /* @ECU_Address@sDTC_FaultList.HistoryList.sHistory[9].uDTC.DTC@ */ /end MEASUREMENT
/begin MEASUREMENT DiagInfoList_10 "DTC Info" ULONG CM_DiagList 1 100 0 65535 FORMAT "%20.0" ECU_ADDRESS 0x400199B0 /* @ECU_Address@sDTC_FaultList.HistoryList.sHistory[10].uDTC.DTC@ */ /end MEASUREMENT
/begin MEASUREMENT DiagInfoList_11 "DTC Info" ULONG CM_DiagList 1 100 0 65535 FORMAT "%20.0" ECU_ADDRESS 0x400199C0 /* @ECU_Address@sDTC_FaultList.HistoryList.sHistory[11].uDTC.DTC@ */ /end MEASUREMENT
/begin MEASUREMENT DiagInfoList_12 "DTC Info" ULONG CM_DiagList 1 100 0 65535 FORMAT "%20.0" ECU_ADDRESS 0x400199D0 /* @ECU_Address@sDTC_FaultList.HistoryList.sHistory[12].uDTC.DTC@ */ /end MEASUREMENT
/begin MEASUREMENT DiagInfoList_13 "DTC Info" ULONG CM_DiagList 1 100 0 65535 FORMAT "%20.0" ECU_ADDRESS 0x400199E0 /* @ECU_Address@sDTC_FaultList.HistoryList.sHistory[13].uDTC.DTC@ */ /end MEASUREMENT
/begin MEASUREMENT DiagInfoList_14 "DTC Info" ULONG CM_DiagList 1 100 0 65535 FORMAT "%20.0" ECU_ADDRESS 0x400199F0 /* @ECU_Address@sDTC_FaultList.HistoryList.sHistory[14].uDTC.DTC@ */ /end MEASUREMENT
/begin MEASUREMENT DiagInfoList_15 "DTC Info" ULONG CM_DiagList 1 100 0 65535 FORMAT "%20.0" ECU_ADDRESS 0x40019A00 /* @ECU_Address@sDTC_FaultList.HistoryList.sHistory[15].uDTC.DTC@ */ /end MEASUREMENT
/begin MEASUREMENT DiagInfoList_16 "DTC Info" ULONG CM_DiagList 1 100 0 65535 FORMAT "%20.0" ECU_ADDRESS 0x40019A10 /* @ECU_Address@sDTC_FaultList.HistoryList.sHistory[16].uDTC.DTC@ */ /end MEASUREMENT
/begin MEASUREMENT DiagInfoList_17 "DTC Info" ULONG CM_DiagList 1 100 0 65535 FORMAT "%20.0" ECU_ADDRESS 0x40019A20 /* @ECU_Address@sDTC_FaultList.HistoryList.sHistory[17].uDTC.DTC@ */ /end MEASUREMENT
/begin MEASUREMENT DiagInfoList_18 "DTC Info" ULONG CM_DiagList 1 100 0 65535 FORMAT "%20.0" ECU_ADDRESS 0x40019A30 /* @ECU_Address@sDTC_FaultList.HistoryList.sHistory[18].uDTC.DTC@ */ /end MEASUREMENT
/begin MEASUREMENT DiagInfoList_19 "DTC Info" ULONG CM_DiagList 1 100 0 65535 FORMAT "%20.0" ECU_ADDRESS 0x40019A40 /* @ECU_Address@sDTC_FaultList.HistoryList.sHistory[19].uDTC.DTC@ */ /end MEASUREMENT
/begin MEASUREMENT DiagInfoList_20 "DTC Info" ULONG CM_DiagList 1 100 0 65535 FORMAT "%20.0" ECU_ADDRESS 0x40019A50 /* @ECU_Address@sDTC_FaultList.HistoryList.sHistory[20].uDTC.DTC@ */ /end MEASUREMENT
/begin MEASUREMENT DiagInfoList_21 "DTC Info" ULONG CM_DiagList 1 100 0 65535 FORMAT "%20.0" ECU_ADDRESS 0x40019A60 /* @ECU_Address@sDTC_FaultList.HistoryList.sHistory[21].uDTC.DTC@ */ /end MEASUREMENT
/begin MEASUREMENT DiagInfoList_22 "DTC Info" ULONG CM_DiagList 1 100 0 65535 FORMAT "%20.0" ECU_ADDRESS 0x40019A70 /* @ECU_Address@sDTC_FaultList.HistoryList.sHistory[22].uDTC.DTC@ */ /end MEASUREMENT
/begin MEASUREMENT DiagInfoList_23 "DTC Info" ULONG CM_DiagList 1 100 0 65535 FORMAT "%20.0" ECU_ADDRESS 0x40019A80 /* @ECU_Address@sDTC_FaultList.HistoryList.sHistory[23].uDTC.DTC@ */ /end MEASUREMENT
/begin MEASUREMENT DiagInfoList_24 "DTC Info" ULONG CM_DiagList 1 100 0 65535 FORMAT "%20.0" ECU_ADDRESS 0x40019A90 /* @ECU_Address@sDTC_FaultList.HistoryList.sHistory[24].uDTC.DTC@ */ /end MEASUREMENT
/begin MEASUREMENT DiagInfoList_25 "DTC Info" ULONG CM_DiagList 1 100 0 65535 FORMAT "%20.0" ECU_ADDRESS 0x40019AA0 /* @ECU_Address@sDTC_FaultList.HistoryList.sHistory[25].uDTC.DTC@ */ /end MEASUREMENT
/* HW_SPECIFIC_ALARM_LIST_END */ /* HW_SPECIFIC_DATABASE_START */
/begin COMPU_METHOD CM_DiagList "" TAB_VERB "%0.0" "" COMPU_TAB_REF CT_DiagList /end COMPU_METHOD
/begin COMPU_VTAB CT_DiagList "" TAB_VERB 3066 /*START_DTC_VALUE_PAIR*/ 0 "No Error" 33554463 "No Error" 2720 "PASSIVE:Coolant Temperature Over Shutdown" 2721 "PASSIVE:Coolant Temperature Under Shutdown" 2722 "PASSIVE:Coolant Temperature Intermittent" 2723 "PASSIVE:Coolant Temperature Short to Battery" 2724 "PASSIVE:Coolant Temperature Short to Ground" 2725 "PASSIVE:Coolant Temperature Open Load" 2726 "PASSIVE:Coolant Temperature Over Current" 2727 "PASSIVE:Coolant Temperature Wire Break" 2728 "PASSIVE:Coolant Temperature Freq Error" 2729 "PASSIVE:Coolant Temperature Update Rate Error" 2730 "PASSIVE:Coolant Temperature Gradient" 2731 "PASSIVE:Coolant Temperature Unknown Cause" 2732 "PASSIVE:Coolant Temperature Bad Component" 2733 "PASSIVE:Coolant Temperature Out Of Calibration" 2734 "PASSIVE:Coolant Temperature Special Instruction" 2735 "PASSIVE:Coolant Temperature Over Warning" 2736 "PASSIVE:Coolant Temperature Over Reduction" 2737 "PASSIVE:Coolant Temperature Under Warning" 2738 "PASSIVE:Coolant Temperature Under Reduction" 2740 "PASSIVE:Coolant Temperature Data Drift High" 2741 "PASSIVE:Coolant Temperature Data Drift Low" 32 "PASSIVE:Air Boost Temperature Over Shutdown" 33 "PASSIVE:Air Boost Temperature Under Shutdown" 34 "PASSIVE:Air Boost Temperature Intermittent" 35 "PASSIVE:Air Boost Temperature Short to Battery" 36 "PASSIVE:Air Boost Temperature Short to Ground" 37 "PASSIVE:Air Boost Temperature Open Load" 38 "PASSIVE:Air Boost Temperature Over Current" 39 "PASSIVE:Air Boost Temperature Wire Break" 40 "PASSIVE:Air Boost Temperature Freq Error" 41 "PASSIVE:Air Boost Temperature Update Rate Error" 42 "PASSIVE:Air Boost Temperature Gradient" 43 "PASSIVE:Air Boost Temperature Unknown Cause" 44 "PASSIVE:Air Boost Temperature Bad Component" 45 "PASSIVE:Air Boost Temperature Out Of Calibration" 46 "PASSIVE:Air Boost Temperature Special Instruction" 47 "PASSIVE:Air Boost Temperature Over Warning" 48 "PASSIVE:Air Boost Temperature Over Reduction" 49 "PASSIVE:Air Boost Temperature Under Warning" 50 "PASSIVE:Air Boost Temperature Under Reduction" 52 "PASSIVE:Air Boost Temperature Data Drift High" 53 "PASSIVE:Air Boost Temperature Data Drift Low" 64 "PASSIVE:Fuel Temperature Over Shutdown" 65 "PASSIVE:Fuel Temperature Under Shutdown" 66 "PASSIVE:Fuel Temperature Intermittent" 67 "PASSIVE:Fuel Temperature Short to Battery" 68 "PASSIVE:Fuel Temperature Short to Ground" 69 "PASSIVE:Fuel Temperature Open Load" 70 "PASSIVE:Fuel Temperature Over Current" 71 "PASSIVE:Fuel Temperature Wire Break" 72 "PASSIVE:Fuel Temperature Freq Error" 73 "PASSIVE:Fuel Temperature Update Rate Error" 74 "PASSIVE:Fuel Temperature Gradient" 75 "PASSIVE:Fuel Temperature Unknown Cause" 76 "PASSIVE:Fuel Temperature Bad Component" 77 "PASSIVE:Fuel Temperature Out Of Calibration" 78 "PASSIVE:Fuel Temperature Special Instruction" 79 "PASSIVE:Fuel Temperature Over Warning" 80 "PASSIVE:Fuel Temperature Over Reduction" 81 "PASSIVE:Fuel Temperature Under Warning" 82 "PASSIVE:Fuel Temperature Under Reduction" 84 "PASSIVE:Fuel Temperature Data Drift High" 85 "PASSIVE:Fuel Temperature Data Drift Low" 96 "PASSIVE:Oil Temperature Over Shutdown" 97 "PASSIVE:Oil Temperature Under Shutdown" 98 "PASSIVE:Oil Temperature Intermittent" 99 "PASSIVE:Oil Temperature Short to Battery" 100 "PASSIVE:Oil Temperature Short to Ground" 101 "PASSIVE:Oil Temperature Open Load" 102 "PASSIVE:Oil Temperature Over Current" 103 "PASSIVE:Oil Temperature Wire Break" 104 "PASSIVE:Oil Temperature Freq Error" 105 "PASSIVE:Oil Temperature Update Rate Error" 106 "PASSIVE:Oil Temperature Gradient" 107 "PASSIVE:Oil Temperature Unknown Cause" 108 "PASSIVE:Oil Temperature Bad Component" 109 "PASSIVE:Oil Temperature Out Of Calibration" 110 "PASSIVE:Oil Temperature Special Instruction" 111 "PASSIVE:Oil Temperature Over Warning" 112 "PASSIVE:Oil Temperature Over Reduction" 113 "PASSIVE:Oil Temperature Under Warning" 114 "PASSIVE:Oil Temperature Under Reduction" 116 "PASSIVE:Oil Temperature Data Drift High" 117 "PASSIVE:Oil Temperature Data Drift Low" 128 "PASSIVE:Ambient Air Temperature Over Shutdown" 129 "PASSIVE:Ambient Air Temperature Under Shutdown" 130 "PASSIVE:Ambient Air Temperature Intermittent" 131 "PASSIVE:Ambient Air Temperature Short to Battery" 132 "PASSIVE:Ambient Air Temperature Short to Ground" 133 "PASSIVE:Ambient Air Temperature Open Load" 134 "PASSIVE:Ambient Air Temperature Over Current" 135 "PASSIVE:Ambient Air Temperature Wire Break" 136 "PASSIVE:Ambient Air Temperature Freq Error" 137 "PASSIVE:Ambient Air Temperature Update Rate Error" 138 "PASSIVE:Ambient Air Temperature Gradient" 139 "PASSIVE:Ambient Air Temperature Unknown Cause" 140 "PASSIVE:Ambient Air Temperature Bad Component" 141 "PASSIVE:Ambient Air Temperature Out Of Calibration" 142 "PASSIVE:Ambient Air Temperature Special Instruction" 143 "PASSIVE:Ambient Air Temperature Over Warning" 144 "PASSIVE:Ambient Air Temperature Over Reduction" 145 "PASSIVE:Ambient Air Temperature Under Warning" 146 "PASSIVE:Ambient Air Temperature Under Reduction" 148 "PASSIVE:Ambient Air Temperature Data Drift High" 149 "PASSIVE:Ambient Air Temperature Data Drift Low" 160 "PASSIVE:Air Boost Pressure Over Shutdown" 161 "PASSIVE:Air Boost Pressure Under Shutdown" 162 "PASSIVE:Air Boost Pressure Intermittent" 163 "PASSIVE:Air Boost Pressure Short to Battery" 164 "PASSIVE:Air Boost Pressure Short to Ground" 165 "PASSIVE:Air Boost Pressure Open Load" 166 "PASSIVE:Air Boost Pressure Over Current" 167 "PASSIVE:Air Boost Pressure Wire Break" 168 "PASSIVE:Air Boost Pressure Freq Error" 169 "PASSIVE:Air Boost Pressure Update Rate Error" 170 "PASSIVE:Air Boost Pressure Gradient" 171 "PASSIVE:Air Boost Pressure Unknown Cause" 172 "PASSIVE:Air Boost Pressure Bad Component" 173 "PASSIVE:Air Boost Pressure Out Of Calibration" 174 "PASSIVE:Air Boost Pressure Special Instruction" 175 "PASSIVE:Air Boost Pressure Over Warning" 176 "PASSIVE:Air Boost Pressure Over Reduction" 177 "PASSIVE:Air Boost Pressure Under Warning" 178 "PASSIVE:Air Boost Pressure Under Reduction" 180 "PASSIVE:Air Boost Pressure Data Drift High" 181 "PASSIVE:Air Boost Pressure Data Drift Low" 192 "PASSIVE:Ambient Air Pressure Over Shutdown" 193 "PASSIVE:Ambient Air Pressure Under Shutdown" 194 "PASSIVE:Ambient Air Pressure Intermittent" 195 "PASSIVE:Ambient Air Pressure Short to Battery" 196 "PASSIVE:Ambient Air Pressure Short to Ground" 197 "PASSIVE:Ambient Air Pressure Open Load" 198 "PASSIVE:Ambient Air Pressure Over Current" 199 "PASSIVE:Ambient Air Pressure Wire Break" 200 "PASSIVE:Ambient Air Pressure Freq Error" 201 "PASSIVE:Ambient Air Pressure Update Rate Error" 202 "PASSIVE:Ambient Air Pressure Gradient" 203 "PASSIVE:Ambient Air Pressure Unknown Cause" 204 "PASSIVE:Ambient Air Pressure Bad Component" 205 "PASSIVE:Ambient Air Pressure Out Of Calibration" 206 "PASSIVE:Ambient Air Pressure Special Instruction" 207 "PASSIVE:Ambient Air Pressure Over Warning" 208 "PASSIVE:Ambient Air Pressure Over Reduction" 209 "PASSIVE:Ambient Air Pressure Under Warning" 210 "PASSIVE:Ambient Air Pressure Under Reduction" 212 "PASSIVE:Ambient Air Pressure Data Drift High" 213 "PASSIVE:Ambient Air Pressure Data Drift Low" 224 "PASSIVE:Oil Pressure Over Shutdown" 225 "PASSIVE:Oil Pressure Under Shutdown" 226 "PASSIVE:Oil Pressure Intermittent" 227 "PASSIVE:Oil Pressure Short to Battery" 228 "PASSIVE:Oil Pressure Short to Ground" 229 "PASSIVE:Oil Pressure Open Load" 230 "PASSIVE:Oil Pressure Over Current" 231 "PASSIVE:Oil Pressure Wire Break" 232 "PASSIVE:Oil Pressure Freq Error" 233 "PASSIVE:Oil Pressure Update Rate Error" 234 "PASSIVE:Oil Pressure Gradient" 235 "PASSIVE:Oil Pressure Unknown Cause" 236 "PASSIVE:Oil Pressure Bad Component" 237 "PASSIVE:Oil Pressure Out Of Calibration" 238 "PASSIVE:Oil Pressure Special Instruction" 239 "PASSIVE:Oil Pressure Over Warning" 240 "PASSIVE:Oil Pressure Over Reduction" 241 "PASSIVE:Oil Pressure Under Warning" 242 "PASSIVE:Oil Pressure Under Reduction" 244 "PASSIVE:Oil Pressure Data Drift High" 245 "PASSIVE:Oil Pressure Data Drift Low" 256 "PASSIVE:Fuel Pressure Over Shutdown" 257 "PASSIVE:Fuel Pressure Under Shutdown" 258 "PASSIVE:Fuel Pressure Intermittent" 259 "PASSIVE:Fuel Pressure Short to Battery" 260 "PASSIVE:Fuel Pressure Short to Ground" 261 "PASSIVE:Fuel Pressure Open Load" 262 "PASSIVE:Fuel Pressure Over Current" 263 "PASSIVE:Fuel Pressure Wire Break" 264 "PASSIVE:Fuel Pressure Freq Error" 265 "PASSIVE:Fuel Pressure Update Rate Error" 266 "PASSIVE:Fuel Pressure Gradient" 267 "PASSIVE:Fuel Pressure Unknown Cause" 268 "PASSIVE:Fuel Pressure Bad Component" 269 "PASSIVE:Fuel Pressure Out Of Calibration" 270 "PASSIVE:Fuel Pressure Special Instruction" 271 "PASSIVE:Fuel Pressure Over Warning" 272 "PASSIVE:Fuel Pressure Over Reduction" 273 "PASSIVE:Fuel Pressure Under Warning" 274 "PASSIVE:Fuel Pressure Under Reduction" 276 "PASSIVE:Fuel Pressure Data Drift High" 277 "PASSIVE:Fuel Pressure Data Drift Low" 288 "PASSIVE:Rail Pressure Over Shutdown" 289 "PASSIVE:Rail Pressure Under Shutdown" 290 "PASSIVE:Rail Pressure Intermittent" 291 "PASSIVE:Rail Pressure Short to Battery" 292 "PASSIVE:Rail Pressure Short to Ground" 293 "PASSIVE:Rail Pressure Open Load" 294 "PASSIVE:Rail Pressure Over Current" 295 "PASSIVE:Rail Pressure Wire Break" 296 "PASSIVE:Rail Pressure Freq Error" 297 "PASSIVE:Rail Pressure Update Rate Error" 298 "PASSIVE:Rail Pressure Gradient" 299 "PASSIVE:Rail Pressure Unknown Cause" 300 "PASSIVE:Rail Pressure Bad Component" 301 "PASSIVE:Rail Pressure Out Of Calibration" 302 "PASSIVE:Rail Pressure Special Instruction" 303 "PASSIVE:Rail Pressure Over Warning" 304 "PASSIVE:Rail Pressure Over Reduction" 305 "PASSIVE:Rail Pressure Under Warning" 306 "PASSIVE:Rail Pressure Under Reduction" 308 "PASSIVE:Rail Pressure Data Drift High" 309 "PASSIVE:Rail Pressure Data Drift Low" 320 "PASSIVE:Battery Voltage Over Shutdown" 321 "PASSIVE:Battery Voltage Under Shutdown" 322 "PASSIVE:Battery Voltage Intermittent" 323 "PASSIVE:Battery Voltage Short to Battery" 324 "PASSIVE:Battery Voltage Short to Ground" 325 "PASSIVE:Battery Voltage Open Load" 326 "PASSIVE:Battery Voltage Over Current" 327 "PASSIVE:Battery Voltage Wire Break" 328 "PASSIVE:Battery Voltage Freq Error" 329 "PASSIVE:Battery Voltage Update Rate Error" 330 "PASSIVE:Battery Voltage Gradient" 331 "PASSIVE:Battery Voltage Unknown Cause" 332 "PASSIVE:Battery Voltage Bad Component" 333 "PASSIVE:Battery Voltage Out Of Calibration" 334 "PASSIVE:Battery Voltage Special Instruction" 335 "PASSIVE:Battery Voltage Over Warning" 336 "PASSIVE:Battery Voltage Over Reduction" 337 "PASSIVE:Battery Voltage Under Warning" 338 "PASSIVE:Battery Voltage Under Reduction" 340 "PASSIVE:Battery Voltage Data Drift High" 341 "PASSIVE:Battery Voltage Data Drift Low" 3392 "PASSIVE:Battery Voltage Coherence Over Shutdown" 3393 "PASSIVE:Battery Voltage Coherence Under Shutdown" 3394 "PASSIVE:Battery Voltage Coherence Intermittent" 3395 "PASSIVE:Battery Voltage Coherence Short to Battery" 3396 "PASSIVE:Battery Voltage Coherence Short to Ground" 3397 "PASSIVE:Battery Voltage Coherence Open Load" 3398 "PASSIVE:Battery Voltage Coherence Over Current" 3399 "PASSIVE:Battery Voltage Coherence Wire Break" 3400 "PASSIVE:Battery Voltage Coherence Freq Error" 3401 "PASSIVE:Battery Voltage Coherence Update Rate Error" 3402 "PASSIVE:Battery Voltage Coherence Gradient" 3403 "PASSIVE:Battery Voltage Coherence Unknown Cause" 3404 "PASSIVE:Battery Voltage Coherence Bad Component" 3405 "PASSIVE:Battery Voltage Coherence Out Of Calibration" 3406 "PASSIVE:Battery Voltage Coherence Special Instruction" 3407 "PASSIVE:Battery Voltage Coherence Over Warning" 3408 "PASSIVE:Battery Voltage Coherence Over Reduction" 3409 "PASSIVE:Battery Voltage Coherence Under Warning" 3410 "PASSIVE:Battery Voltage Coherence Under Reduction" 3412 "PASSIVE:Battery Voltage Coherence Data Drift High" 3413 "PASSIVE:Battery Voltage Coherence Data Drift Low" 352 "PASSIVE:Ecu Temperature Over Shutdown" 353 "PASSIVE:Ecu Temperature Under Shutdown" 354 "PASSIVE:Ecu Temperature Intermittent" 355 "PASSIVE:Ecu Temperature Short to Battery" 356 "PASSIVE:Ecu Temperature Short to Ground" 357 "PASSIVE:Ecu Temperature Open Load" 358 "PASSIVE:Ecu Temperature Over Current" 359 "PASSIVE:Ecu Temperature Wire Break" 360 "PASSIVE:Ecu Temperature Freq Error" 361 "PASSIVE:Ecu Temperature Update Rate Error" 362 "PASSIVE:Ecu Temperature Gradient" 363 "PASSIVE:Ecu Temperature Unknown Cause" 364 "PASSIVE:Ecu Temperature Bad Component" 365 "PASSIVE:Ecu Temperature Out Of Calibration" 366 "PASSIVE:Ecu Temperature Special Instruction" 367 "PASSIVE:Ecu Temperature Over Warning" 368 "PASSIVE:Ecu Temperature Over Reduction" 369 "PASSIVE:Ecu Temperature Under Warning" 370 "PASSIVE:Ecu Temperature Under Reduction" 372 "PASSIVE:Ecu Temperature Data Drift High" 373 "PASSIVE:Ecu Temperature Data Drift Low" 384 "PASSIVE:Cylinder Misfire Over Shutdown" 385 "PASSIVE:Cylinder Misfire Under Shutdown" 386 "PASSIVE:Cylinder Misfire Intermittent" 387 "PASSIVE:Cylinder Misfire Short to Battery" 388 "PASSIVE:Cylinder Misfire Short to Ground" 389 "PASSIVE:Cylinder Misfire Open Load" 390 "PASSIVE:Cylinder Misfire Over Current" 391 "PASSIVE:Cylinder Misfire Wire Break" 392 "PASSIVE:Cylinder Misfire Freq Error" 393 "PASSIVE:Cylinder Misfire Update Rate Error" 394 "PASSIVE:Cylinder Misfire Gradient" 395 "PASSIVE:Cylinder Misfire Unknown Cause" 396 "PASSIVE:Cylinder Misfire Bad Component" 397 "PASSIVE:Cylinder Misfire Out Of Calibration" 398 "PASSIVE:Cylinder Misfire Special Instruction" 399 "PASSIVE:Cylinder Misfire Over Warning" 400 "PASSIVE:Cylinder Misfire Over Reduction" 401 "PASSIVE:Cylinder Misfire Under Warning" 402 "PASSIVE:Cylinder Misfire Under Reduction" 404 "PASSIVE:Cylinder Misfire Data Drift High" 405 "PASSIVE:Cylinder Misfire Data Drift Low" 416 "PASSIVE:Cam Crank Sensor Defect Over Shutdown" 417 "PASSIVE:Cam Crank Sensor Defect Under Shutdown" 418 "PASSIVE:Cam Crank Sensor Defect Intermittent" 419 "PASSIVE:Cam Crank Sensor Defect Short to Battery" 420 "PASSIVE:Cam Crank Sensor Defect Short to Ground" 421 "PASSIVE:Cam Crank Sensor Defect Open Load" 422 "PASSIVE:Cam Crank Sensor Defect Over Current" 423 "PASSIVE:Cam Crank Sensor Defect Wire Break" 424 "PASSIVE:Cam Crank Sensor Defect Freq Error" 425 "PASSIVE:Cam Crank Sensor Defect Update Rate Error" 426 "PASSIVE:Cam Crank Sensor Defect Gradient" 427 "PASSIVE:Cam Crank Sensor Defect Unknown Cause" 428 "PASSIVE:Cam Crank Sensor Defect Bad Component" 429 "PASSIVE:Cam Crank Sensor Defect Out Of Calibration" 430 "PASSIVE:Cam Crank Sensor Defect Special Instruction" 431 "PASSIVE:Cam Crank Sensor Defect Over Warning" 432 "PASSIVE:Cam Crank Sensor Defect Over Reduction" 433 "PASSIVE:Cam Crank Sensor Defect Under Warning" 434 "PASSIVE:Cam Crank Sensor Defect Under Reduction" 436 "PASSIVE:Cam Crank Sensor Defect Data Drift High" 437 "PASSIVE:Cam Crank Sensor Defect Data Drift Low" 448 "PASSIVE:Injector Defect Over Shutdown" 449 "PASSIVE:Injector Defect Under Shutdown" 450 "PASSIVE:Injector Defect Intermittent" 451 "PASSIVE:Injector Defect Short to Battery" 452 "PASSIVE:Injector Defect Short to Ground" 453 "PASSIVE:Injector Defect Open Load" 454 "PASSIVE:Injector Defect Over Current" 455 "PASSIVE:Injector Defect Wire Break" 456 "PASSIVE:Injector Defect Freq Error" 457 "PASSIVE:Injector Defect Update Rate Error" 458 "PASSIVE:Injector Defect Gradient" 459 "PASSIVE:Injector Defect Unknown Cause" 460 "PASSIVE:Injector Defect Bad Component" 461 "PASSIVE:Injector Defect Out Of Calibration" 462 "PASSIVE:Injector Defect Special Instruction" 463 "PASSIVE:Injector Defect Over Warning" 464 "PASSIVE:Injector Defect Over Reduction" 465 "PASSIVE:Injector Defect Under Warning" 466 "PASSIVE:Injector Defect Under Reduction" 468 "PASSIVE:Injector Defect Data Drift High" 469 "PASSIVE:Injector Defect Data Drift Low" 480 "PASSIVE:Over Speed Error Over Shutdown" 481 "PASSIVE:Over Speed Error Under Shutdown" 482 "PASSIVE:Over Speed Error Intermittent" 483 "PASSIVE:Over Speed Error Short to Battery" 484 "PASSIVE:Over Speed Error Short to Ground" 485 "PASSIVE:Over Speed Error Open Load" 486 "PASSIVE:Over Speed Error Over Current" 487 "PASSIVE:Over Speed Error Wire Break" 488 "PASSIVE:Over Speed Error Freq Error" 489 "PASSIVE:Over Speed Error Update Rate Error" 490 "PASSIVE:Over Speed Error Gradient" 491 "PASSIVE:Over Speed Error Unknown Cause" 492 "PASSIVE:Over Speed Error Bad Component" 493 "PASSIVE:Over Speed Error Out Of Calibration" 494 "PASSIVE:Over Speed Error Special Instruction" 495 "PASSIVE:Over Speed Error Over Warning" 496 "PASSIVE:Over Speed Error Over Reduction" 497 "PASSIVE:Over Speed Error Under Warning" 498 "PASSIVE:Over Speed Error Under Reduction" 500 "PASSIVE:Over Speed Error Data Drift High" 501 "PASSIVE:Over Speed Error Data Drift Low" 544 "PASSIVE:Start Request Over Shutdown" 545 "PASSIVE:Start Request Under Shutdown" 546 "PASSIVE:Start Request Intermittent" 547 "PASSIVE:Start Request Short to Battery" 548 "PASSIVE:Start Request Short to Ground" 549 "PASSIVE:Start Request Open Load" 550 "PASSIVE:Start Request Over Current" 551 "PASSIVE:Start Request Wire Break" 552 "PASSIVE:Start Request Freq Error" 553 "PASSIVE:Start Request Update Rate Error" 554 "PASSIVE:Start Request Gradient" 555 "PASSIVE:Start Request Unknown Cause" 556 "PASSIVE:Start Request Bad Component" 557 "PASSIVE:Start Request Out Of Calibration" 558 "PASSIVE:Start Request Special Instruction" 559 "PASSIVE:Start Request Over Warning" 560 "PASSIVE:Start Request Over Reduction" 561 "PASSIVE:Start Request Under Warning" 562 "PASSIVE:Start Request Under Reduction" 564 "PASSIVE:Start Request Data Drift High" 565 "PASSIVE:Start Request Data Drift Low" 576 "PASSIVE:Engine Break100 Over Shutdown" 577 "PASSIVE:Engine Break100 Under Shutdown" 578 "PASSIVE:Engine Break100 Intermittent" 579 "PASSIVE:Engine Break100 Short to Battery" 580 "PASSIVE:Engine Break100 Short to Ground" 581 "PASSIVE:Engine Break100 Open Load" 582 "PASSIVE:Engine Break100 Over Current" 583 "PASSIVE:Engine Break100 Wire Break" 584 "PASSIVE:Engine Break100 Freq Error" 585 "PASSIVE:Engine Break100 Update Rate Error" 586 "PASSIVE:Engine Break100 Gradient" 587 "PASSIVE:Engine Break100 Unknown Cause" 588 "PASSIVE:Engine Break100 Bad Component" 589 "PASSIVE:Engine Break100 Out Of Calibration" 590 "PASSIVE:Engine Break100 Special Instruction" 591 "PASSIVE:Engine Break100 Over Warning" 592 "PASSIVE:Engine Break100 Over Reduction" 593 "PASSIVE:Engine Break100 Under Warning" 594 "PASSIVE:Engine Break100 Under Reduction" 596 "PASSIVE:Engine Break100 Data Drift High" 597 "PASSIVE:Engine Break100 Data Drift Low" 608 "PASSIVE:Cruise Control 1 Over Shutdown" 609 "PASSIVE:Cruise Control 1 Under Shutdown" 610 "PASSIVE:Cruise Control 1 Intermittent" 611 "PASSIVE:Cruise Control 1 Short to Battery" 612 "PASSIVE:Cruise Control 1 Short to Ground" 613 "PASSIVE:Cruise Control 1 Open Load" 614 "PASSIVE:Cruise Control 1 Over Current" 615 "PASSIVE:Cruise Control 1 Wire Break" 616 "PASSIVE:Cruise Control 1 Freq Error" 617 "PASSIVE:Cruise Control 1 Update Rate Error" 618 "PASSIVE:Cruise Control 1 Gradient" 619 "PASSIVE:Cruise Control 1 Unknown Cause" 620 "PASSIVE:Cruise Control 1 Bad Component" 621 "PASSIVE:Cruise Control 1 Out Of Calibration" 622 "PASSIVE:Cruise Control 1 Special Instruction" 623 "PASSIVE:Cruise Control 1 Over Warning" 624 "PASSIVE:Cruise Control 1 Over Reduction" 625 "PASSIVE:Cruise Control 1 Under Warning" 626 "PASSIVE:Cruise Control 1 Under Reduction" 628 "PASSIVE:Cruise Control 1 Data Drift High" 629 "PASSIVE:Cruise Control 1 Data Drift Low" 640 "PASSIVE:Cruise Control 2 Over Shutdown" 641 "PASSIVE:Cruise Control 2 Under Shutdown" 642 "PASSIVE:Cruise Control 2 Intermittent" 643 "PASSIVE:Cruise Control 2 Short to Battery" 644 "PASSIVE:Cruise Control 2 Short to Ground" 645 "PASSIVE:Cruise Control 2 Open Load" 646 "PASSIVE:Cruise Control 2 Over Current" 647 "PASSIVE:Cruise Control 2 Wire Break" 648 "PASSIVE:Cruise Control 2 Freq Error" 649 "PASSIVE:Cruise Control 2 Update Rate Error" 650 "PASSIVE:Cruise Control 2 Gradient" 651 "PASSIVE:Cruise Control 2 Unknown Cause" 652 "PASSIVE:Cruise Control 2 Bad Component" 653 "PASSIVE:Cruise Control 2 Out Of Calibration" 654 "PASSIVE:Cruise Control 2 Special Instruction" 655 "PASSIVE:Cruise Control 2 Over Warning" 656 "PASSIVE:Cruise Control 2 Over Reduction" 657 "PASSIVE:Cruise Control 2 Under Warning" 658 "PASSIVE:Cruise Control 2 Under Reduction" 660 "PASSIVE:Cruise Control 2 Data Drift High" 661 "PASSIVE:Cruise Control 2 Data Drift Low" 672 "PASSIVE:Brake Pedal 1 Over Shutdown" 673 "PASSIVE:Brake Pedal 1 Under Shutdown" 674 "PASSIVE:Brake Pedal 1 Intermittent" 675 "PASSIVE:Brake Pedal 1 Short to Battery" 676 "PASSIVE:Brake Pedal 1 Short to Ground" 677 "PASSIVE:Brake Pedal 1 Open Load" 678 "PASSIVE:Brake Pedal 1 Over Current" 679 "PASSIVE:Brake Pedal 1 Wire Break" 680 "PASSIVE:Brake Pedal 1 Freq Error" 681 "PASSIVE:Brake Pedal 1 Update Rate Error" 682 "PASSIVE:Brake Pedal 1 Gradient" 683 "PASSIVE:Brake Pedal 1 Unknown Cause" 684 "PASSIVE:Brake Pedal 1 Bad Component" 685 "PASSIVE:Brake Pedal 1 Out Of Calibration" 686 "PASSIVE:Brake Pedal 1 Special Instruction" 687 "PASSIVE:Brake Pedal 1 Over Warning" 688 "PASSIVE:Brake Pedal 1 Over Reduction" 689 "PASSIVE:Brake Pedal 1 Under Warning" 690 "PASSIVE:Brake Pedal 1 Under Reduction" 692 "PASSIVE:Brake Pedal 1 Data Drift High" 693 "PASSIVE:Brake Pedal 1 Data Drift Low" 704 "PASSIVE:Cruise Control 3 Over Shutdown" 705 "PASSIVE:Cruise Control 3 Under Shutdown" 706 "PASSIVE:Cruise Control 3 Intermittent" 707 "PASSIVE:Cruise Control 3 Short to Battery" 708 "PASSIVE:Cruise Control 3 Short to Ground" 709 "PASSIVE:Cruise Control 3 Open Load" 710 "PASSIVE:Cruise Control 3 Over Current" 711 "PASSIVE:Cruise Control 3 Wire Break" 712 "PASSIVE:Cruise Control 3 Freq Error" 713 "PASSIVE:Cruise Control 3 Update Rate Error" 714 "PASSIVE:Cruise Control 3 Gradient" 715 "PASSIVE:Cruise Control 3 Unknown Cause" 716 "PASSIVE:Cruise Control 3 Bad Component" 717 "PASSIVE:Cruise Control 3 Out Of Calibration" 718 "PASSIVE:Cruise Control 3 Special Instruction" 719 "PASSIVE:Cruise Control 3 Over Warning" 720 "PASSIVE:Cruise Control 3 Over Reduction" 721 "PASSIVE:Cruise Control 3 Under Warning" 722 "PASSIVE:Cruise Control 3 Under Reduction" 724 "PASSIVE:Cruise Control 3 Data Drift High" 725 "PASSIVE:Cruise Control 3 Data Drift Low" 736 "PASSIVE:Engine Break 50 Over Shutdown" 737 "PASSIVE:Engine Break 50 Under Shutdown" 738 "PASSIVE:Engine Break 50 Intermittent" 739 "PASSIVE:Engine Break 50 Short to Battery" 740 "PASSIVE:Engine Break 50 Short to Ground" 741 "PASSIVE:Engine Break 50 Open Load" 742 "PASSIVE:Engine Break 50 Over Current" 743 "PASSIVE:Engine Break 50 Wire Break" 744 "PASSIVE:Engine Break 50 Freq Error" 745 "PASSIVE:Engine Break 50 Update Rate Error" 746 "PASSIVE:Engine Break 50 Gradient" 747 "PASSIVE:Engine Break 50 Unknown Cause" 748 "PASSIVE:Engine Break 50 Bad Component" 749 "PASSIVE:Engine Break 50 Out Of Calibration" 750 "PASSIVE:Engine Break 50 Special Instruction" 751 "PASSIVE:Engine Break 50 Over Warning" 752 "PASSIVE:Engine Break 50 Over Reduction" 753 "PASSIVE:Engine Break 50 Under Warning" 754 "PASSIVE:Engine Break 50 Under Reduction" 756 "PASSIVE:Engine Break 50 Data Drift High" 757 "PASSIVE:Engine Break 50 Data Drift Low" 800 "PASSIVE:Hand Brake Parking Over Shutdown" 801 "PASSIVE:Hand Brake Parking Under Shutdown" 802 "PASSIVE:Hand Brake Parking Intermittent" 803 "PASSIVE:Hand Brake Parking Short to Battery" 804 "PASSIVE:Hand Brake Parking Short to Ground" 805 "PASSIVE:Hand Brake Parking Open Load" 806 "PASSIVE:Hand Brake Parking Over Current" 807 "PASSIVE:Hand Brake Parking Wire Break" 808 "PASSIVE:Hand Brake Parking Freq Error" 809 "PASSIVE:Hand Brake Parking Update Rate Error" 810 "PASSIVE:Hand Brake Parking Gradient" 811 "PASSIVE:Hand Brake Parking Unknown Cause" 812 "PASSIVE:Hand Brake Parking Bad Component" 813 "PASSIVE:Hand Brake Parking Out Of Calibration" 814 "PASSIVE:Hand Brake Parking Special Instruction" 815 "PASSIVE:Hand Brake Parking Over Warning" 816 "PASSIVE:Hand Brake Parking Over Reduction" 817 "PASSIVE:Hand Brake Parking Under Warning" 818 "PASSIVE:Hand Brake Parking Under Reduction" 820 "PASSIVE:Hand Brake Parking Data Drift High" 821 "PASSIVE:Hand Brake Parking Data Drift Low" 832 "PASSIVE:Overriding Switch Over Shutdown" 833 "PASSIVE:Overriding Switch Under Shutdown" 834 "PASSIVE:Overriding Switch Intermittent" 835 "PASSIVE:Overriding Switch Short to Battery" 836 "PASSIVE:Overriding Switch Short to Ground" 837 "PASSIVE:Overriding Switch Open Load" 838 "PASSIVE:Overriding Switch Over Current" 839 "PASSIVE:Overriding Switch Wire Break" 840 "PASSIVE:Overriding Switch Freq Error" 841 "PASSIVE:Overriding Switch Update Rate Error" 842 "PASSIVE:Overriding Switch Gradient" 843 "PASSIVE:Overriding Switch Unknown Cause" 844 "PASSIVE:Overriding Switch Bad Component" 845 "PASSIVE:Overriding Switch Out Of Calibration" 846 "PASSIVE:Overriding Switch Special Instruction" 847 "PASSIVE:Overriding Switch Over Warning" 848 "PASSIVE:Overriding Switch Over Reduction" 849 "PASSIVE:Overriding Switch Under Warning" 850 "PASSIVE:Overriding Switch Under Reduction" 852 "PASSIVE:Overriding Switch Data Drift High" 853 "PASSIVE:Overriding Switch Data Drift Low" 864 "PASSIVE:Ignition Over Shutdown" 865 "PASSIVE:Ignition Under Shutdown" 866 "PASSIVE:Ignition Intermittent" 867 "PASSIVE:Ignition Short to Battery" 868 "PASSIVE:Ignition Short to Ground" 869 "PASSIVE:Ignition Open Load" 870 "PASSIVE:Ignition Over Current" 871 "PASSIVE:Ignition Wire Break" 872 "PASSIVE:Ignition Freq Error" 873 "PASSIVE:Ignition Update Rate Error" 874 "PASSIVE:Ignition Gradient" 875 "PASSIVE:Ignition Unknown Cause" 876 "PASSIVE:Ignition Bad Component" 877 "PASSIVE:Ignition Out Of Calibration" 878 "PASSIVE:Ignition Special Instruction" 879 "PASSIVE:Ignition Over Warning" 880 "PASSIVE:Ignition Over Reduction" 881 "PASSIVE:Ignition Under Warning" 882 "PASSIVE:Ignition Under Reduction" 884 "PASSIVE:Ignition Data Drift High" 885 "PASSIVE:Ignition Data Drift Low" 896 "PASSIVE:Grid Heater Over Shutdown" 897 "PASSIVE:Grid Heater Under Shutdown" 898 "PASSIVE:Grid Heater Intermittent" 899 "PASSIVE:Grid Heater Short to Battery" 900 "PASSIVE:Grid Heater Short to Ground" 901 "PASSIVE:Grid Heater Open Load" 902 "PASSIVE:Grid Heater Over Current" 903 "PASSIVE:Grid Heater Wire Break" 904 "PASSIVE:Grid Heater Freq Error" 905 "PASSIVE:Grid Heater Update Rate Error" 906 "PASSIVE:Grid Heater Gradient" 907 "PASSIVE:Grid Heater Unknown Cause" 908 "PASSIVE:Grid Heater Bad Component" 909 "PASSIVE:Grid Heater Out Of Calibration" 910 "PASSIVE:Grid Heater Special Instruction" 911 "PASSIVE:Grid Heater Over Warning" 912 "PASSIVE:Grid Heater Over Reduction" 913 "PASSIVE:Grid Heater Under Warning" 914 "PASSIVE:Grid Heater Under Reduction" 916 "PASSIVE:Grid Heater Data Drift High" 917 "PASSIVE:Grid Heater Data Drift Low" 1344 "PASSIVE:Coolant Temperature Diag Over Shutdown" 1345 "PASSIVE:Coolant Temperature Diag Under Shutdown" 1346 "PASSIVE:Coolant Temperature Diag Intermittent" 1347 "PASSIVE:Coolant Temperature Diag Short to Battery" 1348 "PASSIVE:Coolant Temperature Diag Short to Ground" 1349 "PASSIVE:Coolant Temperature Diag Open Load" 1350 "PASSIVE:Coolant Temperature Diag Over Current" 1351 "PASSIVE:Coolant Temperature Diag Wire Break" 1352 "PASSIVE:Coolant Temperature Diag Freq Error" 1353 "PASSIVE:Coolant Temperature Diag Update Rate Error" 1354 "PASSIVE:Coolant Temperature Diag Gradient" 1355 "PASSIVE:Coolant Temperature Diag Unknown Cause" 1356 "PASSIVE:Coolant Temperature Diag Bad Component" 1357 "PASSIVE:Coolant Temperature Diag Out Of Calibration" 1358 "PASSIVE:Coolant Temperature Diag Special Instruction" 1359 "PASSIVE:Coolant Temperature Diag Over Warning" 1360 "PASSIVE:Coolant Temperature Diag Over Reduction" 1361 "PASSIVE:Coolant Temperature Diag Under Warning" 1362 "PASSIVE:Coolant Temperature Diag Under Reduction" 1364 "PASSIVE:Coolant Temperature Diag Data Drift High" 1365 "PASSIVE:Coolant Temperature Diag Data Drift Low" 1376 "PASSIVE:Air Boost Temperature Diag Over Shutdown" 1377 "PASSIVE:Air Boost Temperature Diag Under Shutdown" 1378 "PASSIVE:Air Boost Temperature Diag Intermittent" 1379 "PASSIVE:Air Boost Temperature Diag Short to Battery" 1380 "PASSIVE:Air Boost Temperature Diag Short to Ground" 1381 "PASSIVE:Air Boost Temperature Diag Open Load" 1382 "PASSIVE:Air Boost Temperature Diag Over Current" 1383 "PASSIVE:Air Boost Temperature Diag Wire Break" 1384 "PASSIVE:Air Boost Temperature Diag Freq Error" 1385 "PASSIVE:Air Boost Temperature Diag Update Rate Error" 1386 "PASSIVE:Air Boost Temperature Diag Gradient" 1387 "PASSIVE:Air Boost Temperature Diag Unknown Cause" 1388 "PASSIVE:Air Boost Temperature Diag Bad Component" 1389 "PASSIVE:Air Boost Temperature Diag Out Of Calibration" 1390 "PASSIVE:Air Boost Temperature Diag Special Instruction" 1391 "PASSIVE:Air Boost Temperature Diag Over Warning" 1392 "PASSIVE:Air Boost Temperature Diag Over Reduction" 1393 "PASSIVE:Air Boost Temperature Diag Under Warning" 1394 "PASSIVE:Air Boost Temperature Diag Under Reduction" 1396 "PASSIVE:Air Boost Temperature Diag Data Drift High" 1397 "PASSIVE:Air Boost Temperature Diag Data Drift Low" 1632 "PASSIVE:Accelerator Pedal 1 Over Shutdown" 1633 "PASSIVE:Accelerator Pedal 1 Under Shutdown" 1634 "PASSIVE:Accelerator Pedal 1 Intermittent" 1635 "PASSIVE:Accelerator Pedal 1 Short to Battery" 1636 "PASSIVE:Accelerator Pedal 1 Short to Ground" 1637 "PASSIVE:Accelerator Pedal 1 Open Load" 1638 "PASSIVE:Accelerator Pedal 1 Over Current" 1639 "PASSIVE:Accelerator Pedal 1 Wire Break" 1640 "PASSIVE:Accelerator Pedal 1 Freq Error" 1641 "PASSIVE:Accelerator Pedal 1 Update Rate Error" 1642 "PASSIVE:Accelerator Pedal 1 Gradient" 1643 "PASSIVE:Accelerator Pedal 1 Unknown Cause" 1644 "PASSIVE:Accelerator Pedal 1 Bad Component" 1645 "PASSIVE:Accelerator Pedal 1 Out Of Calibration" 1646 "PASSIVE:Accelerator Pedal 1 Special Instruction" 1647 "PASSIVE:Accelerator Pedal 1 Over Warning" 1648 "PASSIVE:Accelerator Pedal 1 Over Reduction" 1649 "PASSIVE:Accelerator Pedal 1 Under Warning" 1650 "PASSIVE:Accelerator Pedal 1 Under Reduction" 1652 "PASSIVE:Accelerator Pedal 1 Data Drift High" 1653 "PASSIVE:Accelerator Pedal 1 Data Drift Low" 1664 "PASSIVE:Accelerator Pedal 2 Over Shutdown" 1665 "PASSIVE:Accelerator Pedal 2 Under Shutdown" 1666 "PASSIVE:Accelerator Pedal 2 Intermittent" 1667 "PASSIVE:Accelerator Pedal 2 Short to Battery" 1668 "PASSIVE:Accelerator Pedal 2 Short to Ground" 1669 "PASSIVE:Accelerator Pedal 2 Open Load" 1670 "PASSIVE:Accelerator Pedal 2 Over Current" 1671 "PASSIVE:Accelerator Pedal 2 Wire Break" 1672 "PASSIVE:Accelerator Pedal 2 Freq Error" 1673 "PASSIVE:Accelerator Pedal 2 Update Rate Error" 1674 "PASSIVE:Accelerator Pedal 2 Gradient" 1675 "PASSIVE:Accelerator Pedal 2 Unknown Cause" 1676 "PASSIVE:Accelerator Pedal 2 Bad Component" 1677 "PASSIVE:Accelerator Pedal 2 Out Of Calibration" 1678 "PASSIVE:Accelerator Pedal 2 Special Instruction" 1679 "PASSIVE:Accelerator Pedal 2 Over Warning" 1680 "PASSIVE:Accelerator Pedal 2 Over Reduction" 1681 "PASSIVE:Accelerator Pedal 2 Under Warning" 1682 "PASSIVE:Accelerator Pedal 2 Under Reduction" 1684 "PASSIVE:Accelerator Pedal 2 Data Drift High" 1685 "PASSIVE:Accelerator Pedal 2 Data Drift Low" 1952 "PASSIVE:VCV Current Output Over Shutdown" 1953 "PASSIVE:VCV Current Output Under Shutdown" 1954 "PASSIVE:VCV Current Output Intermittent" 1955 "PASSIVE:VCV Current Output Short to Battery" 1956 "PASSIVE:VCV Current Output Short to Ground" 1957 "PASSIVE:VCV Current Output Open Load" 1958 "PASSIVE:VCV Current Output Over Current" 1959 "PASSIVE:VCV Current Output Wire Break" 1960 "PASSIVE:VCV Current Output Freq Error" 1961 "PASSIVE:VCV Current Output Update Rate Error" 1962 "PASSIVE:VCV Current Output Gradient" 1963 "PASSIVE:VCV Current Output Unknown Cause" 1964 "PASSIVE:VCV Current Output Bad Component" 1965 "PASSIVE:VCV Current Output Out Of Calibration" 1966 "PASSIVE:VCV Current Output Special Instruction" 1967 "PASSIVE:VCV Current Output Over Warning" 1968 "PASSIVE:VCV Current Output Over Reduction" 1969 "PASSIVE:VCV Current Output Under Warning" 1970 "PASSIVE:VCV Current Output Under Reduction" 1972 "PASSIVE:VCV Current Output Data Drift High" 1973 "PASSIVE:VCV Current Output Data Drift Low" 1984 "PASSIVE:PCV Current Output Over Shutdown" 1985 "PASSIVE:PCV Current Output Under Shutdown" 1986 "PASSIVE:PCV Current Output Intermittent" 1987 "PASSIVE:PCV Current Output Short to Battery" 1988 "PASSIVE:PCV Current Output Short to Ground" 1989 "PASSIVE:PCV Current Output Open Load" 1990 "PASSIVE:PCV Current Output Over Current" 1991 "PASSIVE:PCV Current Output Wire Break" 1992 "PASSIVE:PCV Current Output Freq Error" 1993 "PASSIVE:PCV Current Output Update Rate Error" 1994 "PASSIVE:PCV Current Output Gradient" 1995 "PASSIVE:PCV Current Output Unknown Cause" 1996 "PASSIVE:PCV Current Output Bad Component" 1997 "PASSIVE:PCV Current Output Out Of Calibration" 1998 "PASSIVE:PCV Current Output Special Instruction" 1999 "PASSIVE:PCV Current Output Over Warning" 2000 "PASSIVE:PCV Current Output Over Reduction" 2001 "PASSIVE:PCV Current Output Under Warning" 2002 "PASSIVE:PCV Current Output Under Reduction" 2004 "PASSIVE:PCV Current Output Data Drift High" 2005 "PASSIVE:PCV Current Output Data Drift Low" 2112 "PASSIVE:VoltageDigitalOutputFeedback1 Over Shutdown" 2113 "PASSIVE:VoltageDigitalOutputFeedback1 Under Shutdown" 2114 "PASSIVE:VoltageDigitalOutputFeedback1 Intermittent" 2115 "PASSIVE:VoltageDigitalOutputFeedback1 Short to Battery" 2116 "PASSIVE:VoltageDigitalOutputFeedback1 Short to Ground" 2117 "PASSIVE:VoltageDigitalOutputFeedback1 Open Load" 2118 "PASSIVE:VoltageDigitalOutputFeedback1 Over Current" 2119 "PASSIVE:VoltageDigitalOutputFeedback1 Wire Break" 2120 "PASSIVE:VoltageDigitalOutputFeedback1 Freq Error" 2121 "PASSIVE:VoltageDigitalOutputFeedback1 Update Rate Error" 2122 "PASSIVE:VoltageDigitalOutputFeedback1 Gradient" 2123 "PASSIVE:VoltageDigitalOutputFeedback1 Unknown Cause" 2124 "PASSIVE:VoltageDigitalOutputFeedback1 Bad Component" 2125 "PASSIVE:VoltageDigitalOutputFeedback1 Out Of Calibration" 2126 "PASSIVE:VoltageDigitalOutputFeedback1 Special Instruction" 2127 "PASSIVE:VoltageDigitalOutputFeedback1 Over Warning" 2128 "PASSIVE:VoltageDigitalOutputFeedback1 Over Reduction" 2129 "PASSIVE:VoltageDigitalOutputFeedback1 Under Warning" 2130 "PASSIVE:VoltageDigitalOutputFeedback1 Under Reduction" 2132 "PASSIVE:VoltageDigitalOutputFeedback1 Data Drift High" 2133 "PASSIVE:VoltageDigitalOutputFeedback1 Data Drift Low" 2208 "PASSIVE:RSL Lamp Diagnostic Over Shutdown" 2209 "PASSIVE:RSL Lamp Diagnostic Under Shutdown" 2210 "PASSIVE:RSL Lamp Diagnostic Intermittent" 2211 "PASSIVE:RSL Lamp Diagnostic Short to Battery" 2212 "PASSIVE:RSL Lamp Diagnostic Short to Ground" 2213 "PASSIVE:RSL Lamp Diagnostic Open Load" 2214 "PASSIVE:RSL Lamp Diagnostic Over Current" 2215 "PASSIVE:RSL Lamp Diagnostic Wire Break" 2216 "PASSIVE:RSL Lamp Diagnostic Freq Error" 2217 "PASSIVE:RSL Lamp Diagnostic Update Rate Error" 2218 "PASSIVE:RSL Lamp Diagnostic Gradient" 2219 "PASSIVE:RSL Lamp Diagnostic Unknown Cause" 2220 "PASSIVE:RSL Lamp Diagnostic Bad Component" 2221 "PASSIVE:RSL Lamp Diagnostic Out Of Calibration" 2222 "PASSIVE:RSL Lamp Diagnostic Special Instruction" 2223 "PASSIVE:RSL Lamp Diagnostic Over Warning" 2224 "PASSIVE:RSL Lamp Diagnostic Over Reduction" 2225 "PASSIVE:RSL Lamp Diagnostic Under Warning" 2226 "PASSIVE:RSL Lamp Diagnostic Under Reduction" 2228 "PASSIVE:RSL Lamp Diagnostic Data Drift High" 2229 "PASSIVE:RSL Lamp Diagnostic Data Drift Low" 2240 "PASSIVE:CSL Lamp Diagnostic Over Shutdown" 2241 "PASSIVE:CSL Lamp Diagnostic Under Shutdown" 2242 "PASSIVE:CSL Lamp Diagnostic Intermittent" 2243 "PASSIVE:CSL Lamp Diagnostic Short to Battery" 2244 "PASSIVE:CSL Lamp Diagnostic Short to Ground" 2245 "PASSIVE:CSL Lamp Diagnostic Open Load" 2246 "PASSIVE:CSL Lamp Diagnostic Over Current" 2247 "PASSIVE:CSL Lamp Diagnostic Wire Break" 2248 "PASSIVE:CSL Lamp Diagnostic Freq Error" 2249 "PASSIVE:CSL Lamp Diagnostic Update Rate Error" 2250 "PASSIVE:CSL Lamp Diagnostic Gradient" 2251 "PASSIVE:CSL Lamp Diagnostic Unknown Cause" 2252 "PASSIVE:CSL Lamp Diagnostic Bad Component" 2253 "PASSIVE:CSL Lamp Diagnostic Out Of Calibration" 2254 "PASSIVE:CSL Lamp Diagnostic Special Instruction" 2255 "PASSIVE:CSL Lamp Diagnostic Over Warning" 2256 "PASSIVE:CSL Lamp Diagnostic Over Reduction" 2257 "PASSIVE:CSL Lamp Diagnostic Under Warning" 2258 "PASSIVE:CSL Lamp Diagnostic Under Reduction" 2260 "PASSIVE:CSL Lamp Diagnostic Data Drift High" 2261 "PASSIVE:CSL Lamp Diagnostic Data Drift Low" 2304 "PASSIVE:AWL Lamp Diagnostic Over Shutdown" 2305 "PASSIVE:AWL Lamp Diagnostic Under Shutdown" 2306 "PASSIVE:AWL Lamp Diagnostic Intermittent" 2307 "PASSIVE:AWL Lamp Diagnostic Short to Battery" 2308 "PASSIVE:AWL Lamp Diagnostic Short to Ground" 2309 "PASSIVE:AWL Lamp Diagnostic Open Load" 2310 "PASSIVE:AWL Lamp Diagnostic Over Current" 2311 "PASSIVE:AWL Lamp Diagnostic Wire Break" 2312 "PASSIVE:AWL Lamp Diagnostic Freq Error" 2313 "PASSIVE:AWL Lamp Diagnostic Update Rate Error" 2314 "PASSIVE:AWL Lamp Diagnostic Gradient" 2315 "PASSIVE:AWL Lamp Diagnostic Unknown Cause" 2316 "PASSIVE:AWL Lamp Diagnostic Bad Component" 2317 "PASSIVE:AWL Lamp Diagnostic Out Of Calibration" 2318 "PASSIVE:AWL Lamp Diagnostic Special Instruction" 2319 "PASSIVE:AWL Lamp Diagnostic Over Warning" 2320 "PASSIVE:AWL Lamp Diagnostic Over Reduction" 2321 "PASSIVE:AWL Lamp Diagnostic Under Warning" 2322 "PASSIVE:AWL Lamp Diagnostic Under Reduction" 2324 "PASSIVE:AWL Lamp Diagnostic Data Drift High" 2325 "PASSIVE:AWL Lamp Diagnostic Data Drift Low" 2336 "PASSIVE:Voltage48V Over Shutdown" 2337 "PASSIVE:Voltage48V Under Shutdown" 2338 "PASSIVE:Voltage48V Intermittent" 2339 "PASSIVE:Voltage48V Short to Battery" 2340 "PASSIVE:Voltage48V Short to Ground" 2341 "PASSIVE:Voltage48V Open Load" 2342 "PASSIVE:Voltage48V Over Current" 2343 "PASSIVE:Voltage48V Wire Break" 2344 "PASSIVE:Voltage48V Freq Error" 2345 "PASSIVE:Voltage48V Update Rate Error" 2346 "PASSIVE:Voltage48V Gradient" 2347 "PASSIVE:Voltage48V Unknown Cause" 2348 "PASSIVE:Voltage48V Bad Component" 2349 "PASSIVE:Voltage48V Out Of Calibration" 2350 "PASSIVE:Voltage48V Special Instruction" 2351 "PASSIVE:Voltage48V Over Warning" 2352 "PASSIVE:Voltage48V Over Reduction" 2353 "PASSIVE:Voltage48V Under Warning" 2354 "PASSIVE:Voltage48V Under Reduction" 2356 "PASSIVE:Voltage48V Data Drift High" 2357 "PASSIVE:Voltage48V Data Drift Low" 2368 "PASSIVE:Voltage24V Over Shutdown" 2369 "PASSIVE:Voltage24V Under Shutdown" 2370 "PASSIVE:Voltage24V Intermittent" 2371 "PASSIVE:Voltage24V Short to Battery" 2372 "PASSIVE:Voltage24V Short to Ground" 2373 "PASSIVE:Voltage24V Open Load" 2374 "PASSIVE:Voltage24V Over Current" 2375 "PASSIVE:Voltage24V Wire Break" 2376 "PASSIVE:Voltage24V Freq Error" 2377 "PASSIVE:Voltage24V Update Rate Error" 2378 "PASSIVE:Voltage24V Gradient" 2379 "PASSIVE:Voltage24V Unknown Cause" 2380 "PASSIVE:Voltage24V Bad Component" 2381 "PASSIVE:Voltage24V Out Of Calibration" 2382 "PASSIVE:Voltage24V Special Instruction" 2383 "PASSIVE:Voltage24V Over Warning" 2384 "PASSIVE:Voltage24V Over Reduction" 2385 "PASSIVE:Voltage24V Under Warning" 2386 "PASSIVE:Voltage24V Under Reduction" 2388 "PASSIVE:Voltage24V Data Drift High" 2389 "PASSIVE:Voltage24V Data Drift Low" 2400 "PASSIVE:Voltage12V Over Shutdown" 2401 "PASSIVE:Voltage12V Under Shutdown" 2402 "PASSIVE:Voltage12V Intermittent" 2403 "PASSIVE:Voltage12V Short to Battery" 2404 "PASSIVE:Voltage12V Short to Ground" 2405 "PASSIVE:Voltage12V Open Load" 2406 "PASSIVE:Voltage12V Over Current" 2407 "PASSIVE:Voltage12V Wire Break" 2408 "PASSIVE:Voltage12V Freq Error" 2409 "PASSIVE:Voltage12V Update Rate Error" 2410 "PASSIVE:Voltage12V Gradient" 2411 "PASSIVE:Voltage12V Unknown Cause" 2412 "PASSIVE:Voltage12V Bad Component" 2413 "PASSIVE:Voltage12V Out Of Calibration" 2414 "PASSIVE:Voltage12V Special Instruction" 2415 "PASSIVE:Voltage12V Over Warning" 2416 "PASSIVE:Voltage12V Over Reduction" 2417 "PASSIVE:Voltage12V Under Warning" 2418 "PASSIVE:Voltage12V Under Reduction" 2420 "PASSIVE:Voltage12V Data Drift High" 2421 "PASSIVE:Voltage12V Data Drift Low" 2432 "PASSIVE:Voltage5V Over Shutdown" 2433 "PASSIVE:Voltage5V Under Shutdown" 2434 "PASSIVE:Voltage5V Intermittent" 2435 "PASSIVE:Voltage5V Short to Battery" 2436 "PASSIVE:Voltage5V Short to Ground" 2437 "PASSIVE:Voltage5V Open Load" 2438 "PASSIVE:Voltage5V Over Current" 2439 "PASSIVE:Voltage5V Wire Break" 2440 "PASSIVE:Voltage5V Freq Error" 2441 "PASSIVE:Voltage5V Update Rate Error" 2442 "PASSIVE:Voltage5V Gradient" 2443 "PASSIVE:Voltage5V Unknown Cause" 2444 "PASSIVE:Voltage5V Bad Component" 2445 "PASSIVE:Voltage5V Out Of Calibration" 2446 "PASSIVE:Voltage5V Special Instruction" 2447 "PASSIVE:Voltage5V Over Warning" 2448 "PASSIVE:Voltage5V Over Reduction" 2449 "PASSIVE:Voltage5V Under Warning" 2450 "PASSIVE:Voltage5V Under Reduction" 2452 "PASSIVE:Voltage5V Data Drift High" 2453 "PASSIVE:Voltage5V Data Drift Low" 2464 "PASSIVE:Voltage5VRef Over Shutdown" 2465 "PASSIVE:Voltage5VRef Under Shutdown" 2466 "PASSIVE:Voltage5VRef Intermittent" 2467 "PASSIVE:Voltage5VRef Short to Battery" 2468 "PASSIVE:Voltage5VRef Short to Ground" 2469 "PASSIVE:Voltage5VRef Open Load" 2470 "PASSIVE:Voltage5VRef Over Current" 2471 "PASSIVE:Voltage5VRef Wire Break" 2472 "PASSIVE:Voltage5VRef Freq Error" 2473 "PASSIVE:Voltage5VRef Update Rate Error" 2474 "PASSIVE:Voltage5VRef Gradient" 2475 "PASSIVE:Voltage5VRef Unknown Cause" 2476 "PASSIVE:Voltage5VRef Bad Component" 2477 "PASSIVE:Voltage5VRef Out Of Calibration" 2478 "PASSIVE:Voltage5VRef Special Instruction" 2479 "PASSIVE:Voltage5VRef Over Warning" 2480 "PASSIVE:Voltage5VRef Over Reduction" 2481 "PASSIVE:Voltage5VRef Under Warning" 2482 "PASSIVE:Voltage5VRef Under Reduction" 2484 "PASSIVE:Voltage5VRef Data Drift High" 2485 "PASSIVE:Voltage5VRef Data Drift Low" 2496 "PASSIVE:Voltage3_3V Over Shutdown" 2497 "PASSIVE:Voltage3_3V Under Shutdown" 2498 "PASSIVE:Voltage3_3V Intermittent" 2499 "PASSIVE:Voltage3_3V Short to Battery" 2500 "PASSIVE:Voltage3_3V Short to Ground" 2501 "PASSIVE:Voltage3_3V Open Load" 2502 "PASSIVE:Voltage3_3V Over Current" 2503 "PASSIVE:Voltage3_3V Wire Break" 2504 "PASSIVE:Voltage3_3V Freq Error" 2505 "PASSIVE:Voltage3_3V Update Rate Error" 2506 "PASSIVE:Voltage3_3V Gradient" 2507 "PASSIVE:Voltage3_3V Unknown Cause" 2508 "PASSIVE:Voltage3_3V Bad Component" 2509 "PASSIVE:Voltage3_3V Out Of Calibration" 2510 "PASSIVE:Voltage3_3V Special Instruction" 2511 "PASSIVE:Voltage3_3V Over Warning" 2512 "PASSIVE:Voltage3_3V Over Reduction" 2513 "PASSIVE:Voltage3_3V Under Warning" 2514 "PASSIVE:Voltage3_3V Under Reduction" 2516 "PASSIVE:Voltage3_3V Data Drift High" 2517 "PASSIVE:Voltage3_3V Data Drift Low" 2528 "PASSIVE:Voltage1_25V Over Shutdown" 2529 "PASSIVE:Voltage1_25V Under Shutdown" 2530 "PASSIVE:Voltage1_25V Intermittent" 2531 "PASSIVE:Voltage1_25V Short to Battery" 2532 "PASSIVE:Voltage1_25V Short to Ground" 2533 "PASSIVE:Voltage1_25V Open Load" 2534 "PASSIVE:Voltage1_25V Over Current" 2535 "PASSIVE:Voltage1_25V Wire Break" 2536 "PASSIVE:Voltage1_25V Freq Error" 2537 "PASSIVE:Voltage1_25V Update Rate Error" 2538 "PASSIVE:Voltage1_25V Gradient" 2539 "PASSIVE:Voltage1_25V Unknown Cause" 2540 "PASSIVE:Voltage1_25V Bad Component" 2541 "PASSIVE:Voltage1_25V Out Of Calibration" 2542 "PASSIVE:Voltage1_25V Special Instruction" 2543 "PASSIVE:Voltage1_25V Over Warning" 2544 "PASSIVE:Voltage1_25V Over Reduction" 2545 "PASSIVE:Voltage1_25V Under Warning" 2546 "PASSIVE:Voltage1_25V Under Reduction" 2548 "PASSIVE:Voltage1_25V Data Drift High" 2549 "PASSIVE:Voltage1_25V Data Drift Low" 2560 "PASSIVE:Voltage12VCamDiag Over Shutdown" 2561 "PASSIVE:Voltage12VCamDiag Under Shutdown" 2562 "PASSIVE:Voltage12VCamDiag Intermittent" 2563 "PASSIVE:Voltage12VCamDiag Short to Battery" 2564 "PASSIVE:Voltage12VCamDiag Short to Ground" 2565 "PASSIVE:Voltage12VCamDiag Open Load" 2566 "PASSIVE:Voltage12VCamDiag Over Current" 2567 "PASSIVE:Voltage12VCamDiag Wire Break" 2568 "PASSIVE:Voltage12VCamDiag Freq Error" 2569 "PASSIVE:Voltage12VCamDiag Update Rate Error" 2570 "PASSIVE:Voltage12VCamDiag Gradient" 2571 "PASSIVE:Voltage12VCamDiag Unknown Cause" 2572 "PASSIVE:Voltage12VCamDiag Bad Component" 2573 "PASSIVE:Voltage12VCamDiag Out Of Calibration" 2574 "PASSIVE:Voltage12VCamDiag Special Instruction" 2575 "PASSIVE:Voltage12VCamDiag Over Warning" 2576 "PASSIVE:Voltage12VCamDiag Over Reduction" 2577 "PASSIVE:Voltage12VCamDiag Under Warning" 2578 "PASSIVE:Voltage12VCamDiag Under Reduction" 2580 "PASSIVE:Voltage12VCamDiag Data Drift High" 2581 "PASSIVE:Voltage12VCamDiag Data Drift Low" 3456 "PASSIVE:Voltage12VCrankDiag Over Shutdown" 3457 "PASSIVE:Voltage12VCrankDiag Under Shutdown" 3458 "PASSIVE:Voltage12VCrankDiag Intermittent" 3459 "PASSIVE:Voltage12VCrankDiag Short to Battery" 3460 "PASSIVE:Voltage12VCrankDiag Short to Ground" 3461 "PASSIVE:Voltage12VCrankDiag Open Load" 3462 "PASSIVE:Voltage12VCrankDiag Over Current" 3463 "PASSIVE:Voltage12VCrankDiag Wire Break" 3464 "PASSIVE:Voltage12VCrankDiag Freq Error" 3465 "PASSIVE:Voltage12VCrankDiag Update Rate Error" 3466 "PASSIVE:Voltage12VCrankDiag Gradient" 3467 "PASSIVE:Voltage12VCrankDiag Unknown Cause" 3468 "PASSIVE:Voltage12VCrankDiag Bad Component" 3469 "PASSIVE:Voltage12VCrankDiag Out Of Calibration" 3470 "PASSIVE:Voltage12VCrankDiag Special Instruction" 3471 "PASSIVE:Voltage12VCrankDiag Over Warning" 3472 "PASSIVE:Voltage12VCrankDiag Over Reduction" 3473 "PASSIVE:Voltage12VCrankDiag Under Warning" 3474 "PASSIVE:Voltage12VCrankDiag Under Reduction" 3476 "PASSIVE:Voltage12VCrankDiag Data Drift High" 3477 "PASSIVE:Voltage12VCrankDiag Data Drift Low" 2592 "PASSIVE:Voltage5VDiag1 Over Shutdown" 2593 "PASSIVE:Voltage5VDiag1 Under Shutdown" 2594 "PASSIVE:Voltage5VDiag1 Intermittent" 2595 "PASSIVE:Voltage5VDiag1 Short to Battery" 2596 "PASSIVE:Voltage5VDiag1 Short to Ground" 2597 "PASSIVE:Voltage5VDiag1 Open Load" 2598 "PASSIVE:Voltage5VDiag1 Over Current" 2599 "PASSIVE:Voltage5VDiag1 Wire Break" 2600 "PASSIVE:Voltage5VDiag1 Freq Error" 2601 "PASSIVE:Voltage5VDiag1 Update Rate Error" 2602 "PASSIVE:Voltage5VDiag1 Gradient" 2603 "PASSIVE:Voltage5VDiag1 Unknown Cause" 2604 "PASSIVE:Voltage5VDiag1 Bad Component" 2605 "PASSIVE:Voltage5VDiag1 Out Of Calibration" 2606 "PASSIVE:Voltage5VDiag1 Special Instruction" 2607 "PASSIVE:Voltage5VDiag1 Over Warning" 2608 "PASSIVE:Voltage5VDiag1 Over Reduction" 2609 "PASSIVE:Voltage5VDiag1 Under Warning" 2610 "PASSIVE:Voltage5VDiag1 Under Reduction" 2612 "PASSIVE:Voltage5VDiag1 Data Drift High" 2613 "PASSIVE:Voltage5VDiag1 Data Drift Low" 2624 "PASSIVE:Voltage5VDiag2 Over Shutdown" 2625 "PASSIVE:Voltage5VDiag2 Under Shutdown" 2626 "PASSIVE:Voltage5VDiag2 Intermittent" 2627 "PASSIVE:Voltage5VDiag2 Short to Battery" 2628 "PASSIVE:Voltage5VDiag2 Short to Ground" 2629 "PASSIVE:Voltage5VDiag2 Open Load" 2630 "PASSIVE:Voltage5VDiag2 Over Current" 2631 "PASSIVE:Voltage5VDiag2 Wire Break" 2632 "PASSIVE:Voltage5VDiag2 Freq Error" 2633 "PASSIVE:Voltage5VDiag2 Update Rate Error" 2634 "PASSIVE:Voltage5VDiag2 Gradient" 2635 "PASSIVE:Voltage5VDiag2 Unknown Cause" 2636 "PASSIVE:Voltage5VDiag2 Bad Component" 2637 "PASSIVE:Voltage5VDiag2 Out Of Calibration" 2638 "PASSIVE:Voltage5VDiag2 Special Instruction" 2639 "PASSIVE:Voltage5VDiag2 Over Warning" 2640 "PASSIVE:Voltage5VDiag2 Over Reduction" 2641 "PASSIVE:Voltage5VDiag2 Under Warning" 2642 "PASSIVE:Voltage5VDiag2 Under Reduction" 2644 "PASSIVE:Voltage5VDiag2 Data Drift High" 2645 "PASSIVE:Voltage5VDiag2 Data Drift Low" 2656 "PASSIVE:Voltage Temperature Sensor 1 Over Shutdown" 2657 "PASSIVE:Voltage Temperature Sensor 1 Under Shutdown" 2658 "PASSIVE:Voltage Temperature Sensor 1 Intermittent" 2659 "PASSIVE:Voltage Temperature Sensor 1 Short to Battery" 2660 "PASSIVE:Voltage Temperature Sensor 1 Short to Ground" 2661 "PASSIVE:Voltage Temperature Sensor 1 Open Load" 2662 "PASSIVE:Voltage Temperature Sensor 1 Over Current" 2663 "PASSIVE:Voltage Temperature Sensor 1 Wire Break" 2664 "PASSIVE:Voltage Temperature Sensor 1 Freq Error" 2665 "PASSIVE:Voltage Temperature Sensor 1 Update Rate Error" 2666 "PASSIVE:Voltage Temperature Sensor 1 Gradient" 2667 "PASSIVE:Voltage Temperature Sensor 1 Unknown Cause" 2668 "PASSIVE:Voltage Temperature Sensor 1 Bad Component" 2669 "PASSIVE:Voltage Temperature Sensor 1 Out Of Calibration" 2670 "PASSIVE:Voltage Temperature Sensor 1 Special Instruction" 2671 "PASSIVE:Voltage Temperature Sensor 1 Over Warning" 2672 "PASSIVE:Voltage Temperature Sensor 1 Over Reduction" 2673 "PASSIVE:Voltage Temperature Sensor 1 Under Warning" 2674 "PASSIVE:Voltage Temperature Sensor 1 Under Reduction" 2676 "PASSIVE:Voltage Temperature Sensor 1 Data Drift High" 2677 "PASSIVE:Voltage Temperature Sensor 1 Data Drift Low" 2688 "PASSIVE:Voltage Pressure Sensor Over Shutdown" 2689 "PASSIVE:Voltage Pressure Sensor Under Shutdown" 2690 "PASSIVE:Voltage Pressure Sensor Intermittent" 2691 "PASSIVE:Voltage Pressure Sensor Short to Battery" 2692 "PASSIVE:Voltage Pressure Sensor Short to Ground" 2693 "PASSIVE:Voltage Pressure Sensor Open Load" 2694 "PASSIVE:Voltage Pressure Sensor Over Current" 2695 "PASSIVE:Voltage Pressure Sensor Wire Break" 2696 "PASSIVE:Voltage Pressure Sensor Freq Error" 2697 "PASSIVE:Voltage Pressure Sensor Update Rate Error" 2698 "PASSIVE:Voltage Pressure Sensor Gradient" 2699 "PASSIVE:Voltage Pressure Sensor Unknown Cause" 2700 "PASSIVE:Voltage Pressure Sensor Bad Component" 2701 "PASSIVE:Voltage Pressure Sensor Out Of Calibration" 2702 "PASSIVE:Voltage Pressure Sensor Special Instruction" 2703 "PASSIVE:Voltage Pressure Sensor Over Warning" 2704 "PASSIVE:Voltage Pressure Sensor Over Reduction" 2705 "PASSIVE:Voltage Pressure Sensor Under Warning" 2706 "PASSIVE:Voltage Pressure Sensor Under Reduction" 2708 "PASSIVE:Voltage Pressure Sensor Data Drift High" 2709 "PASSIVE:Voltage Pressure Sensor Data Drift Low" 3488 "PASSIVE:Voltage 5V Referance MCU Diagnostic Over Shutdown" 3489 "PASSIVE:Voltage 5V Referance MCU Diagnostic Under Shutdown" 3490 "PASSIVE:Voltage 5V Referance MCU Diagnostic Intermittent" 3491 "PASSIVE:Voltage 5V Referance MCU Diagnostic Short to Battery" 3492 "PASSIVE:Voltage 5V Referance MCU Diagnostic Short to Ground" 3493 "PASSIVE:Voltage 5V Referance MCU Diagnostic Open Load" 3494 "PASSIVE:Voltage 5V Referance MCU Diagnostic Over Current" 3495 "PASSIVE:Voltage 5V Referance MCU Diagnostic Wire Break" 3496 "PASSIVE:Voltage 5V Referance MCU Diagnostic Freq Error" 3497 "PASSIVE:Voltage 5V Referance MCU Diagnostic Update Rate Error" 3498 "PASSIVE:Voltage 5V Referance MCU Diagnostic Gradient" 3499 "PASSIVE:Voltage 5V Referance MCU Diagnostic Unknown Cause" 3500 "PASSIVE:Voltage 5V Referance MCU Diagnostic Bad Component" 3501 "PASSIVE:Voltage 5V Referance MCU Diagnostic Out Of Calibration" 3502 "PASSIVE:Voltage 5V Referance MCU Diagnostic Special Instruction" 3503 "PASSIVE:Voltage 5V Referance MCU Diagnostic Over Warning" 3504 "PASSIVE:Voltage 5V Referance MCU Diagnostic Over Reduction" 3505 "PASSIVE:Voltage 5V Referance MCU Diagnostic Under Warning" 3506 "PASSIVE:Voltage 5V Referance MCU Diagnostic Under Reduction" 3508 "PASSIVE:Voltage 5V Referance MCU Diagnostic Data Drift High" 3509 "PASSIVE:Voltage 5V Referance MCU Diagnostic Data Drift Low" 3136 "PASSIVE:Starter Over Shutdown" 3137 "PASSIVE:Starter Under Shutdown" 3138 "PASSIVE:Starter Intermittent" 3139 "PASSIVE:Starter Short to Battery" 3140 "PASSIVE:Starter Short to Ground" 3141 "PASSIVE:Starter Open Load" 3142 "PASSIVE:Starter Over Current" 3143 "PASSIVE:Starter Wire Break" 3144 "PASSIVE:Starter Freq Error" 3145 "PASSIVE:Starter Update Rate Error" 3146 "PASSIVE:Starter Gradient" 3147 "PASSIVE:Starter Unknown Cause" 3148 "PASSIVE:Starter Bad Component" 3149 "PASSIVE:Starter Out Of Calibration" 3150 "PASSIVE:Starter Special Instruction" 3151 "PASSIVE:Starter Over Warning" 3152 "PASSIVE:Starter Over Reduction" 3153 "PASSIVE:Starter Under Warning" 3154 "PASSIVE:Starter Under Reduction" 3156 "PASSIVE:Starter Data Drift High" 3157 "PASSIVE:Starter Data Drift Low" 3264 "PASSIVE:Heat Flange Relay Over Shutdown" 3265 "PASSIVE:Heat Flange Relay Under Shutdown" 3266 "PASSIVE:Heat Flange Relay Intermittent" 3267 "PASSIVE:Heat Flange Relay Short to Battery" 3268 "PASSIVE:Heat Flange Relay Short to Ground" 3269 "PASSIVE:Heat Flange Relay Open Load" 3270 "PASSIVE:Heat Flange Relay Over Current" 3271 "PASSIVE:Heat Flange Relay Wire Break" 3272 "PASSIVE:Heat Flange Relay Freq Error" 3273 "PASSIVE:Heat Flange Relay Update Rate Error" 3274 "PASSIVE:Heat Flange Relay Gradient" 3275 "PASSIVE:Heat Flange Relay Unknown Cause" 3276 "PASSIVE:Heat Flange Relay Bad Component" 3277 "PASSIVE:Heat Flange Relay Out Of Calibration" 3278 "PASSIVE:Heat Flange Relay Special Instruction" 3279 "PASSIVE:Heat Flange Relay Over Warning" 3280 "PASSIVE:Heat Flange Relay Over Reduction" 3281 "PASSIVE:Heat Flange Relay Under Warning" 3282 "PASSIVE:Heat Flange Relay Under Reduction" 3284 "PASSIVE:Heat Flange Relay Data Drift High" 3285 "PASSIVE:Heat Flange Relay Data Drift Low" 3552 "PASSIVE:Engine Break Selonoid 1 Over Shutdown" 3553 "PASSIVE:Engine Break Selonoid 1 Under Shutdown" 3554 "PASSIVE:Engine Break Selonoid 1 Intermittent" 3555 "PASSIVE:Engine Break Selonoid 1 Short to Battery" 3556 "PASSIVE:Engine Break Selonoid 1 Short to Ground" 3557 "PASSIVE:Engine Break Selonoid 1 Open Load" 3558 "PASSIVE:Engine Break Selonoid 1 Over Current" 3559 "PASSIVE:Engine Break Selonoid 1 Wire Break" 3560 "PASSIVE:Engine Break Selonoid 1 Freq Error" 3561 "PASSIVE:Engine Break Selonoid 1 Update Rate Error" 3562 "PASSIVE:Engine Break Selonoid 1 Gradient" 3563 "PASSIVE:Engine Break Selonoid 1 Unknown Cause" 3564 "PASSIVE:Engine Break Selonoid 1 Bad Component" 3565 "PASSIVE:Engine Break Selonoid 1 Out Of Calibration" 3566 "PASSIVE:Engine Break Selonoid 1 Special Instruction" 3567 "PASSIVE:Engine Break Selonoid 1 Over Warning" 3568 "PASSIVE:Engine Break Selonoid 1 Over Reduction" 3569 "PASSIVE:Engine Break Selonoid 1 Under Warning" 3570 "PASSIVE:Engine Break Selonoid 1 Under Reduction" 3572 "PASSIVE:Engine Break Selonoid 1 Data Drift High" 3573 "PASSIVE:Engine Break Selonoid 1 Data Drift Low" 3584 "PASSIVE:RSL Lamp Over Shutdown" 3585 "PASSIVE:RSL Lamp Under Shutdown" 3586 "PASSIVE:RSL Lamp Intermittent" 3587 "PASSIVE:RSL Lamp Short to Battery" 3588 "PASSIVE:RSL Lamp Short to Ground" 3589 "PASSIVE:RSL Lamp Open Load" 3590 "PASSIVE:RSL Lamp Over Current" 3591 "PASSIVE:RSL Lamp Wire Break" 3592 "PASSIVE:RSL Lamp Freq Error" 3593 "PASSIVE:RSL Lamp Update Rate Error" 3594 "PASSIVE:RSL Lamp Gradient" 3595 "PASSIVE:RSL Lamp Unknown Cause" 3596 "PASSIVE:RSL Lamp Bad Component" 3597 "PASSIVE:RSL Lamp Out Of Calibration" 3598 "PASSIVE:RSL Lamp Special Instruction" 3599 "PASSIVE:RSL Lamp Over Warning" 3600 "PASSIVE:RSL Lamp Over Reduction" 3601 "PASSIVE:RSL Lamp Under Warning" 3602 "PASSIVE:RSL Lamp Under Reduction" 3604 "PASSIVE:RSL Lamp Data Drift High" 3605 "PASSIVE:RSL Lamp Data Drift Low" 3616 "PASSIVE:CSL Lamp Over Shutdown" 3617 "PASSIVE:CSL Lamp Under Shutdown" 3618 "PASSIVE:CSL Lamp Intermittent" 3619 "PASSIVE:CSL Lamp Short to Battery" 3620 "PASSIVE:CSL Lamp Short to Ground" 3621 "PASSIVE:CSL Lamp Open Load" 3622 "PASSIVE:CSL Lamp Over Current" 3623 "PASSIVE:CSL Lamp Wire Break" 3624 "PASSIVE:CSL Lamp Freq Error" 3625 "PASSIVE:CSL Lamp Update Rate Error" 3626 "PASSIVE:CSL Lamp Gradient" 3627 "PASSIVE:CSL Lamp Unknown Cause" 3628 "PASSIVE:CSL Lamp Bad Component" 3629 "PASSIVE:CSL Lamp Out Of Calibration" 3630 "PASSIVE:CSL Lamp Special Instruction" 3631 "PASSIVE:CSL Lamp Over Warning" 3632 "PASSIVE:CSL Lamp Over Reduction" 3633 "PASSIVE:CSL Lamp Under Warning" 3634 "PASSIVE:CSL Lamp Under Reduction" 3636 "PASSIVE:CSL Lamp Data Drift High" 3637 "PASSIVE:CSL Lamp Data Drift Low" 3680 "PASSIVE:AWL Lamp Over Shutdown" 3681 "PASSIVE:AWL Lamp Under Shutdown" 3682 "PASSIVE:AWL Lamp Intermittent" 3683 "PASSIVE:AWL Lamp Short to Battery" 3684 "PASSIVE:AWL Lamp Short to Ground" 3685 "PASSIVE:AWL Lamp Open Load" 3686 "PASSIVE:AWL Lamp Over Current" 3687 "PASSIVE:AWL Lamp Wire Break" 3688 "PASSIVE:AWL Lamp Freq Error" 3689 "PASSIVE:AWL Lamp Update Rate Error" 3690 "PASSIVE:AWL Lamp Gradient" 3691 "PASSIVE:AWL Lamp Unknown Cause" 3692 "PASSIVE:AWL Lamp Bad Component" 3693 "PASSIVE:AWL Lamp Out Of Calibration" 3694 "PASSIVE:AWL Lamp Special Instruction" 3695 "PASSIVE:AWL Lamp Over Warning" 3696 "PASSIVE:AWL Lamp Over Reduction" 3697 "PASSIVE:AWL Lamp Under Warning" 3698 "PASSIVE:AWL Lamp Under Reduction" 3700 "PASSIVE:AWL Lamp Data Drift High" 3701 "PASSIVE:AWL Lamp Data Drift Low" 3328 "PASSIVE:VCV Over Shutdown" 3329 "PASSIVE:VCV Under Shutdown" 3330 "PASSIVE:VCV Intermittent" 3331 "PASSIVE:VCV Short to Battery" 3332 "PASSIVE:VCV Short to Ground" 3333 "PASSIVE:VCV Open Load" 3334 "PASSIVE:VCV Over Current" 3335 "PASSIVE:VCV Wire Break" 3336 "PASSIVE:VCV Freq Error" 3337 "PASSIVE:VCV Update Rate Error" 3338 "PASSIVE:VCV Gradient" 3339 "PASSIVE:VCV Unknown Cause" 3340 "PASSIVE:VCV Bad Component" 3341 "PASSIVE:VCV Out Of Calibration" 3342 "PASSIVE:VCV Special Instruction" 3343 "PASSIVE:VCV Over Warning" 3344 "PASSIVE:VCV Over Reduction" 3345 "PASSIVE:VCV Under Warning" 3346 "PASSIVE:VCV Under Reduction" 3348 "PASSIVE:VCV Data Drift High" 3349 "PASSIVE:VCV Data Drift Low" 3360 "PASSIVE:PCV Over Shutdown" 3361 "PASSIVE:PCV Under Shutdown" 3362 "PASSIVE:PCV Intermittent" 3363 "PASSIVE:PCV Short to Battery" 3364 "PASSIVE:PCV Short to Ground" 3365 "PASSIVE:PCV Open Load" 3366 "PASSIVE:PCV Over Current" 3367 "PASSIVE:PCV Wire Break" 3368 "PASSIVE:PCV Freq Error" 3369 "PASSIVE:PCV Update Rate Error" 3370 "PASSIVE:PCV Gradient" 3371 "PASSIVE:PCV Unknown Cause" 3372 "PASSIVE:PCV Bad Component" 3373 "PASSIVE:PCV Out Of Calibration" 3374 "PASSIVE:PCV Special Instruction" 3375 "PASSIVE:PCV Over Warning" 3376 "PASSIVE:PCV Over Reduction" 3377 "PASSIVE:PCV Under Warning" 3378 "PASSIVE:PCV Under Reduction" 3380 "PASSIVE:PCV Data Drift High" 3381 "PASSIVE:PCV Data Drift Low" 2784 "PASSIVE:Injector 1 Over Shutdown" 2785 "PASSIVE:Injector 1 Under Shutdown" 2786 "PASSIVE:Injector 1 Intermittent" 2787 "PASSIVE:Injector 1 Short to Battery" 2788 "PASSIVE:Injector 1 Short to Ground" 2789 "PASSIVE:Injector 1 Open Load" 2790 "PASSIVE:Injector 1 Over Current" 2791 "PASSIVE:Injector 1 Wire Break" 2792 "PASSIVE:Injector 1 Freq Error" 2793 "PASSIVE:Injector 1 Update Rate Error" 2794 "PASSIVE:Injector 1 Gradient" 2795 "PASSIVE:Injector 1 Unknown Cause" 2796 "PASSIVE:Injector 1 Bad Component" 2797 "PASSIVE:Injector 1 Out Of Calibration" 2798 "PASSIVE:Injector 1 Special Instruction" 2799 "PASSIVE:Injector 1 Over Warning" 2800 "PASSIVE:Injector 1 Over Reduction" 2801 "PASSIVE:Injector 1 Under Warning" 2802 "PASSIVE:Injector 1 Under Reduction" 2804 "PASSIVE:Injector 1 Data Drift High" 2805 "PASSIVE:Injector 1 Data Drift Low" 2816 "PASSIVE:Injector 2 Over Shutdown" 2817 "PASSIVE:Injector 2 Under Shutdown" 2818 "PASSIVE:Injector 2 Intermittent" 2819 "PASSIVE:Injector 2 Short to Battery" 2820 "PASSIVE:Injector 2 Short to Ground" 2821 "PASSIVE:Injector 2 Open Load" 2822 "PASSIVE:Injector 2 Over Current" 2823 "PASSIVE:Injector 2 Wire Break" 2824 "PASSIVE:Injector 2 Freq Error" 2825 "PASSIVE:Injector 2 Update Rate Error" 2826 "PASSIVE:Injector 2 Gradient" 2827 "PASSIVE:Injector 2 Unknown Cause" 2828 "PASSIVE:Injector 2 Bad Component" 2829 "PASSIVE:Injector 2 Out Of Calibration" 2830 "PASSIVE:Injector 2 Special Instruction" 2831 "PASSIVE:Injector 2 Over Warning" 2832 "PASSIVE:Injector 2 Over Reduction" 2833 "PASSIVE:Injector 2 Under Warning" 2834 "PASSIVE:Injector 2 Under Reduction" 2836 "PASSIVE:Injector 2 Data Drift High" 2837 "PASSIVE:Injector 2 Data Drift Low" 2848 "PASSIVE:Injector 3 Over Shutdown" 2849 "PASSIVE:Injector 3 Under Shutdown" 2850 "PASSIVE:Injector 3 Intermittent" 2851 "PASSIVE:Injector 3 Short to Battery" 2852 "PASSIVE:Injector 3 Short to Ground" 2853 "PASSIVE:Injector 3 Open Load" 2854 "PASSIVE:Injector 3 Over Current" 2855 "PASSIVE:Injector 3 Wire Break" 2856 "PASSIVE:Injector 3 Freq Error" 2857 "PASSIVE:Injector 3 Update Rate Error" 2858 "PASSIVE:Injector 3 Gradient" 2859 "PASSIVE:Injector 3 Unknown Cause" 2860 "PASSIVE:Injector 3 Bad Component" 2861 "PASSIVE:Injector 3 Out Of Calibration" 2862 "PASSIVE:Injector 3 Special Instruction" 2863 "PASSIVE:Injector 3 Over Warning" 2864 "PASSIVE:Injector 3 Over Reduction" 2865 "PASSIVE:Injector 3 Under Warning" 2866 "PASSIVE:Injector 3 Under Reduction" 2868 "PASSIVE:Injector 3 Data Drift High" 2869 "PASSIVE:Injector 3 Data Drift Low" 2880 "PASSIVE:Injector 4 Over Shutdown" 2881 "PASSIVE:Injector 4 Under Shutdown" 2882 "PASSIVE:Injector 4 Intermittent" 2883 "PASSIVE:Injector 4 Short to Battery" 2884 "PASSIVE:Injector 4 Short to Ground" 2885 "PASSIVE:Injector 4 Open Load" 2886 "PASSIVE:Injector 4 Over Current" 2887 "PASSIVE:Injector 4 Wire Break" 2888 "PASSIVE:Injector 4 Freq Error" 2889 "PASSIVE:Injector 4 Update Rate Error" 2890 "PASSIVE:Injector 4 Gradient" 2891 "PASSIVE:Injector 4 Unknown Cause" 2892 "PASSIVE:Injector 4 Bad Component" 2893 "PASSIVE:Injector 4 Out Of Calibration" 2894 "PASSIVE:Injector 4 Special Instruction" 2895 "PASSIVE:Injector 4 Over Warning" 2896 "PASSIVE:Injector 4 Over Reduction" 2897 "PASSIVE:Injector 4 Under Warning" 2898 "PASSIVE:Injector 4 Under Reduction" 2900 "PASSIVE:Injector 4 Data Drift High" 2901 "PASSIVE:Injector 4 Data Drift Low" 2976 "PASSIVE:Camshaft Sensor Over Shutdown" 2977 "PASSIVE:Camshaft Sensor Under Shutdown" 2978 "PASSIVE:Camshaft Sensor Intermittent" 2979 "PASSIVE:Camshaft Sensor Short to Battery" 2980 "PASSIVE:Camshaft Sensor Short to Ground" 2981 "PASSIVE:Camshaft Sensor Open Load" 2982 "PASSIVE:Camshaft Sensor Over Current" 2983 "PASSIVE:Camshaft Sensor Wire Break" 2984 "PASSIVE:Camshaft Sensor Freq Error" 2985 "PASSIVE:Camshaft Sensor Update Rate Error" 2986 "PASSIVE:Camshaft Sensor Gradient" 2987 "PASSIVE:Camshaft Sensor Unknown Cause" 2988 "PASSIVE:Camshaft Sensor Bad Component" 2989 "PASSIVE:Camshaft Sensor Out Of Calibration" 2990 "PASSIVE:Camshaft Sensor Special Instruction" 2991 "PASSIVE:Camshaft Sensor Over Warning" 2992 "PASSIVE:Camshaft Sensor Over Reduction" 2993 "PASSIVE:Camshaft Sensor Under Warning" 2994 "PASSIVE:Camshaft Sensor Under Reduction" 2996 "PASSIVE:Camshaft Sensor Data Drift High" 2997 "PASSIVE:Camshaft Sensor Data Drift Low" 3008 "PASSIVE:Crankshaft Sensor Over Shutdown" 3009 "PASSIVE:Crankshaft Sensor Under Shutdown" 3010 "PASSIVE:Crankshaft Sensor Intermittent" 3011 "PASSIVE:Crankshaft Sensor Short to Battery" 3012 "PASSIVE:Crankshaft Sensor Short to Ground" 3013 "PASSIVE:Crankshaft Sensor Open Load" 3014 "PASSIVE:Crankshaft Sensor Over Current" 3015 "PASSIVE:Crankshaft Sensor Wire Break" 3016 "PASSIVE:Crankshaft Sensor Freq Error" 3017 "PASSIVE:Crankshaft Sensor Update Rate Error" 3018 "PASSIVE:Crankshaft Sensor Gradient" 3019 "PASSIVE:Crankshaft Sensor Unknown Cause" 3020 "PASSIVE:Crankshaft Sensor Bad Component" 3021 "PASSIVE:Crankshaft Sensor Out Of Calibration" 3022 "PASSIVE:Crankshaft Sensor Special Instruction" 3023 "PASSIVE:Crankshaft Sensor Over Warning" 3024 "PASSIVE:Crankshaft Sensor Over Reduction" 3025 "PASSIVE:Crankshaft Sensor Under Warning" 3026 "PASSIVE:Crankshaft Sensor Under Reduction" 3028 "PASSIVE:Crankshaft Sensor Data Drift High" 3029 "PASSIVE:Crankshaft Sensor Data Drift Low" 3438 "PASSIVE:Coolant Temperature Coherence Special Instruction" 3726 "PASSIVE:Air Boost Temperature Coherence Special Instruction" 3758 "PASSIVE:Fuel Temperature Coherence Special Instruction" 3790 "PASSIVE:Oil Temperature Coherence Special Instruction" 3822 "PASSIVE:Ambient Air Temperature Coherence Special Instruction" 3854 "PASSIVE:Air Boost Pressure Coherence Special Instruction" 3886 "PASSIVE:Ambient Air Pressure Coherence Special Instruction" 3918 "PASSIVE:Oil Pressure Coherence Special Instruction" 3950 "PASSIVE:Fuel Pressure Coherence Special Instruction" 3982 "PASSIVE:Rail Pressure Coherence Special Instruction" 4014 "PASSIVE:Oil Level Coherence Special Instruction" 4046 "PASSIVE:ECU Temperature Coherence Special Instruction" 4046 "PASSIVE:Cam Crank Defect Coherence Special Instruction" 4078 "PASSIVE:Injector Defect Coherence Special Instruction" 4110 "PASSIVE:Cylinder Misfire Coherence Special Instruction" 4142 "PASSIVE:Over Speed Coherence Special Instruction" 4174 "PASSIVE:Start Request POR Error Special Instruction" 4206 "PASSIVE:Start Request SPI Error Special Instruction" 4238 "PASSIVE:Start Request TSD Error Special Instruction" 4270 "PASSIVE:Start Request TW Error Special Instruction" 4302 "PASSIVE:Start Request OV Error Special Instruction" 4334 "PASSIVE:Start Request UV Error Special Instruction" 4366 "PASSIVE:Start Request VS0 Error Special Instruction" 4398 "PASSIVE:Start Request VS1 Error Special Instruction" 4430 "PASSIVE:Start Request WetDiag Error Special Instruction" 4462 "PASSIVE:Start Request ADC Diag Error Special Instruction" 4494 "PASSIVE:Start Request Chk Error Special Instruction" 4526 "PASSIVE:Start Request Com Error Special Instruction" 4558 "PASSIVE:Start Request Init Error Special Instruction" 4590 "PASSIVE:Engine Break 100 POR Error Special Instruction" 4622 "PASSIVE:Engine Break 100 SPI Error Special Instruction" 4654 "PASSIVE:Engine Break 100 TSD Error Special Instruction" 4686 "PASSIVE:Engine Break 100 TW Error Special Instruction" 4718 "PASSIVE:Engine Break 100 OV Error Special Instruction" 4750 "PASSIVE:Engine Break 100 UV Error Special Instruction" 4782 "PASSIVE:Engine Break 100 VS0 Error Special Instruction" 4814 "PASSIVE:Engine Break 100 VS1 Error Special Instruction" 4846 "PASSIVE:Engine Break 100 WetDiag Error Special Instruction" 4878 "PASSIVE:Engine Break 100 ADC Diag Error Special Instruction" 4910 "PASSIVE:Engine Break 100 Chk Error Special Instruction" 4942 "PASSIVE:Engine Break 100 Com Error Special Instruction" 4974 "PASSIVE:Engine Break 100 Init Error Special Instruction" 5006 "PASSIVE:Cruise Control 1 POR Error Special Instruction" 5038 "PASSIVE:Cruise Control 1 SPI Error Special Instruction" 5070 "PASSIVE:Cruise Control 1 TSD Error Special Instruction" 5102 "PASSIVE:Cruise Control 1 TW Error Special Instruction" 5134 "PASSIVE:Cruise Control 1 OV Error Special Instruction" 5166 "PASSIVE:Cruise Control 1 UV Error Special Instruction" 5198 "PASSIVE:Cruise Control 1 VS0 Error Special Instruction" 5230 "PASSIVE:Cruise Control 1 VS1 Error Special Instruction" 5262 "PASSIVE:Cruise Control 1 WetDiag Error Special Instruction" 5294 "PASSIVE:Cruise Control 1 ADC Diag Error Special Instruction" 5326 "PASSIVE:Cruise Control 1 Chk Error Special Instruction" 5358 "PASSIVE:Cruise Control 1 Com Error Special Instruction" 5390 "PASSIVE:Cruise Control 1 Init Error Special Instruction" 5422 "PASSIVE:Cruise Control 2 POR Error Special Instruction" 5454 "PASSIVE:Cruise Control 2 SPI Error Special Instruction" 5486 "PASSIVE:Cruise Control 2 TSD Error Special Instruction" 5518 "PASSIVE:Cruise Control 2 TW Error Special Instruction" 5550 "PASSIVE:Cruise Control 2 OV Error Special Instruction" 5582 "PASSIVE:Cruise Control 2 UV Error Special Instruction" 5614 "PASSIVE:Cruise Control 2 VS0 Error Special Instruction" 5646 "PASSIVE:Cruise Control 2 VS1 Error Special Instruction" 5678 "PASSIVE:Cruise Control 2 WetDiag Error Special Instruction" 5710 "PASSIVE:Cruise Control 2 ADC Diag Error Special Instruction" 5742 "PASSIVE:Cruise Control 2 Chk Error Special Instruction" 5774 "PASSIVE:Cruise Control 2 Com Error Special Instruction" 5806 "PASSIVE:Cruise Control 2 Init Error Special Instruction" 5838 "PASSIVE:Brake Pedal 1 POR Error Special Instruction" 5870 "PASSIVE:Brake Pedal 1 SPI Error Special Instruction" 5902 "PASSIVE:Brake Pedal 1 TSD Error Special Instruction" 5934 "PASSIVE:Brake Pedal 1 TW Error Special Instruction" 5966 "PASSIVE:Brake Pedal 1 OV Error Special Instruction" 5998 "PASSIVE:Brake Pedal 1 UV Error Special Instruction" 6030 "PASSIVE:Brake Pedal 1 VS0 Error Special Instruction" 6062 "PASSIVE:Brake Pedal 1 VS1 Error Special Instruction" 6094 "PASSIVE:Brake Pedal 1 WetDiag Error Special Instruction" 6126 "PASSIVE:Brake Pedal 1 ADC Diag Error Special Instruction" 6158 "PASSIVE:Brake Pedal 1 Chk Error Special Instruction" 6190 "PASSIVE:Brake Pedal 1 Com Error Special Instruction" 6222 "PASSIVE:Brake Pedal 1 Init Error Special Instruction" 6254 "PASSIVE:Cruise Control 3 POR Error Special Instruction" 6286 "PASSIVE:Cruise Control 3 SPI Error Special Instruction" 6318 "PASSIVE:Cruise Control 3 TSD Error Special Instruction" 6350 "PASSIVE:Cruise Control 3 TW Error Special Instruction" 6382 "PASSIVE:Cruise Control 3 OV Error Special Instruction" 6414 "PASSIVE:Cruise Control 3 UV Error Special Instruction" 6446 "PASSIVE:Cruise Control 3 VS0 Error Special Instruction" 6478 "PASSIVE:Cruise Control 3 VS1 Error Special Instruction" 6510 "PASSIVE:Cruise Control 3 WetDiag Error Special Instruction" 6542 "PASSIVE:Cruise Control 3 ADC Diag Error Special Instruction" 6574 "PASSIVE:Cruise Control 3 Chk Error Special Instruction" 6606 "PASSIVE:Cruise Control 3 Com Error Special Instruction" 6638 "PASSIVE:Cruise Control 3 Init Error Special Instruction" 6670 "PASSIVE:Engine Break 50 POR Error Special Instruction" 6702 "PASSIVE:Engine Break 50 SPI Error Special Instruction" 6734 "PASSIVE:Engine Break 50 TSD Error Special Instruction" 6766 "PASSIVE:Engine Break 50 TW Error Special Instruction" 6798 "PASSIVE:Engine Break 50 OV Error Special Instruction" 6830 "PASSIVE:Engine Break 50 UV Error Special Instruction" 6862 "PASSIVE:Engine Break 50 VS0 Error Special Instruction" 6894 "PASSIVE:Engine Break 50 VS1 Error Special Instruction" 6926 "PASSIVE:Engine Break 50 WetDiag Error Special Instruction" 6958 "PASSIVE:Engine Break 50 ADC Diag Error Special Instruction" 6990 "PASSIVE:Engine Break 50 Chk Error Special Instruction" 7022 "PASSIVE:Engine Break 50 Com Error Special Instruction" 7054 "PASSIVE:Engine Break 50 Init Error Special Instruction" 7086 "PASSIVE:Trouble Shooting Button POR Error Special Instruction" 7118 "PASSIVE:Trouble Shooting Button SPI Error Special Instruction" 7150 "PASSIVE:Trouble Shooting Button TSD Error Special Instruction" 7182 "PASSIVE:Trouble Shooting Button TW Error Special Instruction" 7214 "PASSIVE:Trouble Shooting Button OV Error Special Instruction" 7246 "PASSIVE:Trouble Shooting Button UV Error Special Instruction" 7278 "PASSIVE:Trouble Shooting Button VS0 Error Special Instruction" 7310 "PASSIVE:Trouble Shooting Button VS1 Error Special Instruction" 7342 "PASSIVE:Trouble Shooting Button WetDiag Error Special Instruction" 7374 "PASSIVE:Trouble Shooting Button ADC Diag Error Special Instruction" 7406 "PASSIVE:Trouble Shooting Button Chk Error Special Instruction" 7438 "PASSIVE:Trouble Shooting Button Com Error Special Instruction" 7470 "PASSIVE:Trouble Shooting Button Init Error Special Instruction" 7502 "PASSIVE:Hand Brake Parking POR Error Special Instruction" 7534 "PASSIVE:Hand Brake Parking SPI Error Special Instruction" 7566 "PASSIVE:Hand Brake Parking TSD Error Special Instruction" 7598 "PASSIVE:Hand Brake Parking TW Error Special Instruction" 7630 "PASSIVE:Hand Brake Parking OV Error Special Instruction" 7662 "PASSIVE:Hand Brake Parking UV Error Special Instruction" 7694 "PASSIVE:Hand Brake Parking VS0 Error Special Instruction" 7726 "PASSIVE:Hand Brake Parking VS1 Error Special Instruction" 7758 "PASSIVE:Hand Brake Parking WetDiag Error Special Instruction" 7790 "PASSIVE:Hand Brake Parking ADC Diag Error Special Instruction" 7822 "PASSIVE:Hand Brake Parking Chk Error Special Instruction" 7854 "PASSIVE:Hand Brake Parking Com Error Special Instruction" 7886 "PASSIVE:Hand Brake Parking Init Error Special Instruction" 7918 "PASSIVE:Overriding Switch POR Error Special Instruction" 7950 "PASSIVE:Overriding Switch SPI Error Special Instruction" 7982 "PASSIVE:Overriding Switch TSD Error Special Instruction" 8014 "PASSIVE:Overriding Switch TW Error Special Instruction" 8046 "PASSIVE:Overriding Switch OV Error Special Instruction" 8078 "PASSIVE:Overriding Switch UV Error Special Instruction" 8110 "PASSIVE:Overriding Switch VS0 Error Special Instruction" 8142 "PASSIVE:Overriding Switch VS1 Error Special Instruction" 8174 "PASSIVE:Overriding Switch WetDiag Error Special Instruction" 8206 "PASSIVE:Overriding Switch ADC Diag Error Special Instruction" 8238 "PASSIVE:Overriding Switch Chk Error Special Instruction" 8270 "PASSIVE:Overriding Switch Com Error Special Instruction" 8302 "PASSIVE:Overriding Switch Init Error Special Instruction" 16779936 "ACTIVE:Coolant Temperature Over Shutdown" 16779937 "ACTIVE:Coolant Temperature Under Shutdown" 16779938 "ACTIVE:Coolant Temperature Intermittent" 16779939 "ACTIVE:Coolant Temperature Short to Battery" 16779940 "ACTIVE:Coolant Temperature Short to Ground" 16779941 "ACTIVE:Coolant Temperature Open Load" 16779942 "ACTIVE:Coolant Temperature Over Current" 16779943 "ACTIVE:Coolant Temperature Wire Break" 16779944 "ACTIVE:Coolant Temperature Freq Error" 16779945 "ACTIVE:Coolant Temperature Update Rate Error" 16779946 "ACTIVE:Coolant Temperature Gradient" 16779947 "ACTIVE:Coolant Temperature Unknown Cause" 16779948 "ACTIVE:Coolant Temperature Bad Component" 16779949 "ACTIVE:Coolant Temperature Out Of Calibration" 16779950 "ACTIVE:Coolant Temperature Special Instruction" 16779951 "ACTIVE:Coolant Temperature Over Warning" 16779952 "ACTIVE:Coolant Temperature Over Reduction" 16779953 "ACTIVE:Coolant Temperature Under Warning" 16779954 "ACTIVE:Coolant Temperature Under Reduction" 16779956 "ACTIVE:Coolant Temperature Data Drift High" 16779957 "ACTIVE:Coolant Temperature Data Drift Low" 16777248 "ACTIVE:Air Boost Temperature Over Shutdown" 16777249 "ACTIVE:Air Boost Temperature Under Shutdown" 16777250 "ACTIVE:Air Boost Temperature Intermittent" 16777251 "ACTIVE:Air Boost Temperature Short to Battery" 16777252 "ACTIVE:Air Boost Temperature Short to Ground" 16777253 "ACTIVE:Air Boost Temperature Open Load" 16777254 "ACTIVE:Air Boost Temperature Over Current" 16777255 "ACTIVE:Air Boost Temperature Wire Break" 16777256 "ACTIVE:Air Boost Temperature Freq Error" 16777257 "ACTIVE:Air Boost Temperature Update Rate Error" 16777258 "ACTIVE:Air Boost Temperature Gradient" 16777259 "ACTIVE:Air Boost Temperature Unknown Cause" 16777260 "ACTIVE:Air Boost Temperature Bad Component" 16777261 "ACTIVE:Air Boost Temperature Out Of Calibration" 16777262 "ACTIVE:Air Boost Temperature Special Instruction" 16777263 "ACTIVE:Air Boost Temperature Over Warning" 16777264 "ACTIVE:Air Boost Temperature Over Reduction" 16777265 "ACTIVE:Air Boost Temperature Under Warning" 16777266 "ACTIVE:Air Boost Temperature Under Reduction" 16777268 "ACTIVE:Air Boost Temperature Data Drift High" 16777269 "ACTIVE:Air Boost Temperature Data Drift Low" 16777280 "ACTIVE:Fuel Temperature Over Shutdown" 16777281 "ACTIVE:Fuel Temperature Under Shutdown" 16777282 "ACTIVE:Fuel Temperature Intermittent" 16777283 "ACTIVE:Fuel Temperature Short to Battery" 16777284 "ACTIVE:Fuel Temperature Short to Ground" 16777285 "ACTIVE:Fuel Temperature Open Load" 16777286 "ACTIVE:Fuel Temperature Over Current" 16777287 "ACTIVE:Fuel Temperature Wire Break" 16777288 "ACTIVE:Fuel Temperature Freq Error" 16777289 "ACTIVE:Fuel Temperature Update Rate Error" 16777290 "ACTIVE:Fuel Temperature Gradient" 16777291 "ACTIVE:Fuel Temperature Unknown Cause" 16777292 "ACTIVE:Fuel Temperature Bad Component" 16777293 "ACTIVE:Fuel Temperature Out Of Calibration" 16777294 "ACTIVE:Fuel Temperature Special Instruction" 16777295 "ACTIVE:Fuel Temperature Over Warning" 16777296 "ACTIVE:Fuel Temperature Over Reduction" 16777297 "ACTIVE:Fuel Temperature Under Warning" 16777298 "ACTIVE:Fuel Temperature Under Reduction" 16777300 "ACTIVE:Fuel Temperature Data Drift High" 16777301 "ACTIVE:Fuel Temperature Data Drift Low" 16777312 "ACTIVE:Oil Temperature Over Shutdown" 16777313 "ACTIVE:Oil Temperature Under Shutdown" 16777314 "ACTIVE:Oil Temperature Intermittent" 16777315 "ACTIVE:Oil Temperature Short to Battery" 16777316 "ACTIVE:Oil Temperature Short to Ground" 16777317 "ACTIVE:Oil Temperature Open Load" 16777318 "ACTIVE:Oil Temperature Over Current" 16777319 "ACTIVE:Oil Temperature Wire Break" 16777320 "ACTIVE:Oil Temperature Freq Error" 16777321 "ACTIVE:Oil Temperature Update Rate Error" 16777322 "ACTIVE:Oil Temperature Gradient" 16777323 "ACTIVE:Oil Temperature Unknown Cause" 16777324 "ACTIVE:Oil Temperature Bad Component" 16777325 "ACTIVE:Oil Temperature Out Of Calibration" 16777326 "ACTIVE:Oil Temperature Special Instruction" 16777327 "ACTIVE:Oil Temperature Over Warning" 16777328 "ACTIVE:Oil Temperature Over Reduction" 16777329 "ACTIVE:Oil Temperature Under Warning" 16777330 "ACTIVE:Oil Temperature Under Reduction" 16777332 "ACTIVE:Oil Temperature Data Drift High" 16777333 "ACTIVE:Oil Temperature Data Drift Low" 16777344 "ACTIVE:Ambient Air Temperature Over Shutdown" 16777345 "ACTIVE:Ambient Air Temperature Under Shutdown" 16777346 "ACTIVE:Ambient Air Temperature Intermittent" 16777347 "ACTIVE:Ambient Air Temperature Short to Battery" 16777348 "ACTIVE:Ambient Air Temperature Short to Ground" 16777349 "ACTIVE:Ambient Air Temperature Open Load" 16777350 "ACTIVE:Ambient Air Temperature Over Current" 16777351 "ACTIVE:Ambient Air Temperature Wire Break" 16777352 "ACTIVE:Ambient Air Temperature Freq Error" 16777353 "ACTIVE:Ambient Air Temperature Update Rate Error" 16777354 "ACTIVE:Ambient Air Temperature Gradient" 16777355 "ACTIVE:Ambient Air Temperature Unknown Cause" 16777356 "ACTIVE:Ambient Air Temperature Bad Component" 16777357 "ACTIVE:Ambient Air Temperature Out Of Calibration" 16777358 "ACTIVE:Ambient Air Temperature Special Instruction" 16777359 "ACTIVE:Ambient Air Temperature Over Warning" 16777360 "ACTIVE:Ambient Air Temperature Over Reduction" 16777361 "ACTIVE:Ambient Air Temperature Under Warning" 16777362 "ACTIVE:Ambient Air Temperature Under Reduction" 16777364 "ACTIVE:Ambient Air Temperature Data Drift High" 16777365 "ACTIVE:Ambient Air Temperature Data Drift Low" 16777376 "ACTIVE:Air Boost Pressure Over Shutdown" 16777377 "ACTIVE:Air Boost Pressure Under Shutdown" 16777378 "ACTIVE:Air Boost Pressure Intermittent" 16777379 "ACTIVE:Air Boost Pressure Short to Battery" 16777380 "ACTIVE:Air Boost Pressure Short to Ground" 16777381 "ACTIVE:Air Boost Pressure Open Load" 16777382 "ACTIVE:Air Boost Pressure Over Current" 16777383 "ACTIVE:Air Boost Pressure Wire Break" 16777384 "ACTIVE:Air Boost Pressure Freq Error" 16777385 "ACTIVE:Air Boost Pressure Update Rate Error" 16777386 "ACTIVE:Air Boost Pressure Gradient" 16777387 "ACTIVE:Air Boost Pressure Unknown Cause" 16777388 "ACTIVE:Air Boost Pressure Bad Component" 16777389 "ACTIVE:Air Boost Pressure Out Of Calibration" 16777390 "ACTIVE:Air Boost Pressure Special Instruction" 16777391 "ACTIVE:Air Boost Pressure Over Warning" 16777392 "ACTIVE:Air Boost Pressure Over Reduction" 16777393 "ACTIVE:Air Boost Pressure Under Warning" 16777394 "ACTIVE:Air Boost Pressure Under Reduction" 16777396 "ACTIVE:Air Boost Pressure Data Drift High" 16777397 "ACTIVE:Air Boost Pressure Data Drift Low" 16777408 "ACTIVE:Ambient Air Pressure Over Shutdown" 16777409 "ACTIVE:Ambient Air Pressure Under Shutdown" 16777410 "ACTIVE:Ambient Air Pressure Intermittent" 16777411 "ACTIVE:Ambient Air Pressure Short to Battery" 16777412 "ACTIVE:Ambient Air Pressure Short to Ground" 16777413 "ACTIVE:Ambient Air Pressure Open Load" 16777414 "ACTIVE:Ambient Air Pressure Over Current" 16777415 "ACTIVE:Ambient Air Pressure Wire Break" 16777416 "ACTIVE:Ambient Air Pressure Freq Error" 16777417 "ACTIVE:Ambient Air Pressure Update Rate Error" 16777418 "ACTIVE:Ambient Air Pressure Gradient" 16777419 "ACTIVE:Ambient Air Pressure Unknown Cause" 16777420 "ACTIVE:Ambient Air Pressure Bad Component" 16777421 "ACTIVE:Ambient Air Pressure Out Of Calibration" 16777422 "ACTIVE:Ambient Air Pressure Special Instruction" 16777423 "ACTIVE:Ambient Air Pressure Over Warning" 16777424 "ACTIVE:Ambient Air Pressure Over Reduction" 16777425 "ACTIVE:Ambient Air Pressure Under Warning" 16777426 "ACTIVE:Ambient Air Pressure Under Reduction" 16777428 "ACTIVE:Ambient Air Pressure Data Drift High" 16777429 "ACTIVE:Ambient Air Pressure Data Drift Low" 16777440 "ACTIVE:Oil Pressure Over Shutdown" 16777441 "ACTIVE:Oil Pressure Under Shutdown" 16777442 "ACTIVE:Oil Pressure Intermittent" 16777443 "ACTIVE:Oil Pressure Short to Battery" 16777444 "ACTIVE:Oil Pressure Short to Ground" 16777445 "ACTIVE:Oil Pressure Open Load" 16777446 "ACTIVE:Oil Pressure Over Current" 16777447 "ACTIVE:Oil Pressure Wire Break" 16777448 "ACTIVE:Oil Pressure Freq Error" 16777449 "ACTIVE:Oil Pressure Update Rate Error" 16777450 "ACTIVE:Oil Pressure Gradient" 16777451 "ACTIVE:Oil Pressure Unknown Cause" 16777452 "ACTIVE:Oil Pressure Bad Component" 16777453 "ACTIVE:Oil Pressure Out Of Calibration" 16777454 "ACTIVE:Oil Pressure Special Instruction" 16777455 "ACTIVE:Oil Pressure Over Warning" 16777456 "ACTIVE:Oil Pressure Over Reduction" 16777457 "ACTIVE:Oil Pressure Under Warning" 16777458 "ACTIVE:Oil Pressure Under Reduction" 16777460 "ACTIVE:Oil Pressure Data Drift High" 16777461 "ACTIVE:Oil Pressure Data Drift Low" 16777472 "ACTIVE:Fuel Pressure Over Shutdown" 16777473 "ACTIVE:Fuel Pressure Under Shutdown" 16777474 "ACTIVE:Fuel Pressure Intermittent" 16777475 "ACTIVE:Fuel Pressure Short to Battery" 16777476 "ACTIVE:Fuel Pressure Short to Ground" 16777477 "ACTIVE:Fuel Pressure Open Load" 16777478 "ACTIVE:Fuel Pressure Over Current" 16777479 "ACTIVE:Fuel Pressure Wire Break" 16777480 "ACTIVE:Fuel Pressure Freq Error" 16777481 "ACTIVE:Fuel Pressure Update Rate Error" 16777482 "ACTIVE:Fuel Pressure Gradient" 16777483 "ACTIVE:Fuel Pressure Unknown Cause" 16777484 "ACTIVE:Fuel Pressure Bad Component" 16777485 "ACTIVE:Fuel Pressure Out Of Calibration" 16777486 "ACTIVE:Fuel Pressure Special Instruction" 16777487 "ACTIVE:Fuel Pressure Over Warning" 16777488 "ACTIVE:Fuel Pressure Over Reduction" 16777489 "ACTIVE:Fuel Pressure Under Warning" 16777490 "ACTIVE:Fuel Pressure Under Reduction" 16777492 "ACTIVE:Fuel Pressure Data Drift High" 16777493 "ACTIVE:Fuel Pressure Data Drift Low" 16777504 "ACTIVE:Rail Pressure Over Shutdown" 16777505 "ACTIVE:Rail Pressure Under Shutdown" 16777506 "ACTIVE:Rail Pressure Intermittent" 16777507 "ACTIVE:Rail Pressure Short to Battery" 16777508 "ACTIVE:Rail Pressure Short to Ground" 16777509 "ACTIVE:Rail Pressure Open Load" 16777510 "ACTIVE:Rail Pressure Over Current" 16777511 "ACTIVE:Rail Pressure Wire Break" 16777512 "ACTIVE:Rail Pressure Freq Error" 16777513 "ACTIVE:Rail Pressure Update Rate Error" 16777514 "ACTIVE:Rail Pressure Gradient" 16777515 "ACTIVE:Rail Pressure Unknown Cause" 16777516 "ACTIVE:Rail Pressure Bad Component" 16777517 "ACTIVE:Rail Pressure Out Of Calibration" 16777518 "ACTIVE:Rail Pressure Special Instruction" 16777519 "ACTIVE:Rail Pressure Over Warning" 16777520 "ACTIVE:Rail Pressure Over Reduction" 16777521 "ACTIVE:Rail Pressure Under Warning" 16777522 "ACTIVE:Rail Pressure Under Reduction" 16777524 "ACTIVE:Rail Pressure Data Drift High" 16777525 "ACTIVE:Rail Pressure Data Drift Low" 16777536 "ACTIVE:Battery Voltage Over Shutdown" 16777537 "ACTIVE:Battery Voltage Under Shutdown" 16777538 "ACTIVE:Battery Voltage Intermittent" 16777539 "ACTIVE:Battery Voltage Short to Battery" 16777540 "ACTIVE:Battery Voltage Short to Ground" 16777541 "ACTIVE:Battery Voltage Open Load" 16777542 "ACTIVE:Battery Voltage Over Current" 16777543 "ACTIVE:Battery Voltage Wire Break" 16777544 "ACTIVE:Battery Voltage Freq Error" 16777545 "ACTIVE:Battery Voltage Update Rate Error" 16777546 "ACTIVE:Battery Voltage Gradient" 16777547 "ACTIVE:Battery Voltage Unknown Cause" 16777548 "ACTIVE:Battery Voltage Bad Component" 16777549 "ACTIVE:Battery Voltage Out Of Calibration" 16777550 "ACTIVE:Battery Voltage Special Instruction" 16777551 "ACTIVE:Battery Voltage Over Warning" 16777552 "ACTIVE:Battery Voltage Over Reduction" 16777553 "ACTIVE:Battery Voltage Under Warning" 16777554 "ACTIVE:Battery Voltage Under Reduction" 16777556 "ACTIVE:Battery Voltage Data Drift High" 16777557 "ACTIVE:Battery Voltage Data Drift Low" 16780608 "ACTIVE:Battery Voltage Coherence Over Shutdown" 16780609 "ACTIVE:Battery Voltage Coherence Under Shutdown" 16780610 "ACTIVE:Battery Voltage Coherence Intermittent" 16780611 "ACTIVE:Battery Voltage Coherence Short to Battery" 16780612 "ACTIVE:Battery Voltage Coherence Short to Ground" 16780613 "ACTIVE:Battery Voltage Coherence Open Load" 16780614 "ACTIVE:Battery Voltage Coherence Over Current" 16780615 "ACTIVE:Battery Voltage Coherence Wire Break" 16780616 "ACTIVE:Battery Voltage Coherence Freq Error" 16780617 "ACTIVE:Battery Voltage Coherence Update Rate Error" 16780618 "ACTIVE:Battery Voltage Coherence Gradient" 16780619 "ACTIVE:Battery Voltage Coherence Unknown Cause" 16780620 "ACTIVE:Battery Voltage Coherence Bad Component" 16780621 "ACTIVE:Battery Voltage Coherence Out Of Calibration" 16780622 "ACTIVE:Battery Voltage Coherence Special Instruction" 16780623 "ACTIVE:Battery Voltage Coherence Over Warning" 16780624 "ACTIVE:Battery Voltage Coherence Over Reduction" 16780625 "ACTIVE:Battery Voltage Coherence Under Warning" 16780626 "ACTIVE:Battery Voltage Coherence Under Reduction" 16780628 "ACTIVE:Battery Voltage Coherence Data Drift High" 16780629 "ACTIVE:Battery Voltage Coherence Data Drift Low" 16777568 "ACTIVE:Ecu Temperature Over Shutdown" 16777569 "ACTIVE:Ecu Temperature Under Shutdown" 16777570 "ACTIVE:Ecu Temperature Intermittent" 16777571 "ACTIVE:Ecu Temperature Short to Battery" 16777572 "ACTIVE:Ecu Temperature Short to Ground" 16777573 "ACTIVE:Ecu Temperature Open Load" 16777574 "ACTIVE:Ecu Temperature Over Current" 16777575 "ACTIVE:Ecu Temperature Wire Break" 16777576 "ACTIVE:Ecu Temperature Freq Error" 16777577 "ACTIVE:Ecu Temperature Update Rate Error" 16777578 "ACTIVE:Ecu Temperature Gradient" 16777579 "ACTIVE:Ecu Temperature Unknown Cause" 16777580 "ACTIVE:Ecu Temperature Bad Component" 16777581 "ACTIVE:Ecu Temperature Out Of Calibration" 16777582 "ACTIVE:Ecu Temperature Special Instruction" 16777583 "ACTIVE:Ecu Temperature Over Warning" 16777584 "ACTIVE:Ecu Temperature Over Reduction" 16777585 "ACTIVE:Ecu Temperature Under Warning" 16777586 "ACTIVE:Ecu Temperature Under Reduction" 16777588 "ACTIVE:Ecu Temperature Data Drift High" 16777589 "ACTIVE:Ecu Temperature Data Drift Low" 16777600 "ACTIVE:Cylinder Misfire Over Shutdown" 16777601 "ACTIVE:Cylinder Misfire Under Shutdown" 16777602 "ACTIVE:Cylinder Misfire Intermittent" 16777603 "ACTIVE:Cylinder Misfire Short to Battery" 16777604 "ACTIVE:Cylinder Misfire Short to Ground" 16777605 "ACTIVE:Cylinder Misfire Open Load" 16777606 "ACTIVE:Cylinder Misfire Over Current" 16777607 "ACTIVE:Cylinder Misfire Wire Break" 16777608 "ACTIVE:Cylinder Misfire Freq Error" 16777609 "ACTIVE:Cylinder Misfire Update Rate Error" 16777610 "ACTIVE:Cylinder Misfire Gradient" 16777611 "ACTIVE:Cylinder Misfire Unknown Cause" 16777612 "ACTIVE:Cylinder Misfire Bad Component" 16777613 "ACTIVE:Cylinder Misfire Out Of Calibration" 16777614 "ACTIVE:Cylinder Misfire Special Instruction" 16777615 "ACTIVE:Cylinder Misfire Over Warning" 16777616 "ACTIVE:Cylinder Misfire Over Reduction" 16777617 "ACTIVE:Cylinder Misfire Under Warning" 16777618 "ACTIVE:Cylinder Misfire Under Reduction" 16777620 "ACTIVE:Cylinder Misfire Data Drift High" 16777621 "ACTIVE:Cylinder Misfire Data Drift Low" 16777632 "ACTIVE:Cam Crank Sensor Defect Over Shutdown" 16777633 "ACTIVE:Cam Crank Sensor Defect Under Shutdown" 16777634 "ACTIVE:Cam Crank Sensor Defect Intermittent" 16777635 "ACTIVE:Cam Crank Sensor Defect Short to Battery" 16777636 "ACTIVE:Cam Crank Sensor Defect Short to Ground" 16777637 "ACTIVE:Cam Crank Sensor Defect Open Load" 16777638 "ACTIVE:Cam Crank Sensor Defect Over Current" 16777639 "ACTIVE:Cam Crank Sensor Defect Wire Break" 16777640 "ACTIVE:Cam Crank Sensor Defect Freq Error" 16777641 "ACTIVE:Cam Crank Sensor Defect Update Rate Error" 16777642 "ACTIVE:Cam Crank Sensor Defect Gradient" 16777643 "ACTIVE:Cam Crank Sensor Defect Unknown Cause" 16777644 "ACTIVE:Cam Crank Sensor Defect Bad Component" 16777645 "ACTIVE:Cam Crank Sensor Defect Out Of Calibration" 16777646 "ACTIVE:Cam Crank Sensor Defect Special Instruction" 16777647 "ACTIVE:Cam Crank Sensor Defect Over Warning" 16777648 "ACTIVE:Cam Crank Sensor Defect Over Reduction" 16777649 "ACTIVE:Cam Crank Sensor Defect Under Warning" 16777650 "ACTIVE:Cam Crank Sensor Defect Under Reduction" 16777652 "ACTIVE:Cam Crank Sensor Defect Data Drift High" 16777653 "ACTIVE:Cam Crank Sensor Defect Data Drift Low" 16777664 "ACTIVE:Injector Defect Over Shutdown" 16777665 "ACTIVE:Injector Defect Under Shutdown" 16777666 "ACTIVE:Injector Defect Intermittent" 16777667 "ACTIVE:Injector Defect Short to Battery" 16777668 "ACTIVE:Injector Defect Short to Ground" 16777669 "ACTIVE:Injector Defect Open Load" 16777670 "ACTIVE:Injector Defect Over Current" 16777671 "ACTIVE:Injector Defect Wire Break" 16777672 "ACTIVE:Injector Defect Freq Error" 16777673 "ACTIVE:Injector Defect Update Rate Error" 16777674 "ACTIVE:Injector Defect Gradient" 16777675 "ACTIVE:Injector Defect Unknown Cause" 16777676 "ACTIVE:Injector Defect Bad Component" 16777677 "ACTIVE:Injector Defect Out Of Calibration" 16777678 "ACTIVE:Injector Defect Special Instruction" 16777679 "ACTIVE:Injector Defect Over Warning" 16777680 "ACTIVE:Injector Defect Over Reduction" 16777681 "ACTIVE:Injector Defect Under Warning" 16777682 "ACTIVE:Injector Defect Under Reduction" 16777684 "ACTIVE:Injector Defect Data Drift High" 16777685 "ACTIVE:Injector Defect Data Drift Low" 16777696 "ACTIVE:Over Speed Error Over Shutdown" 16777697 "ACTIVE:Over Speed Error Under Shutdown" 16777698 "ACTIVE:Over Speed Error Intermittent" 16777699 "ACTIVE:Over Speed Error Short to Battery" 16777700 "ACTIVE:Over Speed Error Short to Ground" 16777701 "ACTIVE:Over Speed Error Open Load" 16777702 "ACTIVE:Over Speed Error Over Current" 16777703 "ACTIVE:Over Speed Error Wire Break" 16777704 "ACTIVE:Over Speed Error Freq Error" 16777705 "ACTIVE:Over Speed Error Update Rate Error" 16777706 "ACTIVE:Over Speed Error Gradient" 16777707 "ACTIVE:Over Speed Error Unknown Cause" 16777708 "ACTIVE:Over Speed Error Bad Component" 16777709 "ACTIVE:Over Speed Error Out Of Calibration" 16777710 "ACTIVE:Over Speed Error Special Instruction" 16777711 "ACTIVE:Over Speed Error Over Warning" 16777712 "ACTIVE:Over Speed Error Over Reduction" 16777713 "ACTIVE:Over Speed Error Under Warning" 16777714 "ACTIVE:Over Speed Error Under Reduction" 16777716 "ACTIVE:Over Speed Error Data Drift High" 16777717 "ACTIVE:Over Speed Error Data Drift Low" 16777760 "ACTIVE:Start Request Over Shutdown" 16777761 "ACTIVE:Start Request Under Shutdown" 16777762 "ACTIVE:Start Request Intermittent" 16777763 "ACTIVE:Start Request Short to Battery" 16777764 "ACTIVE:Start Request Short to Ground" 16777765 "ACTIVE:Start Request Open Load" 16777766 "ACTIVE:Start Request Over Current" 16777767 "ACTIVE:Start Request Wire Break" 16777768 "ACTIVE:Start Request Freq Error" 16777769 "ACTIVE:Start Request Update Rate Error" 16777770 "ACTIVE:Start Request Gradient" 16777771 "ACTIVE:Start Request Unknown Cause" 16777772 "ACTIVE:Start Request Bad Component" 16777773 "ACTIVE:Start Request Out Of Calibration" 16777774 "ACTIVE:Start Request Special Instruction" 16777775 "ACTIVE:Start Request Over Warning" 16777776 "ACTIVE:Start Request Over Reduction" 16777777 "ACTIVE:Start Request Under Warning" 16777778 "ACTIVE:Start Request Under Reduction" 16777780 "ACTIVE:Start Request Data Drift High" 16777781 "ACTIVE:Start Request Data Drift Low" 16777792 "ACTIVE:Engine Break100 Over Shutdown" 16777793 "ACTIVE:Engine Break100 Under Shutdown" 16777794 "ACTIVE:Engine Break100 Intermittent" 16777795 "ACTIVE:Engine Break100 Short to Battery" 16777796 "ACTIVE:Engine Break100 Short to Ground" 16777797 "ACTIVE:Engine Break100 Open Load" 16777798 "ACTIVE:Engine Break100 Over Current" 16777799 "ACTIVE:Engine Break100 Wire Break" 16777800 "ACTIVE:Engine Break100 Freq Error" 16777801 "ACTIVE:Engine Break100 Update Rate Error" 16777802 "ACTIVE:Engine Break100 Gradient" 16777803 "ACTIVE:Engine Break100 Unknown Cause" 16777804 "ACTIVE:Engine Break100 Bad Component" 16777805 "ACTIVE:Engine Break100 Out Of Calibration" 16777806 "ACTIVE:Engine Break100 Special Instruction" 16777807 "ACTIVE:Engine Break100 Over Warning" 16777808 "ACTIVE:Engine Break100 Over Reduction" 16777809 "ACTIVE:Engine Break100 Under Warning" 16777810 "ACTIVE:Engine Break100 Under Reduction" 16777812 "ACTIVE:Engine Break100 Data Drift High" 16777813 "ACTIVE:Engine Break100 Data Drift Low" 16777824 "ACTIVE:Cruise Control 1 Over Shutdown" 16777825 "ACTIVE:Cruise Control 1 Under Shutdown" 16777826 "ACTIVE:Cruise Control 1 Intermittent" 16777827 "ACTIVE:Cruise Control 1 Short to Battery" 16777828 "ACTIVE:Cruise Control 1 Short to Ground" 16777829 "ACTIVE:Cruise Control 1 Open Load" 16777830 "ACTIVE:Cruise Control 1 Over Current" 16777831 "ACTIVE:Cruise Control 1 Wire Break" 16777832 "ACTIVE:Cruise Control 1 Freq Error" 16777833 "ACTIVE:Cruise Control 1 Update Rate Error" 16777834 "ACTIVE:Cruise Control 1 Gradient" 16777835 "ACTIVE:Cruise Control 1 Unknown Cause" 16777836 "ACTIVE:Cruise Control 1 Bad Component" 16777837 "ACTIVE:Cruise Control 1 Out Of Calibration" 16777838 "ACTIVE:Cruise Control 1 Special Instruction" 16777839 "ACTIVE:Cruise Control 1 Over Warning" 16777840 "ACTIVE:Cruise Control 1 Over Reduction" 16777841 "ACTIVE:Cruise Control 1 Under Warning" 16777842 "ACTIVE:Cruise Control 1 Under Reduction" 16777844 "ACTIVE:Cruise Control 1 Data Drift High" 16777845 "ACTIVE:Cruise Control 1 Data Drift Low" 16777856 "ACTIVE:Cruise Control 2 Over Shutdown" 16777857 "ACTIVE:Cruise Control 2 Under Shutdown" 16777858 "ACTIVE:Cruise Control 2 Intermittent" 16777859 "ACTIVE:Cruise Control 2 Short to Battery" 16777860 "ACTIVE:Cruise Control 2 Short to Ground" 16777861 "ACTIVE:Cruise Control 2 Open Load" 16777862 "ACTIVE:Cruise Control 2 Over Current" 16777863 "ACTIVE:Cruise Control 2 Wire Break" 16777864 "ACTIVE:Cruise Control 2 Freq Error" 16777865 "ACTIVE:Cruise Control 2 Update Rate Error" 16777866 "ACTIVE:Cruise Control 2 Gradient" 16777867 "ACTIVE:Cruise Control 2 Unknown Cause" 16777868 "ACTIVE:Cruise Control 2 Bad Component" 16777869 "ACTIVE:Cruise Control 2 Out Of Calibration" 16777870 "ACTIVE:Cruise Control 2 Special Instruction" 16777871 "ACTIVE:Cruise Control 2 Over Warning" 16777872 "ACTIVE:Cruise Control 2 Over Reduction" 16777873 "ACTIVE:Cruise Control 2 Under Warning" 16777874 "ACTIVE:Cruise Control 2 Under Reduction" 16777876 "ACTIVE:Cruise Control 2 Data Drift High" 16777877 "ACTIVE:Cruise Control 2 Data Drift Low" 16777888 "ACTIVE:Brake Pedal 1 Over Shutdown" 16777889 "ACTIVE:Brake Pedal 1 Under Shutdown" 16777890 "ACTIVE:Brake Pedal 1 Intermittent" 16777891 "ACTIVE:Brake Pedal 1 Short to Battery" 16777892 "ACTIVE:Brake Pedal 1 Short to Ground" 16777893 "ACTIVE:Brake Pedal 1 Open Load" 16777894 "ACTIVE:Brake Pedal 1 Over Current" 16777895 "ACTIVE:Brake Pedal 1 Wire Break" 16777896 "ACTIVE:Brake Pedal 1 Freq Error" 16777897 "ACTIVE:Brake Pedal 1 Update Rate Error" 16777898 "ACTIVE:Brake Pedal 1 Gradient" 16777899 "ACTIVE:Brake Pedal 1 Unknown Cause" 16777900 "ACTIVE:Brake Pedal 1 Bad Component" 16777901 "ACTIVE:Brake Pedal 1 Out Of Calibration" 16777902 "ACTIVE:Brake Pedal 1 Special Instruction" 16777903 "ACTIVE:Brake Pedal 1 Over Warning" 16777904 "ACTIVE:Brake Pedal 1 Over Reduction" 16777905 "ACTIVE:Brake Pedal 1 Under Warning" 16777906 "ACTIVE:Brake Pedal 1 Under Reduction" 16777908 "ACTIVE:Brake Pedal 1 Data Drift High" 16777909 "ACTIVE:Brake Pedal 1 Data Drift Low" 16777920 "ACTIVE:Cruise Control 3 Over Shutdown" 16777921 "ACTIVE:Cruise Control 3 Under Shutdown" 16777922 "ACTIVE:Cruise Control 3 Intermittent" 16777923 "ACTIVE:Cruise Control 3 Short to Battery" 16777924 "ACTIVE:Cruise Control 3 Short to Ground" 16777925 "ACTIVE:Cruise Control 3 Open Load" 16777926 "ACTIVE:Cruise Control 3 Over Current" 16777927 "ACTIVE:Cruise Control 3 Wire Break" 16777928 "ACTIVE:Cruise Control 3 Freq Error" 16777929 "ACTIVE:Cruise Control 3 Update Rate Error" 16777930 "ACTIVE:Cruise Control 3 Gradient" 16777931 "ACTIVE:Cruise Control 3 Unknown Cause" 16777932 "ACTIVE:Cruise Control 3 Bad Component" 16777933 "ACTIVE:Cruise Control 3 Out Of Calibration" 16777934 "ACTIVE:Cruise Control 3 Special Instruction" 16777935 "ACTIVE:Cruise Control 3 Over Warning" 16777936 "ACTIVE:Cruise Control 3 Over Reduction" 16777937 "ACTIVE:Cruise Control 3 Under Warning" 16777938 "ACTIVE:Cruise Control 3 Under Reduction" 16777940 "ACTIVE:Cruise Control 3 Data Drift High" 16777941 "ACTIVE:Cruise Control 3 Data Drift Low" 16777952 "ACTIVE:Engine Break 50 Over Shutdown" 16777953 "ACTIVE:Engine Break 50 Under Shutdown" 16777954 "ACTIVE:Engine Break 50 Intermittent" 16777955 "ACTIVE:Engine Break 50 Short to Battery" 16777956 "ACTIVE:Engine Break 50 Short to Ground" 16777957 "ACTIVE:Engine Break 50 Open Load" 16777958 "ACTIVE:Engine Break 50 Over Current" 16777959 "ACTIVE:Engine Break 50 Wire Break" 16777960 "ACTIVE:Engine Break 50 Freq Error" 16777961 "ACTIVE:Engine Break 50 Update Rate Error" 16777962 "ACTIVE:Engine Break 50 Gradient" 16777963 "ACTIVE:Engine Break 50 Unknown Cause" 16777964 "ACTIVE:Engine Break 50 Bad Component" 16777965 "ACTIVE:Engine Break 50 Out Of Calibration" 16777966 "ACTIVE:Engine Break 50 Special Instruction" 16777967 "ACTIVE:Engine Break 50 Over Warning" 16777968 "ACTIVE:Engine Break 50 Over Reduction" 16777969 "ACTIVE:Engine Break 50 Under Warning" 16777970 "ACTIVE:Engine Break 50 Under Reduction" 16777972 "ACTIVE:Engine Break 50 Data Drift High" 16777973 "ACTIVE:Engine Break 50 Data Drift Low" 16778016 "ACTIVE:Hand Brake Parking Over Shutdown" 16778017 "ACTIVE:Hand Brake Parking Under Shutdown" 16778018 "ACTIVE:Hand Brake Parking Intermittent" 16778019 "ACTIVE:Hand Brake Parking Short to Battery" 16778020 "ACTIVE:Hand Brake Parking Short to Ground" 16778021 "ACTIVE:Hand Brake Parking Open Load" 16778022 "ACTIVE:Hand Brake Parking Over Current" 16778023 "ACTIVE:Hand Brake Parking Wire Break" 16778024 "ACTIVE:Hand Brake Parking Freq Error" 16778025 "ACTIVE:Hand Brake Parking Update Rate Error" 16778026 "ACTIVE:Hand Brake Parking Gradient" 16778027 "ACTIVE:Hand Brake Parking Unknown Cause" 16778028 "ACTIVE:Hand Brake Parking Bad Component" 16778029 "ACTIVE:Hand Brake Parking Out Of Calibration" 16778030 "ACTIVE:Hand Brake Parking Special Instruction" 16778031 "ACTIVE:Hand Brake Parking Over Warning" 16778032 "ACTIVE:Hand Brake Parking Over Reduction" 16778033 "ACTIVE:Hand Brake Parking Under Warning" 16778034 "ACTIVE:Hand Brake Parking Under Reduction" 16778036 "ACTIVE:Hand Brake Parking Data Drift High" 16778037 "ACTIVE:Hand Brake Parking Data Drift Low" 16778048 "ACTIVE:Overriding Switch Over Shutdown" 16778049 "ACTIVE:Overriding Switch Under Shutdown" 16778050 "ACTIVE:Overriding Switch Intermittent" 16778051 "ACTIVE:Overriding Switch Short to Battery" 16778052 "ACTIVE:Overriding Switch Short to Ground" 16778053 "ACTIVE:Overriding Switch Open Load" 16778054 "ACTIVE:Overriding Switch Over Current" 16778055 "ACTIVE:Overriding Switch Wire Break" 16778056 "ACTIVE:Overriding Switch Freq Error" 16778057 "ACTIVE:Overriding Switch Update Rate Error" 16778058 "ACTIVE:Overriding Switch Gradient" 16778059 "ACTIVE:Overriding Switch Unknown Cause" 16778060 "ACTIVE:Overriding Switch Bad Component" 16778061 "ACTIVE:Overriding Switch Out Of Calibration" 16778062 "ACTIVE:Overriding Switch Special Instruction" 16778063 "ACTIVE:Overriding Switch Over Warning" 16778064 "ACTIVE:Overriding Switch Over Reduction" 16778065 "ACTIVE:Overriding Switch Under Warning" 16778066 "ACTIVE:Overriding Switch Under Reduction" 16778068 "ACTIVE:Overriding Switch Data Drift High" 16778069 "ACTIVE:Overriding Switch Data Drift Low" 16778080 "ACTIVE:Ignition Over Shutdown" 16778081 "ACTIVE:Ignition Under Shutdown" 16778082 "ACTIVE:Ignition Intermittent" 16778083 "ACTIVE:Ignition Short to Battery" 16778084 "ACTIVE:Ignition Short to Ground" 16778085 "ACTIVE:Ignition Open Load" 16778086 "ACTIVE:Ignition Over Current" 16778087 "ACTIVE:Ignition Wire Break" 16778088 "ACTIVE:Ignition Freq Error" 16778089 "ACTIVE:Ignition Update Rate Error" 16778090 "ACTIVE:Ignition Gradient" 16778091 "ACTIVE:Ignition Unknown Cause" 16778092 "ACTIVE:Ignition Bad Component" 16778093 "ACTIVE:Ignition Out Of Calibration" 16778094 "ACTIVE:Ignition Special Instruction" 16778095 "ACTIVE:Ignition Over Warning" 16778096 "ACTIVE:Ignition Over Reduction" 16778097 "ACTIVE:Ignition Under Warning" 16778098 "ACTIVE:Ignition Under Reduction" 16778100 "ACTIVE:Ignition Data Drift High" 16778101 "ACTIVE:Ignition Data Drift Low" 16778112 "ACTIVE:Grid Heater Over Shutdown" 16778113 "ACTIVE:Grid Heater Under Shutdown" 16778114 "ACTIVE:Grid Heater Intermittent" 16778115 "ACTIVE:Grid Heater Short to Battery" 16778116 "ACTIVE:Grid Heater Short to Ground" 16778117 "ACTIVE:Grid Heater Open Load" 16778118 "ACTIVE:Grid Heater Over Current" 16778119 "ACTIVE:Grid Heater Wire Break" 16778120 "ACTIVE:Grid Heater Freq Error" 16778121 "ACTIVE:Grid Heater Update Rate Error" 16778122 "ACTIVE:Grid Heater Gradient" 16778123 "ACTIVE:Grid Heater Unknown Cause" 16778124 "ACTIVE:Grid Heater Bad Component" 16778125 "ACTIVE:Grid Heater Out Of Calibration" 16778126 "ACTIVE:Grid Heater Special Instruction" 16778127 "ACTIVE:Grid Heater Over Warning" 16778128 "ACTIVE:Grid Heater Over Reduction" 16778129 "ACTIVE:Grid Heater Under Warning" 16778130 "ACTIVE:Grid Heater Under Reduction" 16778132 "ACTIVE:Grid Heater Data Drift High" 16778133 "ACTIVE:Grid Heater Data Drift Low" 16778560 "ACTIVE:Coolant Temperature Diag Over Shutdown" 16778561 "ACTIVE:Coolant Temperature Diag Under Shutdown" 16778562 "ACTIVE:Coolant Temperature Diag Intermittent" 16778563 "ACTIVE:Coolant Temperature Diag Short to Battery" 16778564 "ACTIVE:Coolant Temperature Diag Short to Ground" 16778565 "ACTIVE:Coolant Temperature Diag Open Load" 16778566 "ACTIVE:Coolant Temperature Diag Over Current" 16778567 "ACTIVE:Coolant Temperature Diag Wire Break" 16778568 "ACTIVE:Coolant Temperature Diag Freq Error" 16778569 "ACTIVE:Coolant Temperature Diag Update Rate Error" 16778570 "ACTIVE:Coolant Temperature Diag Gradient" 16778571 "ACTIVE:Coolant Temperature Diag Unknown Cause" 16778572 "ACTIVE:Coolant Temperature Diag Bad Component" 16778573 "ACTIVE:Coolant Temperature Diag Out Of Calibration" 16778574 "ACTIVE:Coolant Temperature Diag Special Instruction" 16778575 "ACTIVE:Coolant Temperature Diag Over Warning" 16778576 "ACTIVE:Coolant Temperature Diag Over Reduction" 16778577 "ACTIVE:Coolant Temperature Diag Under Warning" 16778578 "ACTIVE:Coolant Temperature Diag Under Reduction" 16778580 "ACTIVE:Coolant Temperature Diag Data Drift High" 16778581 "ACTIVE:Coolant Temperature Diag Data Drift Low" 16778592 "ACTIVE:Air Boost Temperature Diag Over Shutdown" 16778593 "ACTIVE:Air Boost Temperature Diag Under Shutdown" 16778594 "ACTIVE:Air Boost Temperature Diag Intermittent" 16778595 "ACTIVE:Air Boost Temperature Diag Short to Battery" 16778596 "ACTIVE:Air Boost Temperature Diag Short to Ground" 16778597 "ACTIVE:Air Boost Temperature Diag Open Load" 16778598 "ACTIVE:Air Boost Temperature Diag Over Current" 16778599 "ACTIVE:Air Boost Temperature Diag Wire Break" 16778600 "ACTIVE:Air Boost Temperature Diag Freq Error" 16778601 "ACTIVE:Air Boost Temperature Diag Update Rate Error" 16778602 "ACTIVE:Air Boost Temperature Diag Gradient" 16778603 "ACTIVE:Air Boost Temperature Diag Unknown Cause" 16778604 "ACTIVE:Air Boost Temperature Diag Bad Component" 16778605 "ACTIVE:Air Boost Temperature Diag Out Of Calibration" 16778606 "ACTIVE:Air Boost Temperature Diag Special Instruction" 16778607 "ACTIVE:Air Boost Temperature Diag Over Warning" 16778608 "ACTIVE:Air Boost Temperature Diag Over Reduction" 16778609 "ACTIVE:Air Boost Temperature Diag Under Warning" 16778610 "ACTIVE:Air Boost Temperature Diag Under Reduction" 16778612 "ACTIVE:Air Boost Temperature Diag Data Drift High" 16778613 "ACTIVE:Air Boost Temperature Diag Data Drift Low" 16778848 "ACTIVE:Accelerator Pedal 1 Over Shutdown" 16778849 "ACTIVE:Accelerator Pedal 1 Under Shutdown" 16778850 "ACTIVE:Accelerator Pedal 1 Intermittent" 16778851 "ACTIVE:Accelerator Pedal 1 Short to Battery" 16778852 "ACTIVE:Accelerator Pedal 1 Short to Ground" 16778853 "ACTIVE:Accelerator Pedal 1 Open Load" 16778854 "ACTIVE:Accelerator Pedal 1 Over Current" 16778855 "ACTIVE:Accelerator Pedal 1 Wire Break" 16778856 "ACTIVE:Accelerator Pedal 1 Freq Error" 16778857 "ACTIVE:Accelerator Pedal 1 Update Rate Error" 16778858 "ACTIVE:Accelerator Pedal 1 Gradient" 16778859 "ACTIVE:Accelerator Pedal 1 Unknown Cause" 16778860 "ACTIVE:Accelerator Pedal 1 Bad Component" 16778861 "ACTIVE:Accelerator Pedal 1 Out Of Calibration" 16778862 "ACTIVE:Accelerator Pedal 1 Special Instruction" 16778863 "ACTIVE:Accelerator Pedal 1 Over Warning" 16778864 "ACTIVE:Accelerator Pedal 1 Over Reduction" 16778865 "ACTIVE:Accelerator Pedal 1 Under Warning" 16778866 "ACTIVE:Accelerator Pedal 1 Under Reduction" 16778868 "ACTIVE:Accelerator Pedal 1 Data Drift High" 16778869 "ACTIVE:Accelerator Pedal 1 Data Drift Low" 16778880 "ACTIVE:Accelerator Pedal 2 Over Shutdown" 16778881 "ACTIVE:Accelerator Pedal 2 Under Shutdown" 16778882 "ACTIVE:Accelerator Pedal 2 Intermittent" 16778883 "ACTIVE:Accelerator Pedal 2 Short to Battery" 16778884 "ACTIVE:Accelerator Pedal 2 Short to Ground" 16778885 "ACTIVE:Accelerator Pedal 2 Open Load" 16778886 "ACTIVE:Accelerator Pedal 2 Over Current" 16778887 "ACTIVE:Accelerator Pedal 2 Wire Break" 16778888 "ACTIVE:Accelerator Pedal 2 Freq Error" 16778889 "ACTIVE:Accelerator Pedal 2 Update Rate Error" 16778890 "ACTIVE:Accelerator Pedal 2 Gradient" 16778891 "ACTIVE:Accelerator Pedal 2 Unknown Cause" 16778892 "ACTIVE:Accelerator Pedal 2 Bad Component" 16778893 "ACTIVE:Accelerator Pedal 2 Out Of Calibration" 16778894 "ACTIVE:Accelerator Pedal 2 Special Instruction" 16778895 "ACTIVE:Accelerator Pedal 2 Over Warning" 16778896 "ACTIVE:Accelerator Pedal 2 Over Reduction" 16778897 "ACTIVE:Accelerator Pedal 2 Under Warning" 16778898 "ACTIVE:Accelerator Pedal 2 Under Reduction" 16778900 "ACTIVE:Accelerator Pedal 2 Data Drift High" 16778901 "ACTIVE:Accelerator Pedal 2 Data Drift Low" 16779168 "ACTIVE:VCV Current Output Over Shutdown" 16779169 "ACTIVE:VCV Current Output Under Shutdown" 16779170 "ACTIVE:VCV Current Output Intermittent" 16779171 "ACTIVE:VCV Current Output Short to Battery" 16779172 "ACTIVE:VCV Current Output Short to Ground" 16779173 "ACTIVE:VCV Current Output Open Load" 16779174 "ACTIVE:VCV Current Output Over Current" 16779175 "ACTIVE:VCV Current Output Wire Break" 16779176 "ACTIVE:VCV Current Output Freq Error" 16779177 "ACTIVE:VCV Current Output Update Rate Error" 16779178 "ACTIVE:VCV Current Output Gradient" 16779179 "ACTIVE:VCV Current Output Unknown Cause" 16779180 "ACTIVE:VCV Current Output Bad Component" 16779181 "ACTIVE:VCV Current Output Out Of Calibration" 16779182 "ACTIVE:VCV Current Output Special Instruction" 16779183 "ACTIVE:VCV Current Output Over Warning" 16779184 "ACTIVE:VCV Current Output Over Reduction" 16779185 "ACTIVE:VCV Current Output Under Warning" 16779186 "ACTIVE:VCV Current Output Under Reduction" 16779188 "ACTIVE:VCV Current Output Data Drift High" 16779189 "ACTIVE:VCV Current Output Data Drift Low" 16779200 "ACTIVE:PCV Current Output Over Shutdown" 16779201 "ACTIVE:PCV Current Output Under Shutdown" 16779202 "ACTIVE:PCV Current Output Intermittent" 16779203 "ACTIVE:PCV Current Output Short to Battery" 16779204 "ACTIVE:PCV Current Output Short to Ground" 16779205 "ACTIVE:PCV Current Output Open Load" 16779206 "ACTIVE:PCV Current Output Over Current" 16779207 "ACTIVE:PCV Current Output Wire Break" 16779208 "ACTIVE:PCV Current Output Freq Error" 16779209 "ACTIVE:PCV Current Output Update Rate Error" 16779210 "ACTIVE:PCV Current Output Gradient" 16779211 "ACTIVE:PCV Current Output Unknown Cause" 16779212 "ACTIVE:PCV Current Output Bad Component" 16779213 "ACTIVE:PCV Current Output Out Of Calibration" 16779214 "ACTIVE:PCV Current Output Special Instruction" 16779215 "ACTIVE:PCV Current Output Over Warning" 16779216 "ACTIVE:PCV Current Output Over Reduction" 16779217 "ACTIVE:PCV Current Output Under Warning" 16779218 "ACTIVE:PCV Current Output Under Reduction" 16779220 "ACTIVE:PCV Current Output Data Drift High" 16779221 "ACTIVE:PCV Current Output Data Drift Low" 16779328 "ACTIVE:VoltageDigitalOutputFeedback1 Over Shutdown" 16779329 "ACTIVE:VoltageDigitalOutputFeedback1 Under Shutdown" 16779330 "ACTIVE:VoltageDigitalOutputFeedback1 Intermittent" 16779331 "ACTIVE:VoltageDigitalOutputFeedback1 Short to Battery" 16779332 "ACTIVE:VoltageDigitalOutputFeedback1 Short to Ground" 16779333 "ACTIVE:VoltageDigitalOutputFeedback1 Open Load" 16779334 "ACTIVE:VoltageDigitalOutputFeedback1 Over Current" 16779335 "ACTIVE:VoltageDigitalOutputFeedback1 Wire Break" 16779336 "ACTIVE:VoltageDigitalOutputFeedback1 Freq Error" 16779337 "ACTIVE:VoltageDigitalOutputFeedback1 Update Rate Error" 16779338 "ACTIVE:VoltageDigitalOutputFeedback1 Gradient" 16779339 "ACTIVE:VoltageDigitalOutputFeedback1 Unknown Cause" 16779340 "ACTIVE:VoltageDigitalOutputFeedback1 Bad Component" 16779341 "ACTIVE:VoltageDigitalOutputFeedback1 Out Of Calibration" 16779342 "ACTIVE:VoltageDigitalOutputFeedback1 Special Instruction" 16779343 "ACTIVE:VoltageDigitalOutputFeedback1 Over Warning" 16779344 "ACTIVE:VoltageDigitalOutputFeedback1 Over Reduction" 16779345 "ACTIVE:VoltageDigitalOutputFeedback1 Under Warning" 16779346 "ACTIVE:VoltageDigitalOutputFeedback1 Under Reduction" 16779348 "ACTIVE:VoltageDigitalOutputFeedback1 Data Drift High" 16779349 "ACTIVE:VoltageDigitalOutputFeedback1 Data Drift Low" 16779424 "ACTIVE:RSL Lamp Diagnostic Over Shutdown" 16779425 "ACTIVE:RSL Lamp Diagnostic Under Shutdown" 16779426 "ACTIVE:RSL Lamp Diagnostic Intermittent" 16779427 "ACTIVE:RSL Lamp Diagnostic Short to Battery" 16779428 "ACTIVE:RSL Lamp Diagnostic Short to Ground" 16779429 "ACTIVE:RSL Lamp Diagnostic Open Load" 16779430 "ACTIVE:RSL Lamp Diagnostic Over Current" 16779431 "ACTIVE:RSL Lamp Diagnostic Wire Break" 16779432 "ACTIVE:RSL Lamp Diagnostic Freq Error" 16779433 "ACTIVE:RSL Lamp Diagnostic Update Rate Error" 16779434 "ACTIVE:RSL Lamp Diagnostic Gradient" 16779435 "ACTIVE:RSL Lamp Diagnostic Unknown Cause" 16779436 "ACTIVE:RSL Lamp Diagnostic Bad Component" 16779437 "ACTIVE:RSL Lamp Diagnostic Out Of Calibration" 16779438 "ACTIVE:RSL Lamp Diagnostic Special Instruction" 16779439 "ACTIVE:RSL Lamp Diagnostic Over Warning" 16779440 "ACTIVE:RSL Lamp Diagnostic Over Reduction" 16779441 "ACTIVE:RSL Lamp Diagnostic Under Warning" 16779442 "ACTIVE:RSL Lamp Diagnostic Under Reduction" 16779444 "ACTIVE:RSL Lamp Diagnostic Data Drift High" 16779445 "ACTIVE:RSL Lamp Diagnostic Data Drift Low" 16779456 "ACTIVE:CSL Lamp Diagnostic Over Shutdown" 16779457 "ACTIVE:CSL Lamp Diagnostic Under Shutdown" 16779458 "ACTIVE:CSL Lamp Diagnostic Intermittent" 16779459 "ACTIVE:CSL Lamp Diagnostic Short to Battery" 16779460 "ACTIVE:CSL Lamp Diagnostic Short to Ground" 16779461 "ACTIVE:CSL Lamp Diagnostic Open Load" 16779462 "ACTIVE:CSL Lamp Diagnostic Over Current" 16779463 "ACTIVE:CSL Lamp Diagnostic Wire Break" 16779464 "ACTIVE:CSL Lamp Diagnostic Freq Error" 16779465 "ACTIVE:CSL Lamp Diagnostic Update Rate Error" 16779466 "ACTIVE:CSL Lamp Diagnostic Gradient" 16779467 "ACTIVE:CSL Lamp Diagnostic Unknown Cause" 16779468 "ACTIVE:CSL Lamp Diagnostic Bad Component" 16779469 "ACTIVE:CSL Lamp Diagnostic Out Of Calibration" 16779470 "ACTIVE:CSL Lamp Diagnostic Special Instruction" 16779471 "ACTIVE:CSL Lamp Diagnostic Over Warning" 16779472 "ACTIVE:CSL Lamp Diagnostic Over Reduction" 16779473 "ACTIVE:CSL Lamp Diagnostic Under Warning" 16779474 "ACTIVE:CSL Lamp Diagnostic Under Reduction" 16779476 "ACTIVE:CSL Lamp Diagnostic Data Drift High" 16779477 "ACTIVE:CSL Lamp Diagnostic Data Drift Low" 16779520 "ACTIVE:AWL Lamp Diagnostic Over Shutdown" 16779521 "ACTIVE:AWL Lamp Diagnostic Under Shutdown" 16779522 "ACTIVE:AWL Lamp Diagnostic Intermittent" 16779523 "ACTIVE:AWL Lamp Diagnostic Short to Battery" 16779524 "ACTIVE:AWL Lamp Diagnostic Short to Ground" 16779525 "ACTIVE:AWL Lamp Diagnostic Open Load" 16779526 "ACTIVE:AWL Lamp Diagnostic Over Current" 16779527 "ACTIVE:AWL Lamp Diagnostic Wire Break" 16779528 "ACTIVE:AWL Lamp Diagnostic Freq Error" 16779529 "ACTIVE:AWL Lamp Diagnostic Update Rate Error" 16779530 "ACTIVE:AWL Lamp Diagnostic Gradient" 16779531 "ACTIVE:AWL Lamp Diagnostic Unknown Cause" 16779532 "ACTIVE:AWL Lamp Diagnostic Bad Component" 16779533 "ACTIVE:AWL Lamp Diagnostic Out Of Calibration" 16779534 "ACTIVE:AWL Lamp Diagnostic Special Instruction" 16779535 "ACTIVE:AWL Lamp Diagnostic Over Warning" 16779536 "ACTIVE:AWL Lamp Diagnostic Over Reduction" 16779537 "ACTIVE:AWL Lamp Diagnostic Under Warning" 16779538 "ACTIVE:AWL Lamp Diagnostic Under Reduction" 16779540 "ACTIVE:AWL Lamp Diagnostic Data Drift High" 16779541 "ACTIVE:AWL Lamp Diagnostic Data Drift Low" 16779552 "ACTIVE:Voltage48V Over Shutdown" 16779553 "ACTIVE:Voltage48V Under Shutdown" 16779554 "ACTIVE:Voltage48V Intermittent" 16779555 "ACTIVE:Voltage48V Short to Battery" 16779556 "ACTIVE:Voltage48V Short to Ground" 16779557 "ACTIVE:Voltage48V Open Load" 16779558 "ACTIVE:Voltage48V Over Current" 16779559 "ACTIVE:Voltage48V Wire Break" 16779560 "ACTIVE:Voltage48V Freq Error" 16779561 "ACTIVE:Voltage48V Update Rate Error" 16779562 "ACTIVE:Voltage48V Gradient" 16779563 "ACTIVE:Voltage48V Unknown Cause" 16779564 "ACTIVE:Voltage48V Bad Component" 16779565 "ACTIVE:Voltage48V Out Of Calibration" 16779566 "ACTIVE:Voltage48V Special Instruction" 16779567 "ACTIVE:Voltage48V Over Warning" 16779568 "ACTIVE:Voltage48V Over Reduction" 16779569 "ACTIVE:Voltage48V Under Warning" 16779570 "ACTIVE:Voltage48V Under Reduction" 16779572 "ACTIVE:Voltage48V Data Drift High" 16779573 "ACTIVE:Voltage48V Data Drift Low" 16779584 "ACTIVE:Voltage24V Over Shutdown" 16779585 "ACTIVE:Voltage24V Under Shutdown" 16779586 "ACTIVE:Voltage24V Intermittent" 16779587 "ACTIVE:Voltage24V Short to Battery" 16779588 "ACTIVE:Voltage24V Short to Ground" 16779589 "ACTIVE:Voltage24V Open Load" 16779590 "ACTIVE:Voltage24V Over Current" 16779591 "ACTIVE:Voltage24V Wire Break" 16779592 "ACTIVE:Voltage24V Freq Error" 16779593 "ACTIVE:Voltage24V Update Rate Error" 16779594 "ACTIVE:Voltage24V Gradient" 16779595 "ACTIVE:Voltage24V Unknown Cause" 16779596 "ACTIVE:Voltage24V Bad Component" 16779597 "ACTIVE:Voltage24V Out Of Calibration" 16779598 "ACTIVE:Voltage24V Special Instruction" 16779599 "ACTIVE:Voltage24V Over Warning" 16779600 "ACTIVE:Voltage24V Over Reduction" 16779601 "ACTIVE:Voltage24V Under Warning" 16779602 "ACTIVE:Voltage24V Under Reduction" 16779604 "ACTIVE:Voltage24V Data Drift High" 16779605 "ACTIVE:Voltage24V Data Drift Low" 16779616 "ACTIVE:Voltage12V Over Shutdown" 16779617 "ACTIVE:Voltage12V Under Shutdown" 16779618 "ACTIVE:Voltage12V Intermittent" 16779619 "ACTIVE:Voltage12V Short to Battery" 16779620 "ACTIVE:Voltage12V Short to Ground" 16779621 "ACTIVE:Voltage12V Open Load" 16779622 "ACTIVE:Voltage12V Over Current" 16779623 "ACTIVE:Voltage12V Wire Break" 16779624 "ACTIVE:Voltage12V Freq Error" 16779625 "ACTIVE:Voltage12V Update Rate Error" 16779626 "ACTIVE:Voltage12V Gradient" 16779627 "ACTIVE:Voltage12V Unknown Cause" 16779628 "ACTIVE:Voltage12V Bad Component" 16779629 "ACTIVE:Voltage12V Out Of Calibration" 16779630 "ACTIVE:Voltage12V Special Instruction" 16779631 "ACTIVE:Voltage12V Over Warning" 16779632 "ACTIVE:Voltage12V Over Reduction" 16779633 "ACTIVE:Voltage12V Under Warning" 16779634 "ACTIVE:Voltage12V Under Reduction" 16779636 "ACTIVE:Voltage12V Data Drift High" 16779637 "ACTIVE:Voltage12V Data Drift Low" 16779648 "ACTIVE:Voltage5V Over Shutdown" 16779649 "ACTIVE:Voltage5V Under Shutdown" 16779650 "ACTIVE:Voltage5V Intermittent" 16779651 "ACTIVE:Voltage5V Short to Battery" 16779652 "ACTIVE:Voltage5V Short to Ground" 16779653 "ACTIVE:Voltage5V Open Load" 16779654 "ACTIVE:Voltage5V Over Current" 16779655 "ACTIVE:Voltage5V Wire Break" 16779656 "ACTIVE:Voltage5V Freq Error" 16779657 "ACTIVE:Voltage5V Update Rate Error" 16779658 "ACTIVE:Voltage5V Gradient" 16779659 "ACTIVE:Voltage5V Unknown Cause" 16779660 "ACTIVE:Voltage5V Bad Component" 16779661 "ACTIVE:Voltage5V Out Of Calibration" 16779662 "ACTIVE:Voltage5V Special Instruction" 16779663 "ACTIVE:Voltage5V Over Warning" 16779664 "ACTIVE:Voltage5V Over Reduction" 16779665 "ACTIVE:Voltage5V Under Warning" 16779666 "ACTIVE:Voltage5V Under Reduction" 16779668 "ACTIVE:Voltage5V Data Drift High" 16779669 "ACTIVE:Voltage5V Data Drift Low" 16779680 "ACTIVE:Voltage5VRef Over Shutdown" 16779681 "ACTIVE:Voltage5VRef Under Shutdown" 16779682 "ACTIVE:Voltage5VRef Intermittent" 16779683 "ACTIVE:Voltage5VRef Short to Battery" 16779684 "ACTIVE:Voltage5VRef Short to Ground" 16779685 "ACTIVE:Voltage5VRef Open Load" 16779686 "ACTIVE:Voltage5VRef Over Current" 16779687 "ACTIVE:Voltage5VRef Wire Break" 16779688 "ACTIVE:Voltage5VRef Freq Error" 16779689 "ACTIVE:Voltage5VRef Update Rate Error" 16779690 "ACTIVE:Voltage5VRef Gradient" 16779691 "ACTIVE:Voltage5VRef Unknown Cause" 16779692 "ACTIVE:Voltage5VRef Bad Component" 16779693 "ACTIVE:Voltage5VRef Out Of Calibration" 16779694 "ACTIVE:Voltage5VRef Special Instruction" 16779695 "ACTIVE:Voltage5VRef Over Warning" 16779696 "ACTIVE:Voltage5VRef Over Reduction" 16779697 "ACTIVE:Voltage5VRef Under Warning" 16779698 "ACTIVE:Voltage5VRef Under Reduction" 16779700 "ACTIVE:Voltage5VRef Data Drift High" 16779701 "ACTIVE:Voltage5VRef Data Drift Low" 16779712 "ACTIVE:Voltage3_3V Over Shutdown" 16779713 "ACTIVE:Voltage3_3V Under Shutdown" 16779714 "ACTIVE:Voltage3_3V Intermittent" 16779715 "ACTIVE:Voltage3_3V Short to Battery" 16779716 "ACTIVE:Voltage3_3V Short to Ground" 16779717 "ACTIVE:Voltage3_3V Open Load" 16779718 "ACTIVE:Voltage3_3V Over Current" 16779719 "ACTIVE:Voltage3_3V Wire Break" 16779720 "ACTIVE:Voltage3_3V Freq Error" 16779721 "ACTIVE:Voltage3_3V Update Rate Error" 16779722 "ACTIVE:Voltage3_3V Gradient" 16779723 "ACTIVE:Voltage3_3V Unknown Cause" 16779724 "ACTIVE:Voltage3_3V Bad Component" 16779725 "ACTIVE:Voltage3_3V Out Of Calibration" 16779726 "ACTIVE:Voltage3_3V Special Instruction" 16779727 "ACTIVE:Voltage3_3V Over Warning" 16779728 "ACTIVE:Voltage3_3V Over Reduction" 16779729 "ACTIVE:Voltage3_3V Under Warning" 16779730 "ACTIVE:Voltage3_3V Under Reduction" 16779732 "ACTIVE:Voltage3_3V Data Drift High" 16779733 "ACTIVE:Voltage3_3V Data Drift Low" 16779744 "ACTIVE:Voltage1_25V Over Shutdown" 16779745 "ACTIVE:Voltage1_25V Under Shutdown" 16779746 "ACTIVE:Voltage1_25V Intermittent" 16779747 "ACTIVE:Voltage1_25V Short to Battery" 16779748 "ACTIVE:Voltage1_25V Short to Ground" 16779749 "ACTIVE:Voltage1_25V Open Load" 16779750 "ACTIVE:Voltage1_25V Over Current" 16779751 "ACTIVE:Voltage1_25V Wire Break" 16779752 "ACTIVE:Voltage1_25V Freq Error" 16779753 "ACTIVE:Voltage1_25V Update Rate Error" 16779754 "ACTIVE:Voltage1_25V Gradient" 16779755 "ACTIVE:Voltage1_25V Unknown Cause" 16779756 "ACTIVE:Voltage1_25V Bad Component" 16779757 "ACTIVE:Voltage1_25V Out Of Calibration" 16779758 "ACTIVE:Voltage1_25V Special Instruction" 16779759 "ACTIVE:Voltage1_25V Over Warning" 16779760 "ACTIVE:Voltage1_25V Over Reduction" 16779761 "ACTIVE:Voltage1_25V Under Warning" 16779762 "ACTIVE:Voltage1_25V Under Reduction" 16779764 "ACTIVE:Voltage1_25V Data Drift High" 16779765 "ACTIVE:Voltage1_25V Data Drift Low" 16779776 "ACTIVE:Voltage12VCamDiag Over Shutdown" 16779777 "ACTIVE:Voltage12VCamDiag Under Shutdown" 16779778 "ACTIVE:Voltage12VCamDiag Intermittent" 16779779 "ACTIVE:Voltage12VCamDiag Short to Battery" 16779780 "ACTIVE:Voltage12VCamDiag Short to Ground" 16779781 "ACTIVE:Voltage12VCamDiag Open Load" 16779782 "ACTIVE:Voltage12VCamDiag Over Current" 16779783 "ACTIVE:Voltage12VCamDiag Wire Break" 16779784 "ACTIVE:Voltage12VCamDiag Freq Error" 16779785 "ACTIVE:Voltage12VCamDiag Update Rate Error" 16779786 "ACTIVE:Voltage12VCamDiag Gradient" 16779787 "ACTIVE:Voltage12VCamDiag Unknown Cause" 16779788 "ACTIVE:Voltage12VCamDiag Bad Component" 16779789 "ACTIVE:Voltage12VCamDiag Out Of Calibration" 16779790 "ACTIVE:Voltage12VCamDiag Special Instruction" 16779791 "ACTIVE:Voltage12VCamDiag Over Warning" 16779792 "ACTIVE:Voltage12VCamDiag Over Reduction" 16779793 "ACTIVE:Voltage12VCamDiag Under Warning" 16779794 "ACTIVE:Voltage12VCamDiag Under Reduction" 16779796 "ACTIVE:Voltage12VCamDiag Data Drift High" 16779797 "ACTIVE:Voltage12VCamDiag Data Drift Low" 16780672 "ACTIVE:Voltage12VCrankDiag Over Shutdown" 16780673 "ACTIVE:Voltage12VCrankDiag Under Shutdown" 16780674 "ACTIVE:Voltage12VCrankDiag Intermittent" 16780675 "ACTIVE:Voltage12VCrankDiag Short to Battery" 16780676 "ACTIVE:Voltage12VCrankDiag Short to Ground" 16780677 "ACTIVE:Voltage12VCrankDiag Open Load" 16780678 "ACTIVE:Voltage12VCrankDiag Over Current" 16780679 "ACTIVE:Voltage12VCrankDiag Wire Break" 16780680 "ACTIVE:Voltage12VCrankDiag Freq Error" 16780681 "ACTIVE:Voltage12VCrankDiag Update Rate Error" 16780682 "ACTIVE:Voltage12VCrankDiag Gradient" 16780683 "ACTIVE:Voltage12VCrankDiag Unknown Cause" 16780684 "ACTIVE:Voltage12VCrankDiag Bad Component" 16780685 "ACTIVE:Voltage12VCrankDiag Out Of Calibration" 16780686 "ACTIVE:Voltage12VCrankDiag Special Instruction" 16780687 "ACTIVE:Voltage12VCrankDiag Over Warning" 16780688 "ACTIVE:Voltage12VCrankDiag Over Reduction" 16780689 "ACTIVE:Voltage12VCrankDiag Under Warning" 16780690 "ACTIVE:Voltage12VCrankDiag Under Reduction" 16780692 "ACTIVE:Voltage12VCrankDiag Data Drift High" 16780693 "ACTIVE:Voltage12VCrankDiag Data Drift Low" 16779808 "ACTIVE:Voltage5VDiag1 Over Shutdown" 16779809 "ACTIVE:Voltage5VDiag1 Under Shutdown" 16779810 "ACTIVE:Voltage5VDiag1 Intermittent" 16779811 "ACTIVE:Voltage5VDiag1 Short to Battery" 16779812 "ACTIVE:Voltage5VDiag1 Short to Ground" 16779813 "ACTIVE:Voltage5VDiag1 Open Load" 16779814 "ACTIVE:Voltage5VDiag1 Over Current" 16779815 "ACTIVE:Voltage5VDiag1 Wire Break" 16779816 "ACTIVE:Voltage5VDiag1 Freq Error" 16779817 "ACTIVE:Voltage5VDiag1 Update Rate Error" 16779818 "ACTIVE:Voltage5VDiag1 Gradient" 16779819 "ACTIVE:Voltage5VDiag1 Unknown Cause" 16779820 "ACTIVE:Voltage5VDiag1 Bad Component" 16779821 "ACTIVE:Voltage5VDiag1 Out Of Calibration" 16779822 "ACTIVE:Voltage5VDiag1 Special Instruction" 16779823 "ACTIVE:Voltage5VDiag1 Over Warning" 16779824 "ACTIVE:Voltage5VDiag1 Over Reduction" 16779825 "ACTIVE:Voltage5VDiag1 Under Warning" 16779826 "ACTIVE:Voltage5VDiag1 Under Reduction" 16779828 "ACTIVE:Voltage5VDiag1 Data Drift High" 16779829 "ACTIVE:Voltage5VDiag1 Data Drift Low" 16779840 "ACTIVE:Voltage5VDiag2 Over Shutdown" 16779841 "ACTIVE:Voltage5VDiag2 Under Shutdown" 16779842 "ACTIVE:Voltage5VDiag2 Intermittent" 16779843 "ACTIVE:Voltage5VDiag2 Short to Battery" 16779844 "ACTIVE:Voltage5VDiag2 Short to Ground" 16779845 "ACTIVE:Voltage5VDiag2 Open Load" 16779846 "ACTIVE:Voltage5VDiag2 Over Current" 16779847 "ACTIVE:Voltage5VDiag2 Wire Break" 16779848 "ACTIVE:Voltage5VDiag2 Freq Error" 16779849 "ACTIVE:Voltage5VDiag2 Update Rate Error" 16779850 "ACTIVE:Voltage5VDiag2 Gradient" 16779851 "ACTIVE:Voltage5VDiag2 Unknown Cause" 16779852 "ACTIVE:Voltage5VDiag2 Bad Component" 16779853 "ACTIVE:Voltage5VDiag2 Out Of Calibration" 16779854 "ACTIVE:Voltage5VDiag2 Special Instruction" 16779855 "ACTIVE:Voltage5VDiag2 Over Warning" 16779856 "ACTIVE:Voltage5VDiag2 Over Reduction" 16779857 "ACTIVE:Voltage5VDiag2 Under Warning" 16779858 "ACTIVE:Voltage5VDiag2 Under Reduction" 16779860 "ACTIVE:Voltage5VDiag2 Data Drift High" 16779861 "ACTIVE:Voltage5VDiag2 Data Drift Low" 16779872 "ACTIVE:Voltage Temperature Sensor 1 Over Shutdown" 16779873 "ACTIVE:Voltage Temperature Sensor 1 Under Shutdown" 16779874 "ACTIVE:Voltage Temperature Sensor 1 Intermittent" 16779875 "ACTIVE:Voltage Temperature Sensor 1 Short to Battery" 16779876 "ACTIVE:Voltage Temperature Sensor 1 Short to Ground" 16779877 "ACTIVE:Voltage Temperature Sensor 1 Open Load" 16779878 "ACTIVE:Voltage Temperature Sensor 1 Over Current" 16779879 "ACTIVE:Voltage Temperature Sensor 1 Wire Break" 16779880 "ACTIVE:Voltage Temperature Sensor 1 Freq Error" 16779881 "ACTIVE:Voltage Temperature Sensor 1 Update Rate Error" 16779882 "ACTIVE:Voltage Temperature Sensor 1 Gradient" 16779883 "ACTIVE:Voltage Temperature Sensor 1 Unknown Cause" 16779884 "ACTIVE:Voltage Temperature Sensor 1 Bad Component" 16779885 "ACTIVE:Voltage Temperature Sensor 1 Out Of Calibration" 16779886 "ACTIVE:Voltage Temperature Sensor 1 Special Instruction" 16779887 "ACTIVE:Voltage Temperature Sensor 1 Over Warning" 16779888 "ACTIVE:Voltage Temperature Sensor 1 Over Reduction" 16779889 "ACTIVE:Voltage Temperature Sensor 1 Under Warning" 16779890 "ACTIVE:Voltage Temperature Sensor 1 Under Reduction" 16779892 "ACTIVE:Voltage Temperature Sensor 1 Data Drift High" 16779893 "ACTIVE:Voltage Temperature Sensor 1 Data Drift Low" 16779904 "ACTIVE:Voltage Pressure Sensor Over Shutdown" 16779905 "ACTIVE:Voltage Pressure Sensor Under Shutdown" 16779906 "ACTIVE:Voltage Pressure Sensor Intermittent" 16779907 "ACTIVE:Voltage Pressure Sensor Short to Battery" 16779908 "ACTIVE:Voltage Pressure Sensor Short to Ground" 16779909 "ACTIVE:Voltage Pressure Sensor Open Load" 16779910 "ACTIVE:Voltage Pressure Sensor Over Current" 16779911 "ACTIVE:Voltage Pressure Sensor Wire Break" 16779912 "ACTIVE:Voltage Pressure Sensor Freq Error" 16779913 "ACTIVE:Voltage Pressure Sensor Update Rate Error" 16779914 "ACTIVE:Voltage Pressure Sensor Gradient" 16779915 "ACTIVE:Voltage Pressure Sensor Unknown Cause" 16779916 "ACTIVE:Voltage Pressure Sensor Bad Component" 16779917 "ACTIVE:Voltage Pressure Sensor Out Of Calibration" 16779918 "ACTIVE:Voltage Pressure Sensor Special Instruction" 16779919 "ACTIVE:Voltage Pressure Sensor Over Warning" 16779920 "ACTIVE:Voltage Pressure Sensor Over Reduction" 16779921 "ACTIVE:Voltage Pressure Sensor Under Warning" 16779922 "ACTIVE:Voltage Pressure Sensor Under Reduction" 16779924 "ACTIVE:Voltage Pressure Sensor Data Drift High" 16779925 "ACTIVE:Voltage Pressure Sensor Data Drift Low" 16780704 "ACTIVE:Voltage 5V Referance MCU Diagnostic Over Shutdown" 16780705 "ACTIVE:Voltage 5V Referance MCU Diagnostic Under Shutdown" 16780706 "ACTIVE:Voltage 5V Referance MCU Diagnostic Intermittent" 16780707 "ACTIVE:Voltage 5V Referance MCU Diagnostic Short to Battery" 16780708 "ACTIVE:Voltage 5V Referance MCU Diagnostic Short to Ground" 16780709 "ACTIVE:Voltage 5V Referance MCU Diagnostic Open Load" 16780710 "ACTIVE:Voltage 5V Referance MCU Diagnostic Over Current" 16780711 "ACTIVE:Voltage 5V Referance MCU Diagnostic Wire Break" 16780712 "ACTIVE:Voltage 5V Referance MCU Diagnostic Freq Error" 16780713 "ACTIVE:Voltage 5V Referance MCU Diagnostic Update Rate Error" 16780714 "ACTIVE:Voltage 5V Referance MCU Diagnostic Gradient" 16780715 "ACTIVE:Voltage 5V Referance MCU Diagnostic Unknown Cause" 16780716 "ACTIVE:Voltage 5V Referance MCU Diagnostic Bad Component" 16780717 "ACTIVE:Voltage 5V Referance MCU Diagnostic Out Of Calibration" 16780718 "ACTIVE:Voltage 5V Referance MCU Diagnostic Special Instruction" 16780719 "ACTIVE:Voltage 5V Referance MCU Diagnostic Over Warning" 16780720 "ACTIVE:Voltage 5V Referance MCU Diagnostic Over Reduction" 16780721 "ACTIVE:Voltage 5V Referance MCU Diagnostic Under Warning" 16780722 "ACTIVE:Voltage 5V Referance MCU Diagnostic Under Reduction" 16780724 "ACTIVE:Voltage 5V Referance MCU Diagnostic Data Drift High" 16780725 "ACTIVE:Voltage 5V Referance MCU Diagnostic Data Drift Low" 16780352 "ACTIVE:Starter Over Shutdown" 16780353 "ACTIVE:Starter Under Shutdown" 16780354 "ACTIVE:Starter Intermittent" 16780355 "ACTIVE:Starter Short to Battery" 16780356 "ACTIVE:Starter Short to Ground" 16780357 "ACTIVE:Starter Open Load" 16780358 "ACTIVE:Starter Over Current" 16780359 "ACTIVE:Starter Wire Break" 16780360 "ACTIVE:Starter Freq Error" 16780361 "ACTIVE:Starter Update Rate Error" 16780362 "ACTIVE:Starter Gradient" 16780363 "ACTIVE:Starter Unknown Cause" 16780364 "ACTIVE:Starter Bad Component" 16780365 "ACTIVE:Starter Out Of Calibration" 16780366 "ACTIVE:Starter Special Instruction" 16780367 "ACTIVE:Starter Over Warning" 16780368 "ACTIVE:Starter Over Reduction" 16780369 "ACTIVE:Starter Under Warning" 16780370 "ACTIVE:Starter Under Reduction" 16780372 "ACTIVE:Starter Data Drift High" 16780373 "ACTIVE:Starter Data Drift Low" 16780480 "ACTIVE:Heat Flange Relay Over Shutdown" 16780481 "ACTIVE:Heat Flange Relay Under Shutdown" 16780482 "ACTIVE:Heat Flange Relay Intermittent" 16780483 "ACTIVE:Heat Flange Relay Short to Battery" 16780484 "ACTIVE:Heat Flange Relay Short to Ground" 16780485 "ACTIVE:Heat Flange Relay Open Load" 16780486 "ACTIVE:Heat Flange Relay Over Current" 16780487 "ACTIVE:Heat Flange Relay Wire Break" 16780488 "ACTIVE:Heat Flange Relay Freq Error" 16780489 "ACTIVE:Heat Flange Relay Update Rate Error" 16780490 "ACTIVE:Heat Flange Relay Gradient" 16780491 "ACTIVE:Heat Flange Relay Unknown Cause" 16780492 "ACTIVE:Heat Flange Relay Bad Component" 16780493 "ACTIVE:Heat Flange Relay Out Of Calibration" 16780494 "ACTIVE:Heat Flange Relay Special Instruction" 16780495 "ACTIVE:Heat Flange Relay Over Warning" 16780496 "ACTIVE:Heat Flange Relay Over Reduction" 16780497 "ACTIVE:Heat Flange Relay Under Warning" 16780498 "ACTIVE:Heat Flange Relay Under Reduction" 16780500 "ACTIVE:Heat Flange Relay Data Drift High" 16780501 "ACTIVE:Heat Flange Relay Data Drift Low" 16780768 "ACTIVE:Engine Break Selonoid 1 Over Shutdown" 16780769 "ACTIVE:Engine Break Selonoid 1 Under Shutdown" 16780770 "ACTIVE:Engine Break Selonoid 1 Intermittent" 16780771 "ACTIVE:Engine Break Selonoid 1 Short to Battery" 16780772 "ACTIVE:Engine Break Selonoid 1 Short to Ground" 16780773 "ACTIVE:Engine Break Selonoid 1 Open Load" 16780774 "ACTIVE:Engine Break Selonoid 1 Over Current" 16780775 "ACTIVE:Engine Break Selonoid 1 Wire Break" 16780776 "ACTIVE:Engine Break Selonoid 1 Freq Error" 16780777 "ACTIVE:Engine Break Selonoid 1 Update Rate Error" 16780778 "ACTIVE:Engine Break Selonoid 1 Gradient" 16780779 "ACTIVE:Engine Break Selonoid 1 Unknown Cause" 16780780 "ACTIVE:Engine Break Selonoid 1 Bad Component" 16780781 "ACTIVE:Engine Break Selonoid 1 Out Of Calibration" 16780782 "ACTIVE:Engine Break Selonoid 1 Special Instruction" 16780783 "ACTIVE:Engine Break Selonoid 1 Over Warning" 16780784 "ACTIVE:Engine Break Selonoid 1 Over Reduction" 16780785 "ACTIVE:Engine Break Selonoid 1 Under Warning" 16780786 "ACTIVE:Engine Break Selonoid 1 Under Reduction" 16780788 "ACTIVE:Engine Break Selonoid 1 Data Drift High" 16780789 "ACTIVE:Engine Break Selonoid 1 Data Drift Low" 16780800 "ACTIVE:RSL Lamp Over Shutdown" 16780801 "ACTIVE:RSL Lamp Under Shutdown" 16780802 "ACTIVE:RSL Lamp Intermittent" 16780803 "ACTIVE:RSL Lamp Short to Battery" 16780804 "ACTIVE:RSL Lamp Short to Ground" 16780805 "ACTIVE:RSL Lamp Open Load" 16780806 "ACTIVE:RSL Lamp Over Current" 16780807 "ACTIVE:RSL Lamp Wire Break" 16780808 "ACTIVE:RSL Lamp Freq Error" 16780809 "ACTIVE:RSL Lamp Update Rate Error" 16780810 "ACTIVE:RSL Lamp Gradient" 16780811 "ACTIVE:RSL Lamp Unknown Cause" 16780812 "ACTIVE:RSL Lamp Bad Component" 16780813 "ACTIVE:RSL Lamp Out Of Calibration" 16780814 "ACTIVE:RSL Lamp Special Instruction" 16780815 "ACTIVE:RSL Lamp Over Warning" 16780816 "ACTIVE:RSL Lamp Over Reduction" 16780817 "ACTIVE:RSL Lamp Under Warning" 16780818 "ACTIVE:RSL Lamp Under Reduction" 16780820 "ACTIVE:RSL Lamp Data Drift High" 16780821 "ACTIVE:RSL Lamp Data Drift Low" 16780832 "ACTIVE:CSL Lamp Over Shutdown" 16780833 "ACTIVE:CSL Lamp Under Shutdown" 16780834 "ACTIVE:CSL Lamp Intermittent" 16780835 "ACTIVE:CSL Lamp Short to Battery" 16780836 "ACTIVE:CSL Lamp Short to Ground" 16780837 "ACTIVE:CSL Lamp Open Load" 16780838 "ACTIVE:CSL Lamp Over Current" 16780839 "ACTIVE:CSL Lamp Wire Break" 16780840 "ACTIVE:CSL Lamp Freq Error" 16780841 "ACTIVE:CSL Lamp Update Rate Error" 16780842 "ACTIVE:CSL Lamp Gradient" 16780843 "ACTIVE:CSL Lamp Unknown Cause" 16780844 "ACTIVE:CSL Lamp Bad Component" 16780845 "ACTIVE:CSL Lamp Out Of Calibration" 16780846 "ACTIVE:CSL Lamp Special Instruction" 16780847 "ACTIVE:CSL Lamp Over Warning" 16780848 "ACTIVE:CSL Lamp Over Reduction" 16780849 "ACTIVE:CSL Lamp Under Warning" 16780850 "ACTIVE:CSL Lamp Under Reduction" 16780852 "ACTIVE:CSL Lamp Data Drift High" 16780853 "ACTIVE:CSL Lamp Data Drift Low" 16780896 "ACTIVE:AWL Lamp Over Shutdown" 16780897 "ACTIVE:AWL Lamp Under Shutdown" 16780898 "ACTIVE:AWL Lamp Intermittent" 16780899 "ACTIVE:AWL Lamp Short to Battery" 16780900 "ACTIVE:AWL Lamp Short to Ground" 16780901 "ACTIVE:AWL Lamp Open Load" 16780902 "ACTIVE:AWL Lamp Over Current" 16780903 "ACTIVE:AWL Lamp Wire Break" 16780904 "ACTIVE:AWL Lamp Freq Error" 16780905 "ACTIVE:AWL Lamp Update Rate Error" 16780906 "ACTIVE:AWL Lamp Gradient" 16780907 "ACTIVE:AWL Lamp Unknown Cause" 16780908 "ACTIVE:AWL Lamp Bad Component" 16780909 "ACTIVE:AWL Lamp Out Of Calibration" 16780910 "ACTIVE:AWL Lamp Special Instruction" 16780911 "ACTIVE:AWL Lamp Over Warning" 16780912 "ACTIVE:AWL Lamp Over Reduction" 16780913 "ACTIVE:AWL Lamp Under Warning" 16780914 "ACTIVE:AWL Lamp Under Reduction" 16780916 "ACTIVE:AWL Lamp Data Drift High" 16780917 "ACTIVE:AWL Lamp Data Drift Low" 16780544 "ACTIVE:VCV Over Shutdown" 16780545 "ACTIVE:VCV Under Shutdown" 16780546 "ACTIVE:VCV Intermittent" 16780547 "ACTIVE:VCV Short to Battery" 16780548 "ACTIVE:VCV Short to Ground" 16780549 "ACTIVE:VCV Open Load" 16780550 "ACTIVE:VCV Over Current" 16780551 "ACTIVE:VCV Wire Break" 16780552 "ACTIVE:VCV Freq Error" 16780553 "ACTIVE:VCV Update Rate Error" 16780554 "ACTIVE:VCV Gradient" 16780555 "ACTIVE:VCV Unknown Cause" 16780556 "ACTIVE:VCV Bad Component" 16780557 "ACTIVE:VCV Out Of Calibration" 16780558 "ACTIVE:VCV Special Instruction" 16780559 "ACTIVE:VCV Over Warning" 16780560 "ACTIVE:VCV Over Reduction" 16780561 "ACTIVE:VCV Under Warning" 16780562 "ACTIVE:VCV Under Reduction" 16780564 "ACTIVE:VCV Data Drift High" 16780565 "ACTIVE:VCV Data Drift Low" 16780576 "ACTIVE:PCV Over Shutdown" 16780577 "ACTIVE:PCV Under Shutdown" 16780578 "ACTIVE:PCV Intermittent" 16780579 "ACTIVE:PCV Short to Battery" 16780580 "ACTIVE:PCV Short to Ground" 16780581 "ACTIVE:PCV Open Load" 16780582 "ACTIVE:PCV Over Current" 16780583 "ACTIVE:PCV Wire Break" 16780584 "ACTIVE:PCV Freq Error" 16780585 "ACTIVE:PCV Update Rate Error" 16780586 "ACTIVE:PCV Gradient" 16780587 "ACTIVE:PCV Unknown Cause" 16780588 "ACTIVE:PCV Bad Component" 16780589 "ACTIVE:PCV Out Of Calibration" 16780590 "ACTIVE:PCV Special Instruction" 16780591 "ACTIVE:PCV Over Warning" 16780592 "ACTIVE:PCV Over Reduction" 16780593 "ACTIVE:PCV Under Warning" 16780594 "ACTIVE:PCV Under Reduction" 16780596 "ACTIVE:PCV Data Drift High" 16780597 "ACTIVE:PCV Data Drift Low" 16780000 "ACTIVE:Injector 1 Over Shutdown" 16780001 "ACTIVE:Injector 1 Under Shutdown" 16780002 "ACTIVE:Injector 1 Intermittent" 16780003 "ACTIVE:Injector 1 Short to Battery" 16780004 "ACTIVE:Injector 1 Short to Ground" 16780005 "ACTIVE:Injector 1 Open Load" 16780006 "ACTIVE:Injector 1 Over Current" 16780007 "ACTIVE:Injector 1 Wire Break" 16780008 "ACTIVE:Injector 1 Freq Error" 16780009 "ACTIVE:Injector 1 Update Rate Error" 16780010 "ACTIVE:Injector 1 Gradient" 16780011 "ACTIVE:Injector 1 Unknown Cause" 16780012 "ACTIVE:Injector 1 Bad Component" 16780013 "ACTIVE:Injector 1 Out Of Calibration" 16780014 "ACTIVE:Injector 1 Special Instruction" 16780015 "ACTIVE:Injector 1 Over Warning" 16780016 "ACTIVE:Injector 1 Over Reduction" 16780017 "ACTIVE:Injector 1 Under Warning" 16780018 "ACTIVE:Injector 1 Under Reduction" 16780020 "ACTIVE:Injector 1 Data Drift High" 16780021 "ACTIVE:Injector 1 Data Drift Low" 16780032 "ACTIVE:Injector 2 Over Shutdown" 16780033 "ACTIVE:Injector 2 Under Shutdown" 16780034 "ACTIVE:Injector 2 Intermittent" 16780035 "ACTIVE:Injector 2 Short to Battery" 16780036 "ACTIVE:Injector 2 Short to Ground" 16780037 "ACTIVE:Injector 2 Open Load" 16780038 "ACTIVE:Injector 2 Over Current" 16780039 "ACTIVE:Injector 2 Wire Break" 16780040 "ACTIVE:Injector 2 Freq Error" 16780041 "ACTIVE:Injector 2 Update Rate Error" 16780042 "ACTIVE:Injector 2 Gradient" 16780043 "ACTIVE:Injector 2 Unknown Cause" 16780044 "ACTIVE:Injector 2 Bad Component" 16780045 "ACTIVE:Injector 2 Out Of Calibration" 16780046 "ACTIVE:Injector 2 Special Instruction" 16780047 "ACTIVE:Injector 2 Over Warning" 16780048 "ACTIVE:Injector 2 Over Reduction" 16780049 "ACTIVE:Injector 2 Under Warning" 16780050 "ACTIVE:Injector 2 Under Reduction" 16780052 "ACTIVE:Injector 2 Data Drift High" 16780053 "ACTIVE:Injector 2 Data Drift Low" 16780064 "ACTIVE:Injector 3 Over Shutdown" 16780065 "ACTIVE:Injector 3 Under Shutdown" 16780066 "ACTIVE:Injector 3 Intermittent" 16780067 "ACTIVE:Injector 3 Short to Battery" 16780068 "ACTIVE:Injector 3 Short to Ground" 16780069 "ACTIVE:Injector 3 Open Load" 16780070 "ACTIVE:Injector 3 Over Current" 16780071 "ACTIVE:Injector 3 Wire Break" 16780072 "ACTIVE:Injector 3 Freq Error" 16780073 "ACTIVE:Injector 3 Update Rate Error" 16780074 "ACTIVE:Injector 3 Gradient" 16780075 "ACTIVE:Injector 3 Unknown Cause" 16780076 "ACTIVE:Injector 3 Bad Component" 16780077 "ACTIVE:Injector 3 Out Of Calibration" 16780078 "ACTIVE:Injector 3 Special Instruction" 16780079 "ACTIVE:Injector 3 Over Warning" 16780080 "ACTIVE:Injector 3 Over Reduction" 16780081 "ACTIVE:Injector 3 Under Warning" 16780082 "ACTIVE:Injector 3 Under Reduction" 16780084 "ACTIVE:Injector 3 Data Drift High" 16780085 "ACTIVE:Injector 3 Data Drift Low" 16780096 "ACTIVE:Injector 4 Over Shutdown" 16780097 "ACTIVE:Injector 4 Under Shutdown" 16780098 "ACTIVE:Injector 4 Intermittent" 16780099 "ACTIVE:Injector 4 Short to Battery" 16780100 "ACTIVE:Injector 4 Short to Ground" 16780101 "ACTIVE:Injector 4 Open Load" 16780102 "ACTIVE:Injector 4 Over Current" 16780103 "ACTIVE:Injector 4 Wire Break" 16780104 "ACTIVE:Injector 4 Freq Error" 16780105 "ACTIVE:Injector 4 Update Rate Error" 16780106 "ACTIVE:Injector 4 Gradient" 16780107 "ACTIVE:Injector 4 Unknown Cause" 16780108 "ACTIVE:Injector 4 Bad Component" 16780109 "ACTIVE:Injector 4 Out Of Calibration" 16780110 "ACTIVE:Injector 4 Special Instruction" 16780111 "ACTIVE:Injector 4 Over Warning" 16780112 "ACTIVE:Injector 4 Over Reduction" 16780113 "ACTIVE:Injector 4 Under Warning" 16780114 "ACTIVE:Injector 4 Under Reduction" 16780116 "ACTIVE:Injector 4 Data Drift High" 16780117 "ACTIVE:Injector 4 Data Drift Low" 16780192 "ACTIVE:Camshaft Sensor Over Shutdown" 16780193 "ACTIVE:Camshaft Sensor Under Shutdown" 16780194 "ACTIVE:Camshaft Sensor Intermittent" 16780195 "ACTIVE:Camshaft Sensor Short to Battery" 16780196 "ACTIVE:Camshaft Sensor Short to Ground" 16780197 "ACTIVE:Camshaft Sensor Open Load" 16780198 "ACTIVE:Camshaft Sensor Over Current" 16780199 "ACTIVE:Camshaft Sensor Wire Break" 16780200 "ACTIVE:Camshaft Sensor Freq Error" 16780201 "ACTIVE:Camshaft Sensor Update Rate Error" 16780202 "ACTIVE:Camshaft Sensor Gradient" 16780203 "ACTIVE:Camshaft Sensor Unknown Cause" 16780204 "ACTIVE:Camshaft Sensor Bad Component" 16780205 "ACTIVE:Camshaft Sensor Out Of Calibration" 16780206 "ACTIVE:Camshaft Sensor Special Instruction" 16780207 "ACTIVE:Camshaft Sensor Over Warning" 16780208 "ACTIVE:Camshaft Sensor Over Reduction" 16780209 "ACTIVE:Camshaft Sensor Under Warning" 16780210 "ACTIVE:Camshaft Sensor Under Reduction" 16780212 "ACTIVE:Camshaft Sensor Data Drift High" 16780213 "ACTIVE:Camshaft Sensor Data Drift Low" 16780224 "ACTIVE:Crankshaft Sensor Over Shutdown" 16780225 "ACTIVE:Crankshaft Sensor Under Shutdown" 16780226 "ACTIVE:Crankshaft Sensor Intermittent" 16780227 "ACTIVE:Crankshaft Sensor Short to Battery" 16780228 "ACTIVE:Crankshaft Sensor Short to Ground" 16780229 "ACTIVE:Crankshaft Sensor Open Load" 16780230 "ACTIVE:Crankshaft Sensor Over Current" 16780231 "ACTIVE:Crankshaft Sensor Wire Break" 16780232 "ACTIVE:Crankshaft Sensor Freq Error" 16780233 "ACTIVE:Crankshaft Sensor Update Rate Error" 16780234 "ACTIVE:Crankshaft Sensor Gradient" 16780235 "ACTIVE:Crankshaft Sensor Unknown Cause" 16780236 "ACTIVE:Crankshaft Sensor Bad Component" 16780237 "ACTIVE:Crankshaft Sensor Out Of Calibration" 16780238 "ACTIVE:Crankshaft Sensor Special Instruction" 16780239 "ACTIVE:Crankshaft Sensor Over Warning" 16780240 "ACTIVE:Crankshaft Sensor Over Reduction" 16780241 "ACTIVE:Crankshaft Sensor Under Warning" 16780242 "ACTIVE:Crankshaft Sensor Under Reduction" 16780244 "ACTIVE:Crankshaft Sensor Data Drift High" 16780245 "ACTIVE:Crankshaft Sensor Data Drift Low" 16780654 "ACTIVE:Coolant Temperature Coherence Special Instruction" 16780942 "ACTIVE:Air Boost Temperature Coherence Special Instruction" 16780974 "ACTIVE:Fuel Temperature Coherence Special Instruction" 16781006 "ACTIVE:Oil Temperature Coherence Special Instruction" 16781038 "ACTIVE:Ambient Air Temperature Coherence Special Instruction" 16781070 "ACTIVE:Air Boost Pressure Coherence Special Instruction" 16781102 "ACTIVE:Ambient Air Pressure Coherence Special Instruction" 16781134 "ACTIVE:Oil Pressure Coherence Special Instruction" 16781166 "ACTIVE:Fuel Pressure Coherence Special Instruction" 16781198 "ACTIVE:Rail Pressure Coherence Special Instruction" 16781230 "ACTIVE:Oil Level Coherence Special Instruction" 16781262 "ACTIVE:ECU Temperature Coherence Special Instruction" 16781262 "ACTIVE:Cam Crank Defect Coherence Special Instruction" 16781294 "ACTIVE:Injector Defect Coherence Special Instruction" 16781326 "ACTIVE:Cylinder Misfire Coherence Special Instruction" 16781358 "ACTIVE:Over Speed Coherence Special Instruction" 16781390 "ACTIVE:Start Request POR Error Special Instruction" 16781422 "ACTIVE:Start Request SPI Error Special Instruction" 16781454 "ACTIVE:Start Request TSD Error Special Instruction" 16781486 "ACTIVE:Start Request TW Error Special Instruction" 16781518 "ACTIVE:Start Request OV Error Special Instruction" 16781550 "ACTIVE:Start Request UV Error Special Instruction" 16781582 "ACTIVE:Start Request VS0 Error Special Instruction" 16781614 "ACTIVE:Start Request VS1 Error Special Instruction" 16781646 "ACTIVE:Start Request WetDiag Error Special Instruction" 16781678 "ACTIVE:Start Request ADC Diag Error Special Instruction" 16781710 "ACTIVE:Start Request Chk Error Special Instruction" 16781742 "ACTIVE:Start Request Com Error Special Instruction" 16781774 "ACTIVE:Start Request Init Error Special Instruction" 16781806 "ACTIVE:Engine Break 100 POR Error Special Instruction" 16781838 "ACTIVE:Engine Break 100 SPI Error Special Instruction" 16781870 "ACTIVE:Engine Break 100 TSD Error Special Instruction" 16781902 "ACTIVE:Engine Break 100 TW Error Special Instruction" 16781934 "ACTIVE:Engine Break 100 OV Error Special Instruction" 16781966 "ACTIVE:Engine Break 100 UV Error Special Instruction" 16781998 "ACTIVE:Engine Break 100 VS0 Error Special Instruction" 16782030 "ACTIVE:Engine Break 100 VS1 Error Special Instruction" 16782062 "ACTIVE:Engine Break 100 WetDiag Error Special Instruction" 16782094 "ACTIVE:Engine Break 100 ADC Diag Error Special Instruction" 16782126 "ACTIVE:Engine Break 100 Chk Error Special Instruction" 16782158 "ACTIVE:Engine Break 100 Com Error Special Instruction" 16782190 "ACTIVE:Engine Break 100 Init Error Special Instruction" 16782222 "ACTIVE:Cruise Control 1 POR Error Special Instruction" 16782254 "ACTIVE:Cruise Control 1 SPI Error Special Instruction" 16782286 "ACTIVE:Cruise Control 1 TSD Error Special Instruction" 16782318 "ACTIVE:Cruise Control 1 TW Error Special Instruction" 16782350 "ACTIVE:Cruise Control 1 OV Error Special Instruction" 16782382 "ACTIVE:Cruise Control 1 UV Error Special Instruction" 16782414 "ACTIVE:Cruise Control 1 VS0 Error Special Instruction" 16782446 "ACTIVE:Cruise Control 1 VS1 Error Special Instruction" 16782478 "ACTIVE:Cruise Control 1 WetDiag Error Special Instruction" 16782510 "ACTIVE:Cruise Control 1 ADC Diag Error Special Instruction" 16782542 "ACTIVE:Cruise Control 1 Chk Error Special Instruction" 16782574 "ACTIVE:Cruise Control 1 Com Error Special Instruction" 16782606 "ACTIVE:Cruise Control 1 Init Error Special Instruction" 16782638 "ACTIVE:Cruise Control 2 POR Error Special Instruction" 16782670 "ACTIVE:Cruise Control 2 SPI Error Special Instruction" 16782702 "ACTIVE:Cruise Control 2 TSD Error Special Instruction" 16782734 "ACTIVE:Cruise Control 2 TW Error Special Instruction" 16782766 "ACTIVE:Cruise Control 2 OV Error Special Instruction" 16782798 "ACTIVE:Cruise Control 2 UV Error Special Instruction" 16782830 "ACTIVE:Cruise Control 2 VS0 Error Special Instruction" 16782862 "ACTIVE:Cruise Control 2 VS1 Error Special Instruction" 16782894 "ACTIVE:Cruise Control 2 WetDiag Error Special Instruction" 16782926 "ACTIVE:Cruise Control 2 ADC Diag Error Special Instruction" 16782958 "ACTIVE:Cruise Control 2 Chk Error Special Instruction" 16782990 "ACTIVE:Cruise Control 2 Com Error Special Instruction" 16783022 "ACTIVE:Cruise Control 2 Init Error Special Instruction" 16783054 "ACTIVE:Brake Pedal 1 POR Error Special Instruction" 16783086 "ACTIVE:Brake Pedal 1 SPI Error Special Instruction" 16783118 "ACTIVE:Brake Pedal 1 TSD Error Special Instruction" 16783150 "ACTIVE:Brake Pedal 1 TW Error Special Instruction" 16783182 "ACTIVE:Brake Pedal 1 OV Error Special Instruction" 16783214 "ACTIVE:Brake Pedal 1 UV Error Special Instruction" 16783246 "ACTIVE:Brake Pedal 1 VS0 Error Special Instruction" 16783278 "ACTIVE:Brake Pedal 1 VS1 Error Special Instruction" 16783310 "ACTIVE:Brake Pedal 1 WetDiag Error Special Instruction" 16783342 "ACTIVE:Brake Pedal 1 ADC Diag Error Special Instruction" 16783374 "ACTIVE:Brake Pedal 1 Chk Error Special Instruction" 16783406 "ACTIVE:Brake Pedal 1 Com Error Special Instruction" 16783438 "ACTIVE:Brake Pedal 1 Init Error Special Instruction" 16783470 "ACTIVE:Cruise Control 3 POR Error Special Instruction" 16783502 "ACTIVE:Cruise Control 3 SPI Error Special Instruction" 16783534 "ACTIVE:Cruise Control 3 TSD Error Special Instruction" 16783566 "ACTIVE:Cruise Control 3 TW Error Special Instruction" 16783598 "ACTIVE:Cruise Control 3 OV Error Special Instruction" 16783630 "ACTIVE:Cruise Control 3 UV Error Special Instruction" 16783662 "ACTIVE:Cruise Control 3 VS0 Error Special Instruction" 16783694 "ACTIVE:Cruise Control 3 VS1 Error Special Instruction" 16783726 "ACTIVE:Cruise Control 3 WetDiag Error Special Instruction" 16783758 "ACTIVE:Cruise Control 3 ADC Diag Error Special Instruction" 16783790 "ACTIVE:Cruise Control 3 Chk Error Special Instruction" 16783822 "ACTIVE:Cruise Control 3 Com Error Special Instruction" 16783854 "ACTIVE:Cruise Control 3 Init Error Special Instruction" 16783886 "ACTIVE:Engine Break 50 POR Error Special Instruction" 16783918 "ACTIVE:Engine Break 50 SPI Error Special Instruction" 16783950 "ACTIVE:Engine Break 50 TSD Error Special Instruction" 16783982 "ACTIVE:Engine Break 50 TW Error Special Instruction" 16784014 "ACTIVE:Engine Break 50 OV Error Special Instruction" 16784046 "ACTIVE:Engine Break 50 UV Error Special Instruction" 16784078 "ACTIVE:Engine Break 50 VS0 Error Special Instruction" 16784110 "ACTIVE:Engine Break 50 VS1 Error Special Instruction" 16784142 "ACTIVE:Engine Break 50 WetDiag Error Special Instruction" 16784174 "ACTIVE:Engine Break 50 ADC Diag Error Special Instruction" 16784206 "ACTIVE:Engine Break 50 Chk Error Special Instruction" 16784238 "ACTIVE:Engine Break 50 Com Error Special Instruction" 16784270 "ACTIVE:Engine Break 50 Init Error Special Instruction" 16784302 "ACTIVE:Trouble Shooting Button POR Error Special Instruction" 16784334 "ACTIVE:Trouble Shooting Button SPI Error Special Instruction" 16784366 "ACTIVE:Trouble Shooting Button TSD Error Special Instruction" 16784398 "ACTIVE:Trouble Shooting Button TW Error Special Instruction" 16784430 "ACTIVE:Trouble Shooting Button OV Error Special Instruction" 16784462 "ACTIVE:Trouble Shooting Button UV Error Special Instruction" 16784494 "ACTIVE:Trouble Shooting Button VS0 Error Special Instruction" 16784526 "ACTIVE:Trouble Shooting Button VS1 Error Special Instruction" 16784558 "ACTIVE:Trouble Shooting Button WetDiag Error Special Instruction" 16784590 "ACTIVE:Trouble Shooting Button ADC Diag Error Special Instruction" 16784622 "ACTIVE:Trouble Shooting Button Chk Error Special Instruction" 16784654 "ACTIVE:Trouble Shooting Button Com Error Special Instruction" 16784686 "ACTIVE:Trouble Shooting Button Init Error Special Instruction" 16784718 "ACTIVE:Hand Brake Parking POR Error Special Instruction" 16784750 "ACTIVE:Hand Brake Parking SPI Error Special Instruction" 16784782 "ACTIVE:Hand Brake Parking TSD Error Special Instruction" 16784814 "ACTIVE:Hand Brake Parking TW Error Special Instruction" 16784846 "ACTIVE:Hand Brake Parking OV Error Special Instruction" 16784878 "ACTIVE:Hand Brake Parking UV Error Special Instruction" 16784910 "ACTIVE:Hand Brake Parking VS0 Error Special Instruction" 16784942 "ACTIVE:Hand Brake Parking VS1 Error Special Instruction" 16784974 "ACTIVE:Hand Brake Parking WetDiag Error Special Instruction" 16785006 "ACTIVE:Hand Brake Parking ADC Diag Error Special Instruction" 16785038 "ACTIVE:Hand Brake Parking Chk Error Special Instruction" 16785070 "ACTIVE:Hand Brake Parking Com Error Special Instruction" 16785102 "ACTIVE:Hand Brake Parking Init Error Special Instruction" 16785134 "ACTIVE:Overriding Switch POR Error Special Instruction" 16785166 "ACTIVE:Overriding Switch SPI Error Special Instruction" 16785198 "ACTIVE:Overriding Switch TSD Error Special Instruction" 16785230 "ACTIVE:Overriding Switch TW Error Special Instruction" 16785262 "ACTIVE:Overriding Switch OV Error Special Instruction" 16785294 "ACTIVE:Overriding Switch UV Error Special Instruction" 16785326 "ACTIVE:Overriding Switch VS0 Error Special Instruction" 16785358 "ACTIVE:Overriding Switch VS1 Error Special Instruction" 16785390 "ACTIVE:Overriding Switch WetDiag Error Special Instruction" 16785422 "ACTIVE:Overriding Switch ADC Diag Error Special Instruction" 16785454 "ACTIVE:Overriding Switch Chk Error Special Instruction" 16785486 "ACTIVE:Overriding Switch Com Error Special Instruction" 16785518 "ACTIVE:Overriding Switch Init Error Special Instruction" /*END_DTC_VALUE_PAIR*/ /end COMPU_VTAB
/* HW_SPECIFIC_DATABASE_END */ /* DEBUG_SPECIFIC_DATABASE_START */
/begin CHARACTERISTIC Frq_VCV "CO1_PWM_FREQ_HZ" VALUE 0x40040008 /* @ECU_Address@CO1_Pwm_Freq_Hz@ */ FLOAT32_IEEE 1 NO_COMPU_METHOD 100 2000 FORMAT "%20.0" /end CHARACTERISTIC
/begin CHARACTERISTIC Frq_PCV "CO2_PWM_FREQ_HZ" VALUE 0x4004000C /* @ECU_Address@CO2_Pwm_Freq_Hz@ */ FLOAT32_IEEE 1 NO_COMPU_METHOD 100 2000 FORMAT "%20.0" /end CHARACTERISTIC
/begin MEASUREMENT Chk_Actv_Spd_Snsr "Check the cam/crank signal pattern and calibration" UBYTE CM_Chk_Actv_Spd_Snsr 1 100 0 255 FORMAT "%20.0" ECU_ADDRESS 0x400107AD /* @ECU_Address@ena_crk_sens2@ */ /end MEASUREMENT
/begin COMPU_METHOD CM_Chk_Actv_Spd_Snsr "" TAB_VERB "%0.0" "" COMPU_TAB_REF CT_Chk_Actv_Spd_Snsr /end COMPU_METHOD
/begin COMPU_VTAB CT_Chk_Actv_Spd_Snsr "" TAB_VERB 3 0 "CRANK 1" 1 "CAM" 3 "CRANK 2" /end COMPU_VTAB
/begin MEASUREMENT Chk_Spd_Pat "Check the cam/crank signal pattern and calibration" UBYTE CM_Chk_Spd_Pat 1 100 0 255 FORMAT "%20.0" ECU_ADDRESS 0x40010765 /* @ECU_Address@gucCamCrankPatternCheck@ */ /end MEASUREMENT
/begin COMPU_METHOD CM_Chk_Spd_Pat "" TAB_VERB "%0.0" "" COMPU_TAB_REF CT_Chk_Spd_Pat /end COMPU_METHOD
/begin COMPU_VTAB CT_Chk_Spd_Pat "" TAB_VERB 8 0 "WAIT START" 1 "NO ERROR" 2 "PATTERN OR CALIBRATION ERROR" 3 "REVERSE SYNC ERROR" 4 "CAM ANGLE ERROR" 5 "CRANK PATTERN ERROR" 6 "NO CAM" 7 "NO CRANK" /end COMPU_VTAB
/begin MEASUREMENT EngSync "Implies Status of the Engine synchronization" UBYTE NO_COMPU_METHOD 1 100 0 1 FORMAT "%20.0" ECU_ADDRESS 0x40010774 /* @ECU_Address@gucEngineSync@ */ /end MEASUREMENT
/begin MEASUREMENT current_rise_time_FO1_A1 "current rise time injector 1 measurement" FLOAT32_IEEE Duration_us_Scale1000000_CM 1 100 0 1000 FORMAT "%20.2" ECU_ADDRESS 0x40012898 /* @ECU_Address@gfPickUpTime[0]@ */ /* mta: 5400 */ /end MEASUREMENT
/begin MEASUREMENT current_rise_time_FO2_B1 "current rise time injector 2 measurement" FLOAT32_IEEE Duration_us_Scale1000000_CM 1 100 0 1000 FORMAT "%20.2" ECU_ADDRESS 0x4001289C /* @ECU_Address@gfPickUpTime[1]@ */ /* mta: 5401 */ /end MEASUREMENT
/begin MEASUREMENT current_rise_time_FO3_A2 "current rise time injector 3 measurement" FLOAT32_IEEE Duration_us_Scale1000000_CM 1 100 0 1000 FORMAT "%20.2" ECU_ADDRESS 0x400128A0 /* @ECU_Address@gfPickUpTime[2]@ */ /* mta: 5402 */ /end MEASUREMENT
/begin MEASUREMENT current_rise_time_FO4_B2 "current rise time injector 4 measurement" FLOAT32_IEEE Duration_us_Scale1000000_CM 1 100 0 1000 FORMAT "%20.2" ECU_ADDRESS 0x400128A4 /* @ECU_Address@gfPickUpTime[3]@ */ /* mta: 5403 */ /end MEASUREMENT
/begin MEASUREMENT current_rise_time_FO5_A3 "current rise time injector 5 measurement" FLOAT32_IEEE Duration_us_Scale1000000_CM 1 100 0 1000 FORMAT "%20.2" ECU_ADDRESS 0x400128A8 /* @ECU_Address@gfPickUpTime[4]@ */ /* mta: 5404 */ /end MEASUREMENT
/begin MEASUREMENT current_rise_time_FO6_B3 "current rise time injector 6 measurement" FLOAT32_IEEE Duration_us_Scale1000000_CM 1 100 0 1000 FORMAT "%20.2" ECU_ADDRESS 0x400128AC /* @ECU_Address@gfPickUpTime[5]@ */ /* mta: 5405 */ /end MEASUREMENT
/* DEBUG_SPECIFIC_DATABASE_END */ /*COMPU METHODS*/
/begin COMPU_METHOD Resistor_CM "Scale 1" RAT_FUNC "%20.0" "Ohm" COEFFS 0 1 0 0 0 1 /end COMPU_METHOD
/begin COMPU_METHOD mm3_CM "Scale 1" RAT_FUNC "%20.1" "mm3/stk" COEFFS 0 1 0 0 0 1 /end COMPU_METHOD
/begin COMPU_METHOD hour_CM "Scale 1" RAT_FUNC "%20.1" "h" COEFFS 0 1 0 0 0 1 /end COMPU_METHOD
/begin COMPU_METHOD LevelSensor_CM "Scale 1" RAT_FUNC "%20.0" "%" COEFFS 0 1 0 0 0 1 /end COMPU_METHOD
/begin COMPU_METHOD PressSensor_CM "Scale 1" RAT_FUNC "%20.0" "bar" COEFFS 0 1 0 0 0 1 /end COMPU_METHOD
/begin COMPU_METHOD Voltage_CM "Scale 1" RAT_FUNC "%20.0" "V" COEFFS 0 1 0 0 0 1 /end COMPU_METHOD
/begin COMPU_METHOD Current_CM "Scale 1" RAT_FUNC "%20.0" "A" COEFFS 0 1 0 0 0 1 /end COMPU_METHOD
/begin COMPU_METHOD Duration_ms_Scale1000000_CM "Scale 1000000" RAT_FUNC "%20.0" "us" COEFFS 0 1 0 0 0 1000000 /end COMPU_METHOD
/begin COMPU_METHOD Angle_CM "Scale 1" RAT_FUNC "%20.0" "crk" COEFFS 0 1 0 0 0 1 /end COMPU_METHOD
/begin COMPU_METHOD Duration_us_Scale1000000_CM "Scale 1000000" RAT_FUNC "%20.0" "us" COEFFS 0 1 0 0 0 1000000 /end COMPU_METHOD
/begin COMPU_METHOD Duration_us_Scale_CM "Scale 1" RAT_FUNC "%20.0" "us" COEFFS 0 1 0 0 0 1 /end COMPU_METHOD
/begin COMPU_METHOD Current_A_CM "Scale 1" RAT_FUNC "%20.0" "A" COEFFS 0 1 0 0 0 1 /end COMPU_METHOD
/begin RECORD_LAYOUT FLOAT32_IEEE FNC_VALUES 1 FLOAT32_IEEE ROW_DIR DIRECT /end RECORD_LAYOUT
/begin RECORD_LAYOUT ULONG FNC_VALUES 1 ULONG ROW_DIR DIRECT /end RECORD_LAYOUT
/begin RECORD_LAYOUT UWORD FNC_VALUES 1 UWORD ROW_DIR DIRECT /end RECORD_LAYOUT
/begin RECORD_LAYOUT SWORD FNC_VALUES 1 SWORD ROW_DIR DIRECT /end RECORD_LAYOUT
/begin RECORD_LAYOUT UBYTE FNC_VALUES 1 UBYTE ROW_DIR DIRECT /end RECORD_LAYOUT
/begin RECORD_LAYOUT RL_X_FLOAT32_IEEE AXIS_PTS_X 1 FLOAT32_IEEE INDEX_INCR DIRECT /end RECORD_LAYOUT
/begin RECORD_LAYOUT Lookup2D_WORD FNC_VALUES 1 SWORD ROW_DIR DIRECT /end RECORD_LAYOUT
/begin RECORD_LAYOUT Lookup2D_ULONG FNC_VALUES 1 ULONG ROW_DIR DIRECT /end RECORD_LAYOUT
/begin RECORD_LAYOUT Lookup2D_X_ULONG AXIS_PTS_X 1 ULONG INDEX_INCR DIRECT /end RECORD_LAYOUT
/begin RECORD_LAYOUT Lookup2D_LONG FNC_VALUES 1 SLONG ROW_DIR DIRECT /end RECORD_LAYOUT
/begin RECORD_LAYOUT Lookup2D_X_LONG AXIS_PTS_X 1 SLONG INDEX_INCR DIRECT /end RECORD_LAYOUT
/begin RECORD_LAYOUT Lookup2D_FLOAT64_IEEE FNC_VALUES 1 FLOAT64_IEEE ROW_DIR DIRECT /end RECORD_LAYOUT
/begin RECORD_LAYOUT Lookup2D_X_FLOAT64_IEEE AXIS_PTS_X 1 FLOAT64_IEEE INDEX_INCR DIRECT /end RECORD_LAYOUT
/begin COMPU_METHOD EcuIntgdSwGend_CM_single_J_kgK "Q = V" RAT_FUNC "%8.6" "J/kgK" COEFFS 0 1 0 0 0 1 /end COMPU_METHOD
/begin COMPU_METHOD EcuIntgdSwGend_CM_uint16 "Q = V" RAT_FUNC "%5.0" "" COEFFS 0 1 0 0 0 1 /end COMPU_METHOD
/end MODULE
/end PROJECT
