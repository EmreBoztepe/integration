ASAP2_VERSION 1 6
/begin PROJECT ECEMTAG_CR8 ""
/begin MODULE DIM ""
/begin MOD_COMMON "Mod Common Comment Here" DEPOSIT ABSOLUTE BYTE_ORDER MSB_FIRST /end MOD_COMMON
/begin RECORD_LAYOUT FLOAT32_IEEE FNC_VALUES 1 FLOAT32_IEEE ROW_DIR DIRECT /end RECORD_LAYOUT
/begin RECORD_LAYOUT ULONG FNC_VALUES 1 ULONG ROW_DIR DIRECT /end RECORD_LAYOUT
/begin RECORD_LAYOUT UWORD FNC_VALUES 1 UWORD ROW_DIR DIRECT /end RECORD_LAYOUT
/begin RECORD_LAYOUT SWORD FNC_VALUES 1 SWORD ROW_DIR DIRECT /end RECORD_LAYOUT
/begin RECORD_LAYOUT UBYTE FNC_VALUES 1 UBYTE ROW_DIR DIRECT /end RECORD_LAYOUT
/******************************* From MATLAB ***************************************/ /* MATLAB_SECTION_START_1 */
/begin RECORD_LAYOUT Scalar_BOOLEAN FNC_VALUES 1 UBYTE ROW_DIR DIRECT /end RECORD_LAYOUT
/begin RECORD_LAYOUT Scalar_ULONG FNC_VALUES 1 ULONG ROW_DIR DIRECT /end RECORD_LAYOUT
/begin RECORD_LAYOUT Scalar_FLOAT32_IEEE FNC_VALUES 1 FLOAT32_IEEE ROW_DIR DIRECT /end RECORD_LAYOUT
/begin RECORD_LAYOUT Lookup1D_X_UWORD AXIS_PTS_X 1 UWORD INDEX_INCR DIRECT /end RECORD_LAYOUT
/begin RECORD_LAYOUT Lookup1D_WORD FNC_VALUES 1 SWORD ROW_DIR DIRECT /end RECORD_LAYOUT
/begin RECORD_LAYOUT Lookup1D_ULONG FNC_VALUES 1 ULONG ROW_DIR DIRECT /end RECORD_LAYOUT
/begin RECORD_LAYOUT Lookup1D_X_ULONG AXIS_PTS_X 1 ULONG INDEX_INCR DIRECT /end RECORD_LAYOUT
/begin RECORD_LAYOUT Lookup1D_SLONG FNC_VALUES 1 SLONG ROW_DIR DIRECT /end RECORD_LAYOUT
/begin RECORD_LAYOUT Lookup1D_X_LONG AXIS_PTS_X 1 SLONG INDEX_INCR DIRECT /end RECORD_LAYOUT
/begin RECORD_LAYOUT Lookup1D_FLOAT32_IEEE FNC_VALUES 1 FLOAT32_IEEE ROW_DIR DIRECT /end RECORD_LAYOUT
/begin RECORD_LAYOUT Lookup1D_X_FLOAT32_IEEE AXIS_PTS_X 1 FLOAT32_IEEE INDEX_INCR DIRECT /end RECORD_LAYOUT
/begin RECORD_LAYOUT Lookup1D_FLOAT64_IEEE FNC_VALUES 1 FLOAT64_IEEE ROW_DIR DIRECT /end RECORD_LAYOUT
/begin RECORD_LAYOUT Lookup1D_X_FLOAT64_IEEE AXIS_PTS_X 1 FLOAT64_IEEE INDEX_INCR DIRECT /end RECORD_LAYOUT
/begin RECORD_LAYOUT Lookup2D_FLOAT32_IEEE FNC_VALUES 1 FLOAT32_IEEE ROW_DIR DIRECT /end RECORD_LAYOUT
/begin RECORD_LAYOUT Lookup2D_X_FLOAT32_IEEE AXIS_PTS_X 1 FLOAT32_IEEE INDEX_INCR DIRECT /end RECORD_LAYOUT
/begin AXIS_PTS DTqC_NEng_A "Axis Values of Engine Speed for Break Torque Maps" 0x40041D78 /* @ECU_Address@DTqC_NEng_A@ */ EIP_NEng Lookup2D_X_FLOAT32_IEEE 0 EcuIntgdSwGend_CM_single_rpm 20 0.0 6000.0 /end AXIS_PTS
/begin AXIS_PTS DTqC_ErrNEng_A "Axis Values of Error Engine Speed for PID Coefficient Maps" 0x40041A28 /* @ECU_Address@DTqC_ErrNEng_A@ */ DTqC_ErrNIdle Lookup2D_X_FLOAT32_IEEE 0 EcuIntgdSwGend_CM_single_rpm 10 -500.0 500.0 /end AXIS_PTS
/begin CHARACTERISTIC WgC_PDropIco_M "Pressure Drop Map Out" CURVE 0x400523F0 /* @ECU_Address@WgC_PDropIco_M@ */ Lookup1D_FLOAT32_IEEE 0 EcuIntgdSwGend_CM_single_mbar -1000.0 1000.0
 /begin AXIS_DESCR COM_AXIS WgC_MAirFlow EcuIntgdSwGend_CM_single 5 0.0 100.0 AXIS_PTS_REF WgC_MAirFlow_A /end AXIS_DESCR
/end CHARACTERISTIC
/begin AXIS_PTS WgC_MAirFlow_A "Mass Air Flow Map Axis" 0x40051C78 /* @ECU_Address@WgC_MAirFlow_A@ */ WgC_MAirFlow Lookup1D_X_FLOAT32_IEEE 0 EcuIntgdSwGend_CM_single 5 0.0 100.0 /end AXIS_PTS
/begin CHARACTERISTIC WgC_PCmprOutltCalcd_M "Compressor Outlet Pressure Calculated Map" CURVE 0x400523DC /* @ECU_Address@WgC_PCmprOutltCalcd_M@ */ Lookup1D_FLOAT32_IEEE 0 EcuIntgdSwGend_CM_single_mbar -5000.0 5000.0
 /begin AXIS_DESCR COM_AXIS WgC_MAirFlow EcuIntgdSwGend_CM_single 5 0.0 100.0 AXIS_PTS_REF WgC_MAirFlow_A /end AXIS_DESCR
/end CHARACTERISTIC
/begin CHARACTERISTIC WgC_EffCmpr_M "Compressor Efficiency Map" MAP 0x400517EC /* @ECU_Address@WgC_EffCmpr_M@ */ Lookup2D_FLOAT32_IEEE 0 EcuIntgdSwGend_CM_single 0.0 1000.0
 /begin AXIS_DESCR COM_AXIS WgC_RatPCmpr EcuIntgdSwGend_CM_single 15 0.0 15.0 AXIS_PTS_REF WgC_RatPCmpr_A /end AXIS_DESCR
 /begin AXIS_DESCR COM_AXIS WgC_MCorrdAirFlow EcuIntgdSwGend_CM_single 15 0.0 100.0 AXIS_PTS_REF WgC_MCorrdAirFlow_A /end AXIS_DESCR
/end CHARACTERISTIC
/begin AXIS_PTS WgC_RatPCmpr_A "Compressor Pressure Ratio Map Axis" 0x40052460 /* @ECU_Address@WgC_RatPCmpr_A@ */ WgC_RatPCmpr Lookup2D_X_FLOAT32_IEEE 0 EcuIntgdSwGend_CM_single 15 0.0 15.0 /end AXIS_PTS
/begin AXIS_PTS WgC_MCorrdAirFlow_A "Corrected Mass Air Flow Map Axis" 0x40051CF0 /* @ECU_Address@WgC_MCorrdAirFlow_A@ */ WgC_MCorrdAirFlow Lookup2D_X_FLOAT32_IEEE 0 EcuIntgdSwGend_CM_single 15 0.0 100.0 /end AXIS_PTS
/begin CHARACTERISTIC WgC_MCorrAirFlowPCmprInlt_M "Mass Air Flow Correction for Compressor Inlet Pressure Map" CURVE 0x40051C8C /* @ECU_Address@WgC_MCorrAirFlowPCmprInlt_M@ */ Lookup1D_FLOAT32_IEEE 0 EcuIntgdSwGend_CM_single_kg_s 0.0 100.0
 /begin AXIS_DESCR COM_AXIS WgC_PCmprInltCalcd EcuIntgdSwGend_CM_single 5 0.0 5000.0 AXIS_PTS_REF WgC_PCmprInltCorrdFlow_A /end AXIS_DESCR
/end CHARACTERISTIC
/begin AXIS_PTS WgC_PCmprInltCorrdFlow_A "Corrected Compressor Inlet Pressure Flow Map Axis" 0x400523C8 /* @ECU_Address@WgC_PCmprInltCorrdFlow_A@ */ WgC_PCmprInltCalcd Lookup1D_X_FLOAT32_IEEE 0 EcuIntgdSwGend_CM_single 5 0.0 5000.0 /end AXIS_PTS
/begin CHARACTERISTIC WgC_MCorrAirFlowTAmbAir_M "Mass Air Flow Correction for  Ambient Air Temperature Map" CURVE 0x40051CA0 /* @ECU_Address@WgC_MCorrAirFlowTAmbAir_M@ */ Lookup1D_FLOAT32_IEEE 0 EcuIntgdSwGend_CM_single 0.0 100.0
 /begin AXIS_DESCR COM_AXIS EIP_TAmbAir EcuIntgdSwGend_CM_single_degC 5 -40.0 150.0 AXIS_PTS_REF WgC_TAmbAirCorrdFlow_A /end AXIS_DESCR
/end CHARACTERISTIC
/begin AXIS_PTS WgC_TAmbAirCorrdFlow_A "Ambient Air Temperature Corrected for Flow Map Axis" 0x400525E4 /* @ECU_Address@WgC_TAmbAirCorrdFlow_A@ */ EIP_TAmbAir Lookup1D_X_FLOAT32_IEEE 0 EcuIntgdSwGend_CM_single_degC 5 -40.0 150.0 /end AXIS_PTS
/begin CHARACTERISTIC WgC_SurgeLim_M "Surge Limitation Map" CURVE 0x400525BC /* @ECU_Address@WgC_SurgeLim_M@ */ Lookup1D_FLOAT32_IEEE 0 EcuIntgdSwGend_CM_single 0.0 10.0
 /begin AXIS_DESCR COM_AXIS WgC_MCorrdAirFlow EcuIntgdSwGend_CM_single 10 0.0 100.0 AXIS_PTS_REF WgC_MAirFlowSurgeLim_A /end AXIS_DESCR
/end CHARACTERISTIC
/begin AXIS_PTS WgC_MAirFlowSurgeLim_A "Mass Air Flow for Surge Limit Map Axis" 0x40051C50 /* @ECU_Address@WgC_MAirFlowSurgeLim_A@ */ WgC_MCorrdAirFlow Lookup1D_X_FLOAT32_IEEE 0 EcuIntgdSwGend_CM_single 10 0.0 100.0 /end AXIS_PTS
/begin CHARACTERISTIC WgC_NTrbChrg_M "Turbo Charge Speed Map" MAP 0x40051E80 /* @ECU_Address@WgC_NTrbChrg_M@ */ Lookup2D_FLOAT32_IEEE 0 EcuIntgdSwGend_CM_single_rpm 0.0 150000.0
 /begin AXIS_DESCR COM_AXIS WgC_RatPCmpr EcuIntgdSwGend_CM_single 15 0.0 1000.0 AXIS_PTS_REF WgC_RatPCmprNTrb_A /end AXIS_DESCR
 /begin AXIS_DESCR COM_AXIS WgC_MCorrdAirFlow EcuIntgdSwGend_CM_single 15 0.0 100.0 AXIS_PTS_REF WgC_MCorrdAirFlowNTrb_A /end AXIS_DESCR
/end CHARACTERISTIC
/begin AXIS_PTS WgC_RatPCmprNTrb_A "Compressor Pressure Ratio for Turbocharger Speed" 0x40052424 /* @ECU_Address@WgC_RatPCmprNTrb_A@ */ WgC_RatPCmpr Lookup2D_X_FLOAT32_IEEE 0 EcuIntgdSwGend_CM_single 15 0.0 1000.0 /end AXIS_PTS
/begin AXIS_PTS WgC_MCorrdAirFlowNTrb_A "Corrected Mass Air Flow for Turbocharger Speed Map Axis" 0x40051CB4 /* @ECU_Address@WgC_MCorrdAirFlowNTrb_A@ */ WgC_MCorrdAirFlow Lookup2D_X_FLOAT32_IEEE 0 EcuIntgdSwGend_CM_single 15 0.0 100.0 /end AXIS_PTS
/begin CHARACTERISTIC WgC_VolEff_M "Volumetric EfficiencyMap" MAP 0x40052738 /* @ECU_Address@WgC_VolEff_M@ */ Lookup2D_FLOAT32_IEEE 0 EcuIntgdSwGend_CM_single 0.0 1000.0
 /begin AXIS_DESCR COM_AXIS NO_INPUT_QUANTITY EcuIntgdSwGend_CM_single_N_m 25 0.0 5000.0 AXIS_PTS_REF WgC_TqIndcdLimdVolEff_A /end AXIS_DESCR
 /begin AXIS_DESCR COM_AXIS EIP_NEng EcuIntgdSwGend_CM_single_rpm 25 0.0 3500.0 AXIS_PTS_REF WgC_NEngVolEff_A /end AXIS_DESCR
/end CHARACTERISTIC
/begin AXIS_PTS WgC_TqIndcdLimdVolEff_A "Limited Indicated Torque for Volumetric Effciency Map Axis" 0x400526D4 /* @ECU_Address@WgC_TqIndcdLimdVolEff_A@ */ NO_INPUT_QUANTITY Lookup2D_X_FLOAT32_IEEE 0 EcuIntgdSwGend_CM_single_N_m 25 0.0 5000.0 /end AXIS_PTS
/begin AXIS_PTS WgC_NEngVolEff_A "Volumetric Efficiency Engine Speed Map Axis" 0x40051E14 /* @ECU_Address@WgC_NEngVolEff_A@ */ EIP_NEng Lookup2D_X_FLOAT32_IEEE 0 EcuIntgdSwGend_CM_single_rpm 25 0.0 3500.0 /end AXIS_PTS
/begin CHARACTERISTIC WgC_CoeffDForWgCCtl_M "Derivative Coefficient For Wastegate Control Map" MAP 0x40051280 /* @ECU_Address@WgC_CoeffDForWgCCtl_M@ */ Lookup2D_FLOAT32_IEEE 0 EcuIntgdSwGend_CM_single -100000.0 100000.0
 /begin AXIS_DESCR COM_AXIS EIP_NEng EcuIntgdSwGend_CM_single_rpm 5 0.0 3200.0 AXIS_PTS_REF WgC_NEngForPAirBoostCtl_A /end AXIS_DESCR
 /begin AXIS_DESCR COM_AXIS WgC_ErrPAirBoost EcuIntgdSwGend_CM_single_mbar 5 0.0 1000.0 AXIS_PTS_REF WgC_ErrPAirBoost_A /end AXIS_DESCR
/end CHARACTERISTIC
/begin AXIS_PTS WgC_NEngForPAirBoostCtl_A "Engine Speed for Air Boost Pressure Control Map Axis" 0x40051D4C /* @ECU_Address@WgC_NEngForPAirBoostCtl_A@ */ EIP_NEng Lookup2D_X_FLOAT32_IEEE 0 EcuIntgdSwGend_CM_single_rpm 5 0.0 3200.0 /end AXIS_PTS
/begin AXIS_PTS WgC_ErrPAirBoost_A "Air Bosst Pressure Error Map Axis" 0x40051B70 /* @ECU_Address@WgC_ErrPAirBoost_A@ */ WgC_ErrPAirBoost Lookup2D_X_FLOAT32_IEEE 0 EcuIntgdSwGend_CM_single_mbar 5 0.0 1000.0 /end AXIS_PTS
/begin CHARACTERISTIC WgC_CoeffFiltForWgCCtl_M "Filter Coefficient For Wastegate Control Map" MAP 0x400512E4 /* @ECU_Address@WgC_CoeffFiltForWgCCtl_M@ */ Lookup2D_FLOAT32_IEEE 0 EcuIntgdSwGend_CM_single -100000.0 100000.0
 /begin AXIS_DESCR COM_AXIS EIP_NEng EcuIntgdSwGend_CM_single_rpm 5 0.0 3200.0 AXIS_PTS_REF WgC_NEngForPAirBoostCtl_A /end AXIS_DESCR
 /begin AXIS_DESCR COM_AXIS WgC_ErrPAirBoost EcuIntgdSwGend_CM_single_mbar 5 0.0 1000.0 AXIS_PTS_REF WgC_ErrPAirBoost_A /end AXIS_DESCR
/end CHARACTERISTIC
/begin CHARACTERISTIC WgC_CoeffIForWgCCtl_M "Integrator Coefficient For Wastegate Control Map" MAP 0x40051348 /* @ECU_Address@WgC_CoeffIForWgCCtl_M@ */ Lookup2D_FLOAT32_IEEE 0 EcuIntgdSwGend_CM_single -100000.0 100000.0
 /begin AXIS_DESCR COM_AXIS EIP_NEng EcuIntgdSwGend_CM_single_rpm 5 0.0 3200.0 AXIS_PTS_REF WgC_NEngForPAirBoostCtl_A /end AXIS_DESCR
 /begin AXIS_DESCR COM_AXIS WgC_ErrPAirBoost EcuIntgdSwGend_CM_single_mbar 5 0.0 1000.0 AXIS_PTS_REF WgC_ErrPAirBoost_A /end AXIS_DESCR
/end CHARACTERISTIC
/begin CHARACTERISTIC WgC_CoeffPForWgCCtl_M "Proportional Coefficient For Wastegate Control Map" MAP 0x400513AC /* @ECU_Address@WgC_CoeffPForWgCCtl_M@ */ Lookup2D_FLOAT32_IEEE 0 EcuIntgdSwGend_CM_single -100000.0 100000.0
 /begin AXIS_DESCR COM_AXIS EIP_NEng EcuIntgdSwGend_CM_single_rpm 5 0.0 3200.0 AXIS_PTS_REF WgC_NEngForPAirBoostCtl_A /end AXIS_DESCR
 /begin AXIS_DESCR COM_AXIS WgC_ErrPAirBoost EcuIntgdSwGend_CM_single_mbar 5 0.0 1000.0 AXIS_PTS_REF WgC_ErrPAirBoost_A /end AXIS_DESCR
/end CHARACTERISTIC
/begin CHARACTERISTIC WgC_CorrPAmbAirRef_M "Ambient Air Reference Correction Map" CURVE 0x40051424 /* @ECU_Address@WgC_CorrPAmbAirRef_M@ */ Lookup1D_FLOAT32_IEEE 0 EcuIntgdSwGend_CM_single -5000.0 5000.0
 /begin AXIS_DESCR COM_AXIS EIP_PAmbAir EcuIntgdSwGend_CM_single_mbar 5 -1000.0 1600.0 AXIS_PTS_REF WgC_CorrPAmbAirRef_A /end AXIS_DESCR
/end CHARACTERISTIC
/begin AXIS_PTS WgC_CorrPAmbAirRef_A "Ambient Air Reference Correction Map Axis" 0x40051410 /* @ECU_Address@WgC_CorrPAmbAirRef_A@ */ EIP_PAmbAir Lookup1D_X_FLOAT32_IEEE 0 EcuIntgdSwGend_CM_single_mbar 5 -1000.0 1600.0 /end AXIS_PTS
/begin CHARACTERISTIC WgC_PAirBoostRefCorrTCoolt_M "Reference Air Boost Pressure for Coolant Temperature Correction Map" CURVE 0x40052224 /* @ECU_Address@WgC_PAirBoostRefCorrTCoolt_M@ */ Lookup1D_FLOAT32_IEEE 0 EcuIntgdSwGend_CM_single -5000.0 5000.0
 /begin AXIS_DESCR COM_AXIS EIP_TCoolt EcuIntgdSwGend_CM_single_degC 5 -40.0 150.0 AXIS_PTS_REF WgC_TCoolt_A /end AXIS_DESCR
/end CHARACTERISTIC
/begin AXIS_PTS WgC_TCoolt_A "Coolant Temperature Map Axis" 0x400525F8 /* @ECU_Address@WgC_TCoolt_A@ */ EIP_TCoolt Lookup1D_X_FLOAT32_IEEE 0 EcuIntgdSwGend_CM_single_degC 5 -40.0 150.0 /end AXIS_PTS
/begin CHARACTERISTIC WgC_PAirBoostRef_M "Reference Air Boost Pressure Map" MAP 0x40052238 /* @ECU_Address@WgC_PAirBoostRef_M@ */ Lookup2D_FLOAT32_IEEE 0 EcuIntgdSwGend_CM_single_mbar 0.0 5000.0
 /begin AXIS_DESCR COM_AXIS NO_INPUT_QUANTITY EcuIntgdSwGend_CM_single_N_m 5 0.0 5000.0 AXIS_PTS_REF WgC_TqIndcdLimdPAirBoostRef_A /end AXIS_DESCR
 /begin AXIS_DESCR COM_AXIS EIP_NEng EcuIntgdSwGend_CM_single_rpm 20 0.0 3200.0 AXIS_PTS_REF WgC_NEngPAirBoostRef_A /end AXIS_DESCR
/end CHARACTERISTIC
/begin AXIS_PTS WgC_TqIndcdLimdPAirBoostRef_A "Limited Indicated Torque for Reference Air Boost Pressure Map Axis" 0x400526C0 /* @ECU_Address@WgC_TqIndcdLimdPAirBoostRef_A@ */ NO_INPUT_QUANTITY Lookup2D_X_FLOAT32_IEEE 0 EcuIntgdSwGend_CM_single_N_m 5 0.0 5000.0 /end AXIS_PTS
/begin AXIS_PTS WgC_NEngPAirBoostRef_A "Engine Speed for Air Boost Pressure Reference Map Axis" 0x40051DC4 /* @ECU_Address@WgC_NEngPAirBoostRef_A@ */ EIP_NEng Lookup2D_X_FLOAT32_IEEE 0 EcuIntgdSwGend_CM_single_rpm 20 0.0 3200.0 /end AXIS_PTS
/begin CHARACTERISTIC WgC_SurgeCorrPAirBoostRef_M "AirBoost Pressure Reference Correction for Surge" MAP 0x400524BC /* @ECU_Address@WgC_SurgeCorrPAirBoostRef_M@ */ Lookup2D_FLOAT32_IEEE 0 EcuIntgdSwGend_CM_single_mbar -15000.0 15000.0
 /begin AXIS_DESCR COM_AXIS EIP_NEng EcuIntgdSwGend_CM_single_rpm 8 0.0 3200.0 AXIS_PTS_REF WgC_NEngForCorrSurge_A /end AXIS_DESCR
 /begin AXIS_DESCR COM_AXIS WgC_DifSurgeLine EcuIntgdSwGend_CM_single 8 -100.0 100.0 AXIS_PTS_REF WgC_DifSurgeLine_A /end AXIS_DESCR
/end CHARACTERISTIC
/begin AXIS_PTS WgC_NEngForCorrSurge_A "Engine Speed for Surge Correction Map Axis" 0x40051D2C /* @ECU_Address@WgC_NEngForCorrSurge_A@ */ EIP_NEng Lookup2D_X_FLOAT32_IEEE 0 EcuIntgdSwGend_CM_single_rpm 8 0.0 3200.0 /end AXIS_PTS
/begin AXIS_PTS WgC_DifSurgeLine_A "Surge Line Difference Map Axis" 0x40051438 /* @ECU_Address@WgC_DifSurgeLine_A@ */ WgC_DifSurgeLine Lookup2D_X_FLOAT32_IEEE 0 EcuIntgdSwGend_CM_single 8 -100.0 100.0 /end AXIS_PTS
/begin CHARACTERISTIC WgC_TCorrAmbAirRef_M "Temperature Correction for Ambient Air Reference Map Axis" CURVE 0x40052620 /* @ECU_Address@WgC_TCorrAmbAirRef_M@ */ Lookup1D_FLOAT32_IEEE 0 EcuIntgdSwGend_CM_single -5000.0 5000.0
 /begin AXIS_DESCR COM_AXIS EIP_TAmbAir EcuIntgdSwGend_CM_single_degC 5 -40.0 150.0 AXIS_PTS_REF WgC_TCorrAmbAirRef_A /end AXIS_DESCR
/end CHARACTERISTIC
/begin AXIS_PTS WgC_TCorrAmbAirRef_A "Temperature Correction for Ambient Air Reference Map " 0x4005260C /* @ECU_Address@WgC_TCorrAmbAirRef_A@ */ EIP_TAmbAir Lookup1D_X_FLOAT32_IEEE 0 EcuIntgdSwGend_CM_single_degC 5 -40.0 150.0 /end AXIS_PTS
/begin CHARACTERISTIC WgC_TCorrOilRef_M "Temperature Correction for Oil Reference Temperature Map Axis" CURVE 0x40052648 /* @ECU_Address@WgC_TCorrOilRef_M@ */ Lookup1D_FLOAT32_IEEE 0 EcuIntgdSwGend_CM_single -5000.0 5000.0
 /begin AXIS_DESCR COM_AXIS EIP_TOil EcuIntgdSwGend_CM_single_degC 5 -40.0 150.0 AXIS_PTS_REF WgC_TCorrOilRef_A /end AXIS_DESCR
/end CHARACTERISTIC
/begin AXIS_PTS WgC_TCorrOilRef_A "Temperature Correction for Oil Reference Temperature Map Axis" 0x40052634 /* @ECU_Address@WgC_TCorrOilRef_A@ */ EIP_TOil Lookup1D_X_FLOAT32_IEEE 0 EcuIntgdSwGend_CM_single_degC 5 -40.0 150.0 /end AXIS_PTS
/begin CHARACTERISTIC DTqC_TqBrkMap1_M "Break Torque Map 1" MAP 0x40042044 /* @ECU_Address@DTqC_TqBrkMap1_M@ */ Lookup2D_FLOAT32_IEEE 0 EcuIntgdSwGend_CM_single_N_m -10000.0 10000.0
 /begin AXIS_DESCR COM_AXIS EIP_PercgAccr EcuIntgdSwGend_CM_single__ 20 0.0 100.0 AXIS_PTS_REF DTqC_PercgAccr_A /end AXIS_DESCR
 /begin AXIS_DESCR COM_AXIS EIP_NEng EcuIntgdSwGend_CM_single_rpm 20 0.0 6000.0 AXIS_PTS_REF DTqC_NEng_A /end AXIS_DESCR
/end CHARACTERISTIC
/begin AXIS_PTS DTqC_PercgAccr_A "Axis Values of Accelerator Pedal for Break Torque Maps" 0x40041E18 /* @ECU_Address@DTqC_PercgAccr_A@ */ EIP_PercgAccr Lookup2D_X_FLOAT32_IEEE 0 EcuIntgdSwGend_CM_single__ 20 0.0 100.0 /end AXIS_PTS
/begin CHARACTERISTIC DTqC_TqBrkMap2_M "Break Torque Map 2" MAP 0x40042684 /* @ECU_Address@DTqC_TqBrkMap2_M@ */ Lookup2D_FLOAT32_IEEE 0 EcuIntgdSwGend_CM_single_N_m -10000.0 10000.0
 /begin AXIS_DESCR COM_AXIS EIP_PercgAccr EcuIntgdSwGend_CM_single__ 20 0.0 100.0 AXIS_PTS_REF DTqC_PercgAccr_A /end AXIS_DESCR
 /begin AXIS_DESCR COM_AXIS EIP_NEng EcuIntgdSwGend_CM_single_rpm 20 0.0 6000.0 AXIS_PTS_REF DTqC_NEng_A /end AXIS_DESCR
/end CHARACTERISTIC
/begin CHARACTERISTIC DTqC_TqBrkMap3_M "Break Torque Map 3" MAP 0x40042CC4 /* @ECU_Address@DTqC_TqBrkMap3_M@ */ Lookup2D_FLOAT32_IEEE 0 EcuIntgdSwGend_CM_single_N_m -10000.0 10000.0
 /begin AXIS_DESCR COM_AXIS EIP_PercgAccr EcuIntgdSwGend_CM_single__ 20 0.0 100.0 AXIS_PTS_REF DTqC_PercgAccr_A /end AXIS_DESCR
 /begin AXIS_DESCR COM_AXIS EIP_NEng EcuIntgdSwGend_CM_single_rpm 20 0.0 6000.0 AXIS_PTS_REF DTqC_NEng_A /end AXIS_DESCR
/end CHARACTERISTIC
/begin CHARACTERISTIC DTqC_CoeffDForEndSpdCtl_M "" MAP 0x40040718 /* @ECU_Address@DTqC_CoeffDForEndSpdCtl_M@ */ Lookup2D_FLOAT32_IEEE 0 EcuIntgdSwGend_CM_single -10000.0 10000.0
 /begin AXIS_DESCR COM_AXIS DTqC_NEngDelta EcuIntgdSwGend_CM_single_rpm 10 -500.0 500.0 AXIS_PTS_REF DTqC_ErrNEng_A /end AXIS_DESCR
 /begin AXIS_DESCR COM_AXIS EIP_TCoolt EcuIntgdSwGend_CM_single_degC 10 -50.0 200.0 AXIS_PTS_REF DTqC_TCooltForEndSpdCtl_A /end AXIS_DESCR
/end CHARACTERISTIC
/begin AXIS_PTS DTqC_TCooltForEndSpdCtl_A "" 0x40041E78 /* @ECU_Address@DTqC_TCooltForEndSpdCtl_A@ */ EIP_TCoolt Lookup2D_X_FLOAT32_IEEE 0 EcuIntgdSwGend_CM_single_degC 10 -50.0 200.0 /end AXIS_PTS
/begin CHARACTERISTIC DTqC_CoeffFiltForEndSpdCtl_M "" MAP 0x40040BC8 /* @ECU_Address@DTqC_CoeffFiltForEndSpdCtl_M@ */ Lookup2D_FLOAT32_IEEE 0 EcuIntgdSwGend_CM_single -10000.0 10000.0
 /begin AXIS_DESCR COM_AXIS DTqC_NEngDelta EcuIntgdSwGend_CM_single_rpm 10 -500.0 500.0 AXIS_PTS_REF DTqC_ErrNEng_A /end AXIS_DESCR
 /begin AXIS_DESCR COM_AXIS EIP_TCoolt EcuIntgdSwGend_CM_single_degC 10 -50.0 200.0 AXIS_PTS_REF DTqC_TCooltForEndSpdCtl_A /end AXIS_DESCR
/end CHARACTERISTIC
/begin CHARACTERISTIC DTqC_CoeffIForEndSpdCtl_M "" MAP 0x40041090 /* @ECU_Address@DTqC_CoeffIForEndSpdCtl_M@ */ Lookup2D_FLOAT32_IEEE 0 EcuIntgdSwGend_CM_single -10000.0 10000.0
 /begin AXIS_DESCR COM_AXIS DTqC_NEngDelta EcuIntgdSwGend_CM_single_rpm 10 -500.0 500.0 AXIS_PTS_REF DTqC_ErrNEng_A /end AXIS_DESCR
 /begin AXIS_DESCR COM_AXIS EIP_TCoolt EcuIntgdSwGend_CM_single_degC 10 -50.0 200.0 AXIS_PTS_REF DTqC_TCooltForEndSpdCtl_A /end AXIS_DESCR
/end CHARACTERISTIC
/begin CHARACTERISTIC DTqC_CoeffPForEndSpdCtl_M "" MAP 0x40041540 /* @ECU_Address@DTqC_CoeffPForEndSpdCtl_M@ */ Lookup2D_FLOAT32_IEEE 0 EcuIntgdSwGend_CM_single -10000.0 10000.0
 /begin AXIS_DESCR COM_AXIS DTqC_NEngDelta EcuIntgdSwGend_CM_single_rpm 10 -500.0 500.0 AXIS_PTS_REF DTqC_ErrNEng_A /end AXIS_DESCR
 /begin AXIS_DESCR COM_AXIS EIP_TCoolt EcuIntgdSwGend_CM_single_degC 10 -50.0 200.0 AXIS_PTS_REF DTqC_TCooltForEndSpdCtl_A /end AXIS_DESCR
/end CHARACTERISTIC
/begin CHARACTERISTIC DTqC_CoeffDForTSC1SpdCtl_M "Derivative Coefficient Map for Speed Controller" MAP 0x40040A38 /* @ECU_Address@DTqC_CoeffDForTSC1SpdCtl_M@ */ Lookup2D_FLOAT32_IEEE 0 EcuIntgdSwGend_CM_single -10000.0 10000.0
 /begin AXIS_DESCR COM_AXIS DTqC_ErrNSpdReq EcuIntgdSwGend_CM_single_rpm 10 -1000.0 1000.0 AXIS_PTS_REF DTqC_TSC1ErrNEng_A /end AXIS_DESCR
 /begin AXIS_DESCR COM_AXIS EIP_TCoolt EcuIntgdSwGend_CM_single_degC 10 -50.0 200.0 AXIS_PTS_REF DTqC_TCooltForTSC1SpdCtl_A /end AXIS_DESCR
/end CHARACTERISTIC
/begin AXIS_PTS DTqC_TSC1ErrNEng_A "Axis Values of Error Engine Speed for PID Coefficient Maps" 0x40042014 /* @ECU_Address@DTqC_TSC1ErrNEng_A@ */ DTqC_ErrNSpdReq Lookup2D_X_FLOAT32_IEEE 0 EcuIntgdSwGend_CM_single_rpm 10 -1000.0 1000.0 /end AXIS_PTS
/begin AXIS_PTS DTqC_TCooltForTSC1SpdCtl_A "Axis Values of Coolant Temperature for Speed Control Map" 0x40041EF0 /* @ECU_Address@DTqC_TCooltForTSC1SpdCtl_A@ */ EIP_TCoolt Lookup2D_X_FLOAT32_IEEE 0 EcuIntgdSwGend_CM_single_degC 10 -50.0 200.0 /end AXIS_PTS
/begin CHARACTERISTIC DTqC_CoeffFiltForTSC1SpdCtl_M "Filter Coefficient Map for Speed Controller" MAP 0x40040EE8 /* @ECU_Address@DTqC_CoeffFiltForTSC1SpdCtl_M@ */ Lookup2D_FLOAT32_IEEE 0 EcuIntgdSwGend_CM_single -10000.0 10000.0
 /begin AXIS_DESCR COM_AXIS DTqC_ErrNSpdReq EcuIntgdSwGend_CM_single_rpm 10 -1000.0 1000.0 AXIS_PTS_REF DTqC_TSC1ErrNEng_A /end AXIS_DESCR
 /begin AXIS_DESCR COM_AXIS EIP_TCoolt EcuIntgdSwGend_CM_single_degC 10 -50.0 200.0 AXIS_PTS_REF DTqC_TCooltForTSC1SpdCtl_A /end AXIS_DESCR
/end CHARACTERISTIC
/begin CHARACTERISTIC DTqC_CoeffIForTSC1SpdCtl_M "Integrator Coefficient Map for Speed Controller" MAP 0x400413B0 /* @ECU_Address@DTqC_CoeffIForTSC1SpdCtl_M@ */ Lookup2D_FLOAT32_IEEE 0 EcuIntgdSwGend_CM_single -10000.0 10000.0
 /begin AXIS_DESCR COM_AXIS DTqC_ErrNSpdReq EcuIntgdSwGend_CM_single_rpm 10 -1000.0 1000.0 AXIS_PTS_REF DTqC_TSC1ErrNEng_A /end AXIS_DESCR
 /begin AXIS_DESCR COM_AXIS EIP_TCoolt EcuIntgdSwGend_CM_single_degC 10 -50.0 200.0 AXIS_PTS_REF DTqC_TCooltForTSC1SpdCtl_A /end AXIS_DESCR
/end CHARACTERISTIC
/begin CHARACTERISTIC DTqC_CoeffPForTSC1SpdCtl_M "Proportional Coefficient Map for Speed Controller" MAP 0x40041860 /* @ECU_Address@DTqC_CoeffPForTSC1SpdCtl_M@ */ Lookup2D_FLOAT32_IEEE 0 EcuIntgdSwGend_CM_single -10000.0 10000.0
 /begin AXIS_DESCR COM_AXIS DTqC_ErrNSpdReq EcuIntgdSwGend_CM_single_rpm 10 -1000.0 1000.0 AXIS_PTS_REF DTqC_TSC1ErrNEng_A /end AXIS_DESCR
 /begin AXIS_DESCR COM_AXIS EIP_TCoolt EcuIntgdSwGend_CM_single_degC 10 -50.0 200.0 AXIS_PTS_REF DTqC_TCooltForTSC1SpdCtl_A /end AXIS_DESCR
/end CHARACTERISTIC
/begin CHARACTERISTIC IC_InjChartc1_M "Injector 1 Characteristic Map" MAP 0x40044EF0 /* @ECU_Address@IC_InjChartc1_M@ */ Lookup2D_FLOAT32_IEEE 0 EcuIntgdSwGend_CM_single_us 0.0 10000.0
 /begin AXIS_DESCR COM_AXIS EIP_PRail EcuIntgdSwGend_CM_single_bar 10 0.0 5000.0 AXIS_PTS_REF IC_PRailForDurInj_A /end AXIS_DESCR
 /begin AXIS_DESCR COM_AXIS IC_MMaiFuQntyCorrdCyl1 EcuIntgdSwGend_CM_single_mm_3_stk 15 0.0 5000.0 AXIS_PTS_REF IC_MFuQntyLimdForDurInj_A /end AXIS_DESCR
/end CHARACTERISTIC
/begin AXIS_PTS IC_PRailForDurInj_A "Rail Pressure Map Axis for Injector Characteristic Maps" 0x40045D8C /* @ECU_Address@IC_PRailForDurInj_A@ */ EIP_PRail Lookup2D_X_FLOAT32_IEEE 0 EcuIntgdSwGend_CM_single_bar 10 0.0 5000.0 /end AXIS_PTS
/begin AXIS_PTS IC_MFuQntyLimdForDurInj_A "Limited Fuel Quantity Mass For Injection Duration" 0x40045B0C /* @ECU_Address@IC_MFuQntyLimdForDurInj_A@ */ IC_MMaiFuQntyCorrdCyl1 Lookup2D_X_FLOAT32_IEEE 0 EcuIntgdSwGend_CM_single_mm_3_stk 15 0.0 5000.0 /end AXIS_PTS
/begin CHARACTERISTIC IC_InjChartc2_M "Injector 2 Characteristic Map" MAP 0x40045148 /* @ECU_Address@IC_InjChartc2_M@ */ Lookup2D_FLOAT32_IEEE 0 EcuIntgdSwGend_CM_single_us 0.0 10000.0
 /begin AXIS_DESCR COM_AXIS EIP_PRail EcuIntgdSwGend_CM_single_bar 10 0.0 5000.0 AXIS_PTS_REF IC_PRailForDurInj_A /end AXIS_DESCR
 /begin AXIS_DESCR COM_AXIS IC_MMaiFuQntyCorrdCyl1 EcuIntgdSwGend_CM_single_mm_3_stk 15 0.0 5000.0 AXIS_PTS_REF IC_MFuQntyLimdForDurInj_A /end AXIS_DESCR
/end CHARACTERISTIC
/begin CHARACTERISTIC IC_InjChartc3_M "Injector 3 Characteristic Map" MAP 0x400453A0 /* @ECU_Address@IC_InjChartc3_M@ */ Lookup2D_FLOAT32_IEEE 0 EcuIntgdSwGend_CM_single_us 0.0 10000.0
 /begin AXIS_DESCR COM_AXIS EIP_PRail EcuIntgdSwGend_CM_single_bar 10 0.0 5000.0 AXIS_PTS_REF IC_PRailForDurInj_A /end AXIS_DESCR
 /begin AXIS_DESCR COM_AXIS IC_MMaiFuQntyCorrdCyl1 EcuIntgdSwGend_CM_single_mm_3_stk 15 0.0 5000.0 AXIS_PTS_REF IC_MFuQntyLimdForDurInj_A /end AXIS_DESCR
/end CHARACTERISTIC
/begin CHARACTERISTIC IC_InjChartc4_M "Injector 4 Characteristic Map" MAP 0x400455F8 /* @ECU_Address@IC_InjChartc4_M@ */ Lookup2D_FLOAT32_IEEE 0 EcuIntgdSwGend_CM_single_us 0.0 10000.0
 /begin AXIS_DESCR COM_AXIS EIP_PRail EcuIntgdSwGend_CM_single_bar 10 0.0 5000.0 AXIS_PTS_REF IC_PRailForDurInj_A /end AXIS_DESCR
 /begin AXIS_DESCR COM_AXIS IC_MMaiFuQntyCorrdCyl1 EcuIntgdSwGend_CM_single_mm_3_stk 15 0.0 5000.0 AXIS_PTS_REF IC_MFuQntyLimdForDurInj_A /end AXIS_DESCR
/end CHARACTERISTIC
/begin CHARACTERISTIC IC_InjChartc5_M "Injector 5 Characteristic Map" MAP 0x40045850 /* @ECU_Address@IC_InjChartc5_M@ */ Lookup2D_FLOAT32_IEEE 0 EcuIntgdSwGend_CM_single_us 0.0 10000.0
 /begin AXIS_DESCR COM_AXIS EIP_PRail EcuIntgdSwGend_CM_single_bar 10 0.0 5000.0 AXIS_PTS_REF IC_PRailForDurInj_A /end AXIS_DESCR
 /begin AXIS_DESCR COM_AXIS IC_MMaiFuQntyCorrdCyl1 EcuIntgdSwGend_CM_single_mm_3_stk 15 0.0 5000.0 AXIS_PTS_REF IC_MFuQntyLimdForDurInj_A /end AXIS_DESCR
/end CHARACTERISTIC
/begin CHARACTERISTIC IC_SoiMainInjSetPoint1_M "Start of Main Injection Set Point Calculation Map 1" MAP 0x40045E6C /* @ECU_Address@IC_SoiMainInjSetPoint1_M@ */ Lookup2D_FLOAT32_IEEE 0 EcuIntgdSwGend_CM_single_deg -100.0 500.0
 /begin AXIS_DESCR COM_AXIS IC_MMaiFuQntyCorrd EcuIntgdSwGend_CM_single_mm_3_stk 25 0.0 5000.0 AXIS_PTS_REF IC_MMaiFuQntyCorrdForSoiMainInj_A /end AXIS_DESCR
 /begin AXIS_DESCR COM_AXIS EIP_NEng EcuIntgdSwGend_CM_single_rpm 25 0.0 5000.0 AXIS_PTS_REF IC_NEngForSoiMainInj_A /end AXIS_DESCR
/end CHARACTERISTIC
/begin AXIS_PTS IC_MMaiFuQntyCorrdForSoiMainInj_A "Total Fuel Quantity Map Axis for Start of Pilot Injection Set Point Calcluation for Main Injection Map" 0x40045B48 /* @ECU_Address@IC_MMaiFuQntyCorrdForSoiMainInj_A@ */ IC_MMaiFuQntyCorrd Lookup2D_X_FLOAT32_IEEE 0 EcuIntgdSwGend_CM_single_mm_3_stk 25 0.0 5000.0 /end AXIS_PTS
/begin AXIS_PTS IC_NEngForSoiMainInj_A "Engine Speed Map Axis for Main Start of Injection Set Point Calculation Maps" 0x40045C10 /* @ECU_Address@IC_NEngForSoiMainInj_A@ */ EIP_NEng Lookup2D_X_FLOAT32_IEEE 0 EcuIntgdSwGend_CM_single_rpm 25 0.0 5000.0 /end AXIS_PTS
/begin CHARACTERISTIC IC_SoiMainInjSetPoint2_M "Start of Main Injection Set Point Calculation Map 2" MAP 0x40046830 /* @ECU_Address@IC_SoiMainInjSetPoint2_M@ */ Lookup2D_FLOAT32_IEEE 0 EcuIntgdSwGend_CM_single_deg -100.0 500.0
 /begin AXIS_DESCR COM_AXIS IC_MMaiFuQntyCorrd EcuIntgdSwGend_CM_single_mm_3_stk 25 0.0 5000.0 AXIS_PTS_REF IC_MMaiFuQntyCorrdForSoiMainInj_A /end AXIS_DESCR
 /begin AXIS_DESCR COM_AXIS EIP_NEng EcuIntgdSwGend_CM_single_rpm 25 0.0 5000.0 AXIS_PTS_REF IC_NEngForSoiMainInj_A /end AXIS_DESCR
/end CHARACTERISTIC
/begin CHARACTERISTIC IC_SoiMainInjSetPoint3_M "Start of Main Injection Set Point Calculation Map 3" MAP 0x400471F4 /* @ECU_Address@IC_SoiMainInjSetPoint3_M@ */ Lookup2D_FLOAT32_IEEE 0 EcuIntgdSwGend_CM_single_deg -100.0 500.0
 /begin AXIS_DESCR COM_AXIS IC_MMaiFuQntyCorrd EcuIntgdSwGend_CM_single_mm_3_stk 25 0.0 5000.0 AXIS_PTS_REF IC_MMaiFuQntyCorrdForSoiMainInj_A /end AXIS_DESCR
 /begin AXIS_DESCR COM_AXIS EIP_NEng EcuIntgdSwGend_CM_single_rpm 25 0.0 5000.0 AXIS_PTS_REF IC_NEngForSoiMainInj_A /end AXIS_DESCR
/end CHARACTERISTIC
/begin CHARACTERISTIC IC_SoiPltInjSetPoint1_M "Start of Pilot Injection Set Point Calculation Map 1" MAP 0x40047BC4 /* @ECU_Address@IC_SoiPltInjSetPoint1_M@ */ Lookup2D_FLOAT32_IEEE 0 EcuIntgdSwGend_CM_single_deg -100.0 500.0
 /begin AXIS_DESCR COM_AXIS IC_MMaiFuQntyCorrd EcuIntgdSwGend_CM_single_mm_3_stk 10 0.0 5000.0 AXIS_PTS_REF IC_MMaiFuQntyCorrdForSoiPltInj_A /end AXIS_DESCR
 /begin AXIS_DESCR COM_AXIS EIP_NEng EcuIntgdSwGend_CM_single_rpm 15 0.0 5000.0 AXIS_PTS_REF IC_NEngForSoiPltInj_A /end AXIS_DESCR
/end CHARACTERISTIC
/begin AXIS_PTS IC_MMaiFuQntyCorrdForSoiPltInj_A "Total Fuel Quantity Map Axis for Start of Pilot Injection Set Point Calcluation for Pilot Injection Map" 0x40045BAC /* @ECU_Address@IC_MMaiFuQntyCorrdForSoiPltInj_A@ */ IC_MMaiFuQntyCorrd Lookup2D_X_FLOAT32_IEEE 0 EcuIntgdSwGend_CM_single_mm_3_stk 10 0.0 5000.0 /end AXIS_PTS
/begin AXIS_PTS IC_NEngForSoiPltInj_A "Engine Speed Map Axis for Pilot Start of Injection Set Point Calculation Maps" 0x40045C74 /* @ECU_Address@IC_NEngForSoiPltInj_A@ */ EIP_NEng Lookup2D_X_FLOAT32_IEEE 0 EcuIntgdSwGend_CM_single_rpm 15 0.0 5000.0 /end AXIS_PTS
/begin CHARACTERISTIC IC_SoiPltInjSetPoint2_M "Start of Pilot Injection Set Point Calculation Map 2" MAP 0x40047E1C /* @ECU_Address@IC_SoiPltInjSetPoint2_M@ */ Lookup2D_FLOAT32_IEEE 0 EcuIntgdSwGend_CM_single_deg -100.0 500.0
 /begin AXIS_DESCR COM_AXIS IC_MMaiFuQntyCorrd EcuIntgdSwGend_CM_single_mm_3_stk 10 0.0 5000.0 AXIS_PTS_REF IC_MMaiFuQntyCorrdForSoiPltInj_A /end AXIS_DESCR
 /begin AXIS_DESCR COM_AXIS EIP_NEng EcuIntgdSwGend_CM_single_rpm 15 0.0 5000.0 AXIS_PTS_REF IC_NEngForSoiPltInj_A /end AXIS_DESCR
/end CHARACTERISTIC
/begin CHARACTERISTIC IC_SoiPltInjSetPoint3_M "Start of Pilot Injection Set Point Calculation Map 3" MAP 0x40048074 /* @ECU_Address@IC_SoiPltInjSetPoint3_M@ */ Lookup2D_FLOAT32_IEEE 0 EcuIntgdSwGend_CM_single_deg -100.0 500.0
 /begin AXIS_DESCR COM_AXIS IC_MMaiFuQntyCorrd EcuIntgdSwGend_CM_single_mm_3_stk 10 0.0 5000.0 AXIS_PTS_REF IC_MMaiFuQntyCorrdForSoiPltInj_A /end AXIS_DESCR
 /begin AXIS_DESCR COM_AXIS EIP_NEng EcuIntgdSwGend_CM_single_rpm 15 0.0 5000.0 AXIS_PTS_REF IC_NEngForSoiPltInj_A /end AXIS_DESCR
/end CHARACTERISTIC
/begin CHARACTERISTIC WM_UClmp30OvLvl1_M "Battery Voltage Over Level 1 Map" CURVE 0x400511A4 /* @ECU_Address@WM_UClmp30OvLvl1_M@ */ Lookup1D_FLOAT32_IEEE 0 EcuIntgdSwGend_CM_single_V 0.0 50.0
 /begin AXIS_DESCR COM_AXIS EIP_NEng EcuIntgdSwGend_CM_single_rpm 5 0.0 6000.0 AXIS_PTS_REF WM_NEng_A /end AXIS_DESCR
/end CHARACTERISTIC
/begin AXIS_PTS WM_NEng_A "Engine Speed Map Axis" 0x40050AE8 /* @ECU_Address@WM_NEng_A@ */ EIP_NEng Lookup1D_X_FLOAT32_IEEE 0 EcuIntgdSwGend_CM_single_rpm 5 0.0 6000.0 /end AXIS_PTS
/begin CHARACTERISTIC WM_UClmp30OvLvl2_M "Battery Voltage Under Level 2 Map" CURVE 0x400511B8 /* @ECU_Address@WM_UClmp30OvLvl2_M@ */ Lookup1D_FLOAT32_IEEE 0 EcuIntgdSwGend_CM_single_V 0.0 50.0
 /begin AXIS_DESCR COM_AXIS EIP_NEng EcuIntgdSwGend_CM_single_rpm 5 0.0 6000.0 AXIS_PTS_REF WM_NEng_A /end AXIS_DESCR
/end CHARACTERISTIC
/begin CHARACTERISTIC WM_UClmp30OvLvl3_M "Battery Voltage Under Level 3 Map" CURVE 0x400511CC /* @ECU_Address@WM_UClmp30OvLvl3_M@ */ Lookup1D_FLOAT32_IEEE 0 EcuIntgdSwGend_CM_single_V 0.0 50.0
 /begin AXIS_DESCR COM_AXIS EIP_NEng EcuIntgdSwGend_CM_single_rpm 5 0.0 6000.0 AXIS_PTS_REF WM_NEng_A /end AXIS_DESCR
/end CHARACTERISTIC
/begin CHARACTERISTIC WM_UClmp30UndLvl1_M "Battery Voltage Under Level 1 Map" CURVE 0x400511F0 /* @ECU_Address@WM_UClmp30UndLvl1_M@ */ Lookup1D_FLOAT32_IEEE 0 EcuIntgdSwGend_CM_single_V 0.0 50.0
 /begin AXIS_DESCR COM_AXIS EIP_NEng EcuIntgdSwGend_CM_single_rpm 5 0.0 6000.0 AXIS_PTS_REF WM_NEng_A /end AXIS_DESCR
/end CHARACTERISTIC
/begin CHARACTERISTIC WM_UClmp30UndLvl2_M "Battery Voltage Under Level 2 Map" CURVE 0x40051204 /* @ECU_Address@WM_UClmp30UndLvl2_M@ */ Lookup1D_FLOAT32_IEEE 0 EcuIntgdSwGend_CM_single_V 0.0 50.0
 /begin AXIS_DESCR COM_AXIS EIP_NEng EcuIntgdSwGend_CM_single_rpm 5 0.0 6000.0 AXIS_PTS_REF WM_NEng_A /end AXIS_DESCR
/end CHARACTERISTIC
/begin CHARACTERISTIC WM_UClmp30UndLvl3_M "Battery Voltage Under Level 3 Map" CURVE 0x40051218 /* @ECU_Address@WM_UClmp30UndLvl3_M@ */ Lookup1D_FLOAT32_IEEE 0 EcuIntgdSwGend_CM_single_V 0.0 50.0
 /begin AXIS_DESCR COM_AXIS EIP_NEng EcuIntgdSwGend_CM_single_rpm 5 0.0 6000.0 AXIS_PTS_REF WM_NEng_A /end AXIS_DESCR
/end CHARACTERISTIC
/begin CHARACTERISTIC WM_PAirBoostOvLvl1_M "Air Boost Pressure Over Level 1 Map" CURVE 0x40050B0C /* @ECU_Address@WM_PAirBoostOvLvl1_M@ */ Lookup1D_FLOAT32_IEEE 0 EcuIntgdSwGend_CM_single_mbar 0.0 15000.0
 /begin AXIS_DESCR COM_AXIS EIP_NEng EcuIntgdSwGend_CM_single_rpm 5 0.0 6000.0 AXIS_PTS_REF WM_NEng_A /end AXIS_DESCR
/end CHARACTERISTIC
/begin CHARACTERISTIC WM_PAirBoostOvLvl2_M "Air Boost Pressure Over Level 2 Map" CURVE 0x40050B20 /* @ECU_Address@WM_PAirBoostOvLvl2_M@ */ Lookup1D_FLOAT32_IEEE 0 EcuIntgdSwGend_CM_single_mbar 0.0 15000.0
 /begin AXIS_DESCR COM_AXIS EIP_NEng EcuIntgdSwGend_CM_single_rpm 5 0.0 6000.0 AXIS_PTS_REF WM_NEng_A /end AXIS_DESCR
/end CHARACTERISTIC
/begin CHARACTERISTIC WM_PAirBoostOvLvl3_M "Air Boost Pressure Over Level 3 Map" CURVE 0x40050B34 /* @ECU_Address@WM_PAirBoostOvLvl3_M@ */ Lookup1D_FLOAT32_IEEE 0 EcuIntgdSwGend_CM_single_mbar 0.0 15000.0
 /begin AXIS_DESCR COM_AXIS EIP_NEng EcuIntgdSwGend_CM_single_rpm 5 0.0 6000.0 AXIS_PTS_REF WM_NEng_A /end AXIS_DESCR
/end CHARACTERISTIC
/begin CHARACTERISTIC CrsCtrl_EngBrkLvl1ActvnThd_P "Engine Brake Level 1 Activation Threshold Parameter" VALUE 0x40040534 /* @ECU_Address@CrsCtrl_EngBrkLvl1ActvnThd_P@ */ Scalar_FLOAT32_IEEE 0 EcuIntgdSwGend_CM_single_km_h -300.0 300.0 /end CHARACTERISTIC
/begin CHARACTERISTIC CrsCtrl_EngBrkLvl1DeactvnThd_P "Engine Brake Level 1 Deactivation Threshold Parameter" VALUE 0x40040538 /* @ECU_Address@CrsCtrl_EngBrkLvl1DeactvnThd_P@ */ Scalar_FLOAT32_IEEE 0 EcuIntgdSwGend_CM_single_km_h -300.0 300.0 /end CHARACTERISTIC
/begin CHARACTERISTIC CrsCtrl_EngBrkLvl2ActvnThd_P "Engine Brake Level 1 Activation Threshold Parameter" VALUE 0x4004053C /* @ECU_Address@CrsCtrl_EngBrkLvl2ActvnThd_P@ */ Scalar_FLOAT32_IEEE 0 EcuIntgdSwGend_CM_single_km_h -300.0 300.0 /end CHARACTERISTIC
/begin CHARACTERISTIC CrsCtrl_EngBrkLvl2DeactvnThd_P "Engine Brake Level 1 Deactivation Threshold Parameter" VALUE 0x40040540 /* @ECU_Address@CrsCtrl_EngBrkLvl2DeactvnThd_P@ */ Scalar_FLOAT32_IEEE 0 EcuIntgdSwGend_CM_single_km_h -300.0 300.0 /end CHARACTERISTIC
/begin CHARACTERISTIC CrsCtrl_TiEngBrkLvl1ActvnDeb_P "Engine Brake Level 1 Activation Debounce Time Parameter" VALUE 0x40040674 /* @ECU_Address@CrsCtrl_TiEngBrkLvl1ActvnDeb_P@ */ Scalar_FLOAT32_IEEE 0 EcuIntgdSwGend_CM_single_ms 0.0 10000.0 /end CHARACTERISTIC
/begin CHARACTERISTIC CrsCtrl_TiEngBrkLvl2ActvnDeb_P "Engine Brake Level 2 Activation Debounce Time Parameter" VALUE 0x40040678 /* @ECU_Address@CrsCtrl_TiEngBrkLvl2ActvnDeb_P@ */ Scalar_FLOAT32_IEEE 0 EcuIntgdSwGend_CM_single_ms 0.0 10000.0 /end CHARACTERISTIC
/begin CHARACTERISTIC DTqC_CoeffFiltKdEndSpdCtlOvv_P "" VALUE 0x4004107C /* @ECU_Address@DTqC_CoeffFiltKdEndSpdCtlOvv_P@ */ Scalar_FLOAT32_IEEE 0 EcuIntgdSwGend_CM_single 0.0 1000.0 /end CHARACTERISTIC
/begin CHARACTERISTIC DTqC_CoeffFiltTSC1SpdCtlOvv_P "Derivative Coefficient Parameter for TCU Request Speed Controller - Override Value" VALUE 0x4004108C /* @ECU_Address@DTqC_CoeffFiltTSC1SpdCtlOvv_P@ */ Scalar_FLOAT32_IEEE 0 EcuIntgdSwGend_CM_single -100.0 100.0 /end CHARACTERISTIC
/begin CHARACTERISTIC DTqC_FacSclPIDCoeffEndSpd_P "" VALUE 0x40041A50 /* @ECU_Address@DTqC_FacSclPIDCoeffEndSpd_P@ */ Scalar_FLOAT32_IEEE 0 EcuIntgdSwGend_CM_single 1.0 10000.0 /end CHARACTERISTIC
/begin CHARACTERISTIC DTqC_KdEndSpdCtlOvv_P "" VALUE 0x40041BFC /* @ECU_Address@DTqC_KdEndSpdCtlOvv_P@ */ Scalar_FLOAT32_IEEE 0 EcuIntgdSwGend_CM_single 0.0 1000.0 /end CHARACTERISTIC
/begin CHARACTERISTIC DTqC_KdTSC1SpdCtlOvv_P "Derivative Coefficient Parameter for TCU Request Speed Controller - Override Value" VALUE 0x40041C0C /* @ECU_Address@DTqC_KdTSC1SpdCtlOvv_P@ */ Scalar_FLOAT32_IEEE 0 EcuIntgdSwGend_CM_single -100.0 100.0 /end CHARACTERISTIC
/begin CHARACTERISTIC DTqC_KiEndSpdCtlOvv_P "" VALUE 0x40041C14 /* @ECU_Address@DTqC_KiEndSpdCtlOvv_P@ */ Scalar_FLOAT32_IEEE 0 EcuIntgdSwGend_CM_single 0.0 1000.0 /end CHARACTERISTIC
/begin CHARACTERISTIC DTqC_KiTSC1SpdCtlOvv_P "Integrator Coefficient Parameter for TCU Request Speed Controller - Override Value" VALUE 0x40041C24 /* @ECU_Address@DTqC_KiTSC1SpdCtlOvv_P@ */ Scalar_FLOAT32_IEEE 0 EcuIntgdSwGend_CM_single -100.0 100.0 /end CHARACTERISTIC
/begin CHARACTERISTIC DTqC_KpEndSpdCtlOvv_P "" VALUE 0x40041C2C /* @ECU_Address@DTqC_KpEndSpdCtlOvv_P@ */ Scalar_FLOAT32_IEEE 0 EcuIntgdSwGend_CM_single 0.0 1000.0 /end CHARACTERISTIC
/begin CHARACTERISTIC DTqC_KpTSC1SpdCtlOvv_P "Proportional Coefficient Parameter for TCU Request Speed Controller - Override Value" VALUE 0x40041C3C /* @ECU_Address@DTqC_KpTSC1SpdCtlOvv_P@ */ Scalar_FLOAT32_IEEE 0 EcuIntgdSwGend_CM_single -100.0 100.0 /end CHARACTERISTIC
/begin CHARACTERISTIC DTqC_TCooltMap1Thd_P "Coolant High Temperature Threshold for Break Torque Map 1" VALUE 0x40041F40 /* @ECU_Address@DTqC_TCooltMap1Thd_P@ */ Scalar_FLOAT32_IEEE 0 EcuIntgdSwGend_CM_single_degC -20.0 100.0 /end CHARACTERISTIC
/begin CHARACTERISTIC DTqC_TCooltMap2Thd_P "Coolant High Temperature Threshold for Break Torque Map 2" VALUE 0x40041F44 /* @ECU_Address@DTqC_TCooltMap2Thd_P@ */ Scalar_FLOAT32_IEEE 0 EcuIntgdSwGend_CM_single_degC -20.0 100.0 /end CHARACTERISTIC
/begin CHARACTERISTIC DTqC_TCooltMap3Thd_P "Coolant High Temperature Threshold for Break Torque Map 3" VALUE 0x40041F48 /* @ECU_Address@DTqC_TCooltMap3Thd_P@ */ Scalar_FLOAT32_IEEE 0 EcuIntgdSwGend_CM_single_degC -20.0 100.0 /end CHARACTERISTIC
/begin CHARACTERISTIC DTqC_TqDesSatPIDMaxEndSpd_P "" VALUE 0x40043328 /* @ECU_Address@DTqC_TqDesSatPIDMaxEndSpd_P@ */ Scalar_FLOAT32_IEEE 0 EcuIntgdSwGend_CM_single_N_m 0.0 2000.0 /end CHARACTERISTIC
/begin CHARACTERISTIC DTqC_TqDesSatPIDMinEndSpd_P "" VALUE 0x4004332C /* @ECU_Address@DTqC_TqDesSatPIDMinEndSpd_P@ */ Scalar_FLOAT32_IEEE 0 EcuIntgdSwGend_CM_single_N_m 0.0 2000.0 /end CHARACTERISTIC
/begin CHARACTERISTIC DTqC_TqDesTSC1ReqPIDMax_P "TCU Request PID Controller Saturation Max Parameter" VALUE 0x40043334 /* @ECU_Address@DTqC_TqDesTSC1ReqPIDMax_P@ */ Scalar_FLOAT32_IEEE 0 EcuIntgdSwGend_CM_single_N_m 0.0 10000.0 /end CHARACTERISTIC
/begin CHARACTERISTIC DTqC_TqDesTSC1ReqPIDMin_P "TCU Request PID Controller Saturation Min Parameter" VALUE 0x40043338 /* @ECU_Address@DTqC_TqDesTSC1ReqPIDMin_P@ */ Scalar_FLOAT32_IEEE 0 EcuIntgdSwGend_CM_single_N_m -10000.0 10000.0 /end CHARACTERISTIC
/begin CHARACTERISTIC DTqC_TqLimdBrk1Ovv_P "Break Torque Map 1 Out - Override Value" VALUE 0x40043994 /* @ECU_Address@DTqC_TqLimdBrk1Ovv_P@ */ Scalar_FLOAT32_IEEE 0 EcuIntgdSwGend_CM_single_N_m 0.0 1000.0 /end CHARACTERISTIC
/begin CHARACTERISTIC DTqC_TqLimdBrk2Ovv_P "Break Torque Map 2 Out - Override Value" VALUE 0x4004399C /* @ECU_Address@DTqC_TqLimdBrk2Ovv_P@ */ Scalar_FLOAT32_IEEE 0 EcuIntgdSwGend_CM_single_N_m 0.0 1000.0 /end CHARACTERISTIC
/begin CHARACTERISTIC DTqC_TqLimdBrk3Ovv_P "Break Torque Map 3 Out - Override Value" VALUE 0x400439A4 /* @ECU_Address@DTqC_TqLimdBrk3Ovv_P@ */ Scalar_FLOAT32_IEEE 0 EcuIntgdSwGend_CM_single_N_m 0.0 1000.0 /end CHARACTERISTIC
/begin CHARACTERISTIC EIP_NCyl1ErrOvv_P "Cylinder 1 Speed Difference Error Parameter - Override Value" VALUE 0x400441F8 /* @ECU_Address@EIP_NCyl1ErrOvv_P@ */ Scalar_FLOAT32_IEEE 0 EcuIntgdSwGend_CM_single_rpm -100.0 100.0 /end CHARACTERISTIC
/begin CHARACTERISTIC EIP_NCyl1MinThd_P "Cylinder 1 Speed Minimium Threshold Parameter" VALUE 0x400441FC /* @ECU_Address@EIP_NCyl1MinThd_P@ */ Scalar_FLOAT32_IEEE 0 EcuIntgdSwGend_CM_single_rpm 0.0 3200.0 /end CHARACTERISTIC
/begin CHARACTERISTIC EIP_NCyl2ErrOvv_P "Cylinder 2 Speed Difference Error Parameter - Override Value" VALUE 0x40044204 /* @ECU_Address@EIP_NCyl2ErrOvv_P@ */ Scalar_FLOAT32_IEEE 0 EcuIntgdSwGend_CM_single_rpm -100.0 100.0 /end CHARACTERISTIC
/begin CHARACTERISTIC EIP_NCyl2MinThd_P "Cylinder 2 Speed Minimium Threshold Parameter" VALUE 0x40044208 /* @ECU_Address@EIP_NCyl2MinThd_P@ */ Scalar_FLOAT32_IEEE 0 EcuIntgdSwGend_CM_single_rpm 0.0 3200.0 /end CHARACTERISTIC
/begin CHARACTERISTIC EIP_NCyl3ErrOvv_P "Cylinder 3 Speed Difference Error Parameter - Override Value" VALUE 0x40044210 /* @ECU_Address@EIP_NCyl3ErrOvv_P@ */ Scalar_FLOAT32_IEEE 0 EcuIntgdSwGend_CM_single_rpm -100.0 100.0 /end CHARACTERISTIC
/begin CHARACTERISTIC EIP_NCyl3MinThd_P "Cylinder 3 Speed Minimium Threshold Parameter" VALUE 0x40044214 /* @ECU_Address@EIP_NCyl3MinThd_P@ */ Scalar_FLOAT32_IEEE 0 EcuIntgdSwGend_CM_single_rpm 0.0 3200.0 /end CHARACTERISTIC
/begin CHARACTERISTIC EIP_NCyl4ErrOvv_P "Cylinder 4 Speed Difference Error Parameter - Override Value" VALUE 0x4004421C /* @ECU_Address@EIP_NCyl4ErrOvv_P@ */ Scalar_FLOAT32_IEEE 0 EcuIntgdSwGend_CM_single_rpm -100.0 100.0 /end CHARACTERISTIC
/begin CHARACTERISTIC EIP_NCyl4MinThd_P "Cylinder 4 Speed Minimium Threshold Parameter" VALUE 0x40044220 /* @ECU_Address@EIP_NCyl4MinThd_P@ */ Scalar_FLOAT32_IEEE 0 EcuIntgdSwGend_CM_single_rpm 0.0 3200.0 /end CHARACTERISTIC
/begin CHARACTERISTIC EIP_NCyl5ErrOvv_P "Cylinder 5 Speed Difference Error Parameter - Override Value" VALUE 0x40044228 /* @ECU_Address@EIP_NCyl5ErrOvv_P@ */ Scalar_FLOAT32_IEEE 0 EcuIntgdSwGend_CM_single_rpm -100.0 100.0 /end CHARACTERISTIC
/begin CHARACTERISTIC EIP_NCyl5MinThd_P "Cylinder 5 Speed Minimium Threshold Parameter" VALUE 0x4004422C /* @ECU_Address@EIP_NCyl5MinThd_P@ */ Scalar_FLOAT32_IEEE 0 EcuIntgdSwGend_CM_single_rpm 0.0 3200.0 /end CHARACTERISTIC
/begin CHARACTERISTIC EIP_NCyl6ErrOvv_P "Cylinder 6 Speed Difference  Error Parameter - Override Value" VALUE 0x40044234 /* @ECU_Address@EIP_NCyl6ErrOvv_P@ */ Scalar_FLOAT32_IEEE 0 EcuIntgdSwGend_CM_single_rpm -100.0 100.0 /end CHARACTERISTIC
/begin CHARACTERISTIC EIP_NCyl6MinThd_P "Cylinder 6 Speed Minimium Threshold Parameter" VALUE 0x40044238 /* @ECU_Address@EIP_NCyl6MinThd_P@ */ Scalar_FLOAT32_IEEE 0 EcuIntgdSwGend_CM_single_rpm 0.0 3200.0 /end CHARACTERISTIC
/begin CHARACTERISTIC EIP_NCylMaxThd_P "Cylinder Speed Max Threshold Parameter" VALUE 0x4004423C /* @ECU_Address@EIP_NCylMaxThd_P@ */ Scalar_FLOAT32_IEEE 0 EcuIntgdSwGend_CM_single_rpm 0.0 250.0 /end CHARACTERISTIC
/begin CHARACTERISTIC EIP_NCylMinThd_P "Cylinder Speed Min Threshold Parameter" VALUE 0x40044240 /* @ECU_Address@EIP_NCylMinThd_P@ */ Scalar_FLOAT32_IEEE 0 EcuIntgdSwGend_CM_single_rpm -250.0 0.0 /end CHARACTERISTIC
/begin CHARACTERISTIC EIP_TcNCyl1MinFil_P "Low Pass Filter Time Constant for Min Cylinder Speed 1" VALUE 0x400445AC /* @ECU_Address@EIP_TcNCyl1MinFil_P@ */ Scalar_FLOAT32_IEEE 0 EcuIntgdSwGend_CM_single_ms 0.0 2500.0 /end CHARACTERISTIC
/begin CHARACTERISTIC EIP_TcNCyl2MinFil_P "Low Pass Filter Time Constant for Min Cylinder Speed 2" VALUE 0x400445B0 /* @ECU_Address@EIP_TcNCyl2MinFil_P@ */ Scalar_FLOAT32_IEEE 0 EcuIntgdSwGend_CM_single_ms 0.0 2500.0 /end CHARACTERISTIC
/begin CHARACTERISTIC EIP_TcNCyl3MinFil_P "Low Pass Filter Time Constant for Min Cylinder Speed 3" VALUE 0x400445B4 /* @ECU_Address@EIP_TcNCyl3MinFil_P@ */ Scalar_FLOAT32_IEEE 0 EcuIntgdSwGend_CM_single_ms 0.0 2500.0 /end CHARACTERISTIC
/begin CHARACTERISTIC EIP_TcNCyl4MinFil_P "Low Pass Filter Time Constant for Min Cylinder Speed 4" VALUE 0x400445B8 /* @ECU_Address@EIP_TcNCyl4MinFil_P@ */ Scalar_FLOAT32_IEEE 0 EcuIntgdSwGend_CM_single_ms 0.0 2500.0 /end CHARACTERISTIC
/begin CHARACTERISTIC EIP_TcNCyl5MinFil_P "Low Pass Filter Time Constant for Min Cylinder Speed 5" VALUE 0x400445BC /* @ECU_Address@EIP_TcNCyl5MinFil_P@ */ Scalar_FLOAT32_IEEE 0 EcuIntgdSwGend_CM_single_ms 0.0 2500.0 /end CHARACTERISTIC
/begin CHARACTERISTIC EIP_TcNCyl6MinFil_P "Low Pass Filter Time Constant for Min Cylinder Speed 6" VALUE 0x400445C0 /* @ECU_Address@EIP_TcNCyl6MinFil_P@ */ Scalar_FLOAT32_IEEE 0 EcuIntgdSwGend_CM_single_ms 0.0 2500.0 /end CHARACTERISTIC
/begin CHARACTERISTIC EIP_TcNMeaCylMin_P "Low Pass Filter Time Constant for Min Mean Cylinder Speed" VALUE 0x400445C8 /* @ECU_Address@EIP_TcNMeaCylMin_P@ */ Scalar_FLOAT32_IEEE 0 EcuIntgdSwGend_CM_single_ms 0.0 5000.0 /end CHARACTERISTIC
/begin CHARACTERISTIC IC_TCooltMap1Thd_P "Coolant High Temperature Map 1 Threshold Parameter" VALUE 0x40048424 /* @ECU_Address@IC_TCooltMap1Thd_P@ */ Scalar_FLOAT32_IEEE 0 EcuIntgdSwGend_CM_single_degC -50.0 150.0 /end CHARACTERISTIC
/begin CHARACTERISTIC IC_TCooltMap2Thd_P "Coolant High Temperature Map 2 Threshold Parameter" VALUE 0x40048428 /* @ECU_Address@IC_TCooltMap2Thd_P@ */ Scalar_FLOAT32_IEEE 0 EcuIntgdSwGend_CM_single_degC -50.0 150.0 /end CHARACTERISTIC
/begin CHARACTERISTIC IC_TCooltMap3Thd_P "Coolant High Temperature Map 3 Threshold Parameter" VALUE 0x4004842C /* @ECU_Address@IC_TCooltMap3Thd_P@ */ Scalar_FLOAT32_IEEE 0 EcuIntgdSwGend_CM_single_degC -50.0 150.0 /end CHARACTERISTIC
/begin CHARACTERISTIC RPG_IntglRstCoeffKiThd_P "Integral Reset Coefficient Integral Threshold Parameter" VALUE 0x4004962C /* @ECU_Address@RPG_IntglRstCoeffKiThd_P@ */ Scalar_FLOAT32_IEEE 0 EcuIntgdSwGend_CM_single -100.0 100.0 /end CHARACTERISTIC
/begin CHARACTERISTIC RPG_IntglRstPRailErrThd_P "Error Rail Pressure Threshold Parameter for Integral Reset" VALUE 0x40049630 /* @ECU_Address@RPG_IntglRstPRailErrThd_P@ */ Scalar_FLOAT32_IEEE 0 EcuIntgdSwGend_CM_single -1000.0 1000.0 /end CHARACTERISTIC
/begin CHARACTERISTIC RPG_IntglRstPercgVCVThd_P "Percentage VCV Threshold Parameter for Integral Reset" VALUE 0x40049634 /* @ECU_Address@RPG_IntglRstPercgVCVThd_P@ */ Scalar_FLOAT32_IEEE 0 EcuIntgdSwGend_CM_single__ 0.0 100.0 /end CHARACTERISTIC
/begin CHARACTERISTIC RPG_TiDebCoeffKiRst_P "Debounce Time Parameter of Coefficient Integral Reset" VALUE 0x4004AF28 /* @ECU_Address@RPG_TiDebCoeffKiRst_P@ */ Scalar_FLOAT32_IEEE 0 EcuIntgdSwGend_CM_single 0.0 10000.0 /end CHARACTERISTIC
/begin CHARACTERISTIC WM_ErrCylMisfDesLvlQnty_P "Cylinder Misfire Desired Severity Level Quantity Parameter" VALUE 0x400507F4 /* @ECU_Address@WM_ErrCylMisfDesLvlQnty_P@ */ Scalar_FLOAT32_IEEE 0 EcuIntgdSwGend_CM_single 0.0 3.0 /end CHARACTERISTIC
/begin CHARACTERISTIC WM_NEngDetdThdRTN_P "Return To Normal Engine Speed Level Check Threshold Parameter" VALUE 0x40050A9C /* @ECU_Address@WM_NEngDetdThdRTN_P@ */ Scalar_FLOAT32_IEEE 0 EcuIntgdSwGend_CM_single_rpm 0.0 6000.0 /end CHARACTERISTIC
/begin CHARACTERISTIC WM_NEngLvl1ClrThd_P "Global Enable Engine Speed Level 1 Check Clear Hysteresis Threshold Parameter" VALUE 0x40050AA0 /* @ECU_Address@WM_NEngLvl1ClrThd_P@ */ Scalar_FLOAT32_IEEE 0 EcuIntgdSwGend_CM_single_rpm 0.0 6000.0 /end CHARACTERISTIC
/begin CHARACTERISTIC WM_NEngLvl1DetdThd_P "Global Enable Engine Speed Level 1 Check Hysteresis Threshold Parameter" VALUE 0x40050AA4 /* @ECU_Address@WM_NEngLvl1DetdThd_P@ */ Scalar_FLOAT32_IEEE 0 EcuIntgdSwGend_CM_single_rpm 0.0 6000.0 /end CHARACTERISTIC
/begin CHARACTERISTIC WM_NEngLvl2ClrThd_P "Global Enable Engine Speed Level 2 Check Clear Hysteresis Threshold Parameter" VALUE 0x40050AA8 /* @ECU_Address@WM_NEngLvl2ClrThd_P@ */ Scalar_FLOAT32_IEEE 0 EcuIntgdSwGend_CM_single_rpm 0.0 6000.0 /end CHARACTERISTIC
/begin CHARACTERISTIC WM_NEngLvl2DetdThd_P "Global Enable Engine Speed Level 2 Check Hysteresis Threshold Parameter" VALUE 0x40050AAC /* @ECU_Address@WM_NEngLvl2DetdThd_P@ */ Scalar_FLOAT32_IEEE 0 EcuIntgdSwGend_CM_single_rpm 0.0 6000.0 /end CHARACTERISTIC
/begin CHARACTERISTIC WM_NEngLvl3ClrThd_P "Global Enable Engine Speed Level 3 Check Clear Hysteresis Threshold Parameter" VALUE 0x40050AB0 /* @ECU_Address@WM_NEngLvl3ClrThd_P@ */ Scalar_FLOAT32_IEEE 0 EcuIntgdSwGend_CM_single_rpm 0.0 6000.0 /end CHARACTERISTIC
/begin CHARACTERISTIC WM_NEngLvl3DetdThd_P "Global Enable Engine Speed Level 3 Check Hysteresis Threshold Parameter" VALUE 0x40050AB4 /* @ECU_Address@WM_NEngLvl3DetdThd_P@ */ Scalar_FLOAT32_IEEE 0 EcuIntgdSwGend_CM_single_rpm 0.0 6000.0 /end CHARACTERISTIC
/begin CHARACTERISTIC WM_NEngLvl4ClrThd_P "Global Enable Engine Speed Level 4 Check Clear Hysteresis Threshold Parameter" VALUE 0x40050AB8 /* @ECU_Address@WM_NEngLvl4ClrThd_P@ */ Scalar_FLOAT32_IEEE 0 EcuIntgdSwGend_CM_single_rpm 0.0 6000.0 /end CHARACTERISTIC
/begin CHARACTERISTIC WM_NEngLvl4DetdThd_P "Global Enable Engine Speed Level 4 Check Hysteresis Threshold Parameter" VALUE 0x40050ABC /* @ECU_Address@WM_NEngLvl4DetdThd_P@ */ Scalar_FLOAT32_IEEE 0 EcuIntgdSwGend_CM_single_rpm 0.0 6000.0 /end CHARACTERISTIC
/begin CHARACTERISTIC WM_NEngLvl5ClrThd_P "Global Enable Engine Speed Level 5 Check Clear Hysteresis Threshold Parameter" VALUE 0x40050AC0 /* @ECU_Address@WM_NEngLvl5ClrThd_P@ */ Scalar_FLOAT32_IEEE 0 EcuIntgdSwGend_CM_single_rpm 0.0 6000.0 /end CHARACTERISTIC
/begin CHARACTERISTIC WM_NEngLvl5DetdThd_P "Global Enable Engine Speed Level 5 Check Hysteresis Threshold Parameter" VALUE 0x40050AC4 /* @ECU_Address@WM_NEngLvl5DetdThd_P@ */ Scalar_FLOAT32_IEEE 0 EcuIntgdSwGend_CM_single_rpm 0.0 6000.0 /end CHARACTERISTIC
/begin CHARACTERISTIC WM_NEngLvl6ClrThd_P "Global Enable Engine Speed Level 6 Check Clear Hysteresis Threshold Parameter" VALUE 0x40050AC8 /* @ECU_Address@WM_NEngLvl6ClrThd_P@ */ Scalar_FLOAT32_IEEE 0 EcuIntgdSwGend_CM_single_rpm 0.0 6000.0 /end CHARACTERISTIC
/begin CHARACTERISTIC WM_NEngLvl6DetdThd_P "Global Enable Engine Speed Level 6 Check Hysteresis Threshold Parameter" VALUE 0x40050ACC /* @ECU_Address@WM_NEngLvl6DetdThd_P@ */ Scalar_FLOAT32_IEEE 0 EcuIntgdSwGend_CM_single_rpm 0.0 6000.0 /end CHARACTERISTIC
/begin CHARACTERISTIC WM_NEngLvl7ClrThd_P "Global Enable Engine Speed Level 7 Check Clear Hysteresis Threshold Parameter" VALUE 0x40050AD0 /* @ECU_Address@WM_NEngLvl7ClrThd_P@ */ Scalar_FLOAT32_IEEE 0 EcuIntgdSwGend_CM_single_rpm 0.0 6000.0 /end CHARACTERISTIC
/begin CHARACTERISTIC WM_NEngLvl7DetdThd_P "Global Enable Engine Speed Level 7 Check Hysteresis Threshold Parameter" VALUE 0x40050AD4 /* @ECU_Address@WM_NEngLvl7DetdThd_P@ */ Scalar_FLOAT32_IEEE 0 EcuIntgdSwGend_CM_single_rpm 0.0 6000.0 /end CHARACTERISTIC
/begin CHARACTERISTIC WM_PAirBoostOvDesLvlQnty_P "Air Boost Pressure Over Desired Severity Level Quantity Parameter" VALUE 0x40050AFC /* @ECU_Address@WM_PAirBoostOvDesLvlQnty_P@ */ Scalar_FLOAT32_IEEE 0 EcuIntgdSwGend_CM_single 0.0 3.0 /end CHARACTERISTIC
/begin CHARACTERISTIC WM_PAirBoostOvHysDeacLvl1_P "Air Boost Pressure Over Level 1 Hysteresis Deactivation Parameter" VALUE 0x40050B00 /* @ECU_Address@WM_PAirBoostOvHysDeacLvl1_P@ */ Scalar_FLOAT32_IEEE 0 EcuIntgdSwGend_CM_single_mbar 0.0 15000.0 /end CHARACTERISTIC
/begin CHARACTERISTIC WM_PAirBoostOvHysDeacLvl2_P "Air Boost Pressure Over Level 2 Hysteresis Deactivation Parameter" VALUE 0x40050B04 /* @ECU_Address@WM_PAirBoostOvHysDeacLvl2_P@ */ Scalar_FLOAT32_IEEE 0 EcuIntgdSwGend_CM_single_mbar 0.0 15000.0 /end CHARACTERISTIC
/begin CHARACTERISTIC WM_PAirBoostOvHysDeacLvl3_P "Air Boost Pressure Over Level 3 Hysteresis Deactivation Parameter" VALUE 0x40050B08 /* @ECU_Address@WM_PAirBoostOvHysDeacLvl3_P@ */ Scalar_FLOAT32_IEEE 0 EcuIntgdSwGend_CM_single_mbar 0.0 15000.0 /end CHARACTERISTIC
/begin CHARACTERISTIC WM_TiErrCylMisfDeb_P "Cylinder Misfire Error Debouncer Time Parameter" VALUE 0x400510D4 /* @ECU_Address@WM_TiErrCylMisfDeb_P@ */ Scalar_FLOAT32_IEEE 0 EcuIntgdSwGend_CM_single_ms 0.0 25000.0 /end CHARACTERISTIC
/begin CHARACTERISTIC WM_TiMaxNEngDetdThdRTN_P "Engine Speed Over Threshold Return to Normal Debouncer Parameter" VALUE 0x400510D8 /* @ECU_Address@WM_TiMaxNEngDetdThdRTN_P@ */ Scalar_FLOAT32_IEEE 0 EcuIntgdSwGend_CM_single_ms 0.0 25000.0 /end CHARACTERISTIC
/begin CHARACTERISTIC WM_TiPAirBoostOvDebHi_P "Air Boost Pressure Over Debouncer High Time Parameter" VALUE 0x400510DC /* @ECU_Address@WM_TiPAirBoostOvDebHi_P@ */ Scalar_FLOAT32_IEEE 0 EcuIntgdSwGend_CM_single_ms 0.0 25000.0 /end CHARACTERISTIC
/begin CHARACTERISTIC WM_TiPAirBoostOvDebLo_P "Air Boost Pressure Over Debouncer Low Time Parameter" VALUE 0x400510E0 /* @ECU_Address@WM_TiPAirBoostOvDebLo_P@ */ Scalar_FLOAT32_IEEE 0 EcuIntgdSwGend_CM_single_ms 0.0 25000.0 /end CHARACTERISTIC
/begin CHARACTERISTIC WM_TiUClmp30OvDebHi_P "Battery Voltage Over Debouncer High Time Parameter" VALUE 0x40051184 /* @ECU_Address@WM_TiUClmp30OvDebHi_P@ */ Scalar_FLOAT32_IEEE 0 EcuIntgdSwGend_CM_single_ms 0.0 25000.0 /end CHARACTERISTIC
/begin CHARACTERISTIC WM_TiUClmp30OvDebLo_P "Battery Voltage Over Debouncer Low Time Parameter" VALUE 0x40051188 /* @ECU_Address@WM_TiUClmp30OvDebLo_P@ */ Scalar_FLOAT32_IEEE 0 EcuIntgdSwGend_CM_single_ms 0.0 25000.0 /end CHARACTERISTIC
/begin CHARACTERISTIC WM_TiUClmp30UndDebHi_P "Battery Voltage Under Debouncer High Time Parameter" VALUE 0x4005118C /* @ECU_Address@WM_TiUClmp30UndDebHi_P@ */ Scalar_FLOAT32_IEEE 0 EcuIntgdSwGend_CM_single_ms 0.0 25000.0 /end CHARACTERISTIC
/begin CHARACTERISTIC WM_TiUClmp30UndDebLo_P "Battery Voltage Under Debouncer Low Time Parameter" VALUE 0x40051190 /* @ECU_Address@WM_TiUClmp30UndDebLo_P@ */ Scalar_FLOAT32_IEEE 0 EcuIntgdSwGend_CM_single_ms 0.0 25000.0 /end CHARACTERISTIC
/begin CHARACTERISTIC WM_UClmp30OvDesLvlQnty_P "Battery Voltage Over Desired Severity Level Quantity Parameter" VALUE 0x40051194 /* @ECU_Address@WM_UClmp30OvDesLvlQnty_P@ */ Scalar_FLOAT32_IEEE 0 EcuIntgdSwGend_CM_single 0.0 3.0 /end CHARACTERISTIC
/begin CHARACTERISTIC WM_UClmp30OvHysDeacLvl1_P "Battery Voltage Over Level 1 Hysteresis Deactivation Parameter" VALUE 0x40051198 /* @ECU_Address@WM_UClmp30OvHysDeacLvl1_P@ */ Scalar_FLOAT32_IEEE 0 EcuIntgdSwGend_CM_single_V 0.0 50.0 /end CHARACTERISTIC
/begin CHARACTERISTIC WM_UClmp30OvHysDeacLvl2_P "Battery Voltage Over Level 2 Hysteresis Deactivation Parameter" VALUE 0x4005119C /* @ECU_Address@WM_UClmp30OvHysDeacLvl2_P@ */ Scalar_FLOAT32_IEEE 0 EcuIntgdSwGend_CM_single_V 0.0 50.0 /end CHARACTERISTIC
/begin CHARACTERISTIC WM_UClmp30OvHysDeacLvl3_P "Battery Voltage Over Level 3 Hysteresis Deactivation Parameter" VALUE 0x400511A0 /* @ECU_Address@WM_UClmp30OvHysDeacLvl3_P@ */ Scalar_FLOAT32_IEEE 0 EcuIntgdSwGend_CM_single_V 0.0 50.0 /end CHARACTERISTIC
/begin CHARACTERISTIC WM_UClmp30UndDesLvlQnty_P "Battery Voltage Under Desired Severity Level Quantity Parameter" VALUE 0x400511E0 /* @ECU_Address@WM_UClmp30UndDesLvlQnty_P@ */ Scalar_FLOAT32_IEEE 0 EcuIntgdSwGend_CM_single 0.0 3.0 /end CHARACTERISTIC
/begin CHARACTERISTIC WM_UClmp30UndHysDeacLvl1_P "Battery Voltage Under Level 1 Hysteresis Deactivation Parameter" VALUE 0x400511E4 /* @ECU_Address@WM_UClmp30UndHysDeacLvl1_P@ */ Scalar_FLOAT32_IEEE 0 EcuIntgdSwGend_CM_single_V 0.0 50.0 /end CHARACTERISTIC
/begin CHARACTERISTIC WM_UClmp30UndHysDeacLvl2_P "Battery Voltage Under Level 2 Hysteresis Deactivation Parameter" VALUE 0x400511E8 /* @ECU_Address@WM_UClmp30UndHysDeacLvl2_P@ */ Scalar_FLOAT32_IEEE 0 EcuIntgdSwGend_CM_single_V 0.0 50.0 /end CHARACTERISTIC
/begin CHARACTERISTIC WM_UClmp30UndHysDeacLvl3_P "Battery Voltage Under Level 3 Hysteresis Deactivation Parameter" VALUE 0x400511EC /* @ECU_Address@WM_UClmp30UndHysDeacLvl3_P@ */ Scalar_FLOAT32_IEEE 0 EcuIntgdSwGend_CM_single_V 0.0 50.0 /end CHARACTERISTIC
/begin CHARACTERISTIC WgC_DutySatPIDMax_P "PID Duty Max Saturation Parameter" VALUE 0x40051458 /* @ECU_Address@WgC_DutySatPIDMax_P@ */ Scalar_FLOAT32_IEEE 0 EcuIntgdSwGend_CM_single__ -100.0 100.0 /end CHARACTERISTIC
/begin CHARACTERISTIC WgC_DutySatPIDMin_P "PID Duty Min Saturation Parameter" VALUE 0x4005145C /* @ECU_Address@WgC_DutySatPIDMin_P@ */ Scalar_FLOAT32_IEEE 0 EcuIntgdSwGend_CM_single__ -100.0 100.0 /end CHARACTERISTIC
/begin CHARACTERISTIC WgC_FacSclPIDCoeff_P "PID Scaling Coefficient Factor Parameter" VALUE 0x40051B84 /* @ECU_Address@WgC_FacSclPIDCoeff_P@ */ Scalar_FLOAT32_IEEE 0 EcuIntgdSwGend_CM_single 1.0 10000.0 /end CHARACTERISTIC
/begin CHARACTERISTIC WgC_NTrbChrgOvv_P "Turbo Charge Speed - Override Value Parameter" VALUE 0x40051E7C /* @ECU_Address@WgC_NTrbChrgOvv_P@ */ Scalar_FLOAT32_IEEE 0 EcuIntgdSwGend_CM_single_rpm 0.0 150000.0 /end CHARACTERISTIC
/begin CHARACTERISTIC WgC_PIDCoeffDOvv_P "PID D Coeffcient - Override Value Parameter" VALUE 0x40052408 /* @ECU_Address@WgC_PIDCoeffDOvv_P@ */ Scalar_FLOAT32_IEEE 0 EcuIntgdSwGend_CM_single 0.0 10000.0 /end CHARACTERISTIC
/begin CHARACTERISTIC WgC_PIDCoeffFiltOvv_P "PID Filter Coeffcient - Override Value Parameter" VALUE 0x40052410 /* @ECU_Address@WgC_PIDCoeffFiltOvv_P@ */ Scalar_FLOAT32_IEEE 0 EcuIntgdSwGend_CM_single 0.0 10000.0 /end CHARACTERISTIC
/begin CHARACTERISTIC WgC_PIDCoeffIOvv_P "PID I Coefficient - Override Value Parameter" VALUE 0x40052418 /* @ECU_Address@WgC_PIDCoeffIOvv_P@ */ Scalar_FLOAT32_IEEE 0 EcuIntgdSwGend_CM_single 0.0 10000.0 /end CHARACTERISTIC
/begin CHARACTERISTIC WgC_PIDCoeffPOvv_P "PID P Coefficient - Override Value Parameter" VALUE 0x40052420 /* @ECU_Address@WgC_PIDCoeffPOvv_P@ */ Scalar_FLOAT32_IEEE 0 EcuIntgdSwGend_CM_single 0.0 10000.0 /end CHARACTERISTIC
/begin CHARACTERISTIC WgC_VolEng_P "Engine Volume Parameter" VALUE 0x400530FC /* @ECU_Address@WgC_VolEng_P@ */ Scalar_FLOAT32_IEEE 0 EcuIntgdSwGend_CM_single 0.0 100.0 /end CHARACTERISTIC
/begin CHARACTERISTIC WM_MaskErrCylMisfEnaCond_P "Cylinder Misfire Global Enable Condition Parameter" VALUE 0x400507F8 /* @ECU_Address@WM_MaskErrCylMisfEnaCond_P@ */ Scalar_ULONG 0 EcuIntgdSwGend_CM_uint32 0.0 4.294967295E+9 /end CHARACTERISTIC
/begin CHARACTERISTIC WM_MaskPAirBoostOvEnaCond_P "Airboost Pressure Over Global Enable Condition Parameter" VALUE 0x40050804 /* @ECU_Address@WM_MaskPAirBoostOvEnaCond_P@ */ Scalar_ULONG 0 EcuIntgdSwGend_CM_uint32 0.0 4.294967295E+9 /end CHARACTERISTIC
/begin CHARACTERISTIC WM_MaskRTNForErrCylMisf_P "Return To Normal Mask for Cylinder Misfire Parameter" VALUE 0x4005084C /* @ECU_Address@WM_MaskRTNForErrCylMisf_P@ */ Scalar_ULONG 0 EcuIntgdSwGend_CM_uint32 0.0 4.294967295E+9 /end CHARACTERISTIC
/begin CHARACTERISTIC WM_MaskRTNForErrPAirBoostOv_P "Return To Normal Mask for Air Boost Pressure Over Parameter" VALUE 0x40050854 /* @ECU_Address@WM_MaskRTNForErrPAirBoostOv_P@ */ Scalar_ULONG 0 EcuIntgdSwGend_CM_uint32 0.0 4.294967295E+9 /end CHARACTERISTIC
/begin CHARACTERISTIC WM_MaskRTNForErrUClmp30Ov_P "Return To Normal Mask for Battery Voltage Over Parameter" VALUE 0x400508A4 /* @ECU_Address@WM_MaskRTNForErrUClmp30Ov_P@ */ Scalar_ULONG 0 EcuIntgdSwGend_CM_uint32 0.0 4.294967295E+9 /end CHARACTERISTIC
/begin CHARACTERISTIC WM_MaskRTNForErrUClmp30Und_P "Return To Normal Mask for Battery Voltage Under Parameter" VALUE 0x400508A8 /* @ECU_Address@WM_MaskRTNForErrUClmp30Und_P@ */ Scalar_ULONG 0 EcuIntgdSwGend_CM_uint32 0.0 4.294967295E+9 /end CHARACTERISTIC
/begin CHARACTERISTIC WM_MaskRTNOvv_P "Return To Normal Mask - Override Parameter" VALUE 0x400508B4 /* @ECU_Address@WM_MaskRTNOvv_P@ */ Scalar_ULONG 0 EcuIntgdSwGend_CM_uint32 0.0 4.294967295E+9 /end CHARACTERISTIC
/begin CHARACTERISTIC WM_MaskRctnForErrCylMisfLvl1Err_P "Mask Reaction for Cylinder Misfire Level 1 Error Parameter" VALUE 0x400508D8 /* @ECU_Address@WM_MaskRctnForErrCylMisfLvl1Err_P@ */ Scalar_ULONG 0 EcuIntgdSwGend_CM_uint32 0.0 4.294967295E+9 /end CHARACTERISTIC
/begin CHARACTERISTIC WM_MaskRctnForErrCylMisfLvl2Err_P "Mask Reaction for Cylinder Misfire Level 2 Error Parameter" VALUE 0x400508DC /* @ECU_Address@WM_MaskRctnForErrCylMisfLvl2Err_P@ */ Scalar_ULONG 0 EcuIntgdSwGend_CM_uint32 0.0 4.294967295E+9 /end CHARACTERISTIC
/begin CHARACTERISTIC WM_MaskRctnForErrCylMisfLvl3Err_P "Mask Reaction for Cylinder Misfire Level 3 Error Parameter" VALUE 0x400508E0 /* @ECU_Address@WM_MaskRctnForErrCylMisfLvl3Err_P@ */ Scalar_ULONG 0 EcuIntgdSwGend_CM_uint32 0.0 4.294967295E+9 /end CHARACTERISTIC
/begin CHARACTERISTIC WM_MaskRctnForPAirBoostOvLvl1Err_P "Mask Reaction for Air Boost Pressure Over Level 1 Error Parameter" VALUE 0x400508E8 /* @ECU_Address@WM_MaskRctnForPAirBoostOvLvl1Err_P@ */ Scalar_ULONG 0 EcuIntgdSwGend_CM_uint32 0.0 4.294967295E+9 /end CHARACTERISTIC
/begin CHARACTERISTIC WM_MaskRctnForPAirBoostOvLvl2Err_P "Mask Reaction for Air Boost Pressure Over Level 2 Error Parameter" VALUE 0x400508EC /* @ECU_Address@WM_MaskRctnForPAirBoostOvLvl2Err_P@ */ Scalar_ULONG 0 EcuIntgdSwGend_CM_uint32 0.0 4.294967295E+9 /end CHARACTERISTIC
/begin CHARACTERISTIC WM_MaskRctnForPAirBoostOvLvl3Err_P "Mask Reaction for Air Boost Pressure Over Level 3 Error Parameter" VALUE 0x400508F0 /* @ECU_Address@WM_MaskRctnForPAirBoostOvLvl3Err_P@ */ Scalar_ULONG 0 EcuIntgdSwGend_CM_uint32 0.0 4.294967295E+9 /end CHARACTERISTIC
/begin CHARACTERISTIC WM_MaskRctnForUClmp30OvLvl1Err_P "Mask Reaction for Battery Voltage Over Level 1 Error Parameter" VALUE 0x400509DC /* @ECU_Address@WM_MaskRctnForUClmp30OvLvl1Err_P@ */ Scalar_ULONG 0 EcuIntgdSwGend_CM_uint32 0.0 4.294967295E+9 /end CHARACTERISTIC
/begin CHARACTERISTIC WM_MaskRctnForUClmp30OvLvl2Err_P "Mask Reaction for Battery Voltage Over Level 2 Error Parameter" VALUE 0x400509E0 /* @ECU_Address@WM_MaskRctnForUClmp30OvLvl2Err_P@ */ Scalar_ULONG 0 EcuIntgdSwGend_CM_uint32 0.0 4.294967295E+9 /end CHARACTERISTIC
/begin CHARACTERISTIC WM_MaskRctnForUClmp30OvLvl3Err_P "Mask Reaction for Battery Voltage Over Level 3 Error Parameter" VALUE 0x400509E4 /* @ECU_Address@WM_MaskRctnForUClmp30OvLvl3Err_P@ */ Scalar_ULONG 0 EcuIntgdSwGend_CM_uint32 0.0 4.294967295E+9 /end CHARACTERISTIC
/begin CHARACTERISTIC WM_MaskRctnForUClmp30UndLvl1Err_P "Mask Reaction for Battery Voltage Under Level 1 Error Parameter" VALUE 0x400509E8 /* @ECU_Address@WM_MaskRctnForUClmp30UndLvl1Err_P@ */ Scalar_ULONG 0 EcuIntgdSwGend_CM_uint32 0.0 4.294967295E+9 /end CHARACTERISTIC
/begin CHARACTERISTIC WM_MaskRctnForUClmp30UndLvl2Err_P "Mask Reaction for Battery Voltage Under Level 2 Error Parameter" VALUE 0x400509EC /* @ECU_Address@WM_MaskRctnForUClmp30UndLvl2Err_P@ */ Scalar_ULONG 0 EcuIntgdSwGend_CM_uint32 0.0 4.294967295E+9 /end CHARACTERISTIC
/begin CHARACTERISTIC WM_MaskRctnForUClmp30UndLvl3Err_P "Mask Reaction for Battery Voltage Under Level 3 Error Parameter" VALUE 0x400509F0 /* @ECU_Address@WM_MaskRctnForUClmp30UndLvl3Err_P@ */ Scalar_ULONG 0 EcuIntgdSwGend_CM_uint32 0.0 4.294967295E+9 /end CHARACTERISTIC
/begin CHARACTERISTIC WM_MaskUClmp30OvEnaCond_P "Battery Voltage Over Global Enable Condition Parameter" VALUE 0x40050A94 /* @ECU_Address@WM_MaskUClmp30OvEnaCond_P@ */ Scalar_ULONG 0 EcuIntgdSwGend_CM_uint32 0.0 4.294967295E+9 /end CHARACTERISTIC
/begin CHARACTERISTIC WM_MaskUClmp30UndEnaCond_P "Battery Voltage Under Global Enable Condition Parameter" VALUE 0x40050A98 /* @ECU_Address@WM_MaskUClmp30UndEnaCond_P@ */ Scalar_ULONG 0 EcuIntgdSwGend_CM_uint32 0.0 4.294967295E+9 /end CHARACTERISTIC
/begin CHARACTERISTIC DTqC_CoeffFiltKdEndSpdCtlOvs_P "" VALUE 0x40041078 /* @ECU_Address@DTqC_CoeffFiltKdEndSpdCtlOvs_P@ */ Scalar_BOOLEAN 0 EcuIntgdSwGend_CM_boolean 0.0 1.0 /end CHARACTERISTIC
/begin CHARACTERISTIC DTqC_CoeffFiltTSC1SpdCtlOvs_P "Derivative Coefficient Parameter for TCU Request Speed Controller - Override Switch" VALUE 0x40041088 /* @ECU_Address@DTqC_CoeffFiltTSC1SpdCtlOvs_P@ */ Scalar_BOOLEAN 0 EcuIntgdSwGend_CM_boolean 0.0 1.0 /end CHARACTERISTIC
/begin CHARACTERISTIC DTqC_HardLimEnaSwt_P "" VALUE 0x40041A58 /* @ECU_Address@DTqC_HardLimEnaSwt_P@ */ Scalar_BOOLEAN 0 EcuIntgdSwGend_CM_boolean 0.0 1.0 /end CHARACTERISTIC
/begin CHARACTERISTIC DTqC_KdEndSpdCtlOvs_P "" VALUE 0x40041BF8 /* @ECU_Address@DTqC_KdEndSpdCtlOvs_P@ */ Scalar_BOOLEAN 0 EcuIntgdSwGend_CM_boolean 0.0 1.0 /end CHARACTERISTIC
/begin CHARACTERISTIC DTqC_KdTSC1SpdCtlOvs_P "Derivative Coefficient Parameter for TCU Request Speed Controller - Override Switch" VALUE 0x40041C08 /* @ECU_Address@DTqC_KdTSC1SpdCtlOvs_P@ */ Scalar_BOOLEAN 0 EcuIntgdSwGend_CM_boolean 0.0 1.0 /end CHARACTERISTIC
/begin CHARACTERISTIC DTqC_KiEndSpdCtlOvs_P "" VALUE 0x40041C10 /* @ECU_Address@DTqC_KiEndSpdCtlOvs_P@ */ Scalar_BOOLEAN 0 EcuIntgdSwGend_CM_boolean 0.0 1.0 /end CHARACTERISTIC
/begin CHARACTERISTIC DTqC_KiTSC1SpdCtlOvs_P "Integrator Coefficient Parameter for TCU Request Speed Controller - Override Switch" VALUE 0x40041C20 /* @ECU_Address@DTqC_KiTSC1SpdCtlOvs_P@ */ Scalar_BOOLEAN 0 EcuIntgdSwGend_CM_boolean 0.0 1.0 /end CHARACTERISTIC
/begin CHARACTERISTIC DTqC_KpEndSpdCtlOvs_P "" VALUE 0x40041C28 /* @ECU_Address@DTqC_KpEndSpdCtlOvs_P@ */ Scalar_BOOLEAN 0 EcuIntgdSwGend_CM_boolean 0.0 1.0 /end CHARACTERISTIC
/begin CHARACTERISTIC DTqC_KpTSC1SpdCtlOvs_P "Proportional Coefficient Parameter for TCU Request Speed Controller - Override Switch" VALUE 0x40041C38 /* @ECU_Address@DTqC_KpTSC1SpdCtlOvs_P@ */ Scalar_BOOLEAN 0 EcuIntgdSwGend_CM_boolean 0.0 1.0 /end CHARACTERISTIC
/begin CHARACTERISTIC DTqC_SoftLimEnaSwt_P "" VALUE 0x40041E74 /* @ECU_Address@DTqC_SoftLimEnaSwt_P@ */ Scalar_BOOLEAN 0 EcuIntgdSwGend_CM_boolean 0.0 1.0 /end CHARACTERISTIC
/begin CHARACTERISTIC DTqC_TqLimdBrk1Ovs_P "Break Torque Map 1 Out - Override Switch" VALUE 0x40043990 /* @ECU_Address@DTqC_TqLimdBrk1Ovs_P@ */ Scalar_BOOLEAN 0 EcuIntgdSwGend_CM_boolean 0.0 1.0 /end CHARACTERISTIC
/begin CHARACTERISTIC DTqC_TqLimdBrk2Ovs_P "Break Torque Map 2 Out - Override Switch" VALUE 0x40043998 /* @ECU_Address@DTqC_TqLimdBrk2Ovs_P@ */ Scalar_BOOLEAN 0 EcuIntgdSwGend_CM_boolean 0.0 1.0 /end CHARACTERISTIC
/begin CHARACTERISTIC DTqC_TqLimdBrk3Ovs_P "Break Torque Map 3 Out - Override Switch" VALUE 0x400439A0 /* @ECU_Address@DTqC_TqLimdBrk3Ovs_P@ */ Scalar_BOOLEAN 0 EcuIntgdSwGend_CM_boolean 0.0 1.0 /end CHARACTERISTIC
/begin CHARACTERISTIC EIP_NCyl1ErrOvs_P "Cylinder 1 Speed Difference Error Parameter - Override Switch" VALUE 0x400441F4 /* @ECU_Address@EIP_NCyl1ErrOvs_P@ */ Scalar_BOOLEAN 0 EcuIntgdSwGend_CM_boolean 0.0 1.0 /end CHARACTERISTIC
/begin CHARACTERISTIC EIP_NCyl2ErrOvs_P "Cylinder 2 Speed Difference Error Parameter - Override Switch" VALUE 0x40044200 /* @ECU_Address@EIP_NCyl2ErrOvs_P@ */ Scalar_BOOLEAN 0 EcuIntgdSwGend_CM_boolean 0.0 1.0 /end CHARACTERISTIC
/begin CHARACTERISTIC EIP_NCyl3ErrOvs_P "Cylinder 3 Speed Difference Error Parameter - Override Switch" VALUE 0x4004420C /* @ECU_Address@EIP_NCyl3ErrOvs_P@ */ Scalar_BOOLEAN 0 EcuIntgdSwGend_CM_boolean 0.0 1.0 /end CHARACTERISTIC
/begin CHARACTERISTIC EIP_NCyl4ErrOvs_P "Cylinder 4 Speed Difference Error Parameter - Override Switch" VALUE 0x40044218 /* @ECU_Address@EIP_NCyl4ErrOvs_P@ */ Scalar_BOOLEAN 0 EcuIntgdSwGend_CM_boolean 0.0 1.0 /end CHARACTERISTIC
/begin CHARACTERISTIC EIP_NCyl5ErrOvs_P "Cylinder 5 Speed Difference Error Parameter - Override Switch" VALUE 0x40044224 /* @ECU_Address@EIP_NCyl5ErrOvs_P@ */ Scalar_BOOLEAN 0 EcuIntgdSwGend_CM_boolean 0.0 1.0 /end CHARACTERISTIC
/begin CHARACTERISTIC EIP_NCyl6ErrOvs_P "Cylinder 6 Speed Difference Error Parameter - Override Switch" VALUE 0x40044230 /* @ECU_Address@EIP_NCyl6ErrOvs_P@ */ Scalar_BOOLEAN 0 EcuIntgdSwGend_CM_boolean 0.0 1.0 /end CHARACTERISTIC
/begin CHARACTERISTIC RPG_bCoeffKiRstOvs_P "Coefficient Integral Reset Ovverride Switch Parameter" VALUE 0x4004B034 /* @ECU_Address@RPG_bCoeffKiRstOvs_P@ */ Scalar_BOOLEAN 0 EcuIntgdSwGend_CM_boolean 0.0 1.0 /end CHARACTERISTIC
/begin CHARACTERISTIC RPG_bCoeffKiRstOvv_P "Coefficient Integral Reset Ovverride Value Parameter" VALUE 0x4004B038 /* @ECU_Address@RPG_bCoeffKiRstOvv_P@ */ Scalar_BOOLEAN 0 EcuIntgdSwGend_CM_boolean 0.0 1.0 /end CHARACTERISTIC
/begin CHARACTERISTIC WM_MaskRTNOvs_P "Return To Normal Mask - Override Switch Parameter" VALUE 0x400508B0 /* @ECU_Address@WM_MaskRTNOvs_P@ */ Scalar_BOOLEAN 0 EcuIntgdSwGend_CM_boolean 0.0 1.0 /end CHARACTERISTIC
/begin CHARACTERISTIC WgC_NTrbChrgOvs_P "Turbo Charge Speed - Override Switch Param" VALUE 0x40051E78 /* @ECU_Address@WgC_NTrbChrgOvs_P@ */ Scalar_BOOLEAN 0 EcuIntgdSwGend_CM_boolean 0.0 1.0 /end CHARACTERISTIC
/begin CHARACTERISTIC WgC_PIDCoeffDOvs_P "PID D Coeffcient - Override Switch Parameter" VALUE 0x40052404 /* @ECU_Address@WgC_PIDCoeffDOvs_P@ */ Scalar_BOOLEAN 0 EcuIntgdSwGend_CM_boolean 0.0 1.0 /end CHARACTERISTIC
/begin CHARACTERISTIC WgC_PIDCoeffFiltOvs_P "PID Filter Coeffcient - Override Switch Parameter" VALUE 0x4005240C /* @ECU_Address@WgC_PIDCoeffFiltOvs_P@ */ Scalar_BOOLEAN 0 EcuIntgdSwGend_CM_boolean 0.0 1.0 /end CHARACTERISTIC
/begin CHARACTERISTIC WgC_PIDCoeffIOvs_P "PID I Coefficient - Override Switch Parameter" VALUE 0x40052414 /* @ECU_Address@WgC_PIDCoeffIOvs_P@ */ Scalar_BOOLEAN 0 EcuIntgdSwGend_CM_boolean 0.0 1.0 /end CHARACTERISTIC
/begin CHARACTERISTIC WgC_PIDCoeffPOvs_P "PID P Coefficient - Override Switch Parameter" VALUE 0x4005241C /* @ECU_Address@WgC_PIDCoeffPOvs_P@ */ Scalar_BOOLEAN 0 EcuIntgdSwGend_CM_boolean 0.0 1.0 /end CHARACTERISTIC
/begin MEASUREMENT WM_MaskRTN "Return To Normal Mask" ULONG EcuIntgdSwGend_CM_uint32 0 0 0.0 4.294967295E+9 ECU_ADDRESS 0x4000D6A0 /* @ECU_Address@WM_MaskRTN@ */ /end MEASUREMENT
/begin MEASUREMENT WM_MaskRctnForPAirBoostOvErr "Mask Reaction for Air Boost Pressure Over Error" ULONG EcuIntgdSwGend_CM_uint32 0 0 0.0 4.294967295E+9 ECU_ADDRESS 0x4000E284 /* @ECU_Address@WM_MaskRctnForPAirBoostOvErr@ */ /end MEASUREMENT
/begin MEASUREMENT WM_MaskRctnForUClmp30OvErr "Mask Reaction for Battery Voltage Over Error" ULONG EcuIntgdSwGend_CM_uint32 0 0 0.0 4.294967295E+9 ECU_ADDRESS 0x4000D7D8 /* @ECU_Address@WM_MaskRctnForUClmp30OvErr@ */ /end MEASUREMENT
/begin MEASUREMENT WM_MaskRctnForUClmp30UndErr "Mask Reaction for Battery Voltage Under Error " ULONG EcuIntgdSwGend_CM_uint32 0 0 0.0 4.294967295E+9 ECU_ADDRESS 0x4000D6C8 /* @ECU_Address@WM_MaskRctnForUClmp30UndErr@ */ /end MEASUREMENT
/begin MEASUREMENT WM_MaskRctnForErrCylMisfErr "Mask Reaction for Cylinder Misfire Error" ULONG EcuIntgdSwGend_CM_uint32 0 0 0.0 4.294967295E+9 ECU_ADDRESS 0x4000E6FC /* @ECU_Address@WM_MaskRctnForErrCylMisfErr@ */ /end MEASUREMENT
/begin MEASUREMENT WgC_VolEff "Volumetric Efficiency" FLOAT32_IEEE EcuIntgdSwGend_CM_single 0 0 0.0 1000.0 ECU_ADDRESS 0x4000E688 /* @ECU_Address@WgC_VolEff@ */ /end MEASUREMENT
/begin MEASUREMENT WgC_AirMassFlowCalcMultiOut "Air Mass Flow Calculation Multiplication Output" FLOAT32_IEEE EcuIntgdSwGend_CM_single 0 0 -20000.0 20000.0 ECU_ADDRESS 0x4000E20C /* @ECU_Address@WgC_AirMassFlowCalcMultiOut@ */ /end MEASUREMENT
/begin MEASUREMENT WgC_MAirFlow "Mass Air Flow" FLOAT32_IEEE EcuIntgdSwGend_CM_single_kg_s 0 0 0.0 1000.0 ECU_ADDRESS 0x4000DFB8 /* @ECU_Address@WgC_MAirFlow@ */ /end MEASUREMENT
/begin MEASUREMENT WgC_PDropIcoMapOut "Pressure Drop Map Out" FLOAT32_IEEE EcuIntgdSwGend_CM_single_mbar 0 0 0.0 1000.0 ECU_ADDRESS 0x4000E530 /* @ECU_Address@WgC_PDropIcoMapOut@ */ /end MEASUREMENT
/begin MEASUREMENT WgC_PCmprInltCalcd "Compressor Inlet Pressure Calculated" FLOAT32_IEEE EcuIntgdSwGend_CM_single_mbar 0 0 -1000.0 3000.0 ECU_ADDRESS 0x4000E0C0 /* @ECU_Address@WgC_PCmprInltCalcd@ */ /end MEASUREMENT
/begin MEASUREMENT WgC_PCmprOutltMapOut "Compressor Outlet Pressure Calculated Map Out" FLOAT32_IEEE EcuIntgdSwGend_CM_single 0 0 0.0 1000.0 ECU_ADDRESS 0x4000DC88 /* @ECU_Address@WgC_PCmprOutltMapOut@ */ /end MEASUREMENT
/begin MEASUREMENT WgC_PCmprOutltCalcd "Compressor Outlet Pressure Calculated" FLOAT32_IEEE EcuIntgdSwGend_CM_single_mbar 0 0 -5000.0 5000.0 ECU_ADDRESS 0x4000E5F0 /* @ECU_Address@WgC_PCmprOutltCalcd@ */ /end MEASUREMENT
/begin MEASUREMENT WgC_RatPCmpr "Compressor Pressure Ratio" FLOAT32_IEEE EcuIntgdSwGend_CM_single 0 0 0.0 1000.0 ECU_ADDRESS 0x4000DA98 /* @ECU_Address@WgC_RatPCmpr@ */ /end MEASUREMENT
/begin MEASUREMENT WgC_MCorrAirFlowTCmprInlt "Mass Air Flow Correction for Compressor Inlet Temperature Map" FLOAT32_IEEE EcuIntgdSwGend_CM_single_kg_s 0 0 0.0 1000.0 ECU_ADDRESS 0x4000D880 /* @ECU_Address@WgC_MCorrAirFlowTCmprInlt@ */ /end MEASUREMENT
/begin MEASUREMENT WgC_MCorrAirFlowPCmprInlt "Mass Air Flow Correction for Compressor Inlet Pressure" FLOAT32_IEEE EcuIntgdSwGend_CM_single 0 0 0.0 1000.0 ECU_ADDRESS 0x4000DA8C /* @ECU_Address@WgC_MCorrAirFlowPCmprInlt@ */ /end MEASUREMENT
/begin MEASUREMENT WgC_MCorrdAirFlow "Corrected Mass Air Flow" FLOAT32_IEEE EcuIntgdSwGend_CM_single_kg_s 0 0 0.0 100.0 ECU_ADDRESS 0x4000DCB4 /* @ECU_Address@WgC_MCorrdAirFlow@ */ /end MEASUREMENT
/begin MEASUREMENT WgC_DifSurgeLine "Surge Line Difference" FLOAT32_IEEE EcuIntgdSwGend_CM_single 0 0 -100.0 100.0 ECU_ADDRESS 0x4000E3AC /* @ECU_Address@WgC_DifSurgeLine@ */ /end MEASUREMENT
/begin MEASUREMENT WgC_EffCmpr "Compressor Efficiency" FLOAT32_IEEE EcuIntgdSwGend_CM_single 0 0 0.0 1000.0 ECU_ADDRESS 0x4000E208 /* @ECU_Address@WgC_EffCmpr@ */ /end MEASUREMENT
/begin MEASUREMENT WgC_NTrbChrg "Turbo Charge Speed" FLOAT32_IEEE EcuIntgdSwGend_CM_single_rpm 0 0 0.0 150000.0 ECU_ADDRESS 0x4000E1AC /* @ECU_Address@WgC_NTrbChrg@ */ /end MEASUREMENT
/begin MEASUREMENT WgC_PAirBoostRefMap "Reference Air Boost Pressure Map Out" FLOAT32_IEEE EcuIntgdSwGend_CM_single_mbar 0 0 0.0 5000.0 ECU_ADDRESS 0x4000DB94 /* @ECU_Address@WgC_PAirBoostRefMap@ */ /end MEASUREMENT
/begin MEASUREMENT WgC_PAirBoostRefCorrTCoolt "Reference Air Boost Pressure for Coolant Temperature Correction" FLOAT32_IEEE EcuIntgdSwGend_CM_single 0 0 0.0 5000.0 ECU_ADDRESS 0x4000D8AC /* @ECU_Address@WgC_PAirBoostRefCorrTCoolt@ */ /end MEASUREMENT
/begin MEASUREMENT WgC_CorrPAmbAirRef "Ambient Air Reference Correction" FLOAT32_IEEE EcuIntgdSwGend_CM_single 0 0 0.0 5000.0 ECU_ADDRESS 0x4000D6EC /* @ECU_Address@WgC_CorrPAmbAirRef@ */ /end MEASUREMENT
/begin MEASUREMENT WgC_TCorrAmbAirRef "Temperature Correction for Ambient Air Reference " FLOAT32_IEEE EcuIntgdSwGend_CM_single 0 0 0.0 5000.0 ECU_ADDRESS 0x4000DA84 /* @ECU_Address@WgC_TCorrAmbAirRef@ */ /end MEASUREMENT
/begin MEASUREMENT WgC_TCorrOilRef "Temperature Correction for Oil Reference Temperature" FLOAT32_IEEE EcuIntgdSwGend_CM_single 0 0 0.0 5000.0 ECU_ADDRESS 0x4000DB4C /* @ECU_Address@WgC_TCorrOilRef@ */ /end MEASUREMENT
/begin MEASUREMENT WgC_PAirBoostRefCorrSurge "Reference Air Boost Pressure for Surge Correction" FLOAT32_IEEE EcuIntgdSwGend_CM_single_mbar 0 0 -15000.0 15000.0 ECU_ADDRESS 0x4000DE80 /* @ECU_Address@WgC_PAirBoostRefCorrSurge@ */ /end MEASUREMENT
/begin MEASUREMENT WgC_PAirBoostRef "Reference Air Boost Pressure" FLOAT32_IEEE EcuIntgdSwGend_CM_single_mbar 0 0 0.0 5000.0 ECU_ADDRESS 0x4000DD60 /* @ECU_Address@WgC_PAirBoostRef@ */ /end MEASUREMENT
/begin MEASUREMENT WgC_ErrPAirBoost "Air Bosst Pressure Error for PID" FLOAT32_IEEE EcuIntgdSwGend_CM_single_mbar 0 0 0.0 1000.0 ECU_ADDRESS 0x4000E618 /* @ECU_Address@WgC_ErrPAirBoost@ */ /end MEASUREMENT
/begin MEASUREMENT WgC_CoeffPForWgCCtlMapOut "Proportional Coefficient For Wastegate Control Map Output" FLOAT32_IEEE EcuIntgdSwGend_CM_single 0 0 -100000.0 100000.0 ECU_ADDRESS 0x4000DFA0 /* @ECU_Address@WgC_CoeffPForWgCCtlMapOut@ */ /end MEASUREMENT
/begin MEASUREMENT WgC_PIDCoeffP "PID P Coefficient" FLOAT32_IEEE EcuIntgdSwGend_CM_single 0 0 -100.0 100.0 ECU_ADDRESS 0x4000D9C4 /* @ECU_Address@WgC_PIDCoeffP@ */ /end MEASUREMENT
/begin MEASUREMENT WgC_CoeffDForWgCCtlMapOut "Derivative Coefficient For Wastegate Control Map Output" FLOAT32_IEEE EcuIntgdSwGend_CM_single 0 0 -100000.0 100000.0 ECU_ADDRESS 0x4000E124 /* @ECU_Address@WgC_CoeffDForWgCCtlMapOut@ */ /end MEASUREMENT
/begin MEASUREMENT WgC_PIDCoeffD "PID D Coeffcient" FLOAT32_IEEE EcuIntgdSwGend_CM_single 0 0 -100.0 100.0 ECU_ADDRESS 0x4000E584 /* @ECU_Address@WgC_PIDCoeffD@ */ /end MEASUREMENT
/begin MEASUREMENT WgC_CoeffFiltForWgCCtlMapOut "Filter Coefficient For Wastegate Control Map Output" FLOAT32_IEEE EcuIntgdSwGend_CM_single 0 0 -100000.0 100000.0 ECU_ADDRESS 0x4000DF64 /* @ECU_Address@WgC_CoeffFiltForWgCCtlMapOut@ */ /end MEASUREMENT
/begin MEASUREMENT WgC_PIDCoeffFilt "PID Filter Coeffcient" FLOAT32_IEEE EcuIntgdSwGend_CM_single 0 0 -100.0 100.0 ECU_ADDRESS 0x4000E220 /* @ECU_Address@WgC_PIDCoeffFilt@ */ /end MEASUREMENT
/begin MEASUREMENT WgC_DutyWgtVlvAfterSat "Wastegate Duty Valve After Saturation" FLOAT32_IEEE EcuIntgdSwGend_CM_single__ 0 0 0.0 100.0 ECU_ADDRESS 0x4000E1B0 /* @ECU_Address@WgC_DutyWgtVlvAfterSat@ */ /end MEASUREMENT
/begin MEASUREMENT WgC_CoeffIForWgCCtlMapOut "Integrator Coefficient For Wastegate Control Map Output" FLOAT32_IEEE EcuIntgdSwGend_CM_single 0 0 -100000.0 100000.0 ECU_ADDRESS 0x4000DD3C /* @ECU_Address@WgC_CoeffIForWgCCtlMapOut@ */ /end MEASUREMENT
/begin MEASUREMENT WgC_PIDCoeffI "PID I Coefficient" FLOAT32_IEEE EcuIntgdSwGend_CM_single 0 0 -100.0 100.0 ECU_ADDRESS 0x4000DEC8 /* @ECU_Address@WgC_PIDCoeffI@ */ /end MEASUREMENT
/begin MEASUREMENT TL_TiElpdNEngAcvForTOil "Elapsed Time of Engine Activation for Oil Temperature Limitation" FLOAT32_IEEE EcuIntgdSwGend_CM_single_ms 0 0 0.0 100000.0 ECU_ADDRESS 0x4000E5F8 /* @ECU_Address@TL_TiElpdNEngAcvForTOil@ */ /end MEASUREMENT
/begin MEASUREMENT TL_TiElpdNEngAcvForPAirAmb "Elapsed Time of Engine Activation for Ambient Air Pressure Limitation" FLOAT32_IEEE EcuIntgdSwGend_CM_single_ms 0 0 0.0 100000.0 ECU_ADDRESS 0x4000E2CC /* @ECU_Address@TL_TiElpdNEngAcvForPAirAmb@ */ /end MEASUREMENT
/begin MEASUREMENT TL_TiElpdNEngAcvForTAir "Elapsed Time of Engine Activation for Air Boost Temperature Limitation" FLOAT32_IEEE EcuIntgdSwGend_CM_single_ms 0 0 0.0 100000.0 ECU_ADDRESS 0x4000D7DC /* @ECU_Address@TL_TiElpdNEngAcvForTAir@ */ /end MEASUREMENT
/begin MEASUREMENT TL_TiElpdNEngAcvForPAirBoost "Elapsed Time of Engine Activation for Air Boost Pressure Limitation" FLOAT32_IEEE EcuIntgdSwGend_CM_single_ms 0 0 0.0 100000.0 ECU_ADDRESS 0x4000DC80 /* @ECU_Address@TL_TiElpdNEngAcvForPAirBoost@ */ /end MEASUREMENT
/begin MEASUREMENT TL_TiElpdNEngAcvForNExhTrbChrg "Elapsed Time of Engine Activation for Turbo Charger Speed Limitation" FLOAT32_IEEE EcuIntgdSwGend_CM_single_ms 0 0 0.0 100000.0 ECU_ADDRESS 0x4000DA50 /* @ECU_Address@TL_TiElpdNEngAcvForNExhTrbChrg@ */ /end MEASUREMENT
/begin MEASUREMENT TL_TiElpdNEngAcvForTFu "Elapsed Time of Engine Activation for Fuel Temperature Limitation" FLOAT32_IEEE EcuIntgdSwGend_CM_single_ms 0 0 0.0 100000.0 ECU_ADDRESS 0x4000E4FC /* @ECU_Address@TL_TiElpdNEngAcvForTFu@ */ /end MEASUREMENT
/begin MEASUREMENT TL_TiElpdNEngAcvForTCoolt "Elapsed Time of Engine Activation for Coolant High Temperature Limitation" FLOAT32_IEEE EcuIntgdSwGend_CM_single_ms 0 0 0.0 100000.0 ECU_ADDRESS 0x4000DB38 /* @ECU_Address@TL_TiElpdNEngAcvForTCoolt@ */ /end MEASUREMENT
/begin MEASUREMENT SC_TiElpdEngNotTurn "Timer Elapsed Time Engine Not Turn" FLOAT32_IEEE EcuIntgdSwGend_CM_single_ms 0 0 0.0 100000.0 ECU_ADDRESS 0x4000E788 /* @ECU_Address@SC_TiElpdEngNotTurn@ */ /end MEASUREMENT
/begin MEASUREMENT SC_TiElpdStrtrProtn "Timer Elapsed Time of OverHeat Protection" FLOAT32_IEEE EcuIntgdSwGend_CM_single_ms 0 0 0.0 100000.0 ECU_ADDRESS 0x4000E214 /* @ECU_Address@SC_TiElpdStrtrProtn@ */ /end MEASUREMENT
/begin MEASUREMENT SC_TiElpdAcvnLvlOilDeb "Oil Level Debouncer Elapsed Time" FLOAT32_IEEE EcuIntgdSwGend_CM_single_ms 0 0 0.0 50000.0 ECU_ADDRESS 0x4000D6CC /* @ECU_Address@SC_TiElpdAcvnLvlOilDeb@ */ /end MEASUREMENT
/begin MEASUREMENT SC_TiElpdAcvnLvlFuDeb "Fuel Level Debouncer Elapsed Time" FLOAT32_IEEE EcuIntgdSwGend_CM_single_ms 0 0 0.0 50000.0 ECU_ADDRESS 0x4000E600 /* @ECU_Address@SC_TiElpdAcvnLvlFuDeb@ */ /end MEASUREMENT
/begin MEASUREMENT SC_TiElpdAcvnErrPCVDeb "PCV Error Debouncer Elapsed Time" FLOAT32_IEEE EcuIntgdSwGend_CM_single_ms 0 0 0.0 50000.0 ECU_ADDRESS 0x4000E570 /* @ECU_Address@SC_TiElpdAcvnErrPCVDeb@ */ /end MEASUREMENT
/begin MEASUREMENT SC_TiElpdAcvnErrVCVDeb "VCV Error Debouncer Elapsed Time" FLOAT32_IEEE EcuIntgdSwGend_CM_single_ms 0 0 0.0 50000.0 ECU_ADDRESS 0x4000E038 /* @ECU_Address@SC_TiElpdAcvnErrVCVDeb@ */ /end MEASUREMENT
/begin MEASUREMENT SpdLimr_PIDOutSpdLimrTq "PID Out Speed Limiter Torque" FLOAT32_IEEE EcuIntgdSwGend_CM_single_N_m 0 0 -5000.0 5000.0 ECU_ADDRESS 0x4000D7A8 /* @ECU_Address@SpdLimr_PIDOutSpdLimrTq@ */ /end MEASUREMENT
/begin MEASUREMENT IC_SoiPltInjSetPointFromMap1 "Start of Pilot Injection Set Point Calculation from Map 1" FLOAT32_IEEE EcuIntgdSwGend_CM_single_deg 0 0 -100.0 100.0 ECU_ADDRESS 0x4000E710 /* @ECU_Address@IC_SoiPltInjSetPointFromMap1@ */ /end MEASUREMENT
/begin MEASUREMENT IC_SoiPltInjSetPointFromMap2 "Start of Pilot Injection Set Point Calculation from Map 2" FLOAT32_IEEE EcuIntgdSwGend_CM_single_deg 0 0 -100.0 100.0 ECU_ADDRESS 0x4000E5DC /* @ECU_Address@IC_SoiPltInjSetPointFromMap2@ */ /end MEASUREMENT
/begin MEASUREMENT IC_SoiPltInjSetPoint1to2Intp "Start of Pilot Injection Set Point Calcluation Map 1 to Map 2 Interpolation" FLOAT32_IEEE EcuIntgdSwGend_CM_single_deg 0 0 -100.0 500.0 ECU_ADDRESS 0x4000E154 /* @ECU_Address@IC_SoiPltInjSetPoint1to2Intp@ */ /end MEASUREMENT
/begin MEASUREMENT IC_SoiPltInjSetPointFromMap3 "Start of Pilot Injection Set Point Calculation from Map 3" FLOAT32_IEEE EcuIntgdSwGend_CM_single_deg 0 0 -100.0 100.0 ECU_ADDRESS 0x4000E718 /* @ECU_Address@IC_SoiPltInjSetPointFromMap3@ */ /end MEASUREMENT
/begin MEASUREMENT IC_SoiPltInjSetPoint2to3Intp "Start of Pilot Injection Set Point Calcluation Map 2 to Map 3 Interpolation" FLOAT32_IEEE EcuIntgdSwGend_CM_single_deg 0 0 -100.0 500.0 ECU_ADDRESS 0x4000D890 /* @ECU_Address@IC_SoiPltInjSetPoint2to3Intp@ */ /end MEASUREMENT
/begin MEASUREMENT IC_SoiPltInjSetPoint "Start of Pilot Injection Set Point" FLOAT32_IEEE EcuIntgdSwGend_CM_single_deg 0 0 -100.0 1000.0 ECU_ADDRESS 0x4000D9E8 /* @ECU_Address@IC_SoiPltInjSetPoint@ */ /end MEASUREMENT
/begin MEASUREMENT IC_SoiMainInjSetPointFromMap1 "Start of Main Injection Set Point Calculation from Map 1" FLOAT32_IEEE EcuIntgdSwGend_CM_single_deg 0 0 -100.0 100.0 ECU_ADDRESS 0x4000D8F4 /* @ECU_Address@IC_SoiMainInjSetPointFromMap1@ */ /end MEASUREMENT
/begin MEASUREMENT IC_SoiMainInjSetPointFromMap2 "Start of Main Injection Set Point Calculation from Map 2" FLOAT32_IEEE EcuIntgdSwGend_CM_single_deg 0 0 -100.0 100.0 ECU_ADDRESS 0x4000D900 /* @ECU_Address@IC_SoiMainInjSetPointFromMap2@ */ /end MEASUREMENT
/begin MEASUREMENT IC_SoiMainInjSetPoint1to2Intp "Start of Main Injection Set Point Calcluation Map 1 to Map 2 Interpolation" FLOAT32_IEEE EcuIntgdSwGend_CM_single_deg 0 0 -100.0 500.0 ECU_ADDRESS 0x4000E4B0 /* @ECU_Address@IC_SoiMainInjSetPoint1to2Intp@ */ /end MEASUREMENT
/begin MEASUREMENT IC_SoiMainInjSetPointFromMap3 "Start of Main Injection Set Point Calculation from Map 3" FLOAT32_IEEE EcuIntgdSwGend_CM_single_deg 0 0 -100.0 100.0 ECU_ADDRESS 0x4000E4D0 /* @ECU_Address@IC_SoiMainInjSetPointFromMap3@ */ /end MEASUREMENT
/begin MEASUREMENT IC_SoiMainInjSetPoint2to3Intp "Start of Main Injection Set Point Calcluation Map 2 to Map 3 Interpolation" FLOAT32_IEEE EcuIntgdSwGend_CM_single_deg 0 0 -100.0 500.0 ECU_ADDRESS 0x4000DC18 /* @ECU_Address@IC_SoiMainInjSetPoint2to3Intp@ */ /end MEASUREMENT
/begin MEASUREMENT IC_SoiMainInjSetPoint "Start of Main Injection Set Point" FLOAT32_IEEE EcuIntgdSwGend_CM_single_deg 0 0 -100.0 1000.0 ECU_ADDRESS 0x4000E438 /* @ECU_Address@IC_SoiMainInjSetPoint@ */ /end MEASUREMENT
/begin MEASUREMENT IC_CoeffKpOutCyl1 "Cylinder Balancing PID Controller Kp Coefficient Output for Cylinder 1" FLOAT32_IEEE EcuIntgdSwGend_CM_single 0 0 -1000.0 1000.0 ECU_ADDRESS 0x4000E748 /* @ECU_Address@IC_CoeffKpOutCyl1@ */ /end MEASUREMENT
/begin MEASUREMENT IC_CoeffKiOutCyl1 "Cylinder Balancing PID Controller Ki Coefficient Output for Cylinder 1" FLOAT32_IEEE EcuIntgdSwGend_CM_single 0 0 -1000.0 1000.0 ECU_ADDRESS 0x4000D984 /* @ECU_Address@IC_CoeffKiOutCyl1@ */ /end MEASUREMENT
/begin MEASUREMENT IC_CoeffKdFbOutCyl1 "Cylinder Balancing PID Controller Kd Coefficient Feedback Output for Cylinder 1" FLOAT32_IEEE EcuIntgdSwGend_CM_single 0 0 -1000.0 1000.0 ECU_ADDRESS 0x4000D96C /* @ECU_Address@IC_CoeffKdFbOutCyl1@ */ /end MEASUREMENT
/begin MEASUREMENT IC_CoeffKdOutCyl1 "Cylinder Balancing PID Controller Kd Coefficient Output for Cylinder 1" FLOAT32_IEEE EcuIntgdSwGend_CM_single 0 0 -1000.0 1000.0 ECU_ADDRESS 0x4000E1BC /* @ECU_Address@IC_CoeffKdOutCyl1@ */ /end MEASUREMENT
/begin MEASUREMENT IC_CoeffKiClampPreSatOutCyl1 "Cylinder Balancing PID Controller Ki Coefficient Output before Saturation for Cylinder 1" FLOAT32_IEEE EcuIntgdSwGend_CM_single 0 0 -1000.0 1000.0 ECU_ADDRESS 0x4000D918 /* @ECU_Address@IC_CoeffKiClampPreSatOutCyl1@ */ /end MEASUREMENT
/begin MEASUREMENT IC_PIOutCyl1 "Cylinder Balancing PID Controller Output for Cylinder 1" FLOAT32_IEEE EcuIntgdSwGend_CM_single_mm_3_stk 0 0 -2000.0 2000.0 ECU_ADDRESS 0x4000DACC /* @ECU_Address@IC_PIOutCyl1@ */ /end MEASUREMENT
/begin MEASUREMENT IC_CoeffKiClampOutCyl1 "Cylinder Balancing PID Controller Ki Clmaping Coefficient for Cylinder 1" FLOAT32_IEEE EcuIntgdSwGend_CM_single 0 0 -1000.0 1000.0 ECU_ADDRESS 0x4000D81C /* @ECU_Address@IC_CoeffKiClampOutCyl1@ */ /end MEASUREMENT
/begin MEASUREMENT IC_CoeffKiClampSwtchOutCyl1 "Cylinder Balancing PID Controller Ki Coefficient after Clamping Switch Output for Cylinder 1" FLOAT32_IEEE EcuIntgdSwGend_CM_single 0 0 -1000.0 1000.0 ECU_ADDRESS 0x4000E4B8 /* @ECU_Address@IC_CoeffKiClampSwtchOutCyl1@ */ /end MEASUREMENT
/begin MEASUREMENT IC_CoeffKpOutCyl2 "Cylinder Balancing PID Controller Kp Coefficient Output for Cylinder 2" FLOAT32_IEEE EcuIntgdSwGend_CM_single 0 0 -1000.0 1000.0 ECU_ADDRESS 0x4000E6C8 /* @ECU_Address@IC_CoeffKpOutCyl2@ */ /end MEASUREMENT
/begin MEASUREMENT IC_CoeffKiOutCyl2 "Cylinder Balancing PID Controller Ki Coefficient Output for Cylinder 2" FLOAT32_IEEE EcuIntgdSwGend_CM_single 0 0 -1000.0 1000.0 ECU_ADDRESS 0x4000DC40 /* @ECU_Address@IC_CoeffKiOutCyl2@ */ /end MEASUREMENT
/begin MEASUREMENT IC_CoeffKdFbOutCyl2 "Cylinder Balancing PID Controller Kd Coefficient Feedback Output for Cylinder 2" FLOAT32_IEEE EcuIntgdSwGend_CM_single 0 0 -1000.0 1000.0 ECU_ADDRESS 0x4000D970 /* @ECU_Address@IC_CoeffKdFbOutCyl2@ */ /end MEASUREMENT
/begin MEASUREMENT IC_CoeffKdOutCyl2 "Cylinder Balancing PID Controller Kd Coefficient Output for Cylinder 2" FLOAT32_IEEE EcuIntgdSwGend_CM_single 0 0 -1000.0 1000.0 ECU_ADDRESS 0x4000D79C /* @ECU_Address@IC_CoeffKdOutCyl2@ */ /end MEASUREMENT
/begin MEASUREMENT IC_CoeffKiClampPreSatOutCyl2 "Cylinder Balancing PID Controller Ki Coefficient Output before Saturation for Cylinder 2" FLOAT32_IEEE EcuIntgdSwGend_CM_single 0 0 -1000.0 1000.0 ECU_ADDRESS 0x4000D91C /* @ECU_Address@IC_CoeffKiClampPreSatOutCyl2@ */ /end MEASUREMENT
/begin MEASUREMENT IC_PIOutCyl2 "Cylinder Balancing PID Controller Output for Cylinder 2" FLOAT32_IEEE EcuIntgdSwGend_CM_single_mm_3_stk 0 0 -2000.0 2000.0 ECU_ADDRESS 0x4000DAD0 /* @ECU_Address@IC_PIOutCyl2@ */ /end MEASUREMENT
/begin MEASUREMENT IC_CoeffKiClampOutCyl2 "Cylinder Balancing PID Controller Ki Clmaping Coefficient for Cylinder 2" FLOAT32_IEEE EcuIntgdSwGend_CM_single 0 0 -1000.0 1000.0 ECU_ADDRESS 0x4000D820 /* @ECU_Address@IC_CoeffKiClampOutCyl2@ */ /end MEASUREMENT
/begin MEASUREMENT IC_CoeffKiClampSwtchOutCyl2 "Cylinder Balancing PID Controller Ki Coefficient after Clamping Switch Output for Cylinder 2" FLOAT32_IEEE EcuIntgdSwGend_CM_single 0 0 -1000.0 1000.0 ECU_ADDRESS 0x4000E024 /* @ECU_Address@IC_CoeffKiClampSwtchOutCyl2@ */ /end MEASUREMENT
/begin MEASUREMENT IC_CoeffKpOutCyl3 "Cylinder Balancing PID Controller Kp Coefficient Output for Cylinder 3" FLOAT32_IEEE EcuIntgdSwGend_CM_single 0 0 -1000.0 1000.0 ECU_ADDRESS 0x4000E6CC /* @ECU_Address@IC_CoeffKpOutCyl3@ */ /end MEASUREMENT
/begin MEASUREMENT IC_CoeffKiOutCyl3 "Cylinder Balancing PID Controller Ki Coefficient Output for Cylinder 3" FLOAT32_IEEE EcuIntgdSwGend_CM_single 0 0 -1000.0 1000.0 ECU_ADDRESS 0x4000D98C /* @ECU_Address@IC_CoeffKiOutCyl3@ */ /end MEASUREMENT
/begin MEASUREMENT IC_CoeffKdFbOutCyl3 "Cylinder Balancing PID Controller Kd Coefficient Feedback Output for Cylinder 3" FLOAT32_IEEE EcuIntgdSwGend_CM_single 0 0 -1000.0 1000.0 ECU_ADDRESS 0x4000D6A8 /* @ECU_Address@IC_CoeffKdFbOutCyl3@ */ /end MEASUREMENT
/begin MEASUREMENT IC_CoeffKdOutCyl3 "Cylinder Balancing PID Controller Kd Coefficient Output for Cylinder 3" FLOAT32_IEEE EcuIntgdSwGend_CM_single 0 0 -1000.0 1000.0 ECU_ADDRESS 0x4000E1C4 /* @ECU_Address@IC_CoeffKdOutCyl3@ */ /end MEASUREMENT
/begin MEASUREMENT IC_CoeffKiClampPreSatOutCyl3 "Cylinder Balancing PID Controller Ki Coefficient Output before Saturation for Cylinder 3" FLOAT32_IEEE EcuIntgdSwGend_CM_single 0 0 -1000.0 1000.0 ECU_ADDRESS 0x4000E188 /* @ECU_Address@IC_CoeffKiClampPreSatOutCyl3@ */ /end MEASUREMENT
/begin MEASUREMENT IC_PIOutCyl3 "Cylinder Balancing PID Controller Output for Cylinder 3" FLOAT32_IEEE EcuIntgdSwGend_CM_single_mm_3_stk 0 0 -2000.0 2000.0 ECU_ADDRESS 0x4000DDA8 /* @ECU_Address@IC_PIOutCyl3@ */ /end MEASUREMENT
/begin MEASUREMENT IC_CoeffKiClampOutCyl3 "Cylinder Balancing PID Controller Ki Clmaping Coefficient for Cylinder 3" FLOAT32_IEEE EcuIntgdSwGend_CM_single 0 0 -1000.0 1000.0 ECU_ADDRESS 0x4000D824 /* @ECU_Address@IC_CoeffKiClampOutCyl3@ */ /end MEASUREMENT
/begin MEASUREMENT IC_CoeffKiClampSwtchOutCyl3 "Cylinder Balancing PID Controller Ki Coefficient after Clamping Switch Output for Cylinder 3" FLOAT32_IEEE EcuIntgdSwGend_CM_single 0 0 -1000.0 1000.0 ECU_ADDRESS 0x4000DC00 /* @ECU_Address@IC_CoeffKiClampSwtchOutCyl3@ */ /end MEASUREMENT
/begin MEASUREMENT IC_CoeffKpOutCyl4 "Cylinder Balancing PID Controller Kp Coefficient Output for Cylinder 4" FLOAT32_IEEE EcuIntgdSwGend_CM_single 0 0 -1000.0 1000.0 ECU_ADDRESS 0x4000E6D0 /* @ECU_Address@IC_CoeffKpOutCyl4@ */ /end MEASUREMENT
/begin MEASUREMENT IC_CoeffKiOutCyl4 "Cylinder Balancing PID Controller Ki Coefficient Output for Cylinder 4" FLOAT32_IEEE EcuIntgdSwGend_CM_single 0 0 -1000.0 1000.0 ECU_ADDRESS 0x4000D990 /* @ECU_Address@IC_CoeffKiOutCyl4@ */ /end MEASUREMENT
/begin MEASUREMENT IC_CoeffKdFbOutCyl4 "Cylinder Balancing PID Controller Kd Coefficient Feedback Output for Cylinder 4" FLOAT32_IEEE EcuIntgdSwGend_CM_single 0 0 -1000.0 1000.0 ECU_ADDRESS 0x4000D6AC /* @ECU_Address@IC_CoeffKdFbOutCyl4@ */ /end MEASUREMENT
/begin MEASUREMENT IC_CoeffKdOutCyl4 "Cylinder Balancing PID Controller Kd Coefficient Output for Cylinder 4" FLOAT32_IEEE EcuIntgdSwGend_CM_single 0 0 -1000.0 1000.0 ECU_ADDRESS 0x4000E1C8 /* @ECU_Address@IC_CoeffKdOutCyl4@ */ /end MEASUREMENT
/begin MEASUREMENT IC_CoeffKiClampPreSatOutCyl4 "Cylinder Balancing PID Controller Ki Coefficient Output before Saturation for Cylinder 4" FLOAT32_IEEE EcuIntgdSwGend_CM_single 0 0 -1000.0 1000.0 ECU_ADDRESS 0x4000D924 /* @ECU_Address@IC_CoeffKiClampPreSatOutCyl4@ */ /end MEASUREMENT
/begin MEASUREMENT IC_PIOutCyl4 "Cylinder Balancing PID Controller Output for Cylinder 4" FLOAT32_IEEE EcuIntgdSwGend_CM_single_mm_3_stk 0 0 -2000.0 2000.0 ECU_ADDRESS 0x4000DAD8 /* @ECU_Address@IC_PIOutCyl4@ */ /end MEASUREMENT
/begin MEASUREMENT IC_CoeffKiClampOutCyl4 "Cylinder Balancing PID Controller Ki Clmaping Coefficient for Cylinder 4" FLOAT32_IEEE EcuIntgdSwGend_CM_single 0 0 -1000.0 1000.0 ECU_ADDRESS 0x4000D828 /* @ECU_Address@IC_CoeffKiClampOutCyl4@ */ /end MEASUREMENT
/begin MEASUREMENT IC_CoeffKiClampSwtchOutCyl4 "Cylinder Balancing PID Controller Ki Coefficient after Clamping Switch Output for Cylinder 4" FLOAT32_IEEE EcuIntgdSwGend_CM_single 0 0 -1000.0 1000.0 ECU_ADDRESS 0x4000E4C8 /* @ECU_Address@IC_CoeffKiClampSwtchOutCyl4@ */ /end MEASUREMENT
/begin MEASUREMENT IC_CoeffKpOutCyl6 "Cylinder Balancing PID Controller Kp Coefficient Output for Cylinder 6" FLOAT32_IEEE EcuIntgdSwGend_CM_single 0 0 -1000.0 1000.0 ECU_ADDRESS 0x4000E754 /* @ECU_Address@IC_CoeffKpOutCyl6@ */ /end MEASUREMENT
/begin MEASUREMENT IC_CoeffKiOutCyl6 "Cylinder Balancing PID Controller Ki Coefficient Output for Cylinder 6" FLOAT32_IEEE EcuIntgdSwGend_CM_single 0 0 -1000.0 1000.0 ECU_ADDRESS 0x4000DAE8 /* @ECU_Address@IC_CoeffKiOutCyl6@ */ /end MEASUREMENT
/begin MEASUREMENT IC_CoeffKdFbOutCyl6 "Cylinder Balancing PID Controller Kd Coefficient Feedback Output for Cylinder 6" FLOAT32_IEEE EcuIntgdSwGend_CM_single 0 0 -1000.0 1000.0 ECU_ADDRESS 0x4000D980 /* @ECU_Address@IC_CoeffKdFbOutCyl6@ */ /end MEASUREMENT
/begin MEASUREMENT IC_CoeffKdOutCyl6 "Cylinder Balancing PID Controller Kd Coefficient Output for Cylinder 6" FLOAT32_IEEE EcuIntgdSwGend_CM_single 0 0 -1000.0 1000.0 ECU_ADDRESS 0x4000E57C /* @ECU_Address@IC_CoeffKdOutCyl6@ */ /end MEASUREMENT
/begin MEASUREMENT IC_CoeffKiClampPreSatOutCyl6 "Cylinder Balancing PID Controller Ki Coefficient Output before Saturation for Cylinder 6" FLOAT32_IEEE EcuIntgdSwGend_CM_single 0 0 -1000.0 1000.0 ECU_ADDRESS 0x4000E19C /* @ECU_Address@IC_CoeffKiClampPreSatOutCyl6@ */ /end MEASUREMENT
/begin MEASUREMENT IC_PIOutCyl6 "Cylinder Balancing PID Controller Output for Cylinder 6" FLOAT32_IEEE EcuIntgdSwGend_CM_single_mm_3_stk 0 0 -2000.0 2000.0 ECU_ADDRESS 0x4000E4DC /* @ECU_Address@IC_PIOutCyl6@ */ /end MEASUREMENT
/begin MEASUREMENT IC_CoeffKiClampOutCyl6 "Cylinder Balancing PID Controller Ki Clmaping Coefficient for Cylinder 6" FLOAT32_IEEE EcuIntgdSwGend_CM_single 0 0 -1000.0 1000.0 ECU_ADDRESS 0x4000DE78 /* @ECU_Address@IC_CoeffKiClampOutCyl6@ */ /end MEASUREMENT
/begin MEASUREMENT IC_CoeffKiClampSwtchOutCyl6 "Cylinder Balancing PID Controller Ki Coefficient after Clamping Switch Output for Cylinder 6" FLOAT32_IEEE EcuIntgdSwGend_CM_single 0 0 -1000.0 1000.0 ECU_ADDRESS 0x4000E4D4 /* @ECU_Address@IC_CoeffKiClampSwtchOutCyl6@ */ /end MEASUREMENT
/begin MEASUREMENT IC_CoeffKpOutCyl5 "Cylinder Balancing PID Controller Kp Coefficient Output for Cylinder 5" FLOAT32_IEEE EcuIntgdSwGend_CM_single 0 0 -1000.0 1000.0 ECU_ADDRESS 0x4000E6D4 /* @ECU_Address@IC_CoeffKpOutCyl5@ */ /end MEASUREMENT
/begin MEASUREMENT IC_CoeffKiOutCyl5 "Cylinder Balancing PID Controller Ki Coefficient Output for Cylinder 5" FLOAT32_IEEE EcuIntgdSwGend_CM_single 0 0 -1000.0 1000.0 ECU_ADDRESS 0x4000D994 /* @ECU_Address@IC_CoeffKiOutCyl5@ */ /end MEASUREMENT
/begin MEASUREMENT IC_CoeffKdFbOutCyl5 "Cylinder Balancing PID Controller Kd Coefficient Feedback Output for Cylinder 5" FLOAT32_IEEE EcuIntgdSwGend_CM_single 0 0 -1000.0 1000.0 ECU_ADDRESS 0x4000D6B0 /* @ECU_Address@IC_CoeffKdFbOutCyl5@ */ /end MEASUREMENT
/begin MEASUREMENT IC_CoeffKdOutCyl5 "Cylinder Balancing PID Controller Kd Coefficient Output for Cylinder 5" FLOAT32_IEEE EcuIntgdSwGend_CM_single 0 0 -1000.0 1000.0 ECU_ADDRESS 0x4000E578 /* @ECU_Address@IC_CoeffKdOutCyl5@ */ /end MEASUREMENT
/begin MEASUREMENT IC_CoeffKiClampPreSatOutCyl5 "Cylinder Balancing PID Controller Ki Coefficient Output before Saturation for Cylinder 5" FLOAT32_IEEE EcuIntgdSwGend_CM_single 0 0 -1000.0 1000.0 ECU_ADDRESS 0x4000D928 /* @ECU_Address@IC_CoeffKiClampPreSatOutCyl5@ */ /end MEASUREMENT
/begin MEASUREMENT IC_PIOutCyl5 "Cylinder Balancing PID Controller Output for Cylinder 5" FLOAT32_IEEE EcuIntgdSwGend_CM_single_mm_3_stk 0 0 -2000.0 2000.0 ECU_ADDRESS 0x4000DADC /* @ECU_Address@IC_PIOutCyl5@ */ /end MEASUREMENT
/begin MEASUREMENT IC_CoeffKiClampOutCyl5 "Cylinder Balancing PID Controller Ki Clmaping Coefficient for Cylinder 5" FLOAT32_IEEE EcuIntgdSwGend_CM_single 0 0 -1000.0 1000.0 ECU_ADDRESS 0x4000E674 /* @ECU_Address@IC_CoeffKiClampOutCyl5@ */ /end MEASUREMENT
/begin MEASUREMENT IC_CoeffKiClampSwtchOutCyl5 "Cylinder Balancing PID Controller Ki Coefficient after Clamping Switch Output for Cylinder 5" FLOAT32_IEEE EcuIntgdSwGend_CM_single 0 0 -1000.0 1000.0 ECU_ADDRESS 0x4000E040 /* @ECU_Address@IC_CoeffKiClampSwtchOutCyl5@ */ /end MEASUREMENT
/begin MEASUREMENT EIP_PAirBoostFild "Filtered Air Boost Pressure" FLOAT32_IEEE EcuIntgdSwGend_CM_single_mbar 0 0 0.0 15000.0 ECU_ADDRESS 0x4000E148 /* @ECU_Address@EIP_PAirBoostFild@ */ /end MEASUREMENT
/begin MEASUREMENT EIP_TiElpdErrPAirBoostSnsr "Elapsed Time for Error Air Boost Pressure Sensor" FLOAT32_IEEE EcuIntgdSwGend_CM_single_ms 0 0 0.0 250000.0 ECU_ADDRESS 0x4000D794 /* @ECU_Address@EIP_TiElpdErrPAirBoostSnsr@ */ /end MEASUREMENT
/begin MEASUREMENT EIP_PAmbAirFild "Filtered Ambient Air Pressure" FLOAT32_IEEE EcuIntgdSwGend_CM_single_mbar 0 0 0.0 15000.0 ECU_ADDRESS 0x4000DD44 /* @ECU_Address@EIP_PAmbAirFild@ */ /end MEASUREMENT
/begin MEASUREMENT EIP_TiElpdErrPAmbAirSnsr "Elapsed Time for Error Ambient Air Pressure Sensor" FLOAT32_IEEE EcuIntgdSwGend_CM_single_ms 0 0 0.0 250000.0 ECU_ADDRESS 0x4000DEA0 /* @ECU_Address@EIP_TiElpdErrPAmbAirSnsr@ */ /end MEASUREMENT
/begin MEASUREMENT EIP_PRailFild "Filtered Rail Pressure" FLOAT32_IEEE EcuIntgdSwGend_CM_single_bar 0 0 0.0 15000.0 ECU_ADDRESS 0x4000DD84 /* @ECU_Address@EIP_PRailFild@ */ /end MEASUREMENT
/begin MEASUREMENT EIP_PFuFild "Filtered Fuel Pressure" FLOAT32_IEEE EcuIntgdSwGend_CM_single_mbar 0 0 0.0 15000.0 ECU_ADDRESS 0x4000E2BC /* @ECU_Address@EIP_PFuFild@ */ /end MEASUREMENT
/begin MEASUREMENT EIP_POilFild "Filtered Oil Pressure" FLOAT32_IEEE EcuIntgdSwGend_CM_single_mbar 0 0 0.0 15000.0 ECU_ADDRESS 0x4000E764 /* @ECU_Address@EIP_POilFild@ */ /end MEASUREMENT
/begin MEASUREMENT EIP_TiElpdErrPOilSnsr "Elapsed Time for Error Oil Pressure Sensor" FLOAT32_IEEE EcuIntgdSwGend_CM_single_ms 0 0 0.0 250000.0 ECU_ADDRESS 0x4000D718 /* @ECU_Address@EIP_TiElpdErrPOilSnsr@ */ /end MEASUREMENT
/begin MEASUREMENT EIP_TiElpdErrPFuSnsr "Elapsed Time for Error Fuel Pressure Sensor" FLOAT32_IEEE EcuIntgdSwGend_CM_single_ms 0 0 0.0 250000.0 ECU_ADDRESS 0x4000D6F4 /* @ECU_Address@EIP_TiElpdErrPFuSnsr@ */ /end MEASUREMENT
/begin MEASUREMENT EIP_TiElpdErrPRailSnsr "Elapsed Time for Error Rail Pressure Sensor" FLOAT32_IEEE EcuIntgdSwGend_CM_single_ms 0 0 0.0 250000.0 ECU_ADDRESS 0x4000E020 /* @ECU_Address@EIP_TiElpdErrPRailSnsr@ */ /end MEASUREMENT
/begin MEASUREMENT EIP_TiElpdErrAccrDiff "Elapsed Time for Error Accelerator Difference" FLOAT32_IEEE EcuIntgdSwGend_CM_single_ms 0 0 0.0 250000.0 ECU_ADDRESS 0x4000E598 /* @ECU_Address@EIP_TiElpdErrAccrDiff@ */ /end MEASUREMENT
/begin MEASUREMENT EIP_TiElpdErrAccrDervDiffHi "Elapsed Time for Error Accelerator Derivation Difference High" FLOAT32_IEEE EcuIntgdSwGend_CM_single_ms 0 0 0.0 250000.0 ECU_ADDRESS 0x4000D8B8 /* @ECU_Address@EIP_TiElpdErrAccrDervDiffHi@ */ /end MEASUREMENT
/begin MEASUREMENT EIP_TiElpdErrAccrDervDiffLo "Elapsed Time for Error Accelerator Derivation Difference Low" FLOAT32_IEEE EcuIntgdSwGend_CM_single_ms 0 0 0.0 250000.0 ECU_ADDRESS 0x4000DB18 /* @ECU_Address@EIP_TiElpdErrAccrDervDiffLo@ */ /end MEASUREMENT
/begin MEASUREMENT EIP_TiElpdNEngAcvEmgcyShtdwnForOvspd "Elapsed Time for Engine Speed Actvie for Emergency Shutdown for Overspeed" FLOAT32_IEEE EcuIntgdSwGend_CM_single_ms 0 0 0.0 250000.0 ECU_ADDRESS 0x4000DA54 /* @ECU_Address@EIP_TiElpdNEngAcvEmgcyShtdwnForOvspd@ */ /end MEASUREMENT
/begin MEASUREMENT EIP_TAirBoostFild "Filtered Air Boost Temperature" FLOAT32_IEEE EcuIntgdSwGend_CM_single_degC 0 0 -50.0 250.0 ECU_ADDRESS 0x4000D9EC /* @ECU_Address@EIP_TAirBoostFild@ */ /end MEASUREMENT
/begin MEASUREMENT EIP_TiElpdErrTAirBoostSnsr "Elapsed Time for Error Air Boost Temperature Sensor" FLOAT32_IEEE EcuIntgdSwGend_CM_single_ms 0 0 0.0 250000.0 ECU_ADDRESS 0x4000D77C /* @ECU_Address@EIP_TiElpdErrTAirBoostSnsr@ */ /end MEASUREMENT
/begin MEASUREMENT EIP_TOilFild "Filtered Oil Temperature" FLOAT32_IEEE EcuIntgdSwGend_CM_single_degC 0 0 -50.0 250.0 ECU_ADDRESS 0x4000D9DC /* @ECU_Address@EIP_TOilFild@ */ /end MEASUREMENT
/begin MEASUREMENT EIP_TCooltFild "Filtered Coolant Temperature" FLOAT32_IEEE EcuIntgdSwGend_CM_single_degC 0 0 -50.0 250.0 ECU_ADDRESS 0x4000E3B0 /* @ECU_Address@EIP_TCooltFild@ */ /end MEASUREMENT
/begin MEASUREMENT EIP_TiElpdErrTOilSnsr "Elapsed Time for Error Oil Temperature Sensor" FLOAT32_IEEE EcuIntgdSwGend_CM_single_ms 0 0 0.0 250000.0 ECU_ADDRESS 0x4000E058 /* @ECU_Address@EIP_TiElpdErrTOilSnsr@ */ /end MEASUREMENT
/begin MEASUREMENT EIP_TiElpdErrTCooltSnsr "Elapsed Time for Error Coolant Temperature Sensor" FLOAT32_IEEE EcuIntgdSwGend_CM_single_ms 0 0 0.0 250000.0 ECU_ADDRESS 0x4000DECC /* @ECU_Address@EIP_TiElpdErrTCooltSnsr@ */ /end MEASUREMENT
/begin MEASUREMENT EIP_TFuFild "Filtered Fuel Temperature" FLOAT32_IEEE EcuIntgdSwGend_CM_single_degC 0 0 -50.0 250.0 ECU_ADDRESS 0x4000E1CC /* @ECU_Address@EIP_TFuFild@ */ /end MEASUREMENT
/begin MEASUREMENT EIP_TEcuFild "Filtered Ecu Temperature" FLOAT32_IEEE EcuIntgdSwGend_CM_single_degC 0 0 -50.0 250.0 ECU_ADDRESS 0x4000E1F0 /* @ECU_Address@EIP_TEcuFild@ */ /end MEASUREMENT
/begin MEASUREMENT EIP_TAmbAirFild "Filtered Ambient Air Temperature" FLOAT32_IEEE EcuIntgdSwGend_CM_single_degC 0 0 -50.0 250.0 ECU_ADDRESS 0x4000E128 /* @ECU_Address@EIP_TAmbAirFild@ */ /end MEASUREMENT
/begin MEASUREMENT EIP_TiElpdErrTAmbAirSnsr "Elapsed Time for Error Ambient Air Temperature Sensor" FLOAT32_IEEE EcuIntgdSwGend_CM_single_ms 0 0 0.0 250000.0 ECU_ADDRESS 0x4000E028 /* @ECU_Address@EIP_TiElpdErrTAmbAirSnsr@ */ /end MEASUREMENT
/begin MEASUREMENT EIP_TiElpdErrTEcuSnsr "Elapsed Time for Error ECU Temperature Sensor" FLOAT32_IEEE EcuIntgdSwGend_CM_single_ms 0 0 0.0 250000.0 ECU_ADDRESS 0x4000DCA0 /* @ECU_Address@EIP_TiElpdErrTEcuSnsr@ */ /end MEASUREMENT
/begin MEASUREMENT EIP_TiEpldErrTFuSnsr "Elapsed Time for Error Fuel Temperature Sensor" FLOAT32_IEEE EcuIntgdSwGend_CM_single_ms 0 0 0.0 250000.0 ECU_ADDRESS 0x4000D8EC /* @ECU_Address@EIP_TiEpldErrTFuSnsr@ */ /end MEASUREMENT
/begin MEASUREMENT EIP_LvlOilFild "Filtered Oil Level" FLOAT32_IEEE EcuIntgdSwGend_CM_single__ 0 0 0.0 100.0 ECU_ADDRESS 0x4000DD9C /* @ECU_Address@EIP_LvlOilFild@ */ /end MEASUREMENT
/begin MEASUREMENT EIP_TiElpdErrLvlOilSnsr "Elapsed Time for Error Level Oil Sensor" FLOAT32_IEEE EcuIntgdSwGend_CM_single_ms 0 0 0.0 250000.0 ECU_ADDRESS 0x4000D89C /* @ECU_Address@EIP_TiElpdErrLvlOilSnsr@ */ /end MEASUREMENT
/begin MEASUREMENT EIP_TiElpdIdleMod "Elapsed Time for Idle Mod" FLOAT32_IEEE EcuIntgdSwGend_CM_single_ms 0 0 0.0 50000.0 ECU_ADDRESS 0x4000E0A0 /* @ECU_Address@EIP_TiElpdIdleMod@ */ /end MEASUREMENT
/begin MEASUREMENT EIP_NCyl1Dif "Cylinder 1 Speed Difference" FLOAT32_IEEE EcuIntgdSwGend_CM_single_rpm 0 0 -2000.0 2000.0 ECU_ADDRESS 0x4000DE9C /* @ECU_Address@EIP_NCyl1Dif@ */ /end MEASUREMENT
/begin MEASUREMENT EIP_ErrNCyl1 "Cylinder Speed Error For Cylinder 1" FLOAT32_IEEE EcuIntgdSwGend_CM_single_rpm 0 0 -4000.0 4000.0 ECU_ADDRESS 0x4000DB6C /* @ECU_Address@EIP_ErrNCyl1@ */ /end MEASUREMENT
/begin MEASUREMENT EIP_NCyl2Dif "Cylinder 2 Speed Difference" FLOAT32_IEEE EcuIntgdSwGend_CM_single_rpm 0 0 -2000.0 2000.0 ECU_ADDRESS 0x4000E744 /* @ECU_Address@EIP_NCyl2Dif@ */ /end MEASUREMENT
/begin MEASUREMENT EIP_ErrNCyl2 "Cylinder Speed Error For Cylinder 2" FLOAT32_IEEE EcuIntgdSwGend_CM_single_rpm 0 0 -4000.0 4000.0 ECU_ADDRESS 0x4000DB70 /* @ECU_Address@EIP_ErrNCyl2@ */ /end MEASUREMENT
/begin MEASUREMENT EIP_NCyl3Dif "Cylinder 3 Speed Difference" FLOAT32_IEEE EcuIntgdSwGend_CM_single_rpm 0 0 -2000.0 2000.0 ECU_ADDRESS 0x4000DED4 /* @ECU_Address@EIP_NCyl3Dif@ */ /end MEASUREMENT
/begin MEASUREMENT EIP_ErrNCyl3 "Cylinder Speed Error For Cylinder 3" FLOAT32_IEEE EcuIntgdSwGend_CM_single_rpm 0 0 -4000.0 4000.0 ECU_ADDRESS 0x4000DB74 /* @ECU_Address@EIP_ErrNCyl3@ */ /end MEASUREMENT
/begin MEASUREMENT EIP_NCyl4Dif "Cylinder 4 Speed Difference" FLOAT32_IEEE EcuIntgdSwGend_CM_single_rpm 0 0 -2000.0 2000.0 ECU_ADDRESS 0x4000E76C /* @ECU_Address@EIP_NCyl4Dif@ */ /end MEASUREMENT
/begin MEASUREMENT EIP_ErrNCyl4 "Cylinder Speed Error For Cylinder 4" FLOAT32_IEEE EcuIntgdSwGend_CM_single_rpm 0 0 -4000.0 4000.0 ECU_ADDRESS 0x4000DB78 /* @ECU_Address@EIP_ErrNCyl4@ */ /end MEASUREMENT
/begin MEASUREMENT EIP_TiElpdErrCylMisfWarn "Elapsed Time for Error Cylinder Misfire Warning" FLOAT32_IEEE EcuIntgdSwGend_CM_single_ms 0 0 0.0 250000.0 ECU_ADDRESS 0x4000DCB8 /* @ECU_Address@EIP_TiElpdErrCylMisfWarn@ */ /end MEASUREMENT
/begin MEASUREMENT EIP_TiElpdErrCylMisfRedn "Elapsed Time for Error Cylinder Misfire Reduction" FLOAT32_IEEE EcuIntgdSwGend_CM_single_ms 0 0 0.0 250000.0 ECU_ADDRESS 0x4000D998 /* @ECU_Address@EIP_TiElpdErrCylMisfRedn@ */ /end MEASUREMENT
/begin MEASUREMENT EIP_TiElpdErrCylMisfShtdwn "Elapsed Time for Error Cylinder Misfire Shutdown" FLOAT32_IEEE EcuIntgdSwGend_CM_single_ms 0 0 0.0 250000.0 ECU_ADDRESS 0x4000E1A8 /* @ECU_Address@EIP_TiElpdErrCylMisfShtdwn@ */ /end MEASUREMENT
/begin MEASUREMENT EIP_NCyl6Dif "Cylinder 6 Speed Difference" FLOAT32_IEEE EcuIntgdSwGend_CM_single_rpm 0 0 -2000.0 2000.0 ECU_ADDRESS 0x4000E790 /* @ECU_Address@EIP_NCyl6Dif@ */ /end MEASUREMENT
/begin MEASUREMENT EIP_ErrNCyl6 "Cylinder Speed Error For Cylinder 6" FLOAT32_IEEE EcuIntgdSwGend_CM_single_rpm 0 0 -4000.0 4000.0 ECU_ADDRESS 0x4000DB80 /* @ECU_Address@EIP_ErrNCyl6@ */ /end MEASUREMENT
/begin MEASUREMENT EIP_NCyl5Dif "Cylinder 5 Speed Difference" FLOAT32_IEEE EcuIntgdSwGend_CM_single_rpm 0 0 -2000.0 2000.0 ECU_ADDRESS 0x4000DEFC /* @ECU_Address@EIP_NCyl5Dif@ */ /end MEASUREMENT
/begin MEASUREMENT EIP_ErrNCyl5 "Cylinder Speed Error For Cylinder 5" FLOAT32_IEEE EcuIntgdSwGend_CM_single_rpm 0 0 -4000.0 4000.0 ECU_ADDRESS 0x4000DB7C /* @ECU_Address@EIP_ErrNCyl5@ */ /end MEASUREMENT
/begin MEASUREMENT EIP_TiElpdErrInjrShtdwn "Elapsed Time for Error Injection Shutdown" FLOAT32_IEEE EcuIntgdSwGend_CM_single_ms 0 0 0.0 250000.0 ECU_ADDRESS 0x4000E0D0 /* @ECU_Address@EIP_TiElpdErrInjrShtdwn@ */ /end MEASUREMENT
/begin MEASUREMENT DTqC_CoeffKpOut "PID Controller Proportional Out" FLOAT32_IEEE EcuIntgdSwGend_CM_single 0 0 -1000.0 1000.0 ECU_ADDRESS 0x4000D9D0 /* @ECU_Address@DTqC_CoeffKpOut@ */ /end MEASUREMENT
/begin MEASUREMENT DTqC_CoeffKiOut "PID Controller Integrator Out" FLOAT32_IEEE EcuIntgdSwGend_CM_single 0 0 -1000.0 1000.0 ECU_ADDRESS 0x4000E194 /* @ECU_Address@DTqC_CoeffKiOut@ */ /end MEASUREMENT
/begin MEASUREMENT DTqC_CoeffKdFbOut "PID Controller Derivative Feedback Out" FLOAT32_IEEE EcuIntgdSwGend_CM_single 0 0 -1000.0 1000.0 ECU_ADDRESS 0x4000E514 /* @ECU_Address@DTqC_CoeffKdFbOut@ */ /end MEASUREMENT
/begin MEASUREMENT DTqC_CoeffKdOut "PID Controller Derivative Out" FLOAT32_IEEE EcuIntgdSwGend_CM_single 0 0 -1000.0 1000.0 ECU_ADDRESS 0x4000D8B4 /* @ECU_Address@DTqC_CoeffKdOut@ */ /end MEASUREMENT
/begin MEASUREMENT DTqC_CoeffKiClampPreSatOut "PID Controller Integrator Clamp Pre Saturation Out" FLOAT32_IEEE EcuIntgdSwGend_CM_single 0 0 -1000.0 1000.0 ECU_ADDRESS 0x4000DA0C /* @ECU_Address@DTqC_CoeffKiClampPreSatOut@ */ /end MEASUREMENT
/begin MEASUREMENT DTqC_IdleSpdCtlPIDOut "Idle Speed Controller PID Out" FLOAT32_IEEE EcuIntgdSwGend_CM_single_N_m 0 0 -10000.0 10000.0 ECU_ADDRESS 0x4000D7B0 /* @ECU_Address@DTqC_IdleSpdCtlPIDOut@ */ /end MEASUREMENT
/begin MEASUREMENT DTqC_TqBrkMap1 "Break Torque Map 1 Signal" FLOAT32_IEEE EcuIntgdSwGend_CM_single_N_m 0 0 -1000.0 10000.0 ECU_ADDRESS 0x4000D90C /* @ECU_Address@DTqC_TqBrkMap1@ */ /end MEASUREMENT
/begin MEASUREMENT DTqC_TqBrkMap2 "Break Torque Map 2 Signal" FLOAT32_IEEE EcuIntgdSwGend_CM_single_N_m 0 0 -1000.0 10000.0 ECU_ADDRESS 0x4000D910 /* @ECU_Address@DTqC_TqBrkMap2@ */ /end MEASUREMENT
/begin MEASUREMENT DTqC_TqLimdBrk1to2Intp "Break Torque Value Interpolation Between Map 1 and 2" FLOAT32_IEEE EcuIntgdSwGend_CM_single_N_m 0 0 0.0 10000.0 ECU_ADDRESS 0x4000D84C /* @ECU_Address@DTqC_TqLimdBrk1to2Intp@ */ /end MEASUREMENT
/begin MEASUREMENT DTqC_TqBrkMap3 "Break Torque Map 3 Signal" FLOAT32_IEEE EcuIntgdSwGend_CM_single_N_m 0 0 -1000.0 10000.0 ECU_ADDRESS 0x4000D914 /* @ECU_Address@DTqC_TqBrkMap3@ */ /end MEASUREMENT
/begin MEASUREMENT DTqC_TqLimdBrk2To3Intp "Break Torque Value Interpolation Between Map 2 and 3" FLOAT32_IEEE EcuIntgdSwGend_CM_single_N_m 0 0 0.0 10000.0 ECU_ADDRESS 0x4000E424 /* @ECU_Address@DTqC_TqLimdBrk2To3Intp@ */ /end MEASUREMENT
/begin MEASUREMENT DTqC_TqLimdBrk "Driver Demand Break Torque" FLOAT32_IEEE EcuIntgdSwGend_CM_single_N_m 0 0 0.0 10000.0 ECU_ADDRESS 0x4000E0D4 /* @ECU_Address@DTqC_TqLimdBrk@ */ /end MEASUREMENT
/begin MEASUREMENT DTqC_ErrNSpdReq "TCU Speed Request and Engine Speed Differences" FLOAT32_IEEE EcuIntgdSwGend_CM_single_rpm 0 0 -10000.0 10000.0 ECU_ADDRESS 0x4000DA30 /* @ECU_Address@DTqC_ErrNSpdReq@ */ /end MEASUREMENT
/begin MEASUREMENT DTqC_CoeffPForTSC1ReqSpdCtlMapOut "Proportional Coefficient Map Out Signal for TCU Request Speed Controller" FLOAT32_IEEE EcuIntgdSwGend_CM_single 0 0 -10000.0 10000.0 ECU_ADDRESS 0x4000E750 /* @ECU_Address@DTqC_CoeffPForTSC1ReqSpdCtlMapOut@ */ /end MEASUREMENT
/begin MEASUREMENT DTqC_CoeffPForTSC1ReqSpdCtl "Proportional Coefficient Signal for TCU Request Speed Controller" FLOAT32_IEEE EcuIntgdSwGend_CM_single 0 0 -100.0 100.0 ECU_ADDRESS 0x4000D9CC /* @ECU_Address@DTqC_CoeffPForTSC1ReqSpdCtl@ */ /end MEASUREMENT
/begin MEASUREMENT DTqC_CoeffDForTSC1ReqSpdCtlMapOut "Derivative Coefficient Map Out Signal for TCU Request Speed Controller" FLOAT32_IEEE EcuIntgdSwGend_CM_single 0 0 -10000.0 10000.0 ECU_ADDRESS 0x4000E770 /* @ECU_Address@DTqC_CoeffDForTSC1ReqSpdCtlMapOut@ */ /end MEASUREMENT
/begin MEASUREMENT DTqC_CoeffDForTSC1ReqSpdCtl "Derivative Coefficient Signal for TCU Request Speed Controller" FLOAT32_IEEE EcuIntgdSwGend_CM_single 0 0 -100.0 100.0 ECU_ADDRESS 0x4000D7CC /* @ECU_Address@DTqC_CoeffDForTSC1ReqSpdCtl@ */ /end MEASUREMENT
/begin MEASUREMENT DTqC_CoeffFiltForTSC1ReqSpdCtlMapOut "Filter Coefficient Map Out Signal for TCU Request Speed Controller" FLOAT32_IEEE EcuIntgdSwGend_CM_single 0 0 -10000.0 10000.0 ECU_ADDRESS 0x4000DE10 /* @ECU_Address@DTqC_CoeffFiltForTSC1ReqSpdCtlMapOut@ */ /end MEASUREMENT
/begin MEASUREMENT DTqC_CoeffFiltForTSC1ReqSpdCtl "Filter Coefficient Signal for TCU Request Speed Controller" FLOAT32_IEEE EcuIntgdSwGend_CM_single 0 0 -100.0 100.0 ECU_ADDRESS 0x4000DC64 /* @ECU_Address@DTqC_CoeffFiltForTSC1ReqSpdCtl@ */ /end MEASUREMENT
/begin MEASUREMENT DTqC_NEngDelta "" FLOAT32_IEEE EcuIntgdSwGend_CM_single_rpm 0 0 -3300.0 3300.0 ECU_ADDRESS 0x4000D8D4 /* @ECU_Address@DTqC_NEngDelta@ */ /end MEASUREMENT
/begin MEASUREMENT DTqC_CoeffPForEndSpdCtlMapOut "" FLOAT32_IEEE EcuIntgdSwGend_CM_single 0 0 -10000.0 10000.0 ECU_ADDRESS 0x4000DDE0 /* @ECU_Address@DTqC_CoeffPForEndSpdCtlMapOut@ */ /end MEASUREMENT
/begin MEASUREMENT DTqC_CoeffPForSpdCtlEndSpd "" FLOAT32_IEEE EcuIntgdSwGend_CM_single 0 0 -100.0 100.0 ECU_ADDRESS 0x4000E318 /* @ECU_Address@DTqC_CoeffPForSpdCtlEndSpd@ */ /end MEASUREMENT
/begin MEASUREMENT DTqC_CoeffDForEndSpdCtlMapOut "" FLOAT32_IEEE EcuIntgdSwGend_CM_single 0 0 -10000.0 10000.0 ECU_ADDRESS 0x4000DB90 /* @ECU_Address@DTqC_CoeffDForEndSpdCtlMapOut@ */ /end MEASUREMENT
/begin MEASUREMENT DTqC_CoeffDForSpdCtlEndSpd "" FLOAT32_IEEE EcuIntgdSwGend_CM_single 0 0 -100.0 100.0 ECU_ADDRESS 0x4000DCF4 /* @ECU_Address@DTqC_CoeffDForSpdCtlEndSpd@ */ /end MEASUREMENT
/begin MEASUREMENT DTqC_CoeffFiltForEndSpdCtlMapOut "" FLOAT32_IEEE EcuIntgdSwGend_CM_single 0 0 -10000.0 10000.0 ECU_ADDRESS 0x4000DC1C /* @ECU_Address@DTqC_CoeffFiltForEndSpdCtlMapOut@ */ /end MEASUREMENT
/begin MEASUREMENT DTqC_CoeffFiltForSpdCtlEndSpd "" FLOAT32_IEEE EcuIntgdSwGend_CM_single 0 0 -100.0 100.0 ECU_ADDRESS 0x4000DBD8 /* @ECU_Address@DTqC_CoeffFiltForSpdCtlEndSpd@ */ /end MEASUREMENT
/begin MEASUREMENT DTqC_CoeffIForEndSpdCtlMapOut "" FLOAT32_IEEE EcuIntgdSwGend_CM_single 0 0 -10000.0 10000.0 ECU_ADDRESS 0x4000D78C /* @ECU_Address@DTqC_CoeffIForEndSpdCtlMapOut@ */ /end MEASUREMENT
/begin MEASUREMENT DTqC_CoeffIForSpdCtlEndSpd "" FLOAT32_IEEE EcuIntgdSwGend_CM_single 0 0 -100.0 100.0 ECU_ADDRESS 0x4000D8A4 /* @ECU_Address@DTqC_CoeffIForSpdCtlEndSpd@ */ /end MEASUREMENT
/begin MEASUREMENT DTqC_CoeffIForTSC1ReqSpdCtlMapOut "Integrator Coefficient Map Out Signal for TCU Request Speed Controller" FLOAT32_IEEE EcuIntgdSwGend_CM_single 0 0 -10000.0 10000.0 ECU_ADDRESS 0x4000E300 /* @ECU_Address@DTqC_CoeffIForTSC1ReqSpdCtlMapOut@ */ /end MEASUREMENT
/begin MEASUREMENT DTqC_CoeffIForTSC1ReqSpdCtl "Integrator Coefficient Signal for TCU Request Speed Controller" FLOAT32_IEEE EcuIntgdSwGend_CM_single 0 0 -100.0 100.0 ECU_ADDRESS 0x4000E520 /* @ECU_Address@DTqC_CoeffIForTSC1ReqSpdCtl@ */ /end MEASUREMENT
/begin MEASUREMENT DTqC_CoeffKiClampOut "PID Controller Integrator Clamp Out" FLOAT32_IEEE EcuIntgdSwGend_CM_single 0 0 -1000.0 1000.0 ECU_ADDRESS 0x4000E2F0 /* @ECU_Address@DTqC_CoeffKiClampOut@ */ /end MEASUREMENT
/begin MEASUREMENT DTqC_CoeffKiClampSwtchOut "PID Controller Integrator Clamp Switch Out" FLOAT32_IEEE EcuIntgdSwGend_CM_single 0 0 -1000.0 1000.0 ECU_ADDRESS 0x4000DF44 /* @ECU_Address@DTqC_CoeffKiClampSwtchOut@ */ /end MEASUREMENT
/begin MEASUREMENT CrsCtrl_CoeffKdFbOut "PID Controller Derivative Feedback Out" FLOAT32_IEEE EcuIntgdSwGend_CM_single 0 0 -10000.0 10000.0 ECU_ADDRESS 0x4000DF80 /* @ECU_Address@CrsCtrl_CoeffKdFbOut@ */ /end MEASUREMENT
/begin MEASUREMENT CrsCtrl_CoeffKdOut "PID Controller Derivative Out" FLOAT32_IEEE EcuIntgdSwGend_CM_single 0 0 -10000.0 10000.0 ECU_ADDRESS 0x4000DDC4 /* @ECU_Address@CrsCtrl_CoeffKdOut@ */ /end MEASUREMENT
/begin MEASUREMENT CrsCtrl_CoeffKpOut "PID Controller Proportional Out" FLOAT32_IEEE EcuIntgdSwGend_CM_single 0 0 -10000.0 10000.0 ECU_ADDRESS 0x4000E5C0 /* @ECU_Address@CrsCtrl_CoeffKpOut@ */ /end MEASUREMENT
/begin MEASUREMENT CrsCtrl_CoeffKiClampPreSatOut "PID Controller Integrator Clamp Pre Saturation Out" FLOAT32_IEEE EcuIntgdSwGend_CM_single 0 0 -10000.0 10000.0 ECU_ADDRESS 0x4000D838 /* @ECU_Address@CrsCtrl_CoeffKiClampPreSatOut@ */ /end MEASUREMENT
/begin MEASUREMENT CrsCtrl_PIDOutCrsCtrlTq "Cruise Control PID Out Torque" FLOAT32_IEEE EcuIntgdSwGend_CM_single_N_m 0 0 -10000.0 10000.0 ECU_ADDRESS 0x4000E27C /* @ECU_Address@CrsCtrl_PIDOutCrsCtrlTq@ */ /end MEASUREMENT
/begin MEASUREMENT CrsCtrl_CoeffKiClampOut "PID Controller Integrator Clamp Out" FLOAT32_IEEE EcuIntgdSwGend_CM_single 0 0 -10000.0 10000.0 ECU_ADDRESS 0x4000E730 /* @ECU_Address@CrsCtrl_CoeffKiClampOut@ */ /end MEASUREMENT
/begin MEASUREMENT WgC_bAcvSurgeLim "Surge Limitation Active" UBYTE EcuIntgdSwGend_CM_boolean 0 0 0.0 1.0 ECU_ADDRESS 0x4000DC24 /* @ECU_Address@WgC_bAcvSurgeLim@ */ /end MEASUREMENT
/begin MEASUREMENT WM_bPAirBoostOvEna "Air Boost Pressure Over Error Enable" UBYTE EcuIntgdSwGend_CM_boolean 0 0 0.0 1.0 ECU_ADDRESS 0x4000E775 /* @ECU_Address@WM_bPAirBoostOvEna@ */ /end MEASUREMENT
/begin MEASUREMENT WM_bErrPAirBoostOvLvl1 "Air Boost Pressure Over Error Level 1" UBYTE EcuIntgdSwGend_CM_boolean 0 0 0.0 1.0 ECU_ADDRESS 0x4000DC3C /* @ECU_Address@WM_bErrPAirBoostOvLvl1@ */ /end MEASUREMENT
/begin MEASUREMENT WM_bErrPAirBoostOvLvl2 "Air Boost Pressure Over Error Level 2" UBYTE EcuIntgdSwGend_CM_boolean 0 0 0.0 1.0 ECU_ADDRESS 0x4000E119 /* @ECU_Address@WM_bErrPAirBoostOvLvl2@ */ /end MEASUREMENT
/begin MEASUREMENT WM_bErrPAirBoostOvLvl3 "Air Boost Pressure Over Error Level 3" UBYTE EcuIntgdSwGend_CM_boolean 0 0 0.0 1.0 ECU_ADDRESS 0x4000E735 /* @ECU_Address@WM_bErrPAirBoostOvLvl3@ */ /end MEASUREMENT
/begin MEASUREMENT WM_bErrPAirBoostOv "Air Boost Pressure Over Error" UBYTE EcuIntgdSwGend_CM_boolean 0 0 0.0 1.0 ECU_ADDRESS 0x4000E388 /* @ECU_Address@WM_bErrPAirBoostOv@ */ /end MEASUREMENT
/begin MEASUREMENT WM_bErrCylMisfEna "Cylinder Misfire Error Enable" UBYTE EcuIntgdSwGend_CM_boolean 0 0 0.0 1.0 ECU_ADDRESS 0x4000E51C /* @ECU_Address@WM_bErrCylMisfEna@ */ /end MEASUREMENT
/begin MEASUREMENT WM_bErrCylMisfLvl1 "Cylinder Misfire Error Level 1" UBYTE EcuIntgdSwGend_CM_boolean 0 0 0.0 1.0 ECU_ADDRESS 0x4000DAA4 /* @ECU_Address@WM_bErrCylMisfLvl1@ */ /end MEASUREMENT
/begin MEASUREMENT WM_bErrCylMisfLvl2 "Cylinder Misfire Error Level 2" UBYTE EcuIntgdSwGend_CM_boolean 0 0 0.0 1.0 ECU_ADDRESS 0x4000DC86 /* @ECU_Address@WM_bErrCylMisfLvl2@ */ /end MEASUREMENT
/begin MEASUREMENT WM_bErrCylMisfLvl3 "Cylinder Misfire Error Level 3" UBYTE EcuIntgdSwGend_CM_boolean 0 0 0.0 1.0 ECU_ADDRESS 0x4000DAAC /* @ECU_Address@WM_bErrCylMisfLvl3@ */ /end MEASUREMENT
/begin MEASUREMENT WM_bErrCylMisf "Cylinder Misfire Error" UBYTE EcuIntgdSwGend_CM_boolean 0 0 0.0 1.0 ECU_ADDRESS 0x4000E69E /* @ECU_Address@WM_bErrCylMisf@ */ /end MEASUREMENT
/begin MEASUREMENT WM_bUClmp30UndEna "Battery Voltage Under Error Enable" UBYTE EcuIntgdSwGend_CM_boolean 0 0 0.0 1.0 ECU_ADDRESS 0x4000DD59 /* @ECU_Address@WM_bUClmp30UndEna@ */ /end MEASUREMENT
/begin MEASUREMENT WM_bErrUClmp30UndLvl1 "Batter Voltage Under Error Level 1" UBYTE EcuIntgdSwGend_CM_boolean 0 0 0.0 1.0 ECU_ADDRESS 0x4000D82C /* @ECU_Address@WM_bErrUClmp30UndLvl1@ */ /end MEASUREMENT
/begin MEASUREMENT WM_bErrUClmp30UndLvl2 "Batter Voltage Under Error Level 2" UBYTE EcuIntgdSwGend_CM_boolean 0 0 0.0 1.0 ECU_ADDRESS 0x4000D82D /* @ECU_Address@WM_bErrUClmp30UndLvl2@ */ /end MEASUREMENT
/begin MEASUREMENT WM_bErrUClmp30UndLvl3 "Batter Voltage Under Error Level 3" UBYTE EcuIntgdSwGend_CM_boolean 0 0 0.0 1.0 ECU_ADDRESS 0x4000D82E /* @ECU_Address@WM_bErrUClmp30UndLvl3@ */ /end MEASUREMENT
/begin MEASUREMENT WM_bErrUClmp30Und "Batter Voltage Under Error" UBYTE EcuIntgdSwGend_CM_boolean 0 0 0.0 1.0 ECU_ADDRESS 0x4000E5E1 /* @ECU_Address@WM_bErrUClmp30Und@ */ /end MEASUREMENT
/begin MEASUREMENT WM_bUClmp30OvEna "Battery Voltage Over Error Enable" UBYTE EcuIntgdSwGend_CM_boolean 0 0 0.0 1.0 ECU_ADDRESS 0x4000E004 /* @ECU_Address@WM_bUClmp30OvEna@ */ /end MEASUREMENT
/begin MEASUREMENT WM_bErrUClmp30OvLvl1 "Batter Voltage Over Error Level 1" UBYTE EcuIntgdSwGend_CM_boolean 0 0 0.0 1.0 ECU_ADDRESS 0x4000DF90 /* @ECU_Address@WM_bErrUClmp30OvLvl1@ */ /end MEASUREMENT
/begin MEASUREMENT WM_bErrUClmp30OvLvl2 "Batter Voltage Over Error Level 2" UBYTE EcuIntgdSwGend_CM_boolean 0 0 0.0 1.0 ECU_ADDRESS 0x4000DF91 /* @ECU_Address@WM_bErrUClmp30OvLvl2@ */ /end MEASUREMENT
/begin MEASUREMENT WM_bErrUClmp30OvLvl3 "Batter Voltage Over Error Level 3" UBYTE EcuIntgdSwGend_CM_boolean 0 0 0.0 1.0 ECU_ADDRESS 0x4000E588 /* @ECU_Address@WM_bErrUClmp30OvLvl3@ */ /end MEASUREMENT
/begin MEASUREMENT WM_bErrUClmp30Ov "Batter Voltage Over Error" UBYTE EcuIntgdSwGend_CM_boolean 0 0 0.0 1.0 ECU_ADDRESS 0x4000D9F1 /* @ECU_Address@WM_bErrUClmp30Ov@ */ /end MEASUREMENT
/begin MEASUREMENT TL_bComplDebNEngAcvForTCoolt "Engine Dependent Activation Timer Out for Exhaust Left Temperature" UBYTE EcuIntgdSwGend_CM_boolean 0 0 0.0 1.0 ECU_ADDRESS 0x4000E53E /* @ECU_Address@TL_bComplDebNEngAcvForTCoolt@ */ /end MEASUREMENT
/begin MEASUREMENT TL_bComplDebNEngAcvForTFu "Engine Dependent Activation Timer Out for Compressor Inlet Temperature" UBYTE EcuIntgdSwGend_CM_boolean 0 0 0.0 1.0 ECU_ADDRESS 0x4000E381 /* @ECU_Address@TL_bComplDebNEngAcvForTFu@ */ /end MEASUREMENT
/begin MEASUREMENT TL_bComplDebNEngAcvForNExhTrbChrg "Engine Dependent Activation Timer Out for Turbo Charger Speed" UBYTE EcuIntgdSwGend_CM_boolean 0 0 0.0 1.0 ECU_ADDRESS 0x4000DE60 /* @ECU_Address@TL_bComplDebNEngAcvForNExhTrbChrg@ */ /end MEASUREMENT
/begin MEASUREMENT TL_bComplDebNEngAcvForPAirBoost "Engine Dependent Activation Timer Out for Air Boost Pressure" UBYTE EcuIntgdSwGend_CM_boolean 0 0 0.0 1.0 ECU_ADDRESS 0x4000E179 /* @ECU_Address@TL_bComplDebNEngAcvForPAirBoost@ */ /end MEASUREMENT
/begin MEASUREMENT TL_bComplDebNEngAcvForTAir "Engine Dependent Activation Timer Out for Air Boost Temperature" UBYTE EcuIntgdSwGend_CM_boolean 0 0 0.0 1.0 ECU_ADDRESS 0x4000E67D /* @ECU_Address@TL_bComplDebNEngAcvForTAir@ */ /end MEASUREMENT
/begin MEASUREMENT TL_bComplDebNEngAcvForPAirAmb "Engine Dependent Activation Timer Out for Ambient Air Pressure" UBYTE EcuIntgdSwGend_CM_boolean 0 0 0.0 1.0 ECU_ADDRESS 0x4000D9BD /* @ECU_Address@TL_bComplDebNEngAcvForPAirAmb@ */ /end MEASUREMENT
/begin MEASUREMENT TL_bComplDebNEngAcvForTOil "Engine Speed Dependent Activation Timer Out for Battery Voltage" UBYTE EcuIntgdSwGend_CM_boolean 0 0 0.0 1.0 ECU_ADDRESS 0x4000E340 /* @ECU_Address@TL_bComplDebNEngAcvForTOil@ */ /end MEASUREMENT
/begin MEASUREMENT SC_bEngNotTurnCompTi "" UBYTE EcuIntgdSwGend_CM_boolean 0 0 0.0 1.0 ECU_ADDRESS 0x4000E2EC /* @ECU_Address@SC_bEngNotTurnCompTi@ */ /end MEASUREMENT
/begin MEASUREMENT SC_bTiAcvnErrVCVDebOutp "VCV Error Debouncer Activation" UBYTE EcuIntgdSwGend_CM_boolean 0 0 0.0 1.0 ECU_ADDRESS 0x4000DF12 /* @ECU_Address@SC_bTiAcvnErrVCVDebOutp@ */ /end MEASUREMENT
/begin MEASUREMENT SC_bTiAcvnErrPCVDebOutp "PCV Error Debouncer Activation " UBYTE EcuIntgdSwGend_CM_boolean 0 0 0.0 1.0 ECU_ADDRESS 0x4000E616 /* @ECU_Address@SC_bTiAcvnErrPCVDebOutp@ */ /end MEASUREMENT
/begin MEASUREMENT SC_bTiAcvnLvlFuDebOutp "Fuel Level Debouncer Active Output" UBYTE EcuIntgdSwGend_CM_boolean 0 0 0.0 1.0 ECU_ADDRESS 0x4000DCF2 /* @ECU_Address@SC_bTiAcvnLvlFuDebOutp@ */ /end MEASUREMENT
/begin MEASUREMENT SC_bTiAcvnLvlOilDebOutp "Oil Level Debouncer Active Output" UBYTE EcuIntgdSwGend_CM_boolean 0 0 0.0 1.0 ECU_ADDRESS 0x4000E635 /* @ECU_Address@SC_bTiAcvnLvlOilDebOutp@ */ /end MEASUREMENT
/begin MEASUREMENT RPG_bCoeffKiRst "Coefficient Integral Reset" UBYTE EcuIntgdSwGend_CM_boolean 0 0 0.0 1.0 ECU_ADDRESS 0x4000D6FB /* @ECU_Address@RPG_bCoeffKiRst@ */ /end MEASUREMENT
/begin MEASUREMENT EIP_VehVDeToHi "Vehicle Speed Deviation To High" UBYTE EcuIntgdSwGend_CM_boolean 0 0 0.0 1.0 ECU_ADDRESS 0x4000D9A8 /* @ECU_Address@EIP_VehVDeToHi@ */ /end MEASUREMENT
/begin MEASUREMENT EIP_bPercgAccrDervDiffHi "Acceleartor Percentage Derivative Difference High" UBYTE EcuIntgdSwGend_CM_boolean 0 0 0.0 1.0 ECU_ADDRESS 0x4000DDD3 /* @ECU_Address@EIP_bPercgAccrDervDiffHi@ */ /end MEASUREMENT
/begin MEASUREMENT EIP_bPercgAccrDervDiffLo "Acceleartor Percentage Derivative Difference Low" UBYTE EcuIntgdSwGend_CM_boolean 0 0 0.0 1.0 ECU_ADDRESS 0x4000E00C /* @ECU_Address@EIP_bPercgAccrDervDiffLo@ */ /end MEASUREMENT
/begin MEASUREMENT EIP_bErrAccrDiff "Error Accelerator Actual Value Difference" UBYTE EcuIntgdSwGend_CM_boolean 0 0 0.0 1.0 ECU_ADDRESS 0x4000D951 /* @ECU_Address@EIP_bErrAccrDiff@ */ /end MEASUREMENT
/begin MEASUREMENT EIP_bAcvIdleModDebOut "Idle Mode Debouncer Active" UBYTE EcuIntgdSwGend_CM_boolean 0 0 0.0 1.0 ECU_ADDRESS 0x4000E261 /* @ECU_Address@EIP_bAcvIdleModDebOut@ */ /end MEASUREMENT
/begin MEASUREMENT EIP_bErrCyl1Misf "Error Cylinder Misfire for Cylinder 1" UBYTE EcuIntgdSwGend_CM_boolean 0 0 0.0 1.0 ECU_ADDRESS 0x4000DD93 /* @ECU_Address@EIP_bErrCyl1Misf@ */ /end MEASUREMENT
/begin MEASUREMENT EIP_bErrCyl2Misf "Error Cylinder Misfire for Cylinder 2" UBYTE EcuIntgdSwGend_CM_boolean 0 0 0.0 1.0 ECU_ADDRESS 0x4000DAF7 /* @ECU_Address@EIP_bErrCyl2Misf@ */ /end MEASUREMENT
/begin MEASUREMENT EIP_bErrCyl3Misf "Error Cylinder Misfire for Cylinder 3" UBYTE EcuIntgdSwGend_CM_boolean 0 0 0.0 1.0 ECU_ADDRESS 0x4000D848 /* @ECU_Address@EIP_bErrCyl3Misf@ */ /end MEASUREMENT
/begin MEASUREMENT EIP_bErrCyl4Misf "Error Cylinder Misfire for Cylinder 4" UBYTE EcuIntgdSwGend_CM_boolean 0 0 0.0 1.0 ECU_ADDRESS 0x4000E6C4 /* @ECU_Address@EIP_bErrCyl4Misf@ */ /end MEASUREMENT
/begin MEASUREMENT DTqC_AcvHardLim "Engine Speed Hard Limit Activation Flag" UBYTE EcuIntgdSwGend_CM_boolean 0 0 0.0 1.0 ECU_ADDRESS 0x4000E26A /* @ECU_Address@DTqC_AcvHardLim@ */ /end MEASUREMENT
/begin MEASUREMENT DTqC_AcvSoftLim "Engine Speed Soft Limit Activation Flag" UBYTE EcuIntgdSwGend_CM_boolean 0 0 0.0 1.0 ECU_ADDRESS 0x4000DDEC /* @ECU_Address@DTqC_AcvSoftLim@ */ /end MEASUREMENT
/begin COMPU_METHOD EcuIntgdSwGend_CM_single_N_m "Q = V" RAT_FUNC "%8.6" "N*m" COEFFS 0 1 0 0 0 1 /end COMPU_METHOD
/begin COMPU_METHOD EcuIntgdSwGend_CM_single_rpm "Q = V" RAT_FUNC "%8.6" "rpm" COEFFS 0 1 0 0 0 1 /end COMPU_METHOD
/begin COMPU_METHOD EcuIntgdSwGend_CM_single_degC "Q = V" RAT_FUNC "%8.6" "degC" COEFFS 0 1 0 0 0 1 /end COMPU_METHOD
/begin COMPU_METHOD EcuIntgdSwGend_CM_single "Q = V" RAT_FUNC "%8.6" "" COEFFS 0 1 0 0 0 1 /end COMPU_METHOD
/begin COMPU_METHOD EcuIntgdSwGend_CM_single__ "Q = V" RAT_FUNC "%8.6" "%" COEFFS 0 1 0 0 0 1 /end COMPU_METHOD
/begin COMPU_METHOD EcuIntgdSwGend_CM_single_deg "Q = V" RAT_FUNC "%8.6" "deg" COEFFS 0 1 0 0 0 1 /end COMPU_METHOD
/begin COMPU_METHOD EcuIntgdSwGend_CM_single_ms "Q = V" RAT_FUNC "%8.6" "ms" COEFFS 0 1 0 0 0 1 /end COMPU_METHOD
/begin COMPU_METHOD EcuIntgdSwGend_CM_single_mbar "Q = V" RAT_FUNC "%8.6" "mbar" COEFFS 0 1 0 0 0 1 /end COMPU_METHOD
/begin COMPU_METHOD EcuIntgdSwGend_CM_single_bar "Q = V" RAT_FUNC "%8.6" "bar" COEFFS 0 1 0 0 0 1 /end COMPU_METHOD
/begin COMPU_METHOD EcuIntgdSwGend_CM_single_mm_3_stk "Q = V" RAT_FUNC "%8.6" "mm^3/stk" COEFFS 0 1 0 0 0 1 /end COMPU_METHOD
/begin COMPU_METHOD EcuIntgdSwGend_CM_single_V "Q = V" RAT_FUNC "%8.6" "V" COEFFS 0 1 0 0 0 1 /end COMPU_METHOD
/begin COMPU_METHOD EcuIntgdSwGend_CM_single_km_h "Q = V" RAT_FUNC "%8.6" "km/h" COEFFS 0 1 0 0 0 1 /end COMPU_METHOD
/begin COMPU_METHOD EcuIntgdSwGend_CM_single_us "Q = V" RAT_FUNC "%8.6" "us" COEFFS 0 1 0 0 0 1 /end COMPU_METHOD
/begin COMPU_METHOD EcuIntgdSwGend_CM_single_kg_s "Q = V" RAT_FUNC "%8.6" "kg/s" COEFFS 0 1 0 0 0 1 /end COMPU_METHOD
/begin COMPU_METHOD EcuIntgdSwGend_CM_uint32 "Q = V" RAT_FUNC "%10.0" "" COEFFS 0 1 0 0 0 1 /end COMPU_METHOD
/begin COMPU_METHOD EcuIntgdSwGend_CM_boolean "Q = V" RAT_FUNC "%1.0" "" COEFFS 0 1 0 0 0 1 /end COMPU_METHOD
/begin GROUP S680_Return_To_Normal "EcuIntgdSwGend/ControlSoftware/WarnMong/Warning-Reduction-Shutdown Functions/Return To Normal" /begin SUB_GROUP S686_Debouncer /end SUB_GROUP
 /begin REF_CHARACTERISTIC EG_Mask32Bit0_C EG_Mask32Bit128_C EG_Mask32Bit16_C EG_Mask32Bit1_C EG_Mask32Bit2_C EG_Mask32Bit32_C EG_Mask32Bit4_C EG_Mask32Bit64_C EG_Mask32Bit8_C EG_NmrSng0_C EG_TsSw20_C WM_MaskRTNOvs_P WM_MaskRTNOvv_P WM_NEngDetdThdRTN_P WM_TiMaxNEngDetdThdRTN_P /end REF_CHARACTERISTIC
 /begin REF_MEASUREMENT WM_MaskRTN /end REF_MEASUREMENT
/end GROUP
/begin GROUP S680_Temperature "EcuIntgdSwGend/ControlSoftware/WarnMong/Warning-Reduction-Shutdown Functions/Temperature"
 /begin SUB_GROUP S687_Air_Boost_Over_Temperature S687_Air_Boost_Under_Temperature S687_Ambient_Air_Over_Temperature S687_Ambient_Air_Under_Temperature S687_Coolant_Over_Temperature S687_Coolant_Under_Temperature S687_ECU_Temperature S687_Fuel_Over_Temperature S687_Oil_Over_Temperature S687_Oil_Under_Temperature /end SUB_GROUP
/end GROUP
/begin GROUP S841_AirMassFlowCalc "EcuIntgdSwGend/ControlSoftware/WgtCtl/TurbochargerSpeedEstimation/AirMassFlowCalc" /begin SUB_GROUP S843_avoidzerodivision_max /end SUB_GROUP
 /begin REF_CHARACTERISTIC EG_NmrSng1000_C EG_NmrSng2_C EG_NmrSngK_C WgC_AirGas_C WgC_NoStkEng_C WgC_VolEng_P /end REF_CHARACTERISTIC
 /begin REF_MEASUREMENT WgC_AirMassFlowCalcMultiOut WgC_MAirFlow /end REF_MEASUREMENT
/end GROUP
/begin GROUP S841_CalculatedCompressorInletPressure "EcuIntgdSwGend/ControlSoftware/WgtCtl/TurbochargerSpeedEstimation/CalculatedCompressorInletPressure" /begin REF_CHARACTERISTIC WgC_PDropIco_M /end REF_CHARACTERISTIC /begin REF_MEASUREMENT WgC_PCmprInltCalcd WgC_PDropIcoMapOut /end REF_MEASUREMENT /end GROUP
/begin GROUP S841_CalculatedCompressorOutletPressure "EcuIntgdSwGend/ControlSoftware/WgtCtl/TurbochargerSpeedEstimation/CalculatedCompressorOutletPressure" /begin REF_CHARACTERISTIC WgC_PCmprOutltCalcd_M /end REF_CHARACTERISTIC /begin REF_MEASUREMENT WgC_PCmprOutltCalcd WgC_PCmprOutltMapOut /end REF_MEASUREMENT /end GROUP
/begin GROUP S841_CompressorEfficiency "EcuIntgdSwGend/ControlSoftware/WgtCtl/TurbochargerSpeedEstimation/CompressorEfficiency" /begin REF_CHARACTERISTIC WgC_EffCmpr_M /end REF_CHARACTERISTIC /begin REF_MEASUREMENT WgC_EffCmpr /end REF_MEASUREMENT /end GROUP
/begin GROUP S841_CompressorPressureRatio "EcuIntgdSwGend/ControlSoftware/WgtCtl/TurbochargerSpeedEstimation/CompressorPressureRatio" /begin SUB_GROUP S847_avoidzerodivision_single /end SUB_GROUP /begin REF_MEASUREMENT WgC_RatPCmpr /end REF_MEASUREMENT /end GROUP
/begin GROUP S841_CorrectedAirMassFlow "EcuIntgdSwGend/ControlSoftware/WgtCtl/TurbochargerSpeedEstimation/CorrectedAirMassFlow" /begin REF_CHARACTERISTIC WgC_MCorrAirFlowPCmprInlt_M WgC_MCorrAirFlowTAmbAir_M /end REF_CHARACTERISTIC
 /begin REF_MEASUREMENT WgC_MCorrAirFlowPCmprInlt WgC_MCorrAirFlowTCmprInlt WgC_MCorrdAirFlow /end REF_MEASUREMENT
/end GROUP
/begin GROUP S841_SurgeCheck "EcuIntgdSwGend/ControlSoftware/WgtCtl/TurbochargerSpeedEstimation/SurgeCheck" /begin REF_CHARACTERISTIC WgC_SurgeLim_M /end REF_CHARACTERISTIC /begin REF_MEASUREMENT WgC_DifSurgeLine WgC_bAcvSurgeLim /end REF_MEASUREMENT /end GROUP
/begin GROUP S841_TurbochargerSpeed "EcuIntgdSwGend/ControlSoftware/WgtCtl/TurbochargerSpeedEstimation/TurbochargerSpeed" /begin REF_CHARACTERISTIC WgC_NTrbChrgOvs_P WgC_NTrbChrgOvv_P WgC_NTrbChrg_M /end REF_CHARACTERISTIC /begin REF_MEASUREMENT WgC_NTrbChrg /end REF_MEASUREMENT /end GROUP
/begin GROUP S841_VolumetricEfficiency "EcuIntgdSwGend/ControlSoftware/WgtCtl/TurbochargerSpeedEstimation/VolumetricEfficiency" /begin REF_CHARACTERISTIC WgC_VolEff_M /end REF_CHARACTERISTIC /begin REF_MEASUREMENT WgC_VolEff /end REF_MEASUREMENT /end GROUP
/begin GROUP S842_BoostPressurePID "EcuIntgdSwGend/ControlSoftware/WgtCtl/Wastegate Control/BoostPressurePID" /begin SUB_GROUP S854_PID_Controller /end SUB_GROUP
 /begin REF_CHARACTERISTIC WgC_CoeffDForWgCCtl_M WgC_CoeffFiltForWgCCtl_M WgC_CoeffIForWgCCtl_M WgC_CoeffPForWgCCtl_M WgC_DutySatPIDMax_P WgC_DutySatPIDMin_P WgC_FacSclPIDCoeff_P WgC_PIDCoeffDOvs_P WgC_PIDCoeffDOvv_P WgC_PIDCoeffFiltOvs_P WgC_PIDCoeffFiltOvv_P WgC_PIDCoeffIOvs_P WgC_PIDCoeffIOvv_P WgC_PIDCoeffPOvs_P WgC_PIDCoeffPOvv_P /end REF_CHARACTERISTIC
 /begin REF_MEASUREMENT WgC_CoeffDForWgCCtlMapOut WgC_CoeffFiltForWgCCtlMapOut WgC_CoeffIForWgCCtlMapOut WgC_CoeffPForWgCCtlMapOut WgC_ErrPAirBoost WgC_PIDCoeffD WgC_PIDCoeffFilt WgC_PIDCoeffI WgC_PIDCoeffP /end REF_MEASUREMENT
/end GROUP
/begin GROUP S842_BoostPressureRefSelector "EcuIntgdSwGend/ControlSoftware/WgtCtl/Wastegate Control/BoostPressureRefSelector"
 /begin REF_CHARACTERISTIC WgC_CorrPAmbAirRef_M WgC_PAirBoostRefCorrTCoolt_M WgC_PAirBoostRef_M WgC_SurgeCorrPAirBoostRef_M WgC_TCorrAmbAirRef_M WgC_TCorrOilRef_M /end REF_CHARACTERISTIC
 /begin REF_MEASUREMENT WgC_CorrPAmbAirRef WgC_PAirBoostRef WgC_PAirBoostRefCorrSurge WgC_PAirBoostRefCorrTCoolt WgC_PAirBoostRefMap WgC_TCorrAmbAirRef WgC_TCorrOilRef /end REF_MEASUREMENT
/end GROUP
/begin GROUP S842_saturation "EcuIntgdSwGend/ControlSoftware/WgtCtl/Wastegate Control/saturation" /begin REF_MEASUREMENT WgC_DutyWgtVlvAfterSat /end REF_MEASUREMENT /end GROUP
/begin GROUP S24_PID_Controller "EcuIntgdSwGend/ControlSoftware/CrsCtrl/CruiseControl/CruiseControlPIDController/PID_Controller" /begin SUB_GROUP S27_clamping_unit /end SUB_GROUP /begin REF_CHARACTERISTIC EG_NmrSng0_C /end REF_CHARACTERISTIC
 /begin REF_MEASUREMENT CrsCtrl_CoeffKdFbOut CrsCtrl_CoeffKdOut CrsCtrl_CoeffKiClampOut CrsCtrl_CoeffKiClampPreSatOut CrsCtrl_CoeffKpOut CrsCtrl_PIDOutCrsCtrlTq /end REF_MEASUREMENT
/end GROUP
/begin GROUP S30_Engine_Brake_Level_1_Activation_Condition "EcuIntgdSwGend/ControlSoftware/CrsCtrl/Engine Brake Activation via Cruise Control/Engine Brake Level Activation Condition/Engine Brake Level 1 Activation Condition" /begin SUB_GROUP S32_Debouncer2 S32_SetRstLtch /end SUB_GROUP
 /begin REF_CHARACTERISTIC CrsCtrl_EngBrkLvl1ActvnThd_P CrsCtrl_EngBrkLvl1DeactvnThd_P CrsCtrl_TiEngBrkLvl1ActvnDeb_P EG_NmrSng0_C EG_TsSw_C /end REF_CHARACTERISTIC
/end GROUP
/begin GROUP S30_Engine_Brake_Level_2_Activation_Condition "EcuIntgdSwGend/ControlSoftware/CrsCtrl/Engine Brake Activation via Cruise Control/Engine Brake Level Activation Condition/Engine Brake Level 2 Activation Condition" /begin SUB_GROUP S33_Debouncer S33_SetRstLtch3 /end SUB_GROUP
 /begin REF_CHARACTERISTIC CrsCtrl_EngBrkLvl2ActvnThd_P CrsCtrl_EngBrkLvl2DeactvnThd_P CrsCtrl_TiEngBrkLvl2ActvnDeb_P EG_NmrSng0_C EG_TsSw_C /end REF_CHARACTERISTIC
/end GROUP
/begin GROUP S51_N_Map_Interpolation_for_Brake_Torque "EcuIntgdSwGend/ControlSoftware/DesTqClcn/Running Mode/Driver Demand Torque Calculation/N-Map Interpolation for Brake Torque"
 /begin SUB_GROUP S55_Anti_Jerk_Algorithm S55_avoidzerodivision_single S55_avoidzerodivision_single1 /end SUB_GROUP
 /begin REF_CHARACTERISTIC DTqC_TCooltMap1Thd_P DTqC_TCooltMap2Thd_P DTqC_TCooltMap3Thd_P DTqC_TqBrkMap1_M DTqC_TqBrkMap2_M DTqC_TqBrkMap3_M DTqC_TqLimdBrk1Ovs_P DTqC_TqLimdBrk1Ovv_P DTqC_TqLimdBrk2Ovs_P DTqC_TqLimdBrk2Ovv_P DTqC_TqLimdBrk3Ovs_P DTqC_TqLimdBrk3Ovv_P /end REF_CHARACTERISTIC
 /begin REF_MEASUREMENT DTqC_TqBrkMap1 DTqC_TqBrkMap2 DTqC_TqBrkMap3 DTqC_TqLimdBrk DTqC_TqLimdBrk1to2Intp DTqC_TqLimdBrk2To3Intp /end REF_MEASUREMENT
/end GROUP
/begin GROUP S52_EndSpeed_Soft_Limit_Governor "EcuIntgdSwGend/ControlSoftware/DesTqClcn/Running Mode/EndSpeed Governor/EndSpeed Soft Limit Governor" /begin SUB_GROUP S63_PID_Controller /end SUB_GROUP
 /begin REF_CHARACTERISTIC DTqC_CoeffDForEndSpdCtl_M DTqC_CoeffFiltForEndSpdCtl_M DTqC_CoeffFiltKdEndSpdCtlOvs_P DTqC_CoeffFiltKdEndSpdCtlOvv_P DTqC_CoeffIForEndSpdCtl_M DTqC_CoeffPForEndSpdCtl_M DTqC_FacSclPIDCoeffEndSpd_P DTqC_KdEndSpdCtlOvs_P DTqC_KdEndSpdCtlOvv_P DTqC_KiEndSpdCtlOvs_P DTqC_KiEndSpdCtlOvv_P DTqC_KpEndSpdCtlOvs_P DTqC_KpEndSpdCtlOvv_P DTqC_TqDesSatPIDMaxEndSpd_P DTqC_TqDesSatPIDMinEndSpd_P /end REF_CHARACTERISTIC
 /begin REF_MEASUREMENT DTqC_CoeffDForEndSpdCtlMapOut DTqC_CoeffDForSpdCtlEndSpd DTqC_CoeffFiltForEndSpdCtlMapOut DTqC_CoeffFiltForSpdCtlEndSpd DTqC_CoeffIForEndSpdCtlMapOut DTqC_CoeffIForSpdCtlEndSpd DTqC_CoeffPForEndSpdCtlMapOut DTqC_CoeffPForSpdCtlEndSpd DTqC_NEngDelta /end REF_MEASUREMENT
/end GROUP
/begin GROUP S52_Engine_Speed_Hysteresis_for_Hard_Limitation "EcuIntgdSwGend/ControlSoftware/DesTqClcn/Running Mode/EndSpeed Governor/Engine Speed Hysteresis for Hard Limitation" /begin SUB_GROUP S64_Hard_Limit_Latching /end SUB_GROUP /begin REF_CHARACTERISTIC DTqC_HardLimEnaSwt_P EG_bFlgFalse_C EG_bFlgTrue_C /end REF_CHARACTERISTIC /begin REF_MEASUREMENT DTqC_AcvHardLim /end REF_MEASUREMENT /end GROUP
/begin GROUP S52_Engine_Speed_Hysteresis_for_Soft_Limitation "EcuIntgdSwGend/ControlSoftware/DesTqClcn/Running Mode/EndSpeed Governor/Engine Speed Hysteresis for Soft Limitation" /begin REF_CHARACTERISTIC DTqC_SoftLimEnaSwt_P EG_bFlgFalse_C EG_bFlgTrue_C /end REF_CHARACTERISTIC /begin REF_MEASUREMENT DTqC_AcvSoftLim /end REF_MEASUREMENT /end GROUP
/begin GROUP S53_PID_Controller1 "EcuIntgdSwGend/ControlSoftware/DesTqClcn/Running Mode/Idle Speed Controller/PID_Controller1" /begin SUB_GROUP S74_clamping_unit /end SUB_GROUP /begin REF_CHARACTERISTIC EG_NmrSng0_C /end REF_CHARACTERISTIC
 /begin REF_MEASUREMENT DTqC_CoeffKdFbOut DTqC_CoeffKdOut DTqC_CoeffKiClampOut DTqC_CoeffKiClampPreSatOut DTqC_CoeffKiClampSwtchOut DTqC_CoeffKiOut DTqC_CoeffKpOut DTqC_IdleSpdCtlPIDOut /end REF_MEASUREMENT
/end GROUP
/begin GROUP S54_TSC1_Request_for_Speed_Control "EcuIntgdSwGend/ControlSoftware/DesTqClcn/Running Mode/TSC1 Control Purpose/TSC1 Request for Speed Control" /begin SUB_GROUP S77_PID_Controller1 /end SUB_GROUP
 /begin REF_CHARACTERISTIC DTqC_CoeffDForTSC1SpdCtl_M DTqC_CoeffFiltForTSC1SpdCtl_M DTqC_CoeffFiltTSC1SpdCtlOvs_P DTqC_CoeffFiltTSC1SpdCtlOvv_P DTqC_CoeffIForTSC1SpdCtl_M DTqC_CoeffPForTSC1SpdCtl_M DTqC_KdTSC1SpdCtlOvs_P DTqC_KdTSC1SpdCtlOvv_P DTqC_KiTSC1SpdCtlOvs_P DTqC_KiTSC1SpdCtlOvv_P DTqC_KpTSC1SpdCtlOvs_P DTqC_KpTSC1SpdCtlOvv_P DTqC_TqDesTSC1ReqPIDMax_P DTqC_TqDesTSC1ReqPIDMin_P /end REF_CHARACTERISTIC
 /begin REF_MEASUREMENT DTqC_CoeffDForTSC1ReqSpdCtl DTqC_CoeffDForTSC1ReqSpdCtlMapOut DTqC_CoeffFiltForTSC1ReqSpdCtl DTqC_CoeffFiltForTSC1ReqSpdCtlMapOut DTqC_CoeffIForTSC1ReqSpdCtl DTqC_CoeffIForTSC1ReqSpdCtlMapOut DTqC_CoeffPForTSC1ReqSpdCtl DTqC_CoeffPForTSC1ReqSpdCtlMapOut DTqC_ErrNSpdReq /end REF_MEASUREMENT
/end GROUP
/begin GROUP S98_Debouncer4 "EcuIntgdSwGend/ControlSoftware/EcuInpPrcsg/Actuator Defect Signals/Shutdown For Injector Error/Debouncer4" /begin REF_MEASUREMENT EIP_TiElpdErrInjrShtdwn /end REF_MEASUREMENT /end GROUP
/begin GROUP S100_Cylinder_1_Speed_Error_Calculation "EcuIntgdSwGend/ControlSoftware/EcuInpPrcsg/Additionals/Cylinder Balancing/Cylinder 1 Speed Error Calculation" /begin SUB_GROUP S103_LowPassFilter1 S103_LowPassFilter2 /end SUB_GROUP
 /begin REF_CHARACTERISTIC EG_NmrSng0_C EG_TsSw_C EIP_NCyl1ErrOvs_P EIP_NCyl1ErrOvv_P EIP_NCylMaxThd_P EIP_NCylMinThd_P EIP_TcNCyl1MinFil_P EIP_TcNMeaCylMin_P /end REF_CHARACTERISTIC
 /begin REF_MEASUREMENT EIP_ErrNCyl1 EIP_NCyl1Dif /end REF_MEASUREMENT
/end GROUP
/begin GROUP S100_Cylinder_2_Speed_Error_Calculation "EcuIntgdSwGend/ControlSoftware/EcuInpPrcsg/Additionals/Cylinder Balancing/Cylinder 2 Speed Error Calculation" /begin SUB_GROUP S104_LowPassFilter3 /end SUB_GROUP
 /begin REF_CHARACTERISTIC EG_NmrSng0_C EG_TsSw_C EIP_NCyl2ErrOvs_P EIP_NCyl2ErrOvv_P EIP_NCylMaxThd_P EIP_NCylMinThd_P EIP_TcNCyl2MinFil_P /end REF_CHARACTERISTIC
 /begin REF_MEASUREMENT EIP_ErrNCyl2 EIP_NCyl2Dif /end REF_MEASUREMENT
/end GROUP
/begin GROUP S100_Cylinder_3_Speed_Error_Calculation "EcuIntgdSwGend/ControlSoftware/EcuInpPrcsg/Additionals/Cylinder Balancing/Cylinder 3 Speed Error Calculation" /begin SUB_GROUP S105_LowPassFilter4 /end SUB_GROUP
 /begin REF_CHARACTERISTIC EG_NmrSng0_C EG_TsSw_C EIP_NCyl3ErrOvs_P EIP_NCyl3ErrOvv_P EIP_NCylMaxThd_P EIP_NCylMinThd_P EIP_TcNCyl3MinFil_P /end REF_CHARACTERISTIC
 /begin REF_MEASUREMENT EIP_ErrNCyl3 EIP_NCyl3Dif /end REF_MEASUREMENT
/end GROUP
/begin GROUP S100_Cylinder_4_Speed_Error_Calculation "EcuIntgdSwGend/ControlSoftware/EcuInpPrcsg/Additionals/Cylinder Balancing/Cylinder 4 Speed Error Calculation" /begin SUB_GROUP S106_LowPassFilter5 /end SUB_GROUP
 /begin REF_CHARACTERISTIC EG_NmrSng0_C EG_TsSw_C EIP_NCyl4ErrOvs_P EIP_NCyl4ErrOvv_P EIP_NCylMaxThd_P EIP_NCylMinThd_P EIP_TcNCyl4MinFil_P /end REF_CHARACTERISTIC
 /begin REF_MEASUREMENT EIP_ErrNCyl4 EIP_NCyl4Dif /end REF_MEASUREMENT
/end GROUP
/begin GROUP S100_Cylinder_5_Speed_Error_Calculation "EcuIntgdSwGend/ControlSoftware/EcuInpPrcsg/Additionals/Cylinder Balancing/Cylinder 5 Speed Error Calculation" /begin SUB_GROUP S107_LowPassFilter6 /end SUB_GROUP
 /begin REF_CHARACTERISTIC EG_NmrSng0_C EG_TsSw_C EIP_NCyl5ErrOvs_P EIP_NCyl5ErrOvv_P EIP_NCylMaxThd_P EIP_NCylMinThd_P EIP_TcNCyl5MinFil_P /end REF_CHARACTERISTIC
 /begin REF_MEASUREMENT EIP_ErrNCyl5 EIP_NCyl5Dif /end REF_MEASUREMENT
/end GROUP
/begin GROUP S100_Cylinder_6_Speed_Error_Calculation "EcuIntgdSwGend/ControlSoftware/EcuInpPrcsg/Additionals/Cylinder Balancing/Cylinder 6 Speed Error Calculation" /begin SUB_GROUP S108_LowPassFilter7 /end SUB_GROUP
 /begin REF_CHARACTERISTIC EG_NmrSng0_C EG_TsSw_C EIP_NCyl6ErrOvs_P EIP_NCyl6ErrOvv_P EIP_NCylMaxThd_P EIP_NCylMinThd_P EIP_TcNCyl6MinFil_P /end REF_CHARACTERISTIC
 /begin REF_MEASUREMENT EIP_ErrNCyl6 EIP_NCyl6Dif /end REF_MEASUREMENT
/end GROUP
/begin GROUP S100_Debouncer6 "EcuIntgdSwGend/ControlSoftware/EcuInpPrcsg/Additionals/Cylinder Balancing/Debouncer6" /begin REF_MEASUREMENT EIP_TiElpdIdleMod EIP_bAcvIdleModDebOut /end REF_MEASUREMENT /end GROUP
/begin GROUP S101_Injector_1_Misfire "EcuIntgdSwGend/ControlSoftware/EcuInpPrcsg/Additionals/Misfire Detection/Injector 1 Misfire" /begin REF_CHARACTERISTIC EIP_NCyl1MinThd_P /end REF_CHARACTERISTIC /begin REF_MEASUREMENT EIP_bErrCyl1Misf /end REF_MEASUREMENT /end GROUP
/begin GROUP S101_Injector_2_Misfire "EcuIntgdSwGend/ControlSoftware/EcuInpPrcsg/Additionals/Misfire Detection/Injector 2 Misfire" /begin REF_CHARACTERISTIC EIP_NCyl2MinThd_P /end REF_CHARACTERISTIC /begin REF_MEASUREMENT EIP_bErrCyl2Misf /end REF_MEASUREMENT /end GROUP
/begin GROUP S101_Injector_3_Misfire "EcuIntgdSwGend/ControlSoftware/EcuInpPrcsg/Additionals/Misfire Detection/Injector 3 Misfire" /begin REF_CHARACTERISTIC EIP_NCyl3MinThd_P /end REF_CHARACTERISTIC /begin REF_MEASUREMENT EIP_bErrCyl3Misf /end REF_MEASUREMENT /end GROUP
/begin GROUP S101_Injector_4_Misfire "EcuIntgdSwGend/ControlSoftware/EcuInpPrcsg/Additionals/Misfire Detection/Injector 4 Misfire" /begin REF_CHARACTERISTIC EIP_NCyl4MinThd_P /end REF_CHARACTERISTIC /begin REF_MEASUREMENT EIP_bErrCyl4Misf /end REF_MEASUREMENT /end GROUP
/begin GROUP S101_Injector_5_Misfire "EcuIntgdSwGend/ControlSoftware/EcuInpPrcsg/Additionals/Misfire Detection/Injector 5 Misfire" /begin REF_CHARACTERISTIC EIP_NCyl5MinThd_P /end REF_CHARACTERISTIC /end GROUP
/begin GROUP S101_Injector_6_Misfire "EcuIntgdSwGend/ControlSoftware/EcuInpPrcsg/Additionals/Misfire Detection/Injector 6 Misfire" /begin REF_CHARACTERISTIC EIP_NCyl6MinThd_P /end REF_CHARACTERISTIC /end GROUP
/begin GROUP S102_Debouncer "EcuIntgdSwGend/ControlSoftware/EcuInpPrcsg/Additionals/Shutdown For Cylinder Misfire Error/Debouncer" /begin REF_MEASUREMENT EIP_TiElpdErrCylMisfWarn /end REF_MEASUREMENT /end GROUP
/begin GROUP S102_Debouncer1 "EcuIntgdSwGend/ControlSoftware/EcuInpPrcsg/Additionals/Shutdown For Cylinder Misfire Error/Debouncer1" /begin REF_MEASUREMENT EIP_TiElpdErrCylMisfRedn /end REF_MEASUREMENT /end GROUP
/begin GROUP S102_Debouncer2 "EcuIntgdSwGend/ControlSoftware/EcuInpPrcsg/Additionals/Shutdown For Cylinder Misfire Error/Debouncer2" /begin REF_MEASUREMENT EIP_TiElpdErrCylMisfShtdwn /end REF_MEASUREMENT /end GROUP
/begin GROUP S187_Debouncer1 "EcuIntgdSwGend/ControlSoftware/EcuInpPrcsg/Level Sensor Signals/Level Sensor Errors/Debouncer1" /begin REF_MEASUREMENT EIP_TiElpdErrLvlOilSnsr /end REF_MEASUREMENT /end GROUP
/begin GROUP S187_Level_Sensor_Diagnostics_Info "EcuIntgdSwGend/ControlSoftware/EcuInpPrcsg/Level Sensor Signals/Level Sensor Errors/Level Sensor Diagnostics Info"
 /begin REF_CHARACTERISTIC EG_DiagcSnsrFltInfoNone_C EG_DiagcSnsrInfoLvlOil_C EG_Mask32Bit0_C EG_Mask32Bit256_C EG_Mask32Bit512_C /end REF_CHARACTERISTIC
/end GROUP
/begin GROUP S187_LowPassFilter2 "EcuIntgdSwGend/ControlSoftware/EcuInpPrcsg/Level Sensor Signals/Level Sensor Errors/LowPassFilter2" /begin REF_CHARACTERISTIC EG_NmrSng0_C EG_bFlgTrue_C /end REF_CHARACTERISTIC /begin REF_MEASUREMENT EIP_LvlOilFild /end REF_MEASUREMENT /end GROUP
/begin GROUP S193_Debouncer1 "EcuIntgdSwGend/ControlSoftware/EcuInpPrcsg/Position & Speed Sensor Signals/Accelerator Pedal Sensor Monitoring/Debouncer1" /begin REF_MEASUREMENT EIP_TiElpdErrAccrDervDiffHi EIP_bPercgAccrDervDiffHi /end REF_MEASUREMENT /end GROUP
/begin GROUP S193_Debouncer5 "EcuIntgdSwGend/ControlSoftware/EcuInpPrcsg/Position & Speed Sensor Signals/Accelerator Pedal Sensor Monitoring/Debouncer5" /begin REF_MEASUREMENT EIP_TiElpdErrAccrDiff EIP_bErrAccrDiff /end REF_MEASUREMENT /end GROUP
/begin GROUP S193_Debouncer6 "EcuIntgdSwGend/ControlSoftware/EcuInpPrcsg/Position & Speed Sensor Signals/Accelerator Pedal Sensor Monitoring/Debouncer6" /begin REF_MEASUREMENT EIP_TiElpdErrAccrDervDiffLo EIP_bPercgAccrDervDiffLo /end REF_MEASUREMENT /end GROUP
/begin GROUP S193_Derv "EcuIntgdSwGend/ControlSoftware/EcuInpPrcsg/Position & Speed Sensor Signals/Accelerator Pedal Sensor Monitoring/Derv" /begin REF_CHARACTERISTIC EG_NmrSng0_C EG_TsSw_C EG_bFlgTrue_C /end REF_CHARACTERISTIC /end GROUP
/begin GROUP S193_Derv1 "EcuIntgdSwGend/ControlSoftware/EcuInpPrcsg/Position & Speed Sensor Signals/Accelerator Pedal Sensor Monitoring/Derv1" /begin REF_CHARACTERISTIC EG_NmrSng0_C EG_TsSw_C EG_bFlgTrue_C /end REF_CHARACTERISTIC /end GROUP
/begin GROUP S193_Derv2 "EcuIntgdSwGend/ControlSoftware/EcuInpPrcsg/Position & Speed Sensor Signals/Accelerator Pedal Sensor Monitoring/Derv2" /begin REF_CHARACTERISTIC EG_NmrSng0_C EG_TsSw_C EG_bFlgTrue_C /end REF_CHARACTERISTIC /end GROUP
/begin GROUP S193_Derv3 "EcuIntgdSwGend/ControlSoftware/EcuInpPrcsg/Position & Speed Sensor Signals/Accelerator Pedal Sensor Monitoring/Derv3" /begin REF_CHARACTERISTIC EG_NmrSng0_C EG_TsSw_C EG_bFlgTrue_C /end REF_CHARACTERISTIC /end GROUP
/begin GROUP S194_SetRstLtch1 "EcuIntgdSwGend/ControlSoftware/EcuInpPrcsg/Position & Speed Sensor Signals/Accelerator Under Over Condition/SetRstLtch1" /begin REF_CHARACTERISTIC EG_bFlgFalse_C EG_bFlgTrue_C /end REF_CHARACTERISTIC /end GROUP
/begin GROUP S194_SetRstLtch2 "EcuIntgdSwGend/ControlSoftware/EcuInpPrcsg/Position & Speed Sensor Signals/Accelerator Under Over Condition/SetRstLtch2" /begin REF_CHARACTERISTIC EG_bFlgFalse_C EG_bFlgTrue_C /end REF_CHARACTERISTIC /end GROUP
/begin GROUP S195_Debouncer3 "EcuIntgdSwGend/ControlSoftware/EcuInpPrcsg/Position & Speed Sensor Signals/Engine Shutdown Overspeed/Debouncer3" /begin REF_MEASUREMENT EIP_TiElpdNEngAcvEmgcyShtdwnForOvspd /end REF_MEASUREMENT /end GROUP
/begin GROUP S212_Debouncer "EcuIntgdSwGend/ControlSoftware/EcuInpPrcsg/Pressure Sensor Signals/Pressure Sensor Errors/Debouncer" /begin REF_MEASUREMENT EIP_TiElpdErrPAmbAirSnsr /end REF_MEASUREMENT /end GROUP
/begin GROUP S212_Debouncer2 "EcuIntgdSwGend/ControlSoftware/EcuInpPrcsg/Pressure Sensor Signals/Pressure Sensor Errors/Debouncer2" /begin REF_MEASUREMENT EIP_TiElpdErrPFuSnsr /end REF_MEASUREMENT /end GROUP
/begin GROUP S212_Debouncer3 "EcuIntgdSwGend/ControlSoftware/EcuInpPrcsg/Pressure Sensor Signals/Pressure Sensor Errors/Debouncer3" /begin REF_MEASUREMENT EIP_TiElpdErrPOilSnsr /end REF_MEASUREMENT /end GROUP
/begin GROUP S212_Debouncer4 "EcuIntgdSwGend/ControlSoftware/EcuInpPrcsg/Pressure Sensor Signals/Pressure Sensor Errors/Debouncer4" /begin REF_MEASUREMENT EIP_TiElpdErrPAirBoostSnsr /end REF_MEASUREMENT /end GROUP
/begin GROUP S212_Debouncer5 "EcuIntgdSwGend/ControlSoftware/EcuInpPrcsg/Pressure Sensor Signals/Pressure Sensor Errors/Debouncer5" /begin REF_MEASUREMENT EIP_TiElpdErrPRailSnsr /end REF_MEASUREMENT /end GROUP
/begin GROUP S212_LowPassFilter1 "EcuIntgdSwGend/ControlSoftware/EcuInpPrcsg/Pressure Sensor Signals/Pressure Sensor Errors/LowPassFilter1" /begin REF_CHARACTERISTIC EG_NmrSng0_C EG_bFlgTrue_C /end REF_CHARACTERISTIC /begin REF_MEASUREMENT EIP_PAmbAirFild /end REF_MEASUREMENT /end GROUP
/begin GROUP S212_LowPassFilter4 "EcuIntgdSwGend/ControlSoftware/EcuInpPrcsg/Pressure Sensor Signals/Pressure Sensor Errors/LowPassFilter4" /begin REF_CHARACTERISTIC EG_NmrSng0_C EG_bFlgTrue_C /end REF_CHARACTERISTIC /begin REF_MEASUREMENT EIP_PFuFild /end REF_MEASUREMENT /end GROUP
/begin GROUP S212_LowPassFilter5 "EcuIntgdSwGend/ControlSoftware/EcuInpPrcsg/Pressure Sensor Signals/Pressure Sensor Errors/LowPassFilter5" /begin REF_CHARACTERISTIC EG_NmrSng0_C EG_bFlgTrue_C /end REF_CHARACTERISTIC /begin REF_MEASUREMENT EIP_POilFild /end REF_MEASUREMENT /end GROUP
/begin GROUP S212_LowPassFilter6 "EcuIntgdSwGend/ControlSoftware/EcuInpPrcsg/Pressure Sensor Signals/Pressure Sensor Errors/LowPassFilter6" /begin REF_CHARACTERISTIC EG_NmrSng0_C EG_bFlgTrue_C /end REF_CHARACTERISTIC /begin REF_MEASUREMENT EIP_PAirBoostFild /end REF_MEASUREMENT /end GROUP
/begin GROUP S212_LowPassFilter7 "EcuIntgdSwGend/ControlSoftware/EcuInpPrcsg/Pressure Sensor Signals/Pressure Sensor Errors/LowPassFilter7" /begin REF_CHARACTERISTIC EG_NmrSng0_C EG_bFlgTrue_C /end REF_CHARACTERISTIC /begin REF_MEASUREMENT EIP_PRailFild /end REF_MEASUREMENT /end GROUP
/begin GROUP S212_Pressure_Sensor_Diagnostic_Info "EcuIntgdSwGend/ControlSoftware/EcuInpPrcsg/Pressure Sensor Signals/Pressure Sensor Errors/Pressure Sensor Diagnostic Info"
 /begin REF_CHARACTERISTIC EG_DiagcSnsrFltInfoNone_C EG_DiagcSnsrInfoPAirBoost_C EG_DiagcSnsrInfoPAmbAir_C EG_DiagcSnsrInfoPFu_C EG_DiagcSnsrInfoPOil_C EG_DiagcSnsrInfoPRail_C EG_Mask32Bit0_C EG_Mask32Bit256_C EG_Mask32Bit512_C /end REF_CHARACTERISTIC
/end GROUP
/begin GROUP S234_Debouncer "EcuIntgdSwGend/ControlSoftware/EcuInpPrcsg/Temperature Sensor Signals/Temperature Sensor Errors/Debouncer" /begin REF_MEASUREMENT EIP_TiElpdErrTOilSnsr /end REF_MEASUREMENT /end GROUP
/begin GROUP S234_Debouncer1 "EcuIntgdSwGend/ControlSoftware/EcuInpPrcsg/Temperature Sensor Signals/Temperature Sensor Errors/Debouncer1" /begin REF_MEASUREMENT EIP_TiElpdErrTCooltSnsr /end REF_MEASUREMENT /end GROUP
/begin GROUP S234_Debouncer3 "EcuIntgdSwGend/ControlSoftware/EcuInpPrcsg/Temperature Sensor Signals/Temperature Sensor Errors/Debouncer3" /begin REF_MEASUREMENT EIP_TiElpdErrTAirBoostSnsr /end REF_MEASUREMENT /end GROUP
/begin GROUP S234_Debouncer4 "EcuIntgdSwGend/ControlSoftware/EcuInpPrcsg/Temperature Sensor Signals/Temperature Sensor Errors/Debouncer4" /begin REF_MEASUREMENT EIP_TiElpdErrTEcuSnsr /end REF_MEASUREMENT /end GROUP
/begin GROUP S234_Debouncer5 "EcuIntgdSwGend/ControlSoftware/EcuInpPrcsg/Temperature Sensor Signals/Temperature Sensor Errors/Debouncer5" /begin REF_MEASUREMENT EIP_TiEpldErrTFuSnsr /end REF_MEASUREMENT /end GROUP
/begin GROUP S234_Debouncer7 "EcuIntgdSwGend/ControlSoftware/EcuInpPrcsg/Temperature Sensor Signals/Temperature Sensor Errors/Debouncer7" /begin REF_MEASUREMENT EIP_TiElpdErrTAmbAirSnsr /end REF_MEASUREMENT /end GROUP
/begin GROUP S234_LowPassFilter1 "EcuIntgdSwGend/ControlSoftware/EcuInpPrcsg/Temperature Sensor Signals/Temperature Sensor Errors/LowPassFilter1" /begin REF_CHARACTERISTIC EG_NmrSng0_C EG_bFlgTrue_C /end REF_CHARACTERISTIC /begin REF_MEASUREMENT EIP_TCooltFild /end REF_MEASUREMENT /end GROUP
/begin GROUP S234_LowPassFilter2 "EcuIntgdSwGend/ControlSoftware/EcuInpPrcsg/Temperature Sensor Signals/Temperature Sensor Errors/LowPassFilter2" /begin REF_CHARACTERISTIC EG_NmrSng0_C EG_bFlgTrue_C /end REF_CHARACTERISTIC /begin REF_MEASUREMENT EIP_TOilFild /end REF_MEASUREMENT /end GROUP
/begin GROUP S234_LowPassFilter4 "EcuIntgdSwGend/ControlSoftware/EcuInpPrcsg/Temperature Sensor Signals/Temperature Sensor Errors/LowPassFilter4" /begin REF_CHARACTERISTIC EG_NmrSng0_C EG_bFlgTrue_C /end REF_CHARACTERISTIC /begin REF_MEASUREMENT EIP_TAirBoostFild /end REF_MEASUREMENT /end GROUP
/begin GROUP S234_LowPassFilter5 "EcuIntgdSwGend/ControlSoftware/EcuInpPrcsg/Temperature Sensor Signals/Temperature Sensor Errors/LowPassFilter5" /begin REF_CHARACTERISTIC EG_NmrSng0_C EG_bFlgTrue_C /end REF_CHARACTERISTIC /begin REF_MEASUREMENT EIP_TEcuFild /end REF_MEASUREMENT /end GROUP
/begin GROUP S234_LowPassFilter6 "EcuIntgdSwGend/ControlSoftware/EcuInpPrcsg/Temperature Sensor Signals/Temperature Sensor Errors/LowPassFilter6" /begin REF_CHARACTERISTIC EG_NmrSng0_C EG_bFlgTrue_C /end REF_CHARACTERISTIC /begin REF_MEASUREMENT EIP_TFuFild /end REF_MEASUREMENT /end GROUP
/begin GROUP S234_LowPassFilter8 "EcuIntgdSwGend/ControlSoftware/EcuInpPrcsg/Temperature Sensor Signals/Temperature Sensor Errors/LowPassFilter8" /begin REF_CHARACTERISTIC EG_NmrSng0_C EG_bFlgTrue_C /end REF_CHARACTERISTIC /begin REF_MEASUREMENT EIP_TAmbAirFild /end REF_MEASUREMENT /end GROUP
/begin GROUP S234_Temperature_Sensor_Diagnostic_Info "EcuIntgdSwGend/ControlSoftware/EcuInpPrcsg/Temperature Sensor Signals/Temperature Sensor Errors/Temperature Sensor Diagnostic Info"
 /begin REF_CHARACTERISTIC EG_DiagcSnsrFltInfoNone_C EG_DiagcSnsrInfoTAirBoost_C EG_DiagcSnsrInfoTAmbAir_C EG_DiagcSnsrInfoTCoolt_C EG_DiagcSnsrInfoTEcu_C EG_DiagcSnsrInfoTFu_C EG_DiagcSnsrInfoTOil_C EG_Mask32Bit0_C EG_Mask32Bit1024_C EG_Mask32Bit256_C EG_Mask32Bit512_C /end REF_CHARACTERISTIC
/end GROUP
/begin GROUP S263_Debouncer "EcuIntgdSwGend/ControlSoftware/EcuInpPrcsg/Vehicle Velocity Calculation/Vehicle Velocity Calculation/Debouncer" /begin REF_MEASUREMENT EIP_VehVDeToHi /end REF_MEASUREMENT /end GROUP
/begin GROUP S334_Cool_Down "EcuIntgdSwGend/ControlSoftware/EcuOutpPrcsg/CAN Signals/SPN 3543 - Engine Operating State/Cool Down" /begin REF_CHARACTERISTIC EG_SPN3543CoolDwn_C /end REF_CHARACTERISTIC /end GROUP
/begin GROUP S334_Engine_Running_Mode "EcuIntgdSwGend/ControlSoftware/EcuOutpPrcsg/CAN Signals/SPN 3543 - Engine Operating State/Engine Running Mode"
 /begin REF_CHARACTERISTIC EG_ModEngCtlIdleSpd_C EG_ModEngCtlOvspd_C EG_ModEngCtlPTO_C EG_ModEngCtlTSC1_C EG_ModEngCtlTq_C /end REF_CHARACTERISTIC
/end GROUP
/begin GROUP S334_Engine_Stopped___Ready "EcuIntgdSwGend/ControlSoftware/EcuOutpPrcsg/CAN Signals/SPN 3543 - Engine Operating State/Engine Stopped & Ready" /begin REF_CHARACTERISTIC EG_SPN3543EngStopped_C /end REF_CHARACTERISTIC /end GROUP
/begin GROUP S334_Not_Available "EcuIntgdSwGend/ControlSoftware/EcuOutpPrcsg/CAN Signals/SPN 3543 - Engine Operating State/Not Available" /begin REF_CHARACTERISTIC EG_SPN3543NotAvl_C /end REF_CHARACTERISTIC /end GROUP
/begin GROUP S334_Post_Run "EcuIntgdSwGend/ControlSoftware/EcuOutpPrcsg/CAN Signals/SPN 3543 - Engine Operating State/Post Run" /begin REF_CHARACTERISTIC EG_SPN3543PostRun_C /end REF_CHARACTERISTIC /end GROUP
/begin GROUP S334_Pre_Start "EcuIntgdSwGend/ControlSoftware/EcuOutpPrcsg/CAN Signals/SPN 3543 - Engine Operating State/Pre-Start" /begin REF_CHARACTERISTIC EG_SPN3543PreStrt_C /end REF_CHARACTERISTIC /end GROUP
/begin GROUP S334_Running "EcuIntgdSwGend/ControlSoftware/EcuOutpPrcsg/CAN Signals/SPN 3543 - Engine Operating State/Running" /begin REF_CHARACTERISTIC EG_SPN3543Runng_C /end REF_CHARACTERISTIC /end GROUP
/begin GROUP S334_Starting "EcuIntgdSwGend/ControlSoftware/EcuOutpPrcsg/CAN Signals/SPN 3543 - Engine Operating State/Starting" /begin REF_CHARACTERISTIC EG_SPN3543Strtg_C /end REF_CHARACTERISTIC /end GROUP
/begin GROUP S334_Stopping "EcuIntgdSwGend/ControlSoftware/EcuOutpPrcsg/CAN Signals/SPN 3543 - Engine Operating State/Stopping" /begin REF_CHARACTERISTIC EG_SPN3543Stopping_C /end REF_CHARACTERISTIC /end GROUP
/begin GROUP S334_Warm_Up "EcuIntgdSwGend/ControlSoftware/EcuOutpPrcsg/CAN Signals/SPN 3543 - Engine Operating State/Warm Up" /begin REF_CHARACTERISTIC EG_SPN3543WrmUp_C /end REF_CHARACTERISTIC /end GROUP
/begin GROUP S363_ABS_Control___Activated "EcuIntgdSwGend/ControlSoftware/EcuOutpPrcsg/CAN Signals/SPN 899 - Engine Torque Mode/ABS Control - Activated" /begin REF_CHARACTERISTIC EG_ABSActv_C EG_VldInpSt_C /end REF_CHARACTERISTIC /end GROUP
/begin GROUP S363_ABS_control "EcuIntgdSwGend/ControlSoftware/EcuOutpPrcsg/CAN Signals/SPN 899 - Engine Torque Mode/ABS control" /begin REF_CHARACTERISTIC EG_SPN899ABSCtrl_C /end REF_CHARACTERISTIC /end GROUP
/begin GROUP S363_ASR_Control___Activated "EcuIntgdSwGend/ControlSoftware/EcuOutpPrcsg/CAN Signals/SPN 899 - Engine Torque Mode/ASR Control - Activated" /begin REF_CHARACTERISTIC EG_ASRBrkCtrlActv_C EG_ASREngCtrlActv_C EG_VldInpSt_C /end REF_CHARACTERISTIC /end GROUP
/begin GROUP S363_ASR_control "EcuIntgdSwGend/ControlSoftware/EcuOutpPrcsg/CAN Signals/SPN 899 - Engine Torque Mode/ASR control" /begin REF_CHARACTERISTIC EG_SPN899ASRCtrl_C /end REF_CHARACTERISTIC /end GROUP
/begin GROUP S363_Accelerator_pedal__operator_selection "EcuIntgdSwGend/ControlSoftware/EcuOutpPrcsg/CAN Signals/SPN 899 - Engine Torque Mode/Accelerator pedal//operator selection" /begin REF_CHARACTERISTIC EG_SPN899AccrPedl_C /end REF_CHARACTERISTIC /end GROUP
/begin GROUP S363_Cruise_Control "EcuIntgdSwGend/ControlSoftware/EcuOutpPrcsg/CAN Signals/SPN 899 - Engine Torque Mode/Cruise Control" /begin REF_CHARACTERISTIC EG_SPN899CrsCtrl_C /end REF_CHARACTERISTIC /end GROUP
/begin GROUP S363_High_speed_governor "EcuIntgdSwGend/ControlSoftware/EcuOutpPrcsg/CAN Signals/SPN 899 - Engine Torque Mode/High speed governor" /begin REF_CHARACTERISTIC EG_SPN899HiSpdGovr_C /end REF_CHARACTERISTIC /end GROUP
/begin GROUP S363_Low_idle_governor__no_request__default_mode_ "EcuIntgdSwGend/ControlSoftware/EcuOutpPrcsg/CAN Signals/SPN 899 - Engine Torque Mode/Low idle governor//no request (default mode)" /begin REF_CHARACTERISTIC EG_SPN899LoIdleGovr_C /end REF_CHARACTERISTIC /end GROUP
/begin GROUP S363_Not_Defined "EcuIntgdSwGend/ControlSoftware/EcuOutpPrcsg/CAN Signals/SPN 899 - Engine Torque Mode/Not Defined" /begin REF_CHARACTERISTIC EG_SPN899NotDefd_C /end REF_CHARACTERISTIC /end GROUP
/begin GROUP S363_Road_speed_governor "EcuIntgdSwGend/ControlSoftware/EcuOutpPrcsg/CAN Signals/SPN 899 - Engine Torque Mode/Road speed governor" /begin REF_CHARACTERISTIC EG_SPN899RoadSpdGovr_C /end REF_CHARACTERISTIC /end GROUP
/begin GROUP S363_Torque_limiting "EcuIntgdSwGend/ControlSoftware/EcuOutpPrcsg/CAN Signals/SPN 899 - Engine Torque Mode/Torque limiting" /begin REF_CHARACTERISTIC EG_SPN899TqLimd_C /end REF_CHARACTERISTIC /end GROUP
/begin GROUP S363_Transmission_control "EcuIntgdSwGend/ControlSoftware/EcuOutpPrcsg/CAN Signals/SPN 899 - Engine Torque Mode/Transmission control" /begin REF_CHARACTERISTIC EG_SPN899TrsmCtrl_C /end REF_CHARACTERISTIC /end GROUP
/begin GROUP S365_avoidzerodivision_single "EcuIntgdSwGend/ControlSoftware/EcuOutpPrcsg/CAN Signals/SPN 92 - Engine Percent Load At Current Speed/avoidzerodivision_single" /begin REF_CHARACTERISTIC EG_NmrSng0_C EG_NmrSng1_C /end REF_CHARACTERISTIC /end GROUP
/begin GROUP S398_Hysteresis_Switch "EcuIntgdSwGend/ControlSoftware/EngBrk/Engine Brake Control/Enable Conditionals/Hysteresis_Switch" /begin REF_CHARACTERISTIC EG_NmrSng0_C EG_NmrSng1_C /end REF_CHARACTERISTIC /end GROUP
/begin GROUP S422_PID_Controller_for_Cylinder_1 "EcuIntgdSwGend/ControlSoftware/InjCtl/Cylinder Balancing/Cylinder Balancing PID Controllers /PID Controller for Cylinder 1" /begin SUB_GROUP S423_clamping_unit /end SUB_GROUP /begin REF_CHARACTERISTIC EG_NmrSng0_C /end REF_CHARACTERISTIC
 /begin REF_MEASUREMENT IC_CoeffKdFbOutCyl1 IC_CoeffKdOutCyl1 IC_CoeffKiClampOutCyl1 IC_CoeffKiClampPreSatOutCyl1 IC_CoeffKiClampSwtchOutCyl1 IC_CoeffKiOutCyl1 IC_CoeffKpOutCyl1 IC_PIOutCyl1 /end REF_MEASUREMENT
/end GROUP
/begin GROUP S422_PID_Controller_for_Cylinder_2 "EcuIntgdSwGend/ControlSoftware/InjCtl/Cylinder Balancing/Cylinder Balancing PID Controllers /PID Controller for Cylinder 2" /begin SUB_GROUP S424_clamping_unit /end SUB_GROUP /begin REF_CHARACTERISTIC EG_NmrSng0_C /end REF_CHARACTERISTIC
 /begin REF_MEASUREMENT IC_CoeffKdFbOutCyl2 IC_CoeffKdOutCyl2 IC_CoeffKiClampOutCyl2 IC_CoeffKiClampPreSatOutCyl2 IC_CoeffKiClampSwtchOutCyl2 IC_CoeffKiOutCyl2 IC_CoeffKpOutCyl2 IC_PIOutCyl2 /end REF_MEASUREMENT
/end GROUP
/begin GROUP S422_PID_Controller_for_Cylinder_3 "EcuIntgdSwGend/ControlSoftware/InjCtl/Cylinder Balancing/Cylinder Balancing PID Controllers /PID Controller for Cylinder 3" /begin SUB_GROUP S425_clamping_unit /end SUB_GROUP /begin REF_CHARACTERISTIC EG_NmrSng0_C /end REF_CHARACTERISTIC
 /begin REF_MEASUREMENT IC_CoeffKdFbOutCyl3 IC_CoeffKdOutCyl3 IC_CoeffKiClampOutCyl3 IC_CoeffKiClampPreSatOutCyl3 IC_CoeffKiClampSwtchOutCyl3 IC_CoeffKiOutCyl3 IC_CoeffKpOutCyl3 IC_PIOutCyl3 /end REF_MEASUREMENT
/end GROUP
/begin GROUP S422_PID_Controller_for_Cylinder_4 "EcuIntgdSwGend/ControlSoftware/InjCtl/Cylinder Balancing/Cylinder Balancing PID Controllers /PID Controller for Cylinder 4" /begin SUB_GROUP S426_clamping_unit /end SUB_GROUP /begin REF_CHARACTERISTIC EG_NmrSng0_C /end REF_CHARACTERISTIC
 /begin REF_MEASUREMENT IC_CoeffKdFbOutCyl4 IC_CoeffKdOutCyl4 IC_CoeffKiClampOutCyl4 IC_CoeffKiClampPreSatOutCyl4 IC_CoeffKiClampSwtchOutCyl4 IC_CoeffKiOutCyl4 IC_CoeffKpOutCyl4 IC_PIOutCyl4 /end REF_MEASUREMENT
/end GROUP
/begin GROUP S422_PID_Controller_for_Cylinder_5 "EcuIntgdSwGend/ControlSoftware/InjCtl/Cylinder Balancing/Cylinder Balancing PID Controllers /PID Controller for Cylinder 5" /begin SUB_GROUP S427_clamping_unit /end SUB_GROUP /begin REF_CHARACTERISTIC EG_NmrSng0_C /end REF_CHARACTERISTIC
 /begin REF_MEASUREMENT IC_CoeffKdFbOutCyl5 IC_CoeffKdOutCyl5 IC_CoeffKiClampOutCyl5 IC_CoeffKiClampPreSatOutCyl5 IC_CoeffKiClampSwtchOutCyl5 IC_CoeffKiOutCyl5 IC_CoeffKpOutCyl5 IC_PIOutCyl5 /end REF_MEASUREMENT
/end GROUP
/begin GROUP S422_PID_Controller_for_Cylinder_6 "EcuIntgdSwGend/ControlSoftware/InjCtl/Cylinder Balancing/Cylinder Balancing PID Controllers /PID Controller for Cylinder 6" /begin SUB_GROUP S428_clamping_unit /end SUB_GROUP /begin REF_CHARACTERISTIC EG_NmrSng0_C /end REF_CHARACTERISTIC
 /begin REF_MEASUREMENT IC_CoeffKdFbOutCyl6 IC_CoeffKdOutCyl6 IC_CoeffKiClampOutCyl6 IC_CoeffKiClampPreSatOutCyl6 IC_CoeffKiClampSwtchOutCyl6 IC_CoeffKiOutCyl6 IC_CoeffKpOutCyl6 IC_PIOutCyl6 /end REF_MEASUREMENT
/end GROUP
/begin GROUP S447_Injector_1_Characteristic_Map_1 "EcuIntgdSwGend/ControlSoftware/InjCtl/Main Injector Characteristic Maps/Injector 1 Characteristic/Injector 1 Characteristic Map 1" /begin REF_CHARACTERISTIC IC_InjChartc1_M /end REF_CHARACTERISTIC /end GROUP
/begin GROUP S447_Injector_1_Characteristic_Map_2 "EcuIntgdSwGend/ControlSoftware/InjCtl/Main Injector Characteristic Maps/Injector 1 Characteristic/Injector 1 Characteristic Map 2" /begin REF_CHARACTERISTIC IC_InjChartc2_M /end REF_CHARACTERISTIC /end GROUP
/begin GROUP S447_Injector_1_Characteristic_Map_3 "EcuIntgdSwGend/ControlSoftware/InjCtl/Main Injector Characteristic Maps/Injector 1 Characteristic/Injector 1 Characteristic Map 3" /begin REF_CHARACTERISTIC IC_InjChartc3_M /end REF_CHARACTERISTIC /end GROUP
/begin GROUP S447_Injector_1_Characteristic_Map_4 "EcuIntgdSwGend/ControlSoftware/InjCtl/Main Injector Characteristic Maps/Injector 1 Characteristic/Injector 1 Characteristic Map 4" /begin REF_CHARACTERISTIC IC_InjChartc4_M /end REF_CHARACTERISTIC /end GROUP
/begin GROUP S447_Injector_1_Characteristic_Map_5 "EcuIntgdSwGend/ControlSoftware/InjCtl/Main Injector Characteristic Maps/Injector 1 Characteristic/Injector 1 Characteristic Map 5" /begin REF_CHARACTERISTIC IC_InjChartc5_M /end REF_CHARACTERISTIC /end GROUP
/begin GROUP S449_Injector_2_Characteristic_Map_1 "EcuIntgdSwGend/ControlSoftware/InjCtl/Main Injector Characteristic Maps/Injector 2 Characteristic/Injector 2 Characteristic Map 1" /begin REF_CHARACTERISTIC IC_InjChartc1_M /end REF_CHARACTERISTIC /end GROUP
/begin GROUP S449_Injector_2_Characteristic_Map_2 "EcuIntgdSwGend/ControlSoftware/InjCtl/Main Injector Characteristic Maps/Injector 2 Characteristic/Injector 2 Characteristic Map 2" /begin REF_CHARACTERISTIC IC_InjChartc2_M /end REF_CHARACTERISTIC /end GROUP
/begin GROUP S449_Injector_2_Characteristic_Map_3 "EcuIntgdSwGend/ControlSoftware/InjCtl/Main Injector Characteristic Maps/Injector 2 Characteristic/Injector 2 Characteristic Map 3" /begin REF_CHARACTERISTIC IC_InjChartc3_M /end REF_CHARACTERISTIC /end GROUP
/begin GROUP S449_Injector_2_Characteristic_Map_4 "EcuIntgdSwGend/ControlSoftware/InjCtl/Main Injector Characteristic Maps/Injector 2 Characteristic/Injector 2 Characteristic Map 4" /begin REF_CHARACTERISTIC IC_InjChartc4_M /end REF_CHARACTERISTIC /end GROUP
/begin GROUP S449_Injector_2_Characteristic_Map_5 "EcuIntgdSwGend/ControlSoftware/InjCtl/Main Injector Characteristic Maps/Injector 2 Characteristic/Injector 2 Characteristic Map 5" /begin REF_CHARACTERISTIC IC_InjChartc5_M /end REF_CHARACTERISTIC /end GROUP
/begin GROUP S451_Injector_3_Characteristic_Map_1 "EcuIntgdSwGend/ControlSoftware/InjCtl/Main Injector Characteristic Maps/Injector 3 Characteristic/Injector 3 Characteristic Map 1" /begin REF_CHARACTERISTIC IC_InjChartc1_M /end REF_CHARACTERISTIC /end GROUP
/begin GROUP S451_Injector_3_Characteristic_Map_2 "EcuIntgdSwGend/ControlSoftware/InjCtl/Main Injector Characteristic Maps/Injector 3 Characteristic/Injector 3 Characteristic Map 2" /begin REF_CHARACTERISTIC IC_InjChartc2_M /end REF_CHARACTERISTIC /end GROUP
/begin GROUP S451_Injector_3_Characteristic_Map_3 "EcuIntgdSwGend/ControlSoftware/InjCtl/Main Injector Characteristic Maps/Injector 3 Characteristic/Injector 3 Characteristic Map 3" /begin REF_CHARACTERISTIC IC_InjChartc3_M /end REF_CHARACTERISTIC /end GROUP
/begin GROUP S451_Injector_3_Characteristic_Map_4 "EcuIntgdSwGend/ControlSoftware/InjCtl/Main Injector Characteristic Maps/Injector 3 Characteristic/Injector 3 Characteristic Map 4" /begin REF_CHARACTERISTIC IC_InjChartc4_M /end REF_CHARACTERISTIC /end GROUP
/begin GROUP S451_Injector_3_Characteristic_Map_5 "EcuIntgdSwGend/ControlSoftware/InjCtl/Main Injector Characteristic Maps/Injector 3 Characteristic/Injector 3 Characteristic Map 5" /begin REF_CHARACTERISTIC IC_InjChartc5_M /end REF_CHARACTERISTIC /end GROUP
/begin GROUP S453_Injector_4_Characteristic_Map_1 "EcuIntgdSwGend/ControlSoftware/InjCtl/Main Injector Characteristic Maps/Injector 4 Characteristic/Injector 4 Characteristic Map 1" /begin REF_CHARACTERISTIC IC_InjChartc1_M /end REF_CHARACTERISTIC /end GROUP
/begin GROUP S453_Injector_4_Characteristic_Map_2 "EcuIntgdSwGend/ControlSoftware/InjCtl/Main Injector Characteristic Maps/Injector 4 Characteristic/Injector 4 Characteristic Map 2" /begin REF_CHARACTERISTIC IC_InjChartc2_M /end REF_CHARACTERISTIC /end GROUP
/begin GROUP S453_Injector_4_Characteristic_Map_3 "EcuIntgdSwGend/ControlSoftware/InjCtl/Main Injector Characteristic Maps/Injector 4 Characteristic/Injector 4 Characteristic Map 3" /begin REF_CHARACTERISTIC IC_InjChartc3_M /end REF_CHARACTERISTIC /end GROUP
/begin GROUP S453_Injector_4_Characteristic_Map_4 "EcuIntgdSwGend/ControlSoftware/InjCtl/Main Injector Characteristic Maps/Injector 4 Characteristic/Injector 4 Characteristic Map 4" /begin REF_CHARACTERISTIC IC_InjChartc4_M /end REF_CHARACTERISTIC /end GROUP
/begin GROUP S453_Injector_4_Characteristic_Map_5 "EcuIntgdSwGend/ControlSoftware/InjCtl/Main Injector Characteristic Maps/Injector 4 Characteristic/Injector 4 Characteristic Map 5" /begin REF_CHARACTERISTIC IC_InjChartc5_M /end REF_CHARACTERISTIC /end GROUP
/begin GROUP S455_Injector_5_Characteristic_Map_1 "EcuIntgdSwGend/ControlSoftware/InjCtl/Main Injector Characteristic Maps/Injector 5 Characteristic/Injector 5 Characteristic Map 1" /begin REF_CHARACTERISTIC IC_InjChartc1_M /end REF_CHARACTERISTIC /end GROUP
/begin GROUP S455_Injector_5_Characteristic_Map_2 "EcuIntgdSwGend/ControlSoftware/InjCtl/Main Injector Characteristic Maps/Injector 5 Characteristic/Injector 5 Characteristic Map 2" /begin REF_CHARACTERISTIC IC_InjChartc2_M /end REF_CHARACTERISTIC /end GROUP
/begin GROUP S455_Injector_5_Characteristic_Map_3 "EcuIntgdSwGend/ControlSoftware/InjCtl/Main Injector Characteristic Maps/Injector 5 Characteristic/Injector 5 Characteristic Map 3" /begin REF_CHARACTERISTIC IC_InjChartc3_M /end REF_CHARACTERISTIC /end GROUP
/begin GROUP S455_Injector_5_Characteristic_Map_4 "EcuIntgdSwGend/ControlSoftware/InjCtl/Main Injector Characteristic Maps/Injector 5 Characteristic/Injector 5 Characteristic Map 4" /begin REF_CHARACTERISTIC IC_InjChartc4_M /end REF_CHARACTERISTIC /end GROUP
/begin GROUP S455_Injector_5_Characteristic_Map_5 "EcuIntgdSwGend/ControlSoftware/InjCtl/Main Injector Characteristic Maps/Injector 5 Characteristic/Injector 5 Characteristic Map 5" /begin REF_CHARACTERISTIC IC_InjChartc5_M /end REF_CHARACTERISTIC /end GROUP
/begin GROUP S457_Injector_6_Characteristic_Map_1 "EcuIntgdSwGend/ControlSoftware/InjCtl/Main Injector Characteristic Maps/Injector 6 Characteristic/Injector 6 Characteristic Map 1" /begin REF_CHARACTERISTIC IC_InjChartc1_M /end REF_CHARACTERISTIC /end GROUP
/begin GROUP S457_Injector_6_Characteristic_Map_2 "EcuIntgdSwGend/ControlSoftware/InjCtl/Main Injector Characteristic Maps/Injector 6 Characteristic/Injector 6 Characteristic Map 2" /begin REF_CHARACTERISTIC IC_InjChartc2_M /end REF_CHARACTERISTIC /end GROUP
/begin GROUP S457_Injector_6_Characteristic_Map_3 "EcuIntgdSwGend/ControlSoftware/InjCtl/Main Injector Characteristic Maps/Injector 6 Characteristic/Injector 6 Characteristic Map 3" /begin REF_CHARACTERISTIC IC_InjChartc3_M /end REF_CHARACTERISTIC /end GROUP
/begin GROUP S457_Injector_6_Characteristic_Map_4 "EcuIntgdSwGend/ControlSoftware/InjCtl/Main Injector Characteristic Maps/Injector 6 Characteristic/Injector 6 Characteristic Map 4" /begin REF_CHARACTERISTIC IC_InjChartc4_M /end REF_CHARACTERISTIC /end GROUP
/begin GROUP S457_Injector_6_Characteristic_Map_5 "EcuIntgdSwGend/ControlSoftware/InjCtl/Main Injector Characteristic Maps/Injector 6 Characteristic/Injector 6 Characteristic Map 5" /begin REF_CHARACTERISTIC IC_InjChartc5_M /end REF_CHARACTERISTIC /end GROUP
/begin GROUP S489_Injector_1_Characteristic_Map_1 "EcuIntgdSwGend/ControlSoftware/InjCtl/Pilot Injector Characteristic Maps/ Injector 1 Characteristic/Injector 1 Characteristic Map 1" /begin REF_CHARACTERISTIC IC_InjChartc1_M /end REF_CHARACTERISTIC /end GROUP
/begin GROUP S489_Injector_1_Characteristic_Map_2 "EcuIntgdSwGend/ControlSoftware/InjCtl/Pilot Injector Characteristic Maps/ Injector 1 Characteristic/Injector 1 Characteristic Map 2" /begin REF_CHARACTERISTIC IC_InjChartc2_M /end REF_CHARACTERISTIC /end GROUP
/begin GROUP S489_Injector_1_Characteristic_Map_3 "EcuIntgdSwGend/ControlSoftware/InjCtl/Pilot Injector Characteristic Maps/ Injector 1 Characteristic/Injector 1 Characteristic Map 3" /begin REF_CHARACTERISTIC IC_InjChartc3_M /end REF_CHARACTERISTIC /end GROUP
/begin GROUP S489_Injector_1_Characteristic_Map_4 "EcuIntgdSwGend/ControlSoftware/InjCtl/Pilot Injector Characteristic Maps/ Injector 1 Characteristic/Injector 1 Characteristic Map 4" /begin REF_CHARACTERISTIC IC_InjChartc4_M /end REF_CHARACTERISTIC /end GROUP
/begin GROUP S489_Injector_1_Characteristic_Map_5 "EcuIntgdSwGend/ControlSoftware/InjCtl/Pilot Injector Characteristic Maps/ Injector 1 Characteristic/Injector 1 Characteristic Map 5" /begin REF_CHARACTERISTIC IC_InjChartc5_M /end REF_CHARACTERISTIC /end GROUP
/begin GROUP S491_Injector_2_Characteristic_Map_1 "EcuIntgdSwGend/ControlSoftware/InjCtl/Pilot Injector Characteristic Maps/ Injector 2 Characteristic/Injector 2 Characteristic Map 1" /begin REF_CHARACTERISTIC IC_InjChartc1_M /end REF_CHARACTERISTIC /end GROUP
/begin GROUP S491_Injector_2_Characteristic_Map_2 "EcuIntgdSwGend/ControlSoftware/InjCtl/Pilot Injector Characteristic Maps/ Injector 2 Characteristic/Injector 2 Characteristic Map 2" /begin REF_CHARACTERISTIC IC_InjChartc2_M /end REF_CHARACTERISTIC /end GROUP
/begin GROUP S491_Injector_2_Characteristic_Map_3 "EcuIntgdSwGend/ControlSoftware/InjCtl/Pilot Injector Characteristic Maps/ Injector 2 Characteristic/Injector 2 Characteristic Map 3" /begin REF_CHARACTERISTIC IC_InjChartc3_M /end REF_CHARACTERISTIC /end GROUP
/begin GROUP S491_Injector_2_Characteristic_Map_4 "EcuIntgdSwGend/ControlSoftware/InjCtl/Pilot Injector Characteristic Maps/ Injector 2 Characteristic/Injector 2 Characteristic Map 4" /begin REF_CHARACTERISTIC IC_InjChartc4_M /end REF_CHARACTERISTIC /end GROUP
/begin GROUP S491_Injector_2_Characteristic_Map_5 "EcuIntgdSwGend/ControlSoftware/InjCtl/Pilot Injector Characteristic Maps/ Injector 2 Characteristic/Injector 2 Characteristic Map 5" /begin REF_CHARACTERISTIC IC_InjChartc5_M /end REF_CHARACTERISTIC /end GROUP
/begin GROUP S493_Injector_3_Characteristic_Map_1 "EcuIntgdSwGend/ControlSoftware/InjCtl/Pilot Injector Characteristic Maps/ Injector 3 Characteristic/Injector 3 Characteristic Map 1" /begin REF_CHARACTERISTIC IC_InjChartc1_M /end REF_CHARACTERISTIC /end GROUP
/begin GROUP S493_Injector_3_Characteristic_Map_2 "EcuIntgdSwGend/ControlSoftware/InjCtl/Pilot Injector Characteristic Maps/ Injector 3 Characteristic/Injector 3 Characteristic Map 2" /begin REF_CHARACTERISTIC IC_InjChartc2_M /end REF_CHARACTERISTIC /end GROUP
/begin GROUP S493_Injector_3_Characteristic_Map_3 "EcuIntgdSwGend/ControlSoftware/InjCtl/Pilot Injector Characteristic Maps/ Injector 3 Characteristic/Injector 3 Characteristic Map 3" /begin REF_CHARACTERISTIC IC_InjChartc3_M /end REF_CHARACTERISTIC /end GROUP
/begin GROUP S493_Injector_3_Characteristic_Map_4 "EcuIntgdSwGend/ControlSoftware/InjCtl/Pilot Injector Characteristic Maps/ Injector 3 Characteristic/Injector 3 Characteristic Map 4" /begin REF_CHARACTERISTIC IC_InjChartc4_M /end REF_CHARACTERISTIC /end GROUP
/begin GROUP S493_Injector_3_Characteristic_Map_5 "EcuIntgdSwGend/ControlSoftware/InjCtl/Pilot Injector Characteristic Maps/ Injector 3 Characteristic/Injector 3 Characteristic Map 5" /begin REF_CHARACTERISTIC IC_InjChartc5_M /end REF_CHARACTERISTIC /end GROUP
/begin GROUP S495_Injector_4_Characteristic_Map_1 "EcuIntgdSwGend/ControlSoftware/InjCtl/Pilot Injector Characteristic Maps/ Injector 4 Characteristic/Injector 4 Characteristic Map 1" /begin REF_CHARACTERISTIC IC_InjChartc1_M /end REF_CHARACTERISTIC /end GROUP
/begin GROUP S495_Injector_4_Characteristic_Map_2 "EcuIntgdSwGend/ControlSoftware/InjCtl/Pilot Injector Characteristic Maps/ Injector 4 Characteristic/Injector 4 Characteristic Map 2" /begin REF_CHARACTERISTIC IC_InjChartc2_M /end REF_CHARACTERISTIC /end GROUP
/begin GROUP S495_Injector_4_Characteristic_Map_3 "EcuIntgdSwGend/ControlSoftware/InjCtl/Pilot Injector Characteristic Maps/ Injector 4 Characteristic/Injector 4 Characteristic Map 3" /begin REF_CHARACTERISTIC IC_InjChartc3_M /end REF_CHARACTERISTIC /end GROUP
/begin GROUP S495_Injector_4_Characteristic_Map_4 "EcuIntgdSwGend/ControlSoftware/InjCtl/Pilot Injector Characteristic Maps/ Injector 4 Characteristic/Injector 4 Characteristic Map 4" /begin REF_CHARACTERISTIC IC_InjChartc4_M /end REF_CHARACTERISTIC /end GROUP
/begin GROUP S495_Injector_4_Characteristic_Map_5 "EcuIntgdSwGend/ControlSoftware/InjCtl/Pilot Injector Characteristic Maps/ Injector 4 Characteristic/Injector 4 Characteristic Map 5" /begin REF_CHARACTERISTIC IC_InjChartc5_M /end REF_CHARACTERISTIC /end GROUP
/begin GROUP S497_Injector_5_Characteristic_Map_1 "EcuIntgdSwGend/ControlSoftware/InjCtl/Pilot Injector Characteristic Maps/ Injector 5 Characteristic/Injector 5 Characteristic Map 1" /begin REF_CHARACTERISTIC IC_InjChartc1_M /end REF_CHARACTERISTIC /end GROUP
/begin GROUP S497_Injector_5_Characteristic_Map_2 "EcuIntgdSwGend/ControlSoftware/InjCtl/Pilot Injector Characteristic Maps/ Injector 5 Characteristic/Injector 5 Characteristic Map 2" /begin REF_CHARACTERISTIC IC_InjChartc2_M /end REF_CHARACTERISTIC /end GROUP
/begin GROUP S497_Injector_5_Characteristic_Map_3 "EcuIntgdSwGend/ControlSoftware/InjCtl/Pilot Injector Characteristic Maps/ Injector 5 Characteristic/Injector 5 Characteristic Map 3" /begin REF_CHARACTERISTIC IC_InjChartc3_M /end REF_CHARACTERISTIC /end GROUP
/begin GROUP S497_Injector_5_Characteristic_Map_4 "EcuIntgdSwGend/ControlSoftware/InjCtl/Pilot Injector Characteristic Maps/ Injector 5 Characteristic/Injector 5 Characteristic Map 4" /begin REF_CHARACTERISTIC IC_InjChartc4_M /end REF_CHARACTERISTIC /end GROUP
/begin GROUP S497_Injector_5_Characteristic_Map_5 "EcuIntgdSwGend/ControlSoftware/InjCtl/Pilot Injector Characteristic Maps/ Injector 5 Characteristic/Injector 5 Characteristic Map 5" /begin REF_CHARACTERISTIC IC_InjChartc5_M /end REF_CHARACTERISTIC /end GROUP
/begin GROUP S499_Injector_6_Characteristic_Map_1 "EcuIntgdSwGend/ControlSoftware/InjCtl/Pilot Injector Characteristic Maps/ Injector 6 Characteristic/Injector 6 Characteristic Map 1" /begin REF_CHARACTERISTIC IC_InjChartc1_M /end REF_CHARACTERISTIC /end GROUP
/begin GROUP S499_Injector_6_Characteristic_Map_2 "EcuIntgdSwGend/ControlSoftware/InjCtl/Pilot Injector Characteristic Maps/ Injector 6 Characteristic/Injector 6 Characteristic Map 2" /begin REF_CHARACTERISTIC IC_InjChartc2_M /end REF_CHARACTERISTIC /end GROUP
/begin GROUP S499_Injector_6_Characteristic_Map_3 "EcuIntgdSwGend/ControlSoftware/InjCtl/Pilot Injector Characteristic Maps/ Injector 6 Characteristic/Injector 6 Characteristic Map 3" /begin REF_CHARACTERISTIC IC_InjChartc3_M /end REF_CHARACTERISTIC /end GROUP
/begin GROUP S499_Injector_6_Characteristic_Map_4 "EcuIntgdSwGend/ControlSoftware/InjCtl/Pilot Injector Characteristic Maps/ Injector 6 Characteristic/Injector 6 Characteristic Map 4" /begin REF_CHARACTERISTIC IC_InjChartc4_M /end REF_CHARACTERISTIC /end GROUP
/begin GROUP S499_Injector_6_Characteristic_Map_5 "EcuIntgdSwGend/ControlSoftware/InjCtl/Pilot Injector Characteristic Maps/ Injector 6 Characteristic/Injector 6 Characteristic Map 5" /begin REF_CHARACTERISTIC IC_InjChartc5_M /end REF_CHARACTERISTIC /end GROUP
/begin GROUP S537_N_Map_Interpolation_for_Main_Start_of_Injection "EcuIntgdSwGend/ControlSoftware/InjCtl/Start of Injection Angle for Pilot and Main Injection/Main SOI Reference Calculation/N-Map Interpolation for Main Start of Injection"
 /begin SUB_GROUP S539_avoidzerodivision_single S539_avoidzerodivision_single1 /end SUB_GROUP
 /begin REF_CHARACTERISTIC IC_SoiMainInjSetPoint1_M IC_SoiMainInjSetPoint2_M IC_SoiMainInjSetPoint3_M IC_TCooltMap1Thd_P IC_TCooltMap2Thd_P IC_TCooltMap3Thd_P /end REF_CHARACTERISTIC
 /begin REF_MEASUREMENT IC_SoiMainInjSetPoint IC_SoiMainInjSetPoint1to2Intp IC_SoiMainInjSetPoint2to3Intp IC_SoiMainInjSetPointFromMap1 IC_SoiMainInjSetPointFromMap2 IC_SoiMainInjSetPointFromMap3 /end REF_MEASUREMENT
/end GROUP
/begin GROUP S538_N_Map_Interpolation_for_Pre_Start_of_Injection_ "EcuIntgdSwGend/ControlSoftware/InjCtl/Start of Injection Angle for Pilot and Main Injection/Pilot SOI Reference Calculation/N-Map Interpolation for Pre Start of Injection "
 /begin SUB_GROUP S542_avoidzerodivision_single S542_avoidzerodivision_single1 /end SUB_GROUP
 /begin REF_CHARACTERISTIC IC_SoiPltInjSetPoint1_M IC_SoiPltInjSetPoint2_M IC_SoiPltInjSetPoint3_M IC_TCooltMap1Thd_P IC_TCooltMap2Thd_P IC_TCooltMap3Thd_P /end REF_CHARACTERISTIC
 /begin REF_MEASUREMENT IC_SoiPltInjSetPoint IC_SoiPltInjSetPoint1to2Intp IC_SoiPltInjSetPoint2to3Intp IC_SoiPltInjSetPointFromMap1 IC_SoiPltInjSetPointFromMap2 IC_SoiPltInjSetPointFromMap3 /end REF_MEASUREMENT
/end GROUP
/begin GROUP S573_clamping_unit "EcuIntgdSwGend/ControlSoftware/PtoCtrl/PTO PID/PID_Controller/clamping_unit" /begin SUB_GROUP S574_deadzone /end SUB_GROUP /begin REF_CHARACTERISTIC EG_NmrSng0_C /end REF_CHARACTERISTIC /end GROUP
/begin GROUP S588_Integrator_Reset "EcuIntgdSwGend/ControlSoftware/RailPGovr/Rail Pressure PID Controller/VCV Opening Percentage PID Controller/Integrator Reset" /begin SUB_GROUP S589_Debouncer /end SUB_GROUP
 /begin REF_CHARACTERISTIC EG_TsSw_C RPG_IntglRstCoeffKiThd_P RPG_IntglRstPRailErrThd_P RPG_IntglRstPercgVCVThd_P RPG_TiDebCoeffKiRst_P RPG_bCoeffKiRstOvs_P RPG_bCoeffKiRstOvv_P /end REF_CHARACTERISTIC
 /begin REF_MEASUREMENT RPG_bCoeffKiRst /end REF_MEASUREMENT
/end GROUP
/begin GROUP S588_clamping_unit "EcuIntgdSwGend/ControlSoftware/RailPGovr/Rail Pressure PID Controller/VCV Opening Percentage PID Controller/clamping_unit" /begin SUB_GROUP S590_deadzone /end SUB_GROUP /begin REF_CHARACTERISTIC EG_NmrSng0_C /end REF_CHARACTERISTIC /end GROUP
/begin GROUP S594_avoidzerodivision_single "EcuIntgdSwGend/ControlSoftware/RailPGovr/Rail Pressure Reference Calculation/N-Map Interpolation for Rail Pressure Reference/avoidzerodivision_single" /begin REF_CHARACTERISTIC EG_NmrSng0_C EG_NmrSng1_C /end REF_CHARACTERISTIC /end GROUP
/begin GROUP S594_avoidzerodivision_single1 "EcuIntgdSwGend/ControlSoftware/RailPGovr/Rail Pressure Reference Calculation/N-Map Interpolation for Rail Pressure Reference/avoidzerodivision_single1" /begin REF_CHARACTERISTIC EG_NmrSng0_C EG_NmrSng1_C /end REF_CHARACTERISTIC /end GROUP
/begin GROUP S609_PID_Controller "EcuIntgdSwGend/ControlSoftware/SpdLimr/Speed Limiter PID/SpeedLimiterPIDController/PID_Controller" /begin SUB_GROUP S610_clamping_unit /end SUB_GROUP /begin REF_CHARACTERISTIC EG_NmrSng0_C /end REF_CHARACTERISTIC /begin REF_MEASUREMENT SpdLimr_PIDOutSpdLimrTq /end REF_MEASUREMENT /end GROUP
/begin GROUP S624_CompRstTmr "EcuIntgdSwGend/ControlSoftware/StrtrCtl/Start Error Detect Algorithms /Engine Not Turn/CompRstTmr" /begin REF_CHARACTERISTIC EG_NmrInt0_C /end REF_CHARACTERISTIC /begin REF_MEASUREMENT SC_TiElpdEngNotTurn SC_bEngNotTurnCompTi /end REF_MEASUREMENT /end GROUP
/begin GROUP S624_Pos_Edge2 "EcuIntgdSwGend/ControlSoftware/StrtrCtl/Start Error Detect Algorithms /Engine Not Turn/Pos_Edge2" /begin REF_CHARACTERISTIC EG_NmrSng0_C /end REF_CHARACTERISTIC /end GROUP
/begin GROUP S624_SetRstLtch1 "EcuIntgdSwGend/ControlSoftware/StrtrCtl/Start Error Detect Algorithms /Engine Not Turn/SetRstLtch1" /begin REF_CHARACTERISTIC EG_bFlgFalse_C EG_bFlgTrue_C /end REF_CHARACTERISTIC /end GROUP
/begin GROUP S625_CompRstTmr1 "EcuIntgdSwGend/ControlSoftware/StrtrCtl/Start Error Detect Algorithms /Engine Over Heating Protection/CompRstTmr1" /begin REF_CHARACTERISTIC EG_NmrInt0_C /end REF_CHARACTERISTIC /begin REF_MEASUREMENT SC_TiElpdStrtrProtn /end REF_MEASUREMENT /end GROUP
/begin GROUP S625_Neg_Edge "EcuIntgdSwGend/ControlSoftware/StrtrCtl/Start Error Detect Algorithms /Engine Over Heating Protection/Neg_Edge" /begin REF_CHARACTERISTIC EG_NmrSng0_C /end REF_CHARACTERISTIC /end GROUP
/begin GROUP S625_SetRstLtch "EcuIntgdSwGend/ControlSoftware/StrtrCtl/Start Error Detect Algorithms /Engine Over Heating Protection/SetRstLtch" /begin REF_CHARACTERISTIC EG_bFlgFalse_C EG_bFlgTrue_C /end REF_CHARACTERISTIC /end GROUP
/begin GROUP S632_Debouncer "EcuIntgdSwGend/ControlSoftware/StrtrCtl/StartInhibitor/Electrical Failure Dependent Sensor Inhibitor/Debouncer" /begin REF_MEASUREMENT SC_TiElpdAcvnErrVCVDeb SC_bTiAcvnErrVCVDebOutp /end REF_MEASUREMENT /end GROUP
/begin GROUP S632_Debouncer1 "EcuIntgdSwGend/ControlSoftware/StrtrCtl/StartInhibitor/Electrical Failure Dependent Sensor Inhibitor/Debouncer1" /begin REF_MEASUREMENT SC_TiElpdAcvnErrPCVDeb SC_bTiAcvnErrPCVDebOutp /end REF_MEASUREMENT /end GROUP
/begin GROUP S633_Debouncer1 "EcuIntgdSwGend/ControlSoftware/StrtrCtl/StartInhibitor/Sensor Inhibitor/Debouncer1" /begin REF_MEASUREMENT SC_TiElpdAcvnLvlFuDeb SC_bTiAcvnLvlFuDebOutp /end REF_MEASUREMENT /end GROUP
/begin GROUP S633_Debouncer2 "EcuIntgdSwGend/ControlSoftware/StrtrCtl/StartInhibitor/Sensor Inhibitor/Debouncer2" /begin REF_MEASUREMENT SC_TiElpdAcvnLvlOilDeb SC_bTiAcvnLvlOilDebOutp /end REF_MEASUREMENT /end GROUP
/begin GROUP S662_Debouncer "EcuIntgdSwGend/ControlSoftware/TqLim/Engine Protection/Torque Limitation For Fuel Temperature/Debouncer" /begin REF_MEASUREMENT TL_TiElpdNEngAcvForTFu TL_bComplDebNEngAcvForTFu /end REF_MEASUREMENT /end GROUP
/begin GROUP S663_Debouncer "EcuIntgdSwGend/ControlSoftware/TqLim/Engine Protection/Torque Limitation for Air Temperature/Debouncer" /begin REF_MEASUREMENT TL_TiElpdNEngAcvForTAir TL_bComplDebNEngAcvForTAir /end REF_MEASUREMENT /end GROUP
/begin GROUP S664_Debouncer "EcuIntgdSwGend/ControlSoftware/TqLim/Engine Protection/Torque Limitation for Ambient Air Pressure/Debouncer" /begin REF_MEASUREMENT TL_TiElpdNEngAcvForPAirAmb TL_bComplDebNEngAcvForPAirAmb /end REF_MEASUREMENT /end GROUP
/begin GROUP S665_Debouncer "EcuIntgdSwGend/ControlSoftware/TqLim/Engine Protection/Torque Limitation for Coolant Temperature/Debouncer" /begin REF_MEASUREMENT TL_TiElpdNEngAcvForTCoolt TL_bComplDebNEngAcvForTCoolt /end REF_MEASUREMENT /end GROUP
/begin GROUP S666_Debouncer "EcuIntgdSwGend/ControlSoftware/TqLim/Engine Protection/Torque Limitation for Intake Air Pressure/Debouncer"
 /begin REF_MEASUREMENT TL_TiElpdNEngAcvForPAirBoost TL_bComplDebNEngAcvForPAirBoost /end REF_MEASUREMENT
/end GROUP
/begin GROUP S667_Debouncer1 "EcuIntgdSwGend/ControlSoftware/TqLim/Engine Protection/Torque Limitation for Oil Temperature/Debouncer1" /begin REF_MEASUREMENT TL_TiElpdNEngAcvForTOil TL_bComplDebNEngAcvForTOil /end REF_MEASUREMENT /end GROUP
/begin GROUP S669_Debouncer "EcuIntgdSwGend/ControlSoftware/TqLim/Engine Protection/Torque Limitation for Turbo Charge Speed/Debouncer"
 /begin REF_MEASUREMENT TL_TiElpdNEngAcvForNExhTrbChrg TL_bComplDebNEngAcvForNExhTrbChrg /end REF_MEASUREMENT
/end GROUP
/begin GROUP S681_Engine_Speed_Level_Check "EcuIntgdSwGend/ControlSoftware/WarnMong/Warning-Reduction-Shutdown Functions/Global Enable/Engine Speed Level Check"
 /begin SUB_GROUP S688_Hysteresis_Switch S688_Hysteresis_Switch1 S688_Hysteresis_Switch2 S688_Hysteresis_Switch3 S688_Hysteresis_Switch4 S688_Hysteresis_Switch5 S688_Hysteresis_Switch6 /end SUB_GROUP
 /begin REF_CHARACTERISTIC EG_bFlgTrue_C WM_NEngLvl1ClrThd_P WM_NEngLvl1DetdThd_P WM_NEngLvl2ClrThd_P WM_NEngLvl2DetdThd_P WM_NEngLvl3ClrThd_P WM_NEngLvl3DetdThd_P WM_NEngLvl4ClrThd_P WM_NEngLvl4DetdThd_P WM_NEngLvl5ClrThd_P WM_NEngLvl5DetdThd_P WM_NEngLvl6ClrThd_P WM_NEngLvl6DetdThd_P WM_NEngLvl7ClrThd_P WM_NEngLvl7DetdThd_P /end REF_CHARACTERISTIC
/end GROUP
/begin GROUP S682_Battery_Over_Voltage "EcuIntgdSwGend/ControlSoftware/WarnMong/Warning-Reduction-Shutdown Functions/Internal/Battery Over Voltage"
 /begin REF_CHARACTERISTIC EG_Mask32Bit0_C EG_NmrInt0_C EG_NmrInt1_C EG_NmrInt2_C EG_NmrInt3_C EG_TsSw20_C EG_bFlgFalse_C EG_bFlgTrue_C WM_MaskRTNForErrUClmp30Ov_P WM_MaskRctnForUClmp30OvLvl1Err_P WM_MaskRctnForUClmp30OvLvl2Err_P WM_MaskRctnForUClmp30OvLvl3Err_P WM_MaskUClmp30OvEnaCond_P WM_TiUClmp30OvDebHi_P WM_TiUClmp30OvDebLo_P WM_UClmp30OvDesLvlQnty_P WM_UClmp30OvHysDeacLvl1_P WM_UClmp30OvHysDeacLvl2_P WM_UClmp30OvHysDeacLvl3_P WM_UClmp30OvLvl1_M WM_UClmp30OvLvl2_M WM_UClmp30OvLvl3_M /end REF_CHARACTERISTIC
 /begin REF_MEASUREMENT WM_MaskRctnForUClmp30OvErr WM_bErrUClmp30Ov WM_bErrUClmp30OvLvl1 WM_bErrUClmp30OvLvl2 WM_bErrUClmp30OvLvl3 WM_bUClmp30OvEna /end REF_MEASUREMENT
/end GROUP
/begin GROUP S682_Battery_Under_Voltage "EcuIntgdSwGend/ControlSoftware/WarnMong/Warning-Reduction-Shutdown Functions/Internal/Battery Under Voltage"
 /begin REF_CHARACTERISTIC EG_Mask32Bit0_C EG_NmrInt0_C EG_NmrInt1_C EG_NmrInt2_C EG_NmrInt3_C EG_TsSw20_C EG_bFlgFalse_C EG_bFlgTrue_C WM_MaskRTNForErrUClmp30Und_P WM_MaskRctnForUClmp30UndLvl1Err_P WM_MaskRctnForUClmp30UndLvl2Err_P WM_MaskRctnForUClmp30UndLvl3Err_P WM_MaskUClmp30UndEnaCond_P WM_TiUClmp30UndDebHi_P WM_TiUClmp30UndDebLo_P WM_UClmp30UndDesLvlQnty_P WM_UClmp30UndHysDeacLvl1_P WM_UClmp30UndHysDeacLvl2_P WM_UClmp30UndHysDeacLvl3_P WM_UClmp30UndLvl1_M WM_UClmp30UndLvl2_M WM_UClmp30UndLvl3_M /end REF_CHARACTERISTIC
 /begin REF_MEASUREMENT WM_MaskRctnForUClmp30UndErr WM_bErrUClmp30Und WM_bErrUClmp30UndLvl1 WM_bErrUClmp30UndLvl2 WM_bErrUClmp30UndLvl3 WM_bUClmp30UndEna /end REF_MEASUREMENT
/end GROUP
/begin GROUP S682_Cylinder_Misfire "EcuIntgdSwGend/ControlSoftware/WarnMong/Warning-Reduction-Shutdown Functions/Internal/Cylinder Misfire"
 /begin REF_CHARACTERISTIC EG_Mask32Bit0_C EG_NmrInt0_C EG_NmrInt1_C EG_NmrInt2_C EG_NmrInt3_C EG_TsSw20_C EG_bFlgFalse_C EG_bFlgTrue_C WM_ErrCylMisfDesLvlQnty_P WM_MaskErrCylMisfEnaCond_P WM_MaskRTNForErrCylMisf_P WM_MaskRctnForErrCylMisfLvl1Err_P WM_MaskRctnForErrCylMisfLvl2Err_P WM_MaskRctnForErrCylMisfLvl3Err_P WM_TiErrCylMisfDeb_P /end REF_CHARACTERISTIC
 /begin REF_MEASUREMENT WM_MaskRctnForErrCylMisfErr WM_bErrCylMisf WM_bErrCylMisfEna WM_bErrCylMisfLvl1 WM_bErrCylMisfLvl2 WM_bErrCylMisfLvl3 /end REF_MEASUREMENT
/end GROUP
/begin GROUP S684_Air_Boost_Over_Pressure "EcuIntgdSwGend/ControlSoftware/WarnMong/Warning-Reduction-Shutdown Functions/Pressure/Air Boost Over Pressure"
 /begin REF_CHARACTERISTIC EG_Mask32Bit0_C EG_NmrInt0_C EG_NmrInt1_C EG_NmrInt2_C EG_NmrInt3_C EG_TsSw20_C EG_bFlgFalse_C EG_bFlgTrue_C WM_MaskPAirBoostOvEnaCond_P WM_MaskRTNForErrPAirBoostOv_P WM_MaskRctnForPAirBoostOvLvl1Err_P WM_MaskRctnForPAirBoostOvLvl2Err_P WM_MaskRctnForPAirBoostOvLvl3Err_P WM_PAirBoostOvDesLvlQnty_P WM_PAirBoostOvHysDeacLvl1_P WM_PAirBoostOvHysDeacLvl2_P WM_PAirBoostOvHysDeacLvl3_P WM_PAirBoostOvLvl1_M WM_PAirBoostOvLvl2_M WM_PAirBoostOvLvl3_M WM_TiPAirBoostOvDebHi_P WM_TiPAirBoostOvDebLo_P /end REF_CHARACTERISTIC
 /begin REF_MEASUREMENT WM_MaskRctnForPAirBoostOvErr WM_bErrPAirBoostOv WM_bErrPAirBoostOvLvl1 WM_bErrPAirBoostOvLvl2 WM_bErrPAirBoostOvLvl3 WM_bPAirBoostOvEna /end REF_MEASUREMENT
/end GROUP
/end MODULE
/end PROJECT
