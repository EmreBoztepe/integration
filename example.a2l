ASAP2_VERSION 1 6
/begin PROJECT ECEMTAG_CR8 ""
/begin MODULE DIM ""
/begin MOD_COMMON "Mod Common Comment Here" DEPOSIT ABSOLUTE BYTE_ORDER MSB_FIRST /end MOD_COMMON
/begin RECORD_LAYOUT FLOAT32_IEEE FNC_VALUES 1 FLOAT32_IEEE ROW_DIR DIRECT /end RECORD_LAYOUT
/begin RECORD_LAYOUT ULONG FNC_VALUES 1 ULONG ROW_DIR DIRECT /end RECORD_LAYOUT
/begin RECORD_LAYOUT UWORD FNC_VALUES 1 UWORD ROW_DIR DIRECT /end RECORD_LAYOUT
/begin RECORD_LAYOUT SWORD FNC_VALUES 1 SWORD ROW_DIR DIRECT /end RECORD_LAYOUT
/begin RECORD_LAYOUT UBYTE FNC_VALUES 1 UBYTE ROW_DIR DIRECT /end RECORD_LAYOUT
/begin RECORD_LAYOUT SBYTE FNC_VALUES 1 SBYTE ROW_DIR DIRECT /end RECORD_LAYOUT
/begin RECORD_LAYOUT RL_X_ULONG AXIS_PTS_X 1 ULONG INDEX_INCR DIRECT /end RECORD_LAYOUT
/begin RECORD_LAYOUT RL_X_UWORD AXIS_PTS_X 1 UWORD INDEX_INCR DIRECT /end RECORD_LAYOUT
/begin RECORD_LAYOUT RL_X_UBYTE AXIS_PTS_X 1 UBYTE INDEX_INCR DIRECT /end RECORD_LAYOUT
/begin RECORD_LAYOUT RL_X_SBYTE AXIS_PTS_X 1 SBYTE INDEX_INCR DIRECT /end RECORD_LAYOUT
/******************************* From MATLAB ***************************************/ /* MATLAB_SECTION_START_1 */
/begin RECORD_LAYOUT Scalar_BOOLEAN FNC_VALUES 1 UBYTE ROW_DIR DIRECT /end RECORD_LAYOUT
/begin RECORD_LAYOUT Scalar_UBYTE FNC_VALUES 1 UBYTE ROW_DIR DIRECT /end RECORD_LAYOUT
/begin RECORD_LAYOUT Scalar_BYTE FNC_VALUES 1 SBYTE ROW_DIR DIRECT /end RECORD_LAYOUT
/begin RECORD_LAYOUT Scalar_UWORD FNC_VALUES 1 UWORD ROW_DIR DIRECT /end RECORD_LAYOUT
/begin RECORD_LAYOUT Scalar_SWORD FNC_VALUES 1 SWORD ROW_DIR DIRECT /end RECORD_LAYOUT
/begin RECORD_LAYOUT Scalar_FLOAT32_IEEE FNC_VALUES 1 FLOAT32_IEEE ROW_DIR DIRECT /end RECORD_LAYOUT
/begin RECORD_LAYOUT Lookup1D_X_WORD AXIS_PTS_X 1 SWORD INDEX_INCR DIRECT /end RECORD_LAYOUT
/begin RECORD_LAYOUT Lookup1D_FLOAT32_IEEE FNC_VALUES 1 FLOAT32_IEEE ROW_DIR DIRECT /end RECORD_LAYOUT
/begin RECORD_LAYOUT Lookup1D_X_FLOAT32_IEEE AXIS_PTS_X 1 FLOAT32_IEEE INDEX_INCR DIRECT /end RECORD_LAYOUT
/begin RECORD_LAYOUT Lookup2D_X_WORD AXIS_PTS_X 1 SWORD INDEX_INCR DIRECT /end RECORD_LAYOUT
/begin RECORD_LAYOUT Lookup2D_FLOAT32_IEEE FNC_VALUES 1 FLOAT32_IEEE ROW_DIR DIRECT /end RECORD_LAYOUT
/begin RECORD_LAYOUT Lookup2D_X_FLOAT32_IEEE AXIS_PTS_X 1 FLOAT32_IEEE INDEX_INCR DIRECT /end RECORD_LAYOUT
/begin CHARACTERISTIC CrsCtrl_CoeffDForVVehCtl_M "Coefficient Derrivate For Vehicle Velocity Control Map" CURVE 0x400403F4 /* @ECU_Address@CrsCtrl_CoeffDForVVehCtl_M@ */ Lookup1D_FLOAT32_IEEE 0 EcuIntgdSwGend_CM_single 0.0 10000.0
 /begin AXIS_DESCR COM_AXIS CrsCtrl_ErrVehVRef EcuIntgdSwGend_CM_single_km_h 20 -300.0 300.0 AXIS_PTS_REF CrsCtrl_ErrVVeh_A /end AXIS_DESCR
/end CHARACTERISTIC
/begin AXIS_PTS CrsCtrl_ErrVVeh_A "Error Vehicle Velocity Reference Map Axis" 0x40040544 /* @ECU_Address@CrsCtrl_ErrVVeh_A@ */ CrsCtrl_ErrVehVRef Lookup1D_X_FLOAT32_IEEE 0 EcuIntgdSwGend_CM_single_km_h 20 -300.0 300.0 /end AXIS_PTS
/begin CHARACTERISTIC CrsCtrl_CoeffFiltForVVehCtl_M "Coefficient Filter for Vehicle Velocity Control Map" CURVE 0x40040444 /* @ECU_Address@CrsCtrl_CoeffFiltForVVehCtl_M@ */ Lookup1D_FLOAT32_IEEE 0 EcuIntgdSwGend_CM_single 0.0 10000.0
 /begin AXIS_DESCR COM_AXIS CrsCtrl_ErrVehVRef EcuIntgdSwGend_CM_single_km_h 20 -300.0 300.0 AXIS_PTS_REF CrsCtrl_ErrVVeh_A /end AXIS_DESCR
/end CHARACTERISTIC
/begin CHARACTERISTIC CrsCtrl_CoeffIForVVehCtl_M "Coefficient Integral for Vehicle Velocity Control Map" CURVE 0x40040494 /* @ECU_Address@CrsCtrl_CoeffIForVVehCtl_M@ */ Lookup1D_FLOAT32_IEEE 0 EcuIntgdSwGend_CM_single 0.0 10000.0
 /begin AXIS_DESCR COM_AXIS CrsCtrl_ErrVehVRef EcuIntgdSwGend_CM_single_km_h 20 -300.0 300.0 AXIS_PTS_REF CrsCtrl_ErrVVeh_A /end AXIS_DESCR
/end CHARACTERISTIC
/begin CHARACTERISTIC CrsCtrl_CoeffPForVVehCtl_M "Derivative Coefficient Map Out Signal for Vehicle Velocity" CURVE 0x400404E4 /* @ECU_Address@CrsCtrl_CoeffPForVVehCtl_M@ */ Lookup1D_FLOAT32_IEEE 0 EcuIntgdSwGend_CM_single 0.0 10000.0
 /begin AXIS_DESCR COM_AXIS CrsCtrl_ErrVehVRef EcuIntgdSwGend_CM_single_km_h 20 -300.0 300.0 AXIS_PTS_REF CrsCtrl_ErrVVeh_A /end AXIS_DESCR
/end CHARACTERISTIC
/begin CHARACTERISTIC CrsCtrl_SatPIDMax_M "PID Maximum Saturation Map" MAP 0x400405DC /* @ECU_Address@CrsCtrl_SatPIDMax_M@ */ Lookup2D_FLOAT32_IEEE 0 EcuIntgdSwGend_CM_single_N_m 0.0 10000.0
 /begin AXIS_DESCR COM_AXIS EIP_CanTrsmCurrentGear EcuIntgdSwGend_CM_int16 6 -125.0 251.0 AXIS_PTS_REF CrsCtrl_CanTrsmCurrentGear_A /end AXIS_DESCR
 /begin AXIS_DESCR COM_AXIS EIP_NEng EcuIntgdSwGend_CM_single_rpm 6 0.0 3000.0 AXIS_PTS_REF CrsCtrl_NEngForPIDMax_A /end AXIS_DESCR
/end CHARACTERISTIC
/begin AXIS_PTS CrsCtrl_CanTrsmCurrentGear_A "Transmission Current Gear Map Axis" 0x400403E6 /* @ECU_Address@CrsCtrl_CanTrsmCurrentGear_A@ */ EIP_CanTrsmCurrentGear Lookup2D_X_WORD 0 EcuIntgdSwGend_CM_int16 6 -125.0 251.0 /end AXIS_PTS
/begin AXIS_PTS CrsCtrl_NEngForPIDMax_A "Engine Speed for PID Max Map Axis" 0x400405A0 /* @ECU_Address@CrsCtrl_NEngForPIDMax_A@ */ EIP_NEng Lookup2D_X_FLOAT32_IEEE 0 EcuIntgdSwGend_CM_single_rpm 6 0.0 3000.0 /end AXIS_PTS
/begin CHARACTERISTIC CrsCtrl_TrfCaseStsFac_M "Transfer Case Status Factor Map" CURVE 0x400406A0 /* @ECU_Address@CrsCtrl_TrfCaseStsFac_M@ */ Lookup1D_FLOAT32_IEEE 0 EcuIntgdSwGend_CM_single 0.0 100.0
 /begin AXIS_DESCR COM_AXIS EIP_CanTrfCaseSts EcuIntgdSwGend_CM_single 8 0.0 100.0 AXIS_PTS_REF CrsCtrl_TrfCaseStsFacForFF_A /end AXIS_DESCR
/end CHARACTERISTIC
/begin AXIS_PTS CrsCtrl_TrfCaseStsFacForFF_A "Transfer Case Status Factor for FeedForward Maps Axis" 0x40040680 /* @ECU_Address@CrsCtrl_TrfCaseStsFacForFF_A@ */ EIP_CanTrfCaseSts Lookup1D_X_FLOAT32_IEEE 0 EcuIntgdSwGend_CM_single 8 0.0 100.0 /end AXIS_PTS
/begin CHARACTERISTIC CrsCtrl_TrsmTqCnvrRatFac_M "Transmission Torque Convertor Ratio Factor Map" CURVE 0x400406C0 /* @ECU_Address@CrsCtrl_TrsmTqCnvrRatFac_M@ */ Lookup1D_FLOAT32_IEEE 0 EcuIntgdSwGend_CM_single 0.0 100.0
 /begin AXIS_DESCR COM_AXIS EIP_CanTrsmTqCnvrRat EcuIntgdSwGend_CM_single 8 0.0 100.0 AXIS_PTS_REF CrsCtrl_TrsmTqCnvrRatForFF_A /end AXIS_DESCR
/end CHARACTERISTIC
/begin AXIS_PTS CrsCtrl_TrsmTqCnvrRatForFF_A "Transmission Torque Convertor Ratio for FeedForward Map Axis" 0x400406E0 /* @ECU_Address@CrsCtrl_TrsmTqCnvrRatForFF_A@ */ EIP_CanTrsmTqCnvrRat Lookup1D_X_FLOAT32_IEEE 0 EcuIntgdSwGend_CM_single 8 0.0 100.0 /end AXIS_PTS
/begin CHARACTERISTIC DTqC_NEngIdleGearRef_M "Idle Reference Map According to Gear Index" CURVE 0x40041D44 /* @ECU_Address@DTqC_NEngIdleGearRef_M@ */ Lookup1D_FLOAT32_IEEE 0 EcuIntgdSwGend_CM_single_rpm 0.0 5000.0
 /begin AXIS_DESCR COM_AXIS EIP_CanTrsmCurrentGear EcuIntgdSwGend_CM_int16 5 -3.0 10.0 AXIS_PTS_REF DTqC_IdxGearIdleRef_A /end AXIS_DESCR
/end CHARACTERISTIC
/begin AXIS_PTS DTqC_IdxGearIdleRef_A "Active Index Gear Axis for Reference Idle Engine Speed Map" 0x40041BEC /* @ECU_Address@DTqC_IdxGearIdleRef_A@ */ EIP_CanTrsmCurrentGear Lookup1D_X_WORD 0 EcuIntgdSwGend_CM_int16 5 -3.0 10.0 /end AXIS_PTS
/begin CHARACTERISTIC DTqC_PAmbAirNEngIdleRef_M "Amibent Air Pressure for Reference Engine Idle Speed Map" CURVE 0x40041DF0 /* @ECU_Address@DTqC_PAmbAirNEngIdleRef_M@ */ Lookup1D_FLOAT32_IEEE 0 EcuIntgdSwGend_CM_single -1000.0 1000.0
 /begin AXIS_DESCR COM_AXIS EIP_PAmbAir EcuIntgdSwGend_CM_single_mbar 10 0.0 1600.0 AXIS_PTS_REF DTqC_PAmbAirIdleRef_A /end AXIS_DESCR
/end CHARACTERISTIC
/begin AXIS_PTS DTqC_PAmbAirIdleRef_A "Amibent Air Pressure Map Axis for Reference Engine Idle Speed Map" 0x40041DC8 /* @ECU_Address@DTqC_PAmbAirIdleRef_A@ */ EIP_PAmbAir Lookup1D_X_FLOAT32_IEEE 0 EcuIntgdSwGend_CM_single_mbar 10 0.0 1600.0 /end AXIS_PTS
/begin CHARACTERISTIC DTqC_TCooltNEngIdleRef_M "Coolant Temperature for Reference Engine Idle Speed Map Out" CURVE 0x40041F4C /* @ECU_Address@DTqC_TCooltNEngIdleRef_M@ */ Lookup1D_FLOAT32_IEEE 0 EcuIntgdSwGend_CM_single_degC -1000.0 1000.0
 /begin AXIS_DESCR COM_AXIS EIP_TCoolt EcuIntgdSwGend_CM_single_degC 10 -40.0 150.0 AXIS_PTS_REF DTqC_TCooltIdleRef_A /end AXIS_DESCR
/end CHARACTERISTIC
/begin AXIS_PTS DTqC_TCooltIdleRef_A "Coolant Temperature Map Axis for Reference Engine Idle Speed Map" 0x40041F18 /* @ECU_Address@DTqC_TCooltIdleRef_A@ */ EIP_TCoolt Lookup1D_X_FLOAT32_IEEE 0 EcuIntgdSwGend_CM_single_degC 10 -40.0 150.0 /end AXIS_PTS
/begin CHARACTERISTIC DTqC_TOilNEngIdleRef_M "Oil Temperature for Reference Engine Idle Speed Map" CURVE 0x40041F9C /* @ECU_Address@DTqC_TOilNEngIdleRef_M@ */ Lookup1D_FLOAT32_IEEE 0 EcuIntgdSwGend_CM_single -1000.0 1000.0
 /begin AXIS_DESCR COM_AXIS EIP_TOil EcuIntgdSwGend_CM_single_degC 10 -40.0 150.0 AXIS_PTS_REF DTqC_TOilIdleRef_A /end AXIS_DESCR
/end CHARACTERISTIC
/begin AXIS_PTS DTqC_TOilIdleRef_A "Oil Temperature Map Axis for Reference Engine Idle Speed Map" 0x40041F74 /* @ECU_Address@DTqC_TOilIdleRef_A@ */ EIP_TOil Lookup1D_X_FLOAT32_IEEE 0 EcuIntgdSwGend_CM_single_degC 10 -40.0 150.0 /end AXIS_PTS
/begin CHARACTERISTIC DTqC_CoeffDForSpdCtl_M "Derivative Coefficient Map for Speed Controller" MAP 0x400408A8 /* @ECU_Address@DTqC_CoeffDForSpdCtl_M@ */ Lookup2D_FLOAT32_IEEE 0 EcuIntgdSwGend_CM_single -100000.0 100000.0
 /begin AXIS_DESCR COM_AXIS DTqC_ErrNIdle EcuIntgdSwGend_CM_single_rpm 10 -500.0 500.0 AXIS_PTS_REF DTqC_ErrNEng_A /end AXIS_DESCR
 /begin AXIS_DESCR COM_AXIS EIP_TCoolt EcuIntgdSwGend_CM_single_degC 10 -40.0 150.0 AXIS_PTS_REF DTqC_TCooltForSpdCtl_A /end AXIS_DESCR
/end CHARACTERISTIC
/begin AXIS_PTS DTqC_ErrNEng_A "Axis Values of Error Engine Speed for PID Coefficient Maps" 0x40041A28 /* @ECU_Address@DTqC_ErrNEng_A@ */ DTqC_ErrNIdle Lookup2D_X_FLOAT32_IEEE 0 EcuIntgdSwGend_CM_single_rpm 10 -500.0 500.0 /end AXIS_PTS
/begin AXIS_PTS DTqC_TCooltForSpdCtl_A "Axis Values of Coolant High Temperature for Start Control Torque Map" 0x40041EC8 /* @ECU_Address@DTqC_TCooltForSpdCtl_A@ */ EIP_TCoolt Lookup2D_X_FLOAT32_IEEE 0 EcuIntgdSwGend_CM_single_degC 10 -40.0 150.0 /end AXIS_PTS
/begin CHARACTERISTIC DTqC_CoeffFiltForSpdCtl_M "Filter Coefficient Map for Speed Controller" MAP 0x40040D58 /* @ECU_Address@DTqC_CoeffFiltForSpdCtl_M@ */ Lookup2D_FLOAT32_IEEE 0 EcuIntgdSwGend_CM_single -100000.0 100000.0
 /begin AXIS_DESCR COM_AXIS DTqC_ErrNIdle EcuIntgdSwGend_CM_single_rpm 10 -500.0 500.0 AXIS_PTS_REF DTqC_ErrNEng_A /end AXIS_DESCR
 /begin AXIS_DESCR COM_AXIS EIP_TCoolt EcuIntgdSwGend_CM_single_degC 10 -40.0 150.0 AXIS_PTS_REF DTqC_TCooltForSpdCtl_A /end AXIS_DESCR
/end CHARACTERISTIC
/begin CHARACTERISTIC DTqC_CoeffIForSpdCtl_M "Integrator Coefficient Map for Speed Controller" MAP 0x40041220 /* @ECU_Address@DTqC_CoeffIForSpdCtl_M@ */ Lookup2D_FLOAT32_IEEE 0 EcuIntgdSwGend_CM_single -100000.0 100000.0
 /begin AXIS_DESCR COM_AXIS DTqC_ErrNIdle EcuIntgdSwGend_CM_single_rpm 10 -500.0 500.0 AXIS_PTS_REF DTqC_ErrNEng_A /end AXIS_DESCR
 /begin AXIS_DESCR COM_AXIS EIP_TCoolt EcuIntgdSwGend_CM_single_degC 10 -40.0 150.0 AXIS_PTS_REF DTqC_TCooltForSpdCtl_A /end AXIS_DESCR
/end CHARACTERISTIC
/begin CHARACTERISTIC DTqC_CoeffPForSpdCtl_M "Proportional Coefficient Map for Speed Controller" MAP 0x400416D0 /* @ECU_Address@DTqC_CoeffPForSpdCtl_M@ */ Lookup2D_FLOAT32_IEEE 0 EcuIntgdSwGend_CM_single -100000.0 100000.0
 /begin AXIS_DESCR COM_AXIS DTqC_ErrNIdle EcuIntgdSwGend_CM_single_rpm 10 -500.0 500.0 AXIS_PTS_REF DTqC_ErrNEng_A /end AXIS_DESCR
 /begin AXIS_DESCR COM_AXIS EIP_TCoolt EcuIntgdSwGend_CM_single_degC 10 -40.0 150.0 AXIS_PTS_REF DTqC_TCooltForSpdCtl_A /end AXIS_DESCR
/end CHARACTERISTIC
/begin CHARACTERISTIC DTqC_IdleSpdCtrlFF_M "Idle Speed Controller Feed Forward Map" MAP 0x40041A5C /* @ECU_Address@DTqC_IdleSpdCtrlFF_M@ */ Lookup2D_FLOAT32_IEEE 0 EcuIntgdSwGend_CM_single_N_m -10000.0 10000.0
 /begin AXIS_DESCR COM_AXIS EIP_TCoolt EcuIntgdSwGend_CM_single_degC 10 -50.0 250.0 AXIS_PTS_REF DTqC_TCooltForIdleSpdFF_A /end AXIS_DESCR
 /begin AXIS_DESCR COM_AXIS EIP_NEng EcuIntgdSwGend_CM_single_rpm 10 0.0 5000.0 AXIS_PTS_REF DTqC_NEngForIdleSpdFF_A /end AXIS_DESCR
/end CHARACTERISTIC
/begin AXIS_PTS DTqC_TCooltForIdleSpdFF_A "Idle Speed Controller Feed Forward Coolant Temperature Axis" 0x40041EA0 /* @ECU_Address@DTqC_TCooltForIdleSpdFF_A@ */ EIP_TCoolt Lookup2D_X_FLOAT32_IEEE 0 EcuIntgdSwGend_CM_single_degC 10 -50.0 250.0 /end AXIS_PTS
/begin AXIS_PTS DTqC_NEngForIdleSpdFF_A "Idle Speed Controller Feed Forward Engine Speed Axis" 0x40041CA8 /* @ECU_Address@DTqC_NEngForIdleSpdFF_A@ */ EIP_NEng Lookup2D_X_FLOAT32_IEEE 0 EcuIntgdSwGend_CM_single_rpm 10 0.0 5000.0 /end AXIS_PTS
/begin CHARACTERISTIC DTqC_TqDesSatMax_M "Idle Engine Speed PID Controlller Max Saturation Map" CURVE 0x4004330C /* @ECU_Address@DTqC_TqDesSatMax_M@ */ Lookup1D_FLOAT32_IEEE 0 EcuIntgdSwGend_CM_single_N_m -1000.0 10000.0
 /begin AXIS_DESCR COM_AXIS EIP_NEng EcuIntgdSwGend_CM_single_rpm 7 0.0 6000.0 AXIS_PTS_REF DTqC_NEngForTqDesSatMax_A /end AXIS_DESCR
/end CHARACTERISTIC
/begin AXIS_PTS DTqC_NEngForTqDesSatMax_A "Engine Speed Axis for Idle Speed PID Controller PID Max Saturation Map " 0x40041D20 /* @ECU_Address@DTqC_NEngForTqDesSatMax_A@ */ EIP_NEng Lookup1D_X_FLOAT32_IEEE 0 EcuIntgdSwGend_CM_single_rpm 7 0.0 6000.0 /end AXIS_PTS
/begin CHARACTERISTIC CrsCtrl_PIDCoeffDOvv_P "PID Derivative Coefficient for Cruise Control - Override Value" VALUE 0x400405BC /* @ECU_Address@CrsCtrl_PIDCoeffDOvv_P@ */ Scalar_FLOAT32_IEEE 0 EcuIntgdSwGend_CM_single 0.0 10000.0 /end CHARACTERISTIC
/begin CHARACTERISTIC CrsCtrl_PIDCoeffFiltOvv_P "PID Filter Coefficient for Cruise Control - Override Value" VALUE 0x400405C4 /* @ECU_Address@CrsCtrl_PIDCoeffFiltOvv_P@ */ Scalar_FLOAT32_IEEE 0 EcuIntgdSwGend_CM_single 0.0 10000.0 /end CHARACTERISTIC
/begin CHARACTERISTIC CrsCtrl_PIDCoeffIOvv_P "PID Integrator Coefficient for Cruise Control - Override Value" VALUE 0x400405CC /* @ECU_Address@CrsCtrl_PIDCoeffIOvv_P@ */ Scalar_FLOAT32_IEEE 0 EcuIntgdSwGend_CM_single 0.0 10000.0 /end CHARACTERISTIC
/begin CHARACTERISTIC CrsCtrl_PIDCoeffPOvv_P "PID Proportional Coefficient for Cruise Control - Override Value" VALUE 0x400405D4 /* @ECU_Address@CrsCtrl_PIDCoeffPOvv_P@ */ Scalar_FLOAT32_IEEE 0 EcuIntgdSwGend_CM_single 0.0 10000.0 /end CHARACTERISTIC
/begin CHARACTERISTIC CrsCtrl_PIDMin_P "PID Minimum Parameter" VALUE 0x400405D8 /* @ECU_Address@CrsCtrl_PIDMin_P@ */ Scalar_FLOAT32_IEEE 0 EcuIntgdSwGend_CM_single_N_m -5000.0 0.0 /end CHARACTERISTIC
/begin CHARACTERISTIC DTqC_CoeffFiltKdSpdCtlOvv_P "Filter Coefficient Parameter for Speed Controller - Override Value" VALUE 0x40041084 /* @ECU_Address@DTqC_CoeffFiltKdSpdCtlOvv_P@ */ Scalar_FLOAT32_IEEE 0 EcuIntgdSwGend_CM_single 0.0 1000.0 /end CHARACTERISTIC
/begin CHARACTERISTIC DTqC_EngSpdPoint1_P "Engine Speed Point 1 Value" VALUE 0x400419F8 /* @ECU_Address@DTqC_EngSpdPoint1_P@ */ Scalar_FLOAT32_IEEE 0 EcuIntgdSwGend_CM_single_rpm 0.0 8031.0 /end CHARACTERISTIC
/begin CHARACTERISTIC DTqC_EngSpdPoint2_P "Engine Speed Point 2 Value" VALUE 0x400419FC /* @ECU_Address@DTqC_EngSpdPoint2_P@ */ Scalar_FLOAT32_IEEE 0 EcuIntgdSwGend_CM_single_rpm 0.0 8031.0 /end CHARACTERISTIC
/begin CHARACTERISTIC DTqC_EngSpdPoint3_P "Engine Speed Point 3 Value" VALUE 0x40041A00 /* @ECU_Address@DTqC_EngSpdPoint3_P@ */ Scalar_FLOAT32_IEEE 0 EcuIntgdSwGend_CM_single_rpm 0.0 8031.0 /end CHARACTERISTIC
/begin CHARACTERISTIC DTqC_EngSpdPoint4_P "Engine Speed Point 4 Value" VALUE 0x40041A04 /* @ECU_Address@DTqC_EngSpdPoint4_P@ */ Scalar_FLOAT32_IEEE 0 EcuIntgdSwGend_CM_single_rpm 0.0 8031.0 /end CHARACTERISTIC
/begin CHARACTERISTIC DTqC_EngSpdPoint5_P "Engine Speed Point 5 Value" VALUE 0x40041A08 /* @ECU_Address@DTqC_EngSpdPoint5_P@ */ Scalar_FLOAT32_IEEE 0 EcuIntgdSwGend_CM_single_rpm 0.0 8031.0 /end CHARACTERISTIC
/begin CHARACTERISTIC DTqC_EngSpdPoint6_P "Engine Speed Point 6 Value" VALUE 0x40041A0C /* @ECU_Address@DTqC_EngSpdPoint6_P@ */ Scalar_FLOAT32_IEEE 0 EcuIntgdSwGend_CM_single_rpm 0.0 8031.0 /end CHARACTERISTIC
/begin CHARACTERISTIC DTqC_EngSpdPoint7_P "Engine Speed Point 7 Value" VALUE 0x40041A10 /* @ECU_Address@DTqC_EngSpdPoint7_P@ */ Scalar_FLOAT32_IEEE 0 EcuIntgdSwGend_CM_single_rpm 0.0 3000.0 /end CHARACTERISTIC
/begin CHARACTERISTIC DTqC_EngTqPoint1_P "Engine Torque Point 1" VALUE 0x40041A14 /* @ECU_Address@DTqC_EngTqPoint1_P@ */ Scalar_FLOAT32_IEEE 0 EcuIntgdSwGend_CM_single_N_m 0.0 3000.0 /end CHARACTERISTIC
/begin CHARACTERISTIC DTqC_EngTqPoint2_P "Engine Torque Point 2" VALUE 0x40041A18 /* @ECU_Address@DTqC_EngTqPoint2_P@ */ Scalar_FLOAT32_IEEE 0 EcuIntgdSwGend_CM_single_N_m 0.0 3000.0 /end CHARACTERISTIC
/begin CHARACTERISTIC DTqC_EngTqPoint3_P "Engine Torque Point 3" VALUE 0x40041A1C /* @ECU_Address@DTqC_EngTqPoint3_P@ */ Scalar_FLOAT32_IEEE 0 EcuIntgdSwGend_CM_single_N_m 0.0 3000.0 /end CHARACTERISTIC
/begin CHARACTERISTIC DTqC_EngTqPoint4_P "Engine Torque Point 4" VALUE 0x40041A20 /* @ECU_Address@DTqC_EngTqPoint4_P@ */ Scalar_FLOAT32_IEEE 0 EcuIntgdSwGend_CM_single_N_m 0.0 3000.0 /end CHARACTERISTIC
/begin CHARACTERISTIC DTqC_EngTqPoint5_P "Engine Torque Point 5" VALUE 0x40041A24 /* @ECU_Address@DTqC_EngTqPoint5_P@ */ Scalar_FLOAT32_IEEE 0 EcuIntgdSwGend_CM_single_N_m 0.0 3000.0 /end CHARACTERISTIC
/begin CHARACTERISTIC DTqC_FacSclPIDCoeff_P "Factor Scaling Parameter for PID" VALUE 0x40041A54 /* @ECU_Address@DTqC_FacSclPIDCoeff_P@ */ Scalar_FLOAT32_IEEE 0 EcuIntgdSwGend_CM_single 1.0 10000.0 /end CHARACTERISTIC
/begin CHARACTERISTIC DTqC_KdSpdCtlOvv_P "Derivative Coefficient Parameter for Speed Controller - Override Value" VALUE 0x40041C04 /* @ECU_Address@DTqC_KdSpdCtlOvv_P@ */ Scalar_FLOAT32_IEEE 0 EcuIntgdSwGend_CM_single 0.0 1000.0 /end CHARACTERISTIC
/begin CHARACTERISTIC DTqC_KiSpdCtlOvv_P "Integrator Coefficient Parameter for Speed Controller - Override Value" VALUE 0x40041C1C /* @ECU_Address@DTqC_KiSpdCtlOvv_P@ */ Scalar_FLOAT32_IEEE 0 EcuIntgdSwGend_CM_single 0.0 1000.0 /end CHARACTERISTIC
/begin CHARACTERISTIC DTqC_KpSpdCtlOvv_P "Proportional Coefficient Parameter for Speed Controller - Override Value" VALUE 0x40041C34 /* @ECU_Address@DTqC_KpSpdCtlOvv_P@ */ Scalar_FLOAT32_IEEE 0 EcuIntgdSwGend_CM_single 0.0 1000.0 /end CHARACTERISTIC
/begin CHARACTERISTIC DTqC_NEngHardLimActvnThdOffs_P "Hard Limit Activation Threshold Offset" VALUE 0x40041D3C /* @ECU_Address@DTqC_NEngHardLimActvnThdOffs_P@ */ Scalar_FLOAT32_IEEE 0 EcuIntgdSwGend_CM_single_rpm -3000.0 3000.0 /end CHARACTERISTIC
/begin CHARACTERISTIC DTqC_NEngHardLimDeacThdOffs_P "" VALUE 0x40041D40 /* @ECU_Address@DTqC_NEngHardLimDeacThdOffs_P@ */ Scalar_FLOAT32_IEEE 0 EcuIntgdSwGend_CM_single_rpm 0.0 2400.0 /end CHARACTERISTIC
/begin CHARACTERISTIC DTqC_NEngSoftLimActvnThdOffs_P "Soft Limit Activation Threshold Offset" VALUE 0x40041D68 /* @ECU_Address@DTqC_NEngSoftLimActvnThdOffs_P@ */ Scalar_FLOAT32_IEEE 0 EcuIntgdSwGend_CM_single_rpm -3000.0 3000.0 /end CHARACTERISTIC
/begin CHARACTERISTIC DTqC_NEngSoftLimAcvThd_P "" VALUE 0x40041D6C /* @ECU_Address@DTqC_NEngSoftLimAcvThd_P@ */ Scalar_FLOAT32_IEEE 0 EcuIntgdSwGend_CM_single_rpm 0.0 3000.0 /end CHARACTERISTIC
/begin CHARACTERISTIC DTqC_NEngSoftLimDeacThdOffs_P "" VALUE 0x40041D70 /* @ECU_Address@DTqC_NEngSoftLimDeacThdOffs_P@ */ Scalar_FLOAT32_IEEE 0 EcuIntgdSwGend_CM_single_rpm 0.0 3000.0 /end CHARACTERISTIC
/begin CHARACTERISTIC DTqC_PtoCtrlNEngMaxSpdHys_P "High Speed Governor PTO Engine Max Engine Speed Hysteresis" VALUE 0x40041E68 /* @ECU_Address@DTqC_PtoCtrlNEngMaxSpdHys_P@ */ Scalar_FLOAT32_IEEE 0 EcuIntgdSwGend_CM_single_rpm 0.0 3000.0 /end CHARACTERISTIC
/begin CHARACTERISTIC DTqC_RateLoLimForPTOAccrOvrd_P "Rate Limiter Lower Limit for PTO Accelerator Override" VALUE 0x40041E6C /* @ECU_Address@DTqC_RateLoLimForPTOAccrOvrd_P@ */ Scalar_FLOAT32_IEEE 0 EcuIntgdSwGend_CM_single_N_m -10000.0 0.0 /end CHARACTERISTIC
/begin CHARACTERISTIC DTqC_RateUpLimForPTOAccrOvrd_P "Rate Limiter Upper Limit for PTO Accelerator Override" VALUE 0x40041E70 /* @ECU_Address@DTqC_RateUpLimForPTOAccrOvrd_P@ */ Scalar_FLOAT32_IEEE 0 EcuIntgdSwGend_CM_single_N_m 0.0 10000.0 /end CHARACTERISTIC
/begin CHARACTERISTIC DTqC_TiTrbChrgOilLeakgIdleRef_P "Time Threshold Parameter for Turbo Oil Leakage" VALUE 0x40042040 /* @ECU_Address@DTqC_TiTrbChrgOilLeakgIdleRef_P@ */ Scalar_FLOAT32_IEEE 0 EcuIntgdSwGend_CM_single_ms 0.0 1.0E+6 /end CHARACTERISTIC
/begin CHARACTERISTIC DTqC_TqDesSatPIDMin_P "Idle PID Controller Saturation Min Value" VALUE 0x40043330 /* @ECU_Address@DTqC_TqDesSatPIDMin_P@ */ Scalar_FLOAT32_IEEE 0 EcuIntgdSwGend_CM_single_N_m -1000.0 10000.0 /end CHARACTERISTIC
/begin CHARACTERISTIC DTqC_VehVAcvnTrbChrgOilLeakg_P "Turbo Charger Oil Leakage Activation Threshold According to Vehicle Speed" VALUE 0x40043FE8 /* @ECU_Address@DTqC_VehVAcvnTrbChrgOilLeakg_P@ */ Scalar_FLOAT32_IEEE 0 EcuIntgdSwGend_CM_single_km_h 0.0 200.0 /end CHARACTERISTIC
/begin CHARACTERISTIC EIP_CanEngReqTqHiReslOvv_P "Engine Requested Torque - High Resolution - Override Value" VALUE 0x40044074 /* @ECU_Address@EIP_CanEngReqTqHiReslOvv_P@ */ Scalar_FLOAT32_IEEE 0 EcuIntgdSwGend_CM_single__ 0.0 0.875 /end CHARACTERISTIC
/begin CHARACTERISTIC EIP_CanEngSpdReqOvv_P "Engine Requested Speed/Speed Limit - Override Value" VALUE 0x4004407C /* @ECU_Address@EIP_CanEngSpdReqOvv_P@ */ Scalar_FLOAT32_IEEE 0 EcuIntgdSwGend_CM_single_rpm 0.0 8100.0 /end CHARACTERISTIC
/begin CHARACTERISTIC EIP_CanEstimdPercFanSpdOvv_P "Estimated Percent Fan Speed - Override Value" VALUE 0x40044098 /* @ECU_Address@EIP_CanEstimdPercFanSpdOvv_P@ */ Scalar_FLOAT32_IEEE 0 EcuIntgdSwGend_CM_single__ 0.0 100.0 /end CHARACTERISTIC
/begin CHARACTERISTIC EIP_CanFuLvl1Ovv_P "Fuel Level 1 - Override Value" VALUE 0x400440A0 /* @ECU_Address@EIP_CanFuLvl1Ovv_P@ */ Scalar_FLOAT32_IEEE 0 EcuIntgdSwGend_CM_single__ 0.0 100.0 /end CHARACTERISTIC
/begin CHARACTERISTIC EIP_CanPercCluSlipOvv_P "Percent Clutch Slip - Override Value" VALUE 0x400440B0 /* @ECU_Address@EIP_CanPercCluSlipOvv_P@ */ Scalar_FLOAT32_IEEE 0 EcuIntgdSwGend_CM_single__ 0.0 100.0 /end CHARACTERISTIC
/begin CHARACTERISTIC EIP_CanReqdPercFanSpdOvv_P "Requested Percent Fan Speed - Override Value" VALUE 0x400440B8 /* @ECU_Address@EIP_CanReqdPercFanSpdOvv_P@ */ Scalar_FLOAT32_IEEE 0 EcuIntgdSwGend_CM_single__ 0.0 100.0 /end CHARACTERISTIC
/begin CHARACTERISTIC EIP_CanTrsmActGearRatOvv_P "Transmission Actual Gear Ratio - Override Value" VALUE 0x400440D4 /* @ECU_Address@EIP_CanTrsmActGearRatOvv_P@ */ Scalar_FLOAT32_IEEE 0 EcuIntgdSwGend_CM_single 0.0 64255.0 /end CHARACTERISTIC
/begin CHARACTERISTIC EIP_CanTrsmOutpShaftSpdOvv_P "Transmission Output Shaft Speed - Override Value" VALUE 0x400440F0 /* @ECU_Address@EIP_CanTrsmOutpShaftSpdOvv_P@ */ Scalar_FLOAT32_IEEE 0 EcuIntgdSwGend_CM_single_rpm 0.0 8100.0 /end CHARACTERISTIC
/begin CHARACTERISTIC EIP_CanTrsmTqCnvrRatOvv_P "Transmission Torque Converter Ratio - Override Value" VALUE 0x40044104 /* @ECU_Address@EIP_CanTrsmTqCnvrRatOvv_P@ */ Scalar_FLOAT32_IEEE 0 EcuIntgdSwGend_CM_single 0.0 64255.0 /end CHARACTERISTIC
/begin CHARACTERISTIC EIP_GearSpdCnvnFacForTrsm_P "Gear Speed Conversion Factor for Transmission" VALUE 0x40044194 /* @ECU_Address@EIP_GearSpdCnvnFacForTrsm_P@ */ Scalar_FLOAT32_IEEE 0 EcuIntgdSwGend_CM_single 0.0 1.0 /end CHARACTERISTIC
/begin CHARACTERISTIC EIP_GrdtLvlOil_P "Oil Level Gradient Parameter" VALUE 0x40044198 /* @ECU_Address@EIP_GrdtLvlOil_P@ */ Scalar_FLOAT32_IEEE 0 EcuIntgdSwGend_CM_single -10000.0 20000.0 /end CHARACTERISTIC
/begin CHARACTERISTIC EIP_GrdtPAirBoost_P "Air Boost Pressure Gradient Parameter" VALUE 0x4004419C /* @ECU_Address@EIP_GrdtPAirBoost_P@ */ Scalar_FLOAT32_IEEE 0 EcuIntgdSwGend_CM_single_mbar_sec -10000.0 20000.0 /end CHARACTERISTIC
/begin CHARACTERISTIC EIP_GrdtPAmbAir_P "Ambient Air Pressure Gradient Parameter" VALUE 0x400441A0 /* @ECU_Address@EIP_GrdtPAmbAir_P@ */ Scalar_FLOAT32_IEEE 0 EcuIntgdSwGend_CM_single_mbar_sec -10000.0 20000.0 /end CHARACTERISTIC
/begin CHARACTERISTIC EIP_GrdtPFu_P "Fuel Pressure Gradient Parameter" VALUE 0x400441A4 /* @ECU_Address@EIP_GrdtPFu_P@ */ Scalar_FLOAT32_IEEE 0 EcuIntgdSwGend_CM_single_mbar_sec -10000.0 20000.0 /end CHARACTERISTIC
/begin CHARACTERISTIC EIP_GrdtPOil_P "Oil Pressure Gradient Parameter" VALUE 0x400441A8 /* @ECU_Address@EIP_GrdtPOil_P@ */ Scalar_FLOAT32_IEEE 0 EcuIntgdSwGend_CM_single_mbar_sec -10000.0 20000.0 /end CHARACTERISTIC
/begin CHARACTERISTIC EIP_GrdtPRail_P "Rail Pressure Gradient Parameter" VALUE 0x400441AC /* @ECU_Address@EIP_GrdtPRail_P@ */ Scalar_FLOAT32_IEEE 0 EcuIntgdSwGend_CM_single_bar_sec -10000.0 20000.0 /end CHARACTERISTIC
/begin CHARACTERISTIC EIP_GrdtTAirBoost_P "Air Boost Temperature Gradient Parameter" VALUE 0x400441B0 /* @ECU_Address@EIP_GrdtTAirBoost_P@ */ Scalar_FLOAT32_IEEE 0 EcuIntgdSwGend_CM_single_degC_sec -10000.0 20000.0 /end CHARACTERISTIC
/begin CHARACTERISTIC EIP_GrdtTAmbAir_P "Ambient Air Temperature Gradient Parameter" VALUE 0x400441B4 /* @ECU_Address@EIP_GrdtTAmbAir_P@ */ Scalar_FLOAT32_IEEE 0 EcuIntgdSwGend_CM_single_degC_sec -10000.0 20000.0 /end CHARACTERISTIC
/begin CHARACTERISTIC EIP_GrdtTCoolt_P "Coolant Temperature Gradient Parameter" VALUE 0x400441B8 /* @ECU_Address@EIP_GrdtTCoolt_P@ */ Scalar_FLOAT32_IEEE 0 EcuIntgdSwGend_CM_single_degC_sec -10000.0 20000.0 /end CHARACTERISTIC
/begin CHARACTERISTIC EIP_GrdtTEcu_P "ECU Temperature Gradient Parameter" VALUE 0x400441BC /* @ECU_Address@EIP_GrdtTEcu_P@ */ Scalar_FLOAT32_IEEE 0 EcuIntgdSwGend_CM_single_degC_sec -10000.0 20000.0 /end CHARACTERISTIC
/begin CHARACTERISTIC EIP_GrdtTFu_P "Fuel Temperature Gradient Parameter" VALUE 0x400441C0 /* @ECU_Address@EIP_GrdtTFu_P@ */ Scalar_FLOAT32_IEEE 0 EcuIntgdSwGend_CM_single_degC_sec -10000.0 20000.0 /end CHARACTERISTIC
/begin CHARACTERISTIC EIP_GrdtTOil_P "Oil Temperature Gradient Parameter" VALUE 0x400441C4 /* @ECU_Address@EIP_GrdtTOil_P@ */ Scalar_FLOAT32_IEEE 0 EcuIntgdSwGend_CM_single_degC_sec -10000.0 20000.0 /end CHARACTERISTIC
/begin CHARACTERISTIC EIP_LvlOilMax_P "Max Oil Level Parameter" VALUE 0x400441E4 /* @ECU_Address@EIP_LvlOilMax_P@ */ Scalar_FLOAT32_IEEE 0 EcuIntgdSwGend_CM_single__ 0.0 100.0 /end CHARACTERISTIC
/begin CHARACTERISTIC EIP_LvlOilMin_P "Min Oil Level Parameter" VALUE 0x400441E8 /* @ECU_Address@EIP_LvlOilMin_P@ */ Scalar_FLOAT32_IEEE 0 EcuIntgdSwGend_CM_single__ 0.0 100.0 /end CHARACTERISTIC
/begin CHARACTERISTIC EIP_NEngEmgcyShtdwnForOvspd_P "Engine Speed Parameter for Emergency Shutdown for Overspeed" VALUE 0x40044244 /* @ECU_Address@EIP_NEngEmgcyShtdwnForOvspd_P@ */ Scalar_FLOAT32_IEEE 0 EcuIntgdSwGend_CM_single_rpm 0.0 5000.0 /end CHARACTERISTIC
/begin CHARACTERISTIC EIP_NrErrCylMisfRedn_P "Cylinder Misfire Error Count Number for Torque Reduction Parameter" VALUE 0x40044250 /* @ECU_Address@EIP_NrErrCylMisfRedn_P@ */ Scalar_FLOAT32_IEEE 0 EcuIntgdSwGend_CM_single 0.0 15.0 /end CHARACTERISTIC
/begin CHARACTERISTIC EIP_NrErrCylMisfShtdwn_P "Cylinder Misfire Error Count Number for Shutdown Parameter" VALUE 0x40044254 /* @ECU_Address@EIP_NrErrCylMisfShtdwn_P@ */ Scalar_FLOAT32_IEEE 0 EcuIntgdSwGend_CM_single 0.0 15.0 /end CHARACTERISTIC
/begin CHARACTERISTIC EIP_NrErrCylMisfWarn_P "Cylinder Misfire Error Count Number for Warning Parameter" VALUE 0x40044258 /* @ECU_Address@EIP_NrErrCylMisfWarn_P@ */ Scalar_FLOAT32_IEEE 0 EcuIntgdSwGend_CM_single 0.0 15.0 /end CHARACTERISTIC
/begin CHARACTERISTIC EIP_NrErrInjrShtdwn_P "Injection Error Count Number for Shutdown Parameter" VALUE 0x4004425C /* @ECU_Address@EIP_NrErrInjrShtdwn_P@ */ Scalar_FLOAT32_IEEE 0 EcuIntgdSwGend_CM_single 0.0 8.0 /end CHARACTERISTIC
/begin CHARACTERISTIC EIP_PAirBoostMax_P "Max Air Boost Pressure Parameter" VALUE 0x40044264 /* @ECU_Address@EIP_PAirBoostMax_P@ */ Scalar_FLOAT32_IEEE 0 EcuIntgdSwGend_CM_single_mbar 0.0 15000.0 /end CHARACTERISTIC
/begin CHARACTERISTIC EIP_PAirBoostMin_P "Min Air Boost Pressure Parameter" VALUE 0x40044268 /* @ECU_Address@EIP_PAirBoostMin_P@ */ Scalar_FLOAT32_IEEE 0 EcuIntgdSwGend_CM_single_mbar 0.0 15000.0 /end CHARACTERISTIC
/begin CHARACTERISTIC EIP_PAmbAirMax_P "Max Ambient Air Pressure Parameter" VALUE 0x40044278 /* @ECU_Address@EIP_PAmbAirMax_P@ */ Scalar_FLOAT32_IEEE 0 EcuIntgdSwGend_CM_single_mbar -1000.0 1600.0 /end CHARACTERISTIC
/begin CHARACTERISTIC EIP_PAmbAirMin_P "Min Ambient Air Pressure Parameter" VALUE 0x4004427C /* @ECU_Address@EIP_PAmbAirMin_P@ */ Scalar_FLOAT32_IEEE 0 EcuIntgdSwGend_CM_single_mbar -1000.0 1600.0 /end CHARACTERISTIC
/begin CHARACTERISTIC EIP_PFuMax_P "Max Fuel Pressure Parameter" VALUE 0x4004428C /* @ECU_Address@EIP_PFuMax_P@ */ Scalar_FLOAT32_IEEE 0 EcuIntgdSwGend_CM_single_mbar 0.0 15000.0 /end CHARACTERISTIC
/begin CHARACTERISTIC EIP_PFuMin_P "Min Fuel Pressure Parameter" VALUE 0x40044290 /* @ECU_Address@EIP_PFuMin_P@ */ Scalar_FLOAT32_IEEE 0 EcuIntgdSwGend_CM_single_mbar 0.0 15000.0 /end CHARACTERISTIC
/begin CHARACTERISTIC EIP_POilMax_P "Max Oil Pressure Parameter" VALUE 0x400442A0 /* @ECU_Address@EIP_POilMax_P@ */ Scalar_FLOAT32_IEEE 0 EcuIntgdSwGend_CM_single_mbar 0.0 15000.0 /end CHARACTERISTIC
/begin CHARACTERISTIC EIP_POilMin_P "Min Oil Pressure Parameter" VALUE 0x400442A4 /* @ECU_Address@EIP_POilMin_P@ */ Scalar_FLOAT32_IEEE 0 EcuIntgdSwGend_CM_single_mbar 0.0 15000.0 /end CHARACTERISTIC
/begin CHARACTERISTIC EIP_PRailMax_P "Max Rail Pressure Parameter" VALUE 0x400442B4 /* @ECU_Address@EIP_PRailMax_P@ */ Scalar_FLOAT32_IEEE 0 EcuIntgdSwGend_CM_single_bar 0.0 15000.0 /end CHARACTERISTIC
/begin CHARACTERISTIC EIP_PRailMin_P "Min Rail Pressure Parameter" VALUE 0x400442B8 /* @ECU_Address@EIP_PRailMin_P@ */ Scalar_FLOAT32_IEEE 0 EcuIntgdSwGend_CM_single_bar 0.0 15000.0 /end CHARACTERISTIC
/begin CHARACTERISTIC EIP_PercgAccr1Max_P "Max First Acelerator Pedal Percentage Parameter" VALUE 0x400442C4 /* @ECU_Address@EIP_PercgAccr1Max_P@ */ Scalar_FLOAT32_IEEE 0 EcuIntgdSwGend_CM_single__ 0.0 100.0 /end CHARACTERISTIC
/begin CHARACTERISTIC EIP_PercgAccr1Min_P "Min First Acelerator Pedal Percentage Parameter" VALUE 0x400442C8 /* @ECU_Address@EIP_PercgAccr1Min_P@ */ Scalar_FLOAT32_IEEE 0 EcuIntgdSwGend_CM_single__ 0.0 100.0 /end CHARACTERISTIC
/begin CHARACTERISTIC EIP_PercgAccr2Max_P "Max Second Acelerator Pedal Percentage Parameter" VALUE 0x400442D4 /* @ECU_Address@EIP_PercgAccr2Max_P@ */ Scalar_FLOAT32_IEEE 0 EcuIntgdSwGend_CM_single__ 0.0 100.0 /end CHARACTERISTIC
/begin CHARACTERISTIC EIP_PercgAccr2Min_P "Min Second Acelerator Pedal Percentage Parameter" VALUE 0x400442D8 /* @ECU_Address@EIP_PercgAccr2Min_P@ */ Scalar_FLOAT32_IEEE 0 EcuIntgdSwGend_CM_single__ 0.0 100.0 /end CHARACTERISTIC
/begin CHARACTERISTIC EIP_PercgAccrDiffThd_P "Acelerator Pedal Percentage Difference Threshold Parameter" VALUE 0x400442E4 /* @ECU_Address@EIP_PercgAccrDiffThd_P@ */ Scalar_FLOAT32_IEEE 0 EcuIntgdSwGend_CM_single__ 0.0 100.0 /end CHARACTERISTIC
/begin CHARACTERISTIC EIP_PercgAccrMaxHysThd_P "Acelerator Pedal Percentage Max Hysteresis Threshold Parameter" VALUE 0x400442F4 /* @ECU_Address@EIP_PercgAccrMaxHysThd_P@ */ Scalar_FLOAT32_IEEE 0 EcuIntgdSwGend_CM_single__ 0.0 100.0 /end CHARACTERISTIC
/begin CHARACTERISTIC EIP_PercgAccrMaxThd_P "Acelerator Pedal Percentage Max Threshold Parameter" VALUE 0x400442F8 /* @ECU_Address@EIP_PercgAccrMaxThd_P@ */ Scalar_FLOAT32_IEEE 0 EcuIntgdSwGend_CM_single__ 0.0 100.0 /end CHARACTERISTIC
/begin CHARACTERISTIC EIP_PercgAccrMax_P "Acelerator Pedal Percentage Max Parameter" VALUE 0x400442FC /* @ECU_Address@EIP_PercgAccrMax_P@ */ Scalar_FLOAT32_IEEE 0 EcuIntgdSwGend_CM_single__ 0.0 100.0 /end CHARACTERISTIC
/begin CHARACTERISTIC EIP_PercgAccrMinHysThd_P "Acelerator Pedal Percentage Min Hysteresis Threshold Parameter" VALUE 0x40044300 /* @ECU_Address@EIP_PercgAccrMinHysThd_P@ */ Scalar_FLOAT32_IEEE 0 EcuIntgdSwGend_CM_single__ 0.0 100.0 /end CHARACTERISTIC
/begin CHARACTERISTIC EIP_PercgAccrMinThd_P "Acelerator Pedal Percentage Min Threshold Parameter" VALUE 0x40044304 /* @ECU_Address@EIP_PercgAccrMinThd_P@ */ Scalar_FLOAT32_IEEE 0 EcuIntgdSwGend_CM_single__ 0.0 100.0 /end CHARACTERISTIC
/begin CHARACTERISTIC EIP_PercgAccrMin_P "Acelerator Pedal Percentage Min Parameter" VALUE 0x40044308 /* @ECU_Address@EIP_PercgAccrMin_P@ */ Scalar_FLOAT32_IEEE 0 EcuIntgdSwGend_CM_single__ 0.0 100.0 /end CHARACTERISTIC
/begin CHARACTERISTIC EIP_TAirBoostMax_P "Max Air Boost Temperature Parameter" VALUE 0x40044460 /* @ECU_Address@EIP_TAirBoostMax_P@ */ Scalar_FLOAT32_IEEE 0 EcuIntgdSwGend_CM_single_degC -50.0 250.0 /end CHARACTERISTIC
/begin CHARACTERISTIC EIP_TAirBoostMin_P "Min Air Boost Temperature Parameter" VALUE 0x40044464 /* @ECU_Address@EIP_TAirBoostMin_P@ */ Scalar_FLOAT32_IEEE 0 EcuIntgdSwGend_CM_single_degC -50.0 250.0 /end CHARACTERISTIC
/begin CHARACTERISTIC EIP_TAmbAirMax_P "Max Ambient Air Temperature Parameter" VALUE 0x40044474 /* @ECU_Address@EIP_TAmbAirMax_P@ */ Scalar_FLOAT32_IEEE 0 EcuIntgdSwGend_CM_single_degC -50.0 250.0 /end CHARACTERISTIC
/begin CHARACTERISTIC EIP_TAmbAirMin_P "Min Ambient Air Temperature Parameter" VALUE 0x40044478 /* @ECU_Address@EIP_TAmbAirMin_P@ */ Scalar_FLOAT32_IEEE 0 EcuIntgdSwGend_CM_single_degC -50.0 250.0 /end CHARACTERISTIC
/begin CHARACTERISTIC EIP_TCooltMax_P "Max Coolant Temperature Parameter" VALUE 0x400444B8 /* @ECU_Address@EIP_TCooltMax_P@ */ Scalar_FLOAT32_IEEE 0 EcuIntgdSwGend_CM_single_degC -50.0 250.0 /end CHARACTERISTIC
/begin CHARACTERISTIC EIP_TCooltMin_P "Min Coolant Temperature Parameter" VALUE 0x400444BC /* @ECU_Address@EIP_TCooltMin_P@ */ Scalar_FLOAT32_IEEE 0 EcuIntgdSwGend_CM_single_degC -50.0 250.0 /end CHARACTERISTIC
/begin CHARACTERISTIC EIP_TCooltTOilCohThd_P "Coolant Temperature Oil Temperature Cohenerence Threshold Parameter" VALUE 0x400444C8 /* @ECU_Address@EIP_TCooltTOilCohThd_P@ */ Scalar_FLOAT32_IEEE 0 EcuIntgdSwGend_CM_single_degC -50.0 1000.0 /end CHARACTERISTIC
/begin CHARACTERISTIC EIP_TEcuMax_P "Max Ecu Temperature Parameter" VALUE 0x40044500 /* @ECU_Address@EIP_TEcuMax_P@ */ Scalar_FLOAT32_IEEE 0 EcuIntgdSwGend_CM_single_degC -50.0 250.0 /end CHARACTERISTIC
/begin CHARACTERISTIC EIP_TEcuMin_P "Min Ecu Temperature Parameter" VALUE 0x40044504 /* @ECU_Address@EIP_TEcuMin_P@ */ Scalar_FLOAT32_IEEE 0 EcuIntgdSwGend_CM_single_degC -50.0 250.0 /end CHARACTERISTIC
/begin CHARACTERISTIC EIP_TFuMax_P "Max Fuel Temperature Parameter " VALUE 0x40044514 /* @ECU_Address@EIP_TFuMax_P@ */ Scalar_FLOAT32_IEEE 0 EcuIntgdSwGend_CM_single_degC -50.0 250.0 /end CHARACTERISTIC
/begin CHARACTERISTIC EIP_TFuMin_P "Min Fuel Temperature Parameter" VALUE 0x40044518 /* @ECU_Address@EIP_TFuMin_P@ */ Scalar_FLOAT32_IEEE 0 EcuIntgdSwGend_CM_single_degC -50.0 250.0 /end CHARACTERISTIC
/begin CHARACTERISTIC EIP_TOilMax_P "Max Oil Temperature Parameter" VALUE 0x40044558 /* @ECU_Address@EIP_TOilMax_P@ */ Scalar_FLOAT32_IEEE 0 EcuIntgdSwGend_CM_single_degC -50.0 250.0 /end CHARACTERISTIC
/begin CHARACTERISTIC EIP_TOilMin_P "Min Oil Temperature Parameter" VALUE 0x4004455C /* @ECU_Address@EIP_TOilMin_P@ */ Scalar_FLOAT32_IEEE 0 EcuIntgdSwGend_CM_single_degC -50.0 250.0 /end CHARACTERISTIC
/begin CHARACTERISTIC EIP_TcLvlOilFil_P "Low Pass Filter Time Constant for Oil Level" VALUE 0x400445A8 /* @ECU_Address@EIP_TcLvlOilFil_P@ */ Scalar_FLOAT32_IEEE 0 EcuIntgdSwGend_CM_single_ms 0.0 5000.0 /end CHARACTERISTIC
/begin CHARACTERISTIC EIP_TcPAirBoostFil_P "Low Pass Filter Time Constant for Air Boost Pressure" VALUE 0x400445CC /* @ECU_Address@EIP_TcPAirBoostFil_P@ */ Scalar_FLOAT32_IEEE 0 EcuIntgdSwGend_CM_single_ms 0.0 5000.0 /end CHARACTERISTIC
/begin CHARACTERISTIC EIP_TcPAmbAirFil_P "Low Pass Filter Time Constant for Ambient Air Pressure" VALUE 0x400445D0 /* @ECU_Address@EIP_TcPAmbAirFil_P@ */ Scalar_FLOAT32_IEEE 0 EcuIntgdSwGend_CM_single_ms 0.0 5000.0 /end CHARACTERISTIC
/begin CHARACTERISTIC EIP_TcPFuFil_P "Low Pass Filter Time Constant for Fuel Pressure" VALUE 0x400445D4 /* @ECU_Address@EIP_TcPFuFil_P@ */ Scalar_FLOAT32_IEEE 0 EcuIntgdSwGend_CM_single_ms 0.0 5000.0 /end CHARACTERISTIC
/begin CHARACTERISTIC EIP_TcPOilFil_P "Low Pass Filter Time Constant for Oil Ressure" VALUE 0x400445D8 /* @ECU_Address@EIP_TcPOilFil_P@ */ Scalar_FLOAT32_IEEE 0 EcuIntgdSwGend_CM_single_ms 0.0 5000.0 /end CHARACTERISTIC
/begin CHARACTERISTIC EIP_TcPRailFil_P "Low Pass Filter Time Constant for Rail Pressure" VALUE 0x400445DC /* @ECU_Address@EIP_TcPRailFil_P@ */ Scalar_FLOAT32_IEEE 0 EcuIntgdSwGend_CM_single_ms 0.0 5000.0 /end CHARACTERISTIC
/begin CHARACTERISTIC EIP_TcTAirBoostFil_P "Low Pass Filter Time Constant for Air Boost Temperature" VALUE 0x400445E0 /* @ECU_Address@EIP_TcTAirBoostFil_P@ */ Scalar_FLOAT32_IEEE 0 EcuIntgdSwGend_CM_single_ms 0.0 5000.0 /end CHARACTERISTIC
/begin CHARACTERISTIC EIP_TcTAmbAirFil_P "Low Pass Filter Time Constant for Ambient Air Temperature" VALUE 0x400445E4 /* @ECU_Address@EIP_TcTAmbAirFil_P@ */ Scalar_FLOAT32_IEEE 0 EcuIntgdSwGend_CM_single_ms 0.0 5000.0 /end CHARACTERISTIC
/begin CHARACTERISTIC EIP_TcTCooltFil_P "Low Pass Filter Time Constant for Coolant Temperature" VALUE 0x400445E8 /* @ECU_Address@EIP_TcTCooltFil_P@ */ Scalar_FLOAT32_IEEE 0 EcuIntgdSwGend_CM_single_ms 0.0 5000.0 /end CHARACTERISTIC
/begin CHARACTERISTIC EIP_TcTEcuFil_P "Low Pass Filter Time Constant for ECU Temperature" VALUE 0x400445EC /* @ECU_Address@EIP_TcTEcuFil_P@ */ Scalar_FLOAT32_IEEE 0 EcuIntgdSwGend_CM_single_ms 0.0 5000.0 /end CHARACTERISTIC
/begin CHARACTERISTIC EIP_TcTFuFil_P "Low Pass Filter Time Constant for Fuel Temperature" VALUE 0x400445F0 /* @ECU_Address@EIP_TcTFuFil_P@ */ Scalar_FLOAT32_IEEE 0 EcuIntgdSwGend_CM_single_ms 0.0 5000.0 /end CHARACTERISTIC
/begin CHARACTERISTIC EIP_TcTOilFil_P "Low Pass Filter Time Constant for Oil Temperature" VALUE 0x400445F4 /* @ECU_Address@EIP_TcTOilFil_P@ */ Scalar_FLOAT32_IEEE 0 EcuIntgdSwGend_CM_single_ms 0.0 5000.0 /end CHARACTERISTIC
/begin CHARACTERISTIC EIP_TiAcvEmgcyShtdwnForOvspdDeb_P "Debouncer Time for Emergency Shutdown for Overspeed Active Parameter" VALUE 0x400445FC /* @ECU_Address@EIP_TiAcvEmgcyShtdwnForOvspdDeb_P@ */ Scalar_FLOAT32_IEEE 0 EcuIntgdSwGend_CM_single_ms 0.0 250000.0 /end CHARACTERISTIC
/begin CHARACTERISTIC EIP_TiAcvErrCylMisfRednDeb_P "Debouncer Time for Error Cylinder Misfire Reduction Active Parameter" VALUE 0x40044600 /* @ECU_Address@EIP_TiAcvErrCylMisfRednDeb_P@ */ Scalar_FLOAT32_IEEE 0 EcuIntgdSwGend_CM_single_ms 0.0 250000.0 /end CHARACTERISTIC
/begin CHARACTERISTIC EIP_TiAcvErrCylMisfShtdwnDeb_P "Debouncer Time for Error Cylinder Misfire Shutdown Active Parameter" VALUE 0x40044604 /* @ECU_Address@EIP_TiAcvErrCylMisfShtdwnDeb_P@ */ Scalar_FLOAT32_IEEE 0 EcuIntgdSwGend_CM_single_ms 0.0 250000.0 /end CHARACTERISTIC
/begin CHARACTERISTIC EIP_TiAcvErrCylMisfWarnDeb_P "Debouncer Time for Error Cylinder Misfire Warning Active Parameter" VALUE 0x40044608 /* @ECU_Address@EIP_TiAcvErrCylMisfWarnDeb_P@ */ Scalar_FLOAT32_IEEE 0 EcuIntgdSwGend_CM_single_ms 0.0 250000.0 /end CHARACTERISTIC
/begin CHARACTERISTIC EIP_TiAcvErrInjrShtdwnDeb_P "Debouncer Time for Error Injection Shutdown Active Parameter" VALUE 0x4004460C /* @ECU_Address@EIP_TiAcvErrInjrShtdwnDeb_P@ */ Scalar_FLOAT32_IEEE 0 EcuIntgdSwGend_CM_single_ms 0.0 250000.0 /end CHARACTERISTIC
/begin CHARACTERISTIC EIP_TiDebAccrDervThd_P "Debouncer Time for Accelerator Derivation Threshold Parameter" VALUE 0x4004461C /* @ECU_Address@EIP_TiDebAccrDervThd_P@ */ Scalar_FLOAT32_IEEE 0 EcuIntgdSwGend_CM_single_ms 0.0 250000.0 /end CHARACTERISTIC
/begin CHARACTERISTIC EIP_TiIdleModDeb_P "Debouncer Time for Idle Mode Parameter" VALUE 0x40044630 /* @ECU_Address@EIP_TiIdleModDeb_P@ */ Scalar_FLOAT32_IEEE 0 EcuIntgdSwGend_CM_single_ms 0.0 5000.0 /end CHARACTERISTIC
/begin CHARACTERISTIC EIP_TiLvlOilSnsrDeb_P "Debouncer Time for Oil Level Sensor Parameter" VALUE 0x4004463C /* @ECU_Address@EIP_TiLvlOilSnsrDeb_P@ */ Scalar_FLOAT32_IEEE 0 EcuIntgdSwGend_CM_single_ms 0.0 250000.0 /end CHARACTERISTIC
/begin CHARACTERISTIC EIP_TiPAirBoostSnsrDeb_P "Debouncer Time for Air Boost Pressure Sensor Parameter" VALUE 0x40044640 /* @ECU_Address@EIP_TiPAirBoostSnsrDeb_P@ */ Scalar_FLOAT32_IEEE 0 EcuIntgdSwGend_CM_single_ms 0.0 250000.0 /end CHARACTERISTIC
/begin CHARACTERISTIC EIP_TiPAmbAirSnsrDeb_P "Debouncer Time for Ambient Air Pressure Sensor Parameter" VALUE 0x40044644 /* @ECU_Address@EIP_TiPAmbAirSnsrDeb_P@ */ Scalar_FLOAT32_IEEE 0 EcuIntgdSwGend_CM_single_ms 0.0 250000.0 /end CHARACTERISTIC
/begin CHARACTERISTIC EIP_TiPFuSnsrDeb_P "Debouncer Time for Fuel Pressure Sensor Parameter" VALUE 0x40044648 /* @ECU_Address@EIP_TiPFuSnsrDeb_P@ */ Scalar_FLOAT32_IEEE 0 EcuIntgdSwGend_CM_single_ms 0.0 250000.0 /end CHARACTERISTIC
/begin CHARACTERISTIC EIP_TiPOilSnsrDeb_P "Debouncer Time for Oil Pressure Sensor Parameter" VALUE 0x4004464C /* @ECU_Address@EIP_TiPOilSnsrDeb_P@ */ Scalar_FLOAT32_IEEE 0 EcuIntgdSwGend_CM_single_ms 0.0 250000.0 /end CHARACTERISTIC
/begin CHARACTERISTIC EIP_TiPRailSnsrDeb_P "Debouncer Time for Rail Pressure Sensor Parameter" VALUE 0x40044650 /* @ECU_Address@EIP_TiPRailSnsrDeb_P@ */ Scalar_FLOAT32_IEEE 0 EcuIntgdSwGend_CM_single_ms 0.0 250000.0 /end CHARACTERISTIC
/begin CHARACTERISTIC EIP_TiTAirBoostSnsrDeb_P "Debouncer Time for Air Boost Temperature Sensor Parameter" VALUE 0x4004465C /* @ECU_Address@EIP_TiTAirBoostSnsrDeb_P@ */ Scalar_FLOAT32_IEEE 0 EcuIntgdSwGend_CM_single_ms 0.0 250000.0 /end CHARACTERISTIC
/begin CHARACTERISTIC EIP_TiTAmbAirSnsrDeb_P "Debouncer Time for Ambient Air Temperature Sensor Parameter" VALUE 0x40044660 /* @ECU_Address@EIP_TiTAmbAirSnsrDeb_P@ */ Scalar_FLOAT32_IEEE 0 EcuIntgdSwGend_CM_single_ms 0.0 250000.0 /end CHARACTERISTIC
/begin CHARACTERISTIC EIP_TiTCooltSnsrDeb_P "Debouncer Time for Coolant Temperature Sensor Parameter" VALUE 0x40044664 /* @ECU_Address@EIP_TiTCooltSnsrDeb_P@ */ Scalar_FLOAT32_IEEE 0 EcuIntgdSwGend_CM_single_ms 0.0 250000.0 /end CHARACTERISTIC
/begin CHARACTERISTIC EIP_TiTEcuSnsrDeb_P "Debouncer Time for ECU Temperature Sensor Parameter" VALUE 0x40044668 /* @ECU_Address@EIP_TiTEcuSnsrDeb_P@ */ Scalar_FLOAT32_IEEE 0 EcuIntgdSwGend_CM_single_ms 0.0 250000.0 /end CHARACTERISTIC
/begin CHARACTERISTIC EIP_TiTFuSnsrDeb_P "Debouncer Time for Fuel Temperature Sensor Parameter" VALUE 0x4004466C /* @ECU_Address@EIP_TiTFuSnsrDeb_P@ */ Scalar_FLOAT32_IEEE 0 EcuIntgdSwGend_CM_single_ms 0.0 250000.0 /end CHARACTERISTIC
/begin CHARACTERISTIC EIP_TiTOilSnsrDeb_P "Debouncer Time for Oil Temperature Sensor Parameter" VALUE 0x40044670 /* @ECU_Address@EIP_TiTOilSnsrDeb_P@ */ Scalar_FLOAT32_IEEE 0 EcuIntgdSwGend_CM_single_ms 0.0 250000.0 /end CHARACTERISTIC
/begin CHARACTERISTIC EIP_TiVehVDevErrThd_P "Velocity Deviation Error Activation Timer Value" VALUE 0x4004467C /* @ECU_Address@EIP_TiVehVDevErrThd_P@ */ Scalar_FLOAT32_IEEE 0 EcuIntgdSwGend_CM_single_ms 0.0 50000.0 /end CHARACTERISTIC
/begin CHARACTERISTIC EOP_CanPAirBoostOvv_P "SPN 102 - Engine Intake Manifold 1 Pressure - Override Value" VALUE 0x40044AC0 /* @ECU_Address@EOP_CanPAirBoostOvv_P@ */ Scalar_FLOAT32_IEEE 0 EcuIntgdSwGend_CM_single_kPa 0.0 500.0 /end CHARACTERISTIC
/begin CHARACTERISTIC EOP_CanPBaroOvv_P "SPN 108 - Barometric Pressure - Override Value" VALUE 0x40044AC8 /* @ECU_Address@EOP_CanPBaroOvv_P@ */ Scalar_FLOAT32_IEEE 0 EcuIntgdSwGend_CM_single_kPa 0.0 125.0 /end CHARACTERISTIC
/begin CHARACTERISTIC EOP_CanPOilOvv_P "SPN 100 - Engine Oil Pressure - Override Value" VALUE 0x40044AD8 /* @ECU_Address@EOP_CanPOilOvv_P@ */ Scalar_FLOAT32_IEEE 0 EcuIntgdSwGend_CM_single_kPa 0.0 1000.0 /end CHARACTERISTIC
/begin CHARACTERISTIC EOP_CanTAirBoostOvv_P "SPN 105 - Engine Intake Manifold 1 Temperature - Override Value" VALUE 0x40044B18 /* @ECU_Address@EOP_CanTAirBoostOvv_P@ */ Scalar_FLOAT32_IEEE 0 EcuIntgdSwGend_CM_single_degC -40.0 210.0 /end CHARACTERISTIC
/begin CHARACTERISTIC EIP_CanEngTqReqOvv_P "Engine Requested Torque/Torque Limit - Override Value" VALUE 0x4004408A /* @ECU_Address@EIP_CanEngTqReqOvv_P@ */ Scalar_SWORD 0 EcuIntgdSwGend_CM_int16__ -125.0 125.0 /end CHARACTERISTIC
/begin CHARACTERISTIC EIP_CanTachographVehSpdOvv_P "Tachograph Vehicle Speed - Override Value" VALUE 0x400440C6 /* @ECU_Address@EIP_CanTachographVehSpdOvv_P@ */ Scalar_SWORD 0 EcuIntgdSwGend_CM_int16_km_h 0.0 251.0 /end CHARACTERISTIC
/begin CHARACTERISTIC EIP_CanTrsmCurrentGearOvv_P "Transmission Current Gear - Override Value" VALUE 0x400440DA /* @ECU_Address@EIP_CanTrsmCurrentGearOvv_P@ */ Scalar_SWORD 0 EcuIntgdSwGend_CM_int16 -125.0 251.0 /end CHARACTERISTIC
/begin CHARACTERISTIC EIP_CanTrsmSeldGearOvv_P "Transmission Selected Gear - Override Value" VALUE 0x400440F6 /* @ECU_Address@EIP_CanTrsmSeldGearOvv_P@ */ Scalar_SWORD 0 EcuIntgdSwGend_CM_int16 -125.0 251.0 /end CHARACTERISTIC
/begin CHARACTERISTIC EIP_CanWhlBasVehSpdOvv_P "Wheel Based Vehicle Speed - Override Value" VALUE 0x40044122 /* @ECU_Address@EIP_CanWhlBasVehSpdOvv_P@ */ Scalar_SWORD 0 EcuIntgdSwGend_CM_int16_km_h 0.0 251.0 /end CHARACTERISTIC
/begin CHARACTERISTIC EIP_VehVDevErrThd_P "Vehicle Speed Deviation To High Detection Threshold" VALUE 0x400446A2 /* @ECU_Address@EIP_VehVDevErrThd_P@ */ Scalar_SWORD 0 EcuIntgdSwGend_CM_int16_km_h 0.0 250.0 /end CHARACTERISTIC
/begin CHARACTERISTIC CrsCtrl_PIDCoeffDOvs_P "PID Derivative Coefficient for Cruise Control - Override Switch" VALUE 0x400405B8 /* @ECU_Address@CrsCtrl_PIDCoeffDOvs_P@ */ Scalar_BOOLEAN 0 EcuIntgdSwGend_CM_boolean 0.0 1.0 /end CHARACTERISTIC
/begin CHARACTERISTIC CrsCtrl_PIDCoeffFiltOvs_P "PID Filter Coefficient for Cruise Control - Override Switch" VALUE 0x400405C0 /* @ECU_Address@CrsCtrl_PIDCoeffFiltOvs_P@ */ Scalar_BOOLEAN 0 EcuIntgdSwGend_CM_boolean 0.0 1.0 /end CHARACTERISTIC
/begin CHARACTERISTIC CrsCtrl_PIDCoeffIOvs_P "PID Integrator Coefficient for Cruise Control - Override Switch" VALUE 0x400405C8 /* @ECU_Address@CrsCtrl_PIDCoeffIOvs_P@ */ Scalar_BOOLEAN 0 EcuIntgdSwGend_CM_boolean 0.0 1.0 /end CHARACTERISTIC
/begin CHARACTERISTIC CrsCtrl_PIDCoeffPOvs_P "PID Proportional Coefficient for Cruise Control - Override Switch" VALUE 0x400405D0 /* @ECU_Address@CrsCtrl_PIDCoeffPOvs_P@ */ Scalar_BOOLEAN 0 EcuIntgdSwGend_CM_boolean 0.0 1.0 /end CHARACTERISTIC
/begin CHARACTERISTIC DTqC_AccrPedlOvrdForCrsCtrl_P "Accelerator Pedal Override Parameter For Cruise Control" VALUE 0x40040708 /* @ECU_Address@DTqC_AccrPedlOvrdForCrsCtrl_P@ */ Scalar_BOOLEAN 0 EcuIntgdSwGend_CM_boolean 0.0 1.0 /end CHARACTERISTIC
/begin CHARACTERISTIC DTqC_AccrPedlOvrdForPto_P "Accelerator Pedal Override Parameter For Pto Control" VALUE 0x4004070C /* @ECU_Address@DTqC_AccrPedlOvrdForPto_P@ */ Scalar_BOOLEAN 0 EcuIntgdSwGend_CM_boolean 0.0 1.0 /end CHARACTERISTIC
/begin CHARACTERISTIC DTqC_CoeffFiltKdSpdCtlOvs_P "Filter Coefficient Parameter for Speed Controller - Override Switch" VALUE 0x40041080 /* @ECU_Address@DTqC_CoeffFiltKdSpdCtlOvs_P@ */ Scalar_BOOLEAN 0 EcuIntgdSwGend_CM_boolean 0.0 1.0 /end CHARACTERISTIC
/begin CHARACTERISTIC DTqC_KdSpdCtlOvs_P "Derivative Coefficient Parameter for Speed Controller - Override Switch" VALUE 0x40041C00 /* @ECU_Address@DTqC_KdSpdCtlOvs_P@ */ Scalar_BOOLEAN 0 EcuIntgdSwGend_CM_boolean 0.0 1.0 /end CHARACTERISTIC
/begin CHARACTERISTIC DTqC_KiSpdCtlOvs_P "Integrator Coefficient Parameter for Speed Controller - Override Switch" VALUE 0x40041C18 /* @ECU_Address@DTqC_KiSpdCtlOvs_P@ */ Scalar_BOOLEAN 0 EcuIntgdSwGend_CM_boolean 0.0 1.0 /end CHARACTERISTIC
/begin CHARACTERISTIC DTqC_KpSpdCtlOvs_P "Proportional Coefficient Parameter for Speed Controller - Override Switch" VALUE 0x40041C30 /* @ECU_Address@DTqC_KpSpdCtlOvs_P@ */ Scalar_BOOLEAN 0 EcuIntgdSwGend_CM_boolean 0.0 1.0 /end CHARACTERISTIC
/begin CHARACTERISTIC EIP_CanABSActvOvs_P "Anti-Lock Braking (ABS) Active - Override Switch" VALUE 0x40043FF8 /* @ECU_Address@EIP_CanABSActvOvs_P@ */ Scalar_BOOLEAN 0 EcuIntgdSwGend_CM_boolean 0.0 1.0 /end CHARACTERISTIC
/begin CHARACTERISTIC EIP_CanASRBrkCtrlActvOvs_P "ASR Brake Control Active - Override Switch" VALUE 0x40044000 /* @ECU_Address@EIP_CanASRBrkCtrlActvOvs_P@ */ Scalar_BOOLEAN 0 EcuIntgdSwGend_CM_boolean 0.0 1.0 /end CHARACTERISTIC
/begin CHARACTERISTIC EIP_CanASREngCtrlActvOvs_P "ASR Engine Control Active - Override Switch" VALUE 0x40044008 /* @ECU_Address@EIP_CanASREngCtrlActvOvs_P@ */ Scalar_BOOLEAN 0 EcuIntgdSwGend_CM_boolean 0.0 1.0 /end CHARACTERISTIC
/begin CHARACTERISTIC EIP_CanActMaxAvlRtdrOvs_P "Actual Maximum Available Retarder - Override Switch" VALUE 0x40044010 /* @ECU_Address@EIP_CanActMaxAvlRtdrOvs_P@ */ Scalar_BOOLEAN 0 EcuIntgdSwGend_CM_boolean 0.0 1.0 /end CHARACTERISTIC
/begin CHARACTERISTIC EIP_CanCrsCtrlEnaSwtOvs_P "Cruise Control Enable Switch Override Switch Parameter" VALUE 0x40044018 /* @ECU_Address@EIP_CanCrsCtrlEnaSwtOvs_P@ */ Scalar_BOOLEAN 0 EcuIntgdSwGend_CM_boolean 0.0 1.0 /end CHARACTERISTIC
/begin CHARACTERISTIC EIP_CanCrsCtrlResuSwtOvs_P "Cruise Control Resume Switch From CAN Override Switch Parameter" VALUE 0x40044020 /* @ECU_Address@EIP_CanCrsCtrlResuSwtOvs_P@ */ Scalar_BOOLEAN 0 EcuIntgdSwGend_CM_boolean 0.0 1.0 /end CHARACTERISTIC
/begin CHARACTERISTIC EIP_CanCrsCtrlSetSwtOvs_P "Cruise Control Set Switch From CAN Override Switch Parameter" VALUE 0x40044028 /* @ECU_Address@EIP_CanCrsCtrlSetSwtOvs_P@ */ Scalar_BOOLEAN 0 EcuIntgdSwGend_CM_boolean 0.0 1.0 /end CHARACTERISTIC
/begin CHARACTERISTIC EIP_CanEngAuxShtdwnSwtOvs_P "Engine Auxiliary Shutdown Switch - Override Switch" VALUE 0x40044030 /* @ECU_Address@EIP_CanEngAuxShtdwnSwtOvs_P@ */ Scalar_BOOLEAN 0 EcuIntgdSwGend_CM_boolean 0.0 1.0 /end CHARACTERISTIC
/begin CHARACTERISTIC EIP_CanEngOvrdCtrlModOvs_P "Engine Override Control Mode - Override Switch Parameter" VALUE 0x40044038 /* @ECU_Address@EIP_CanEngOvrdCtrlModOvs_P@ */ Scalar_BOOLEAN 0 EcuIntgdSwGend_CM_boolean 0.0 1.0 /end CHARACTERISTIC
/begin CHARACTERISTIC EIP_CanEngPtoGovrAccrSwtOvs_P "CAN Pto Governor - Accelerator Switch - Override Switch Parameter" VALUE 0x40044040 /* @ECU_Address@EIP_CanEngPtoGovrAccrSwtOvs_P@ */ Scalar_BOOLEAN 0 EcuIntgdSwGend_CM_boolean 0.0 1.0 /end CHARACTERISTIC
/begin CHARACTERISTIC EIP_CanEngPtoGovrCoastSwtOvs_P "CAN Pto Governor - Coast Switch - Override Switch Parameter" VALUE 0x40044048 /* @ECU_Address@EIP_CanEngPtoGovrCoastSwtOvs_P@ */ Scalar_BOOLEAN 0 EcuIntgdSwGend_CM_boolean 0.0 1.0 /end CHARACTERISTIC
/begin CHARACTERISTIC EIP_CanEngPtoGovrEnaSwtOvs_P "CAN Pto Governor - Enable Switch - Override Switch Parameter" VALUE 0x40044050 /* @ECU_Address@EIP_CanEngPtoGovrEnaSwtOvs_P@ */ Scalar_BOOLEAN 0 EcuIntgdSwGend_CM_boolean 0.0 1.0 /end CHARACTERISTIC
/begin CHARACTERISTIC EIP_CanEngPtoGovrResuSwtOvs_P "CAN Pto Governor - Resume Switch - Override Switch Parameter" VALUE 0x40044058 /* @ECU_Address@EIP_CanEngPtoGovrResuSwtOvs_P@ */ Scalar_BOOLEAN 0 EcuIntgdSwGend_CM_boolean 0.0 1.0 /end CHARACTERISTIC
/begin CHARACTERISTIC EIP_CanEngPtoGovrSetSwtOvs_P "CAN Pto Governor - Set Switch - Override Switch Parameter" VALUE 0x40044060 /* @ECU_Address@EIP_CanEngPtoGovrSetSwtOvs_P@ */ Scalar_BOOLEAN 0 EcuIntgdSwGend_CM_boolean 0.0 1.0 /end CHARACTERISTIC
/begin CHARACTERISTIC EIP_CanEngRemPtoGovrProgdSpdCtrlSwtOvs_P "CAN Pto Governor - Programmed Speed Control Switch - Override Switch Parameter" VALUE 0x40044068 /* @ECU_Address@EIP_CanEngRemPtoGovrProgdSpdCtrlSwtOvs_P@ */ Scalar_BOOLEAN 0 EcuIntgdSwGend_CM_boolean 0.0 1.0 /end CHARACTERISTIC
/begin CHARACTERISTIC EIP_CanEngReqTqHiReslOvs_P "Engine Requested Torque - High Resolution - Override Switch" VALUE 0x40044070 /* @ECU_Address@EIP_CanEngReqTqHiReslOvs_P@ */ Scalar_BOOLEAN 0 EcuIntgdSwGend_CM_boolean 0.0 1.0 /end CHARACTERISTIC
/begin CHARACTERISTIC EIP_CanEngSpdReqOvs_P "Engine Requested Speed/Speed Limit - Override Switch" VALUE 0x40044078 /* @ECU_Address@EIP_CanEngSpdReqOvs_P@ */ Scalar_BOOLEAN 0 EcuIntgdSwGend_CM_boolean 0.0 1.0 /end CHARACTERISTIC
/begin CHARACTERISTIC EIP_CanEngTqLimReqMaxCntnsOvs_P "Engine Torque Limit Request - Maximum Continuous - Override Switch" VALUE 0x40044080 /* @ECU_Address@EIP_CanEngTqLimReqMaxCntnsOvs_P@ */ Scalar_BOOLEAN 0 EcuIntgdSwGend_CM_boolean 0.0 1.0 /end CHARACTERISTIC
/begin CHARACTERISTIC EIP_CanEngTqReqOvs_P "Engine Requested Torque/Torque Limit - Override Switch" VALUE 0x40044088 /* @ECU_Address@EIP_CanEngTqReqOvs_P@ */ Scalar_BOOLEAN 0 EcuIntgdSwGend_CM_boolean 0.0 1.0 /end CHARACTERISTIC
/begin CHARACTERISTIC EIP_CanEstimdEngParasiticTqOvs_P "Estimated Engine Parasitic Losses - Override Switch" VALUE 0x4004408C /* @ECU_Address@EIP_CanEstimdEngParasiticTqOvs_P@ */ Scalar_BOOLEAN 0 EcuIntgdSwGend_CM_boolean 0.0 1.0 /end CHARACTERISTIC
/begin CHARACTERISTIC EIP_CanEstimdPercFanSpdOvs_P "Estimated Percent Fan Speed - Override Switch" VALUE 0x40044094 /* @ECU_Address@EIP_CanEstimdPercFanSpdOvs_P@ */ Scalar_BOOLEAN 0 EcuIntgdSwGend_CM_boolean 0.0 1.0 /end CHARACTERISTIC
/begin CHARACTERISTIC EIP_CanFuLvl1Ovs_P "Fuel Level 1 - Override Switch" VALUE 0x4004409C /* @ECU_Address@EIP_CanFuLvl1Ovs_P@ */ Scalar_BOOLEAN 0 EcuIntgdSwGend_CM_boolean 0.0 1.0 /end CHARACTERISTIC
/begin CHARACTERISTIC EIP_CanOvrdCtrlModPrioOvs_P "Override Control Mode Priority - Override Switch" VALUE 0x400440A4 /* @ECU_Address@EIP_CanOvrdCtrlModPrioOvs_P@ */ Scalar_BOOLEAN 0 EcuIntgdSwGend_CM_boolean 0.0 1.0 /end CHARACTERISTIC
/begin CHARACTERISTIC EIP_CanPercCluSlipOvs_P "Percent Clutch Slip - Override Switch" VALUE 0x400440AC /* @ECU_Address@EIP_CanPercCluSlipOvs_P@ */ Scalar_BOOLEAN 0 EcuIntgdSwGend_CM_boolean 0.0 1.0 /end CHARACTERISTIC
/begin CHARACTERISTIC EIP_CanReqdPercFanSpdOvs_P "Requested Percent Fan Speed - Override Switch" VALUE 0x400440B4 /* @ECU_Address@EIP_CanReqdPercFanSpdOvs_P@ */ Scalar_BOOLEAN 0 EcuIntgdSwGend_CM_boolean 0.0 1.0 /end CHARACTERISTIC
/begin CHARACTERISTIC EIP_CanTSC1MessageCntrOvs_P "TSC1 Message Counter - Override Switch" VALUE 0x400440BC /* @ECU_Address@EIP_CanTSC1MessageCntrOvs_P@ */ Scalar_BOOLEAN 0 EcuIntgdSwGend_CM_boolean 0.0 1.0 /end CHARACTERISTIC
/begin CHARACTERISTIC EIP_CanTachographVehSpdOvs_P "Tachograph Vehicle Speed - Override Switch" VALUE 0x400440C4 /* @ECU_Address@EIP_CanTachographVehSpdOvs_P@ */ Scalar_BOOLEAN 0 EcuIntgdSwGend_CM_boolean 0.0 1.0 /end CHARACTERISTIC
/begin CHARACTERISTIC EIP_CanTrfCaseStsOvs_P "Transfer case status - Override Switch" VALUE 0x400440C8 /* @ECU_Address@EIP_CanTrfCaseStsOvs_P@ */ Scalar_BOOLEAN 0 EcuIntgdSwGend_CM_boolean 0.0 1.0 /end CHARACTERISTIC
/begin CHARACTERISTIC EIP_CanTrsmActGearRatOvs_P "Transmission Actual Gear Ratio - Override Switch" VALUE 0x400440D0 /* @ECU_Address@EIP_CanTrsmActGearRatOvs_P@ */ Scalar_BOOLEAN 0 EcuIntgdSwGend_CM_boolean 0.0 1.0 /end CHARACTERISTIC
/begin CHARACTERISTIC EIP_CanTrsmCurrentGearOvs_P "Transmission Current Gear - Override Switch" VALUE 0x400440D8 /* @ECU_Address@EIP_CanTrsmCurrentGearOvs_P@ */ Scalar_BOOLEAN 0 EcuIntgdSwGend_CM_boolean 0.0 1.0 /end CHARACTERISTIC
/begin CHARACTERISTIC EIP_CanTrsmEngCrkEnaOvs_P "Transmission Engine Crank Enable - Override Switch" VALUE 0x400440DC /* @ECU_Address@EIP_CanTrsmEngCrkEnaOvs_P@ */ Scalar_BOOLEAN 0 EcuIntgdSwGend_CM_boolean 0.0 1.0 /end CHARACTERISTIC
/begin CHARACTERISTIC EIP_CanTrsmOilLvlReqOvs_P "Transmission Oil Level Request - Override Switch" VALUE 0x400440E4 /* @ECU_Address@EIP_CanTrsmOilLvlReqOvs_P@ */ Scalar_BOOLEAN 0 EcuIntgdSwGend_CM_boolean 0.0 1.0 /end CHARACTERISTIC
/begin CHARACTERISTIC EIP_CanTrsmOutpShaftSpdOvs_P "Transmission Output Shaft Speed - Override Switch" VALUE 0x400440EC /* @ECU_Address@EIP_CanTrsmOutpShaftSpdOvs_P@ */ Scalar_BOOLEAN 0 EcuIntgdSwGend_CM_boolean 0.0 1.0 /end CHARACTERISTIC
/begin CHARACTERISTIC EIP_CanTrsmSeldGearOvs_P "Transmission Selected Gear - Override Switch" VALUE 0x400440F4 /* @ECU_Address@EIP_CanTrsmSeldGearOvs_P@ */ Scalar_BOOLEAN 0 EcuIntgdSwGend_CM_boolean 0.0 1.0 /end CHARACTERISTIC
/begin CHARACTERISTIC EIP_CanTrsmTqCnvLockUpEngdOvs_P "Transmission Torque Converter Lockup Engaged - Override Switch" VALUE 0x400440F8 /* @ECU_Address@EIP_CanTrsmTqCnvLockUpEngdOvs_P@ */ Scalar_BOOLEAN 0 EcuIntgdSwGend_CM_boolean 0.0 1.0 /end CHARACTERISTIC
/begin CHARACTERISTIC EIP_CanTrsmTqCnvrRatOvs_P "Transmission Torque Converter Ratio - Override Switch" VALUE 0x40044100 /* @ECU_Address@EIP_CanTrsmTqCnvrRatOvs_P@ */ Scalar_BOOLEAN 0 EcuIntgdSwGend_CM_boolean 0.0 1.0 /end CHARACTERISTIC
/begin CHARACTERISTIC EIP_CanVehLimSpdGovrDecSwtOvs_P "Vehicle Limiting Speed Governor Increment Switch Override Switch Parameter" VALUE 0x40044108 /* @ECU_Address@EIP_CanVehLimSpdGovrDecSwtOvs_P@ */ Scalar_BOOLEAN 0 EcuIntgdSwGend_CM_boolean 0.0 1.0 /end CHARACTERISTIC
/begin CHARACTERISTIC EIP_CanVehLimSpdGovrEnaSwtOvs_P "Vehicle Limiting Speed Governor Enable Switch Override Switch Parameter" VALUE 0x40044110 /* @ECU_Address@EIP_CanVehLimSpdGovrEnaSwtOvs_P@ */ Scalar_BOOLEAN 0 EcuIntgdSwGend_CM_boolean 0.0 1.0 /end CHARACTERISTIC
/begin CHARACTERISTIC EIP_CanVehLimSpdGovrInctSwtOvs_P "Vehicle Limiting Speed Governor Decrement Switch Override Switch Parameter" VALUE 0x40044118 /* @ECU_Address@EIP_CanVehLimSpdGovrInctSwtOvs_P@ */ Scalar_BOOLEAN 0 EcuIntgdSwGend_CM_boolean 0.0 1.0 /end CHARACTERISTIC
/begin CHARACTERISTIC EIP_CanWhlBasVehSpdOvs_P "Wheel Based Vehicle Speed - Override Switch" VALUE 0x40044120 /* @ECU_Address@EIP_CanWhlBasVehSpdOvs_P@ */ Scalar_BOOLEAN 0 EcuIntgdSwGend_CM_boolean 0.0 1.0 /end CHARACTERISTIC
/begin CHARACTERISTIC EIP_EngBrkCfg_P "Engine Brake Configuration Parameter" VALUE 0x40044144 /* @ECU_Address@EIP_EngBrkCfg_P@ */ Scalar_BOOLEAN 0 EcuIntgdSwGend_CM_boolean 0.0 1.0 /end CHARACTERISTIC
/begin CHARACTERISTIC EIP_EngBrkLvlCfg_P "Engine Brake Level Configration Parameter" VALUE 0x40044148 /* @ECU_Address@EIP_EngBrkLvlCfg_P@ */ Scalar_BOOLEAN 0 EcuIntgdSwGend_CM_boolean 0.0 1.0 /end CHARACTERISTIC
/begin CHARACTERISTIC EIP_StOfCanABSActvOvs_P "Engine Input Processing State Of Anti-Lock Braking (ABS) Active Override Switch Parameter" VALUE 0x4004431C /* @ECU_Address@EIP_StOfCanABSActvOvs_P@ */ Scalar_BOOLEAN 0 EcuIntgdSwGend_CM_boolean 0.0 1.0 /end CHARACTERISTIC
/begin CHARACTERISTIC EIP_StOfCanABSActvOvv_P "Engine Input Processing State Of Anti-Lock Braking (ABS) Active Override Value Parameter" VALUE 0x40044320 /* @ECU_Address@EIP_StOfCanABSActvOvv_P@ */ Scalar_BOOLEAN 0 EcuIntgdSwGend_CM_boolean 0.0 1.0 /end CHARACTERISTIC
/begin CHARACTERISTIC EIP_StOfCanASRBrkCtrlActvOvs_P "State Of Can Acceleration Slip Regulation (ASR) Brake Control Active Override Switch Parameter" VALUE 0x40044324 /* @ECU_Address@EIP_StOfCanASRBrkCtrlActvOvs_P@ */ Scalar_BOOLEAN 0 EcuIntgdSwGend_CM_boolean 0.0 1.0 /end CHARACTERISTIC
/begin CHARACTERISTIC EIP_StOfCanASRBrkCtrlActvOvv_P "State Of Can Acceleration Slip Regulation (ASR) Brake Control Active Override Value Parameter" VALUE 0x40044328 /* @ECU_Address@EIP_StOfCanASRBrkCtrlActvOvv_P@ */ Scalar_BOOLEAN 0 EcuIntgdSwGend_CM_boolean 0.0 1.0 /end CHARACTERISTIC
/begin CHARACTERISTIC EIP_StOfCanASREngCtrlActvOvs_P "State Of Can Acceleration Slip Regulation (ASR) Engine Control Active Override Switch Parameter" VALUE 0x4004432C /* @ECU_Address@EIP_StOfCanASREngCtrlActvOvs_P@ */ Scalar_BOOLEAN 0 EcuIntgdSwGend_CM_boolean 0.0 1.0 /end CHARACTERISTIC
/begin CHARACTERISTIC EIP_StOfCanASREngCtrlActvOvv_P "State Of Can Acceleration Slip Regulation (ASR) Engine Control Active Override Value Parameter" VALUE 0x40044330 /* @ECU_Address@EIP_StOfCanASREngCtrlActvOvv_P@ */ Scalar_BOOLEAN 0 EcuIntgdSwGend_CM_boolean 0.0 1.0 /end CHARACTERISTIC
/begin CHARACTERISTIC EIP_StOfCanActMaxAvlRtdrOvs_P "State of Can Actual Maximum Available Retarder Override Switch Parameter" VALUE 0x40044334 /* @ECU_Address@EIP_StOfCanActMaxAvlRtdrOvs_P@ */ Scalar_BOOLEAN 0 EcuIntgdSwGend_CM_boolean 0.0 1.0 /end CHARACTERISTIC
/begin CHARACTERISTIC EIP_StOfCanActMaxAvlRtdrOvv_P "State of Can Actual Maximum Available Retarder Override Value Parameter" VALUE 0x40044338 /* @ECU_Address@EIP_StOfCanActMaxAvlRtdrOvv_P@ */ Scalar_BOOLEAN 0 EcuIntgdSwGend_CM_boolean 0.0 1.0 /end CHARACTERISTIC
/begin CHARACTERISTIC EIP_StOfCanCrsCtrlEnaSwtOvs_P "State Of Can Cruise Control Enable Switch Override Switch Parameter" VALUE 0x4004433C /* @ECU_Address@EIP_StOfCanCrsCtrlEnaSwtOvs_P@ */ Scalar_BOOLEAN 0 EcuIntgdSwGend_CM_boolean 0.0 1.0 /end CHARACTERISTIC
/begin CHARACTERISTIC EIP_StOfCanCrsCtrlEnaSwtOvv_P "State Of Can Cruise Control Enable Switch Override Value Parameter" VALUE 0x40044340 /* @ECU_Address@EIP_StOfCanCrsCtrlEnaSwtOvv_P@ */ Scalar_BOOLEAN 0 EcuIntgdSwGend_CM_boolean 0.0 1.0 /end CHARACTERISTIC
/begin CHARACTERISTIC EIP_StOfCanCrsCtrlResuSwtOvs_P "State Of Can Cruise Control Resume Switch Override Switch Parameter" VALUE 0x40044344 /* @ECU_Address@EIP_StOfCanCrsCtrlResuSwtOvs_P@ */ Scalar_BOOLEAN 0 EcuIntgdSwGend_CM_boolean 0.0 1.0 /end CHARACTERISTIC
/begin CHARACTERISTIC EIP_StOfCanCrsCtrlResuSwtOvv_P "State Of Can Cruise Control Resume Switch Override Value Parameter" VALUE 0x40044348 /* @ECU_Address@EIP_StOfCanCrsCtrlResuSwtOvv_P@ */ Scalar_BOOLEAN 0 EcuIntgdSwGend_CM_boolean 0.0 1.0 /end CHARACTERISTIC
/begin CHARACTERISTIC EIP_StOfCanCrsCtrlSetSwtOvs_P "State Of Can Cruise Control Set Switch Override Switch Parameter" VALUE 0x4004434C /* @ECU_Address@EIP_StOfCanCrsCtrlSetSwtOvs_P@ */ Scalar_BOOLEAN 0 EcuIntgdSwGend_CM_boolean 0.0 1.0 /end CHARACTERISTIC
/begin CHARACTERISTIC EIP_StOfCanCrsCtrlSetSwtOvv_P "State Of Can Cruise Control Set Switch Override Value Parameter" VALUE 0x40044350 /* @ECU_Address@EIP_StOfCanCrsCtrlSetSwtOvv_P@ */ Scalar_BOOLEAN 0 EcuIntgdSwGend_CM_boolean 0.0 1.0 /end CHARACTERISTIC
/begin CHARACTERISTIC EIP_StOfCanEngAuxShtdwnSwtOvs_P "State Of Can Engine Auxiliary Shutdown Switch Override Switch Parameter" VALUE 0x40044354 /* @ECU_Address@EIP_StOfCanEngAuxShtdwnSwtOvs_P@ */ Scalar_BOOLEAN 0 EcuIntgdSwGend_CM_boolean 0.0 1.0 /end CHARACTERISTIC
/begin CHARACTERISTIC EIP_StOfCanEngAuxShtdwnSwtOvv_P "State Of Can Engine Auxiliary Shutdown Switch Override Value Parameter" VALUE 0x40044358 /* @ECU_Address@EIP_StOfCanEngAuxShtdwnSwtOvv_P@ */ Scalar_BOOLEAN 0 EcuIntgdSwGend_CM_boolean 0.0 1.0 /end CHARACTERISTIC
/begin CHARACTERISTIC EIP_StOfCanEngOvrdCtrlModOvs_P "State Of Engine Override Control Mode - Override Switch" VALUE 0x4004435C /* @ECU_Address@EIP_StOfCanEngOvrdCtrlModOvs_P@ */ Scalar_BOOLEAN 0 EcuIntgdSwGend_CM_boolean 0.0 1.0 /end CHARACTERISTIC
/begin CHARACTERISTIC EIP_StOfCanEngOvrdCtrlModOvv_P "State Of Engine Override Control Mode - Override Value" VALUE 0x40044360 /* @ECU_Address@EIP_StOfCanEngOvrdCtrlModOvv_P@ */ Scalar_BOOLEAN 0 EcuIntgdSwGend_CM_boolean 0.0 1.0 /end CHARACTERISTIC
/begin CHARACTERISTIC EIP_StOfCanEngPtoGovrAccrSwtOvs_P "Engine Input Processing State Of Can Engine Pto Governor Accelerate Switch Override Switch Parameter" VALUE 0x40044364 /* @ECU_Address@EIP_StOfCanEngPtoGovrAccrSwtOvs_P@ */ Scalar_BOOLEAN 0 EcuIntgdSwGend_CM_boolean 0.0 1.0 /end CHARACTERISTIC
/begin CHARACTERISTIC EIP_StOfCanEngPtoGovrAccrSwtOvv_P "Engine Input Processing State Of Can Engine Pto Governor Accelerate Switch Override Value Parameter" VALUE 0x40044368 /* @ECU_Address@EIP_StOfCanEngPtoGovrAccrSwtOvv_P@ */ Scalar_BOOLEAN 0 EcuIntgdSwGend_CM_boolean 0.0 1.0 /end CHARACTERISTIC
/begin CHARACTERISTIC EIP_StOfCanEngPtoGovrCoastSwtOvs_P "Engine Input Processing State Of Can Engine Pto Governor Coast Switch Override Switch Parameter" VALUE 0x4004436C /* @ECU_Address@EIP_StOfCanEngPtoGovrCoastSwtOvs_P@ */ Scalar_BOOLEAN 0 EcuIntgdSwGend_CM_boolean 0.0 1.0 /end CHARACTERISTIC
/begin CHARACTERISTIC EIP_StOfCanEngPtoGovrCoastSwtOvv_P "Engine Input Processing State Of Can Engine Pto Governor Coast Switch Override Value Parameter" VALUE 0x40044370 /* @ECU_Address@EIP_StOfCanEngPtoGovrCoastSwtOvv_P@ */ Scalar_BOOLEAN 0 EcuIntgdSwGend_CM_boolean 0.0 1.0 /end CHARACTERISTIC
/begin CHARACTERISTIC EIP_StOfCanEngPtoGovrEnaSwtOvs_P "Engine Input Processing State Of Can Engine Pto Governor Enable Switch Override Switch Parameter" VALUE 0x40044374 /* @ECU_Address@EIP_StOfCanEngPtoGovrEnaSwtOvs_P@ */ Scalar_BOOLEAN 0 EcuIntgdSwGend_CM_boolean 0.0 1.0 /end CHARACTERISTIC
/begin CHARACTERISTIC EIP_StOfCanEngPtoGovrEnaSwtOvv_P "Engine Input Processing State Of Can Engine Pto Governor Enable Switch Override Value Parameter" VALUE 0x40044378 /* @ECU_Address@EIP_StOfCanEngPtoGovrEnaSwtOvv_P@ */ Scalar_BOOLEAN 0 EcuIntgdSwGend_CM_boolean 0.0 1.0 /end CHARACTERISTIC
/begin CHARACTERISTIC EIP_StOfCanEngPtoGovrResuSwtOvs_P "Engine Input Processing State Of Can Engine Pto Governor Resume Switch Override Switch Parameter" VALUE 0x4004437C /* @ECU_Address@EIP_StOfCanEngPtoGovrResuSwtOvs_P@ */ Scalar_BOOLEAN 0 EcuIntgdSwGend_CM_boolean 0.0 1.0 /end CHARACTERISTIC
/begin CHARACTERISTIC EIP_StOfCanEngPtoGovrResuSwtOvv_P "Engine Input Processing State Of Can Engine Pto Governor Resume Switch Override Value Parameter" VALUE 0x40044380 /* @ECU_Address@EIP_StOfCanEngPtoGovrResuSwtOvv_P@ */ Scalar_BOOLEAN 0 EcuIntgdSwGend_CM_boolean 0.0 1.0 /end CHARACTERISTIC
/begin CHARACTERISTIC EIP_StOfCanEngPtoGovrSetSwtOvs_P "Engine Input Processing State Of Can Engine Pto Governor Set Switch Override Switch Parameter" VALUE 0x40044384 /* @ECU_Address@EIP_StOfCanEngPtoGovrSetSwtOvs_P@ */ Scalar_BOOLEAN 0 EcuIntgdSwGend_CM_boolean 0.0 1.0 /end CHARACTERISTIC
/begin CHARACTERISTIC EIP_StOfCanEngPtoGovrSetSwtOvv_P "Engine Input Processing State Of Can Engine Pto Governor Set Switch Override Value Parameter" VALUE 0x40044388 /* @ECU_Address@EIP_StOfCanEngPtoGovrSetSwtOvv_P@ */ Scalar_BOOLEAN 0 EcuIntgdSwGend_CM_boolean 0.0 1.0 /end CHARACTERISTIC
/begin CHARACTERISTIC EIP_StOfCanEngRemPtoGovrSpdCtrlSwtOvs_P "Engine Input Processing State Of Can Engine Remote Pto Governor Speed Control Switch Override Switch Parameter" VALUE 0x4004438C /* @ECU_Address@EIP_StOfCanEngRemPtoGovrSpdCtrlSwtOvs_P@ */ Scalar_BOOLEAN 0 EcuIntgdSwGend_CM_boolean 0.0 1.0 /end CHARACTERISTIC
/begin CHARACTERISTIC EIP_StOfCanEngRemPtoGovrSpdCtrlSwtOvv_P "Engine Input Processing State Of Can Engine Remote Pto Governor Speed Control Switch Override Value Parameter" VALUE 0x40044390 /* @ECU_Address@EIP_StOfCanEngRemPtoGovrSpdCtrlSwtOvv_P@ */ Scalar_BOOLEAN 0 EcuIntgdSwGend_CM_boolean 0.0 1.0 /end CHARACTERISTIC
/begin CHARACTERISTIC EIP_StOfCanEngReqTqHiReslOvs_P "State Of Can Engine Request Torque High Resolution Override Switch Parameter" VALUE 0x40044394 /* @ECU_Address@EIP_StOfCanEngReqTqHiReslOvs_P@ */ Scalar_BOOLEAN 0 EcuIntgdSwGend_CM_boolean 0.0 1.0 /end CHARACTERISTIC
/begin CHARACTERISTIC EIP_StOfCanEngReqTqHiReslOvv_P "State Of Can Engine Request Torque High Resolution Override Value Parameter" VALUE 0x40044398 /* @ECU_Address@EIP_StOfCanEngReqTqHiReslOvv_P@ */ Scalar_BOOLEAN 0 EcuIntgdSwGend_CM_boolean 0.0 1.0 /end CHARACTERISTIC
/begin CHARACTERISTIC EIP_StOfCanEngSpdReqOvs_P "State Of Can Engine Speed Request Override Switch Parameter" VALUE 0x4004439C /* @ECU_Address@EIP_StOfCanEngSpdReqOvs_P@ */ Scalar_BOOLEAN 0 EcuIntgdSwGend_CM_boolean 0.0 1.0 /end CHARACTERISTIC
/begin CHARACTERISTIC EIP_StOfCanEngSpdReqOvv_P "State Of Can Engine Speed Request Override Value Parameter" VALUE 0x400443A0 /* @ECU_Address@EIP_StOfCanEngSpdReqOvv_P@ */ Scalar_BOOLEAN 0 EcuIntgdSwGend_CM_boolean 0.0 1.0 /end CHARACTERISTIC
/begin CHARACTERISTIC EIP_StOfCanEngTqLimReqMaxCntnsOvs_P "State Of Can Engine Torque Limit Request - Maximum Continuous Override Switch Parameter" VALUE 0x400443A4 /* @ECU_Address@EIP_StOfCanEngTqLimReqMaxCntnsOvs_P@ */ Scalar_BOOLEAN 0 EcuIntgdSwGend_CM_boolean 0.0 1.0 /end CHARACTERISTIC
/begin CHARACTERISTIC EIP_StOfCanEngTqLimReqMaxCntnsOvv_P "State Of Can Engine Torque Limit Request - Maximum Continuous Override Value Parameter" VALUE 0x400443A8 /* @ECU_Address@EIP_StOfCanEngTqLimReqMaxCntnsOvv_P@ */ Scalar_BOOLEAN 0 EcuIntgdSwGend_CM_boolean 0.0 1.0 /end CHARACTERISTIC
/begin CHARACTERISTIC EIP_StOfCanEngTqReqOvs_P "State Of Can Engine Torque Request Override Switch Parameter" VALUE 0x400443AC /* @ECU_Address@EIP_StOfCanEngTqReqOvs_P@ */ Scalar_BOOLEAN 0 EcuIntgdSwGend_CM_boolean 0.0 1.0 /end CHARACTERISTIC
/begin CHARACTERISTIC EIP_StOfCanEngTqReqOvv_P "State Of Can Engine Torque Request Override Value Parameter" VALUE 0x400443B0 /* @ECU_Address@EIP_StOfCanEngTqReqOvv_P@ */ Scalar_BOOLEAN 0 EcuIntgdSwGend_CM_boolean 0.0 1.0 /end CHARACTERISTIC
/begin CHARACTERISTIC EIP_StOfCanEstimdEngParasiticTqOvs_P "State Of Can Estimated Engine Parasitic Torque Override Switch Parameter" VALUE 0x400443B4 /* @ECU_Address@EIP_StOfCanEstimdEngParasiticTqOvs_P@ */ Scalar_BOOLEAN 0 EcuIntgdSwGend_CM_boolean 0.0 1.0 /end CHARACTERISTIC
/begin CHARACTERISTIC EIP_StOfCanEstimdEngParasiticTqOvv_P "State Of Can Estimated Engine Parasitic Torque Override Value Parameter" VALUE 0x400443B8 /* @ECU_Address@EIP_StOfCanEstimdEngParasiticTqOvv_P@ */ Scalar_BOOLEAN 0 EcuIntgdSwGend_CM_boolean 0.0 1.0 /end CHARACTERISTIC
/begin CHARACTERISTIC EIP_StOfCanEstimdPercFanSpdOvs_P "State Of Can Estimated Percent Fan Speed Override Switch Parameter" VALUE 0x400443BC /* @ECU_Address@EIP_StOfCanEstimdPercFanSpdOvs_P@ */ Scalar_BOOLEAN 0 EcuIntgdSwGend_CM_boolean 0.0 1.0 /end CHARACTERISTIC
/begin CHARACTERISTIC EIP_StOfCanEstimdPercFanSpdOvv_P "State Of Can Estimated Percent Fan Speed Override Value Parameter" VALUE 0x400443C0 /* @ECU_Address@EIP_StOfCanEstimdPercFanSpdOvv_P@ */ Scalar_BOOLEAN 0 EcuIntgdSwGend_CM_boolean 0.0 1.0 /end CHARACTERISTIC
/begin CHARACTERISTIC EIP_StOfCanFuLvl1Ovs_P "State Of Fuel Level 1 - Override Switch" VALUE 0x400443C4 /* @ECU_Address@EIP_StOfCanFuLvl1Ovs_P@ */ Scalar_BOOLEAN 0 EcuIntgdSwGend_CM_boolean 0.0 1.0 /end CHARACTERISTIC
/begin CHARACTERISTIC EIP_StOfCanFuLvl1Ovv_P "State Of Fuel Level 1 - Override Value" VALUE 0x400443C8 /* @ECU_Address@EIP_StOfCanFuLvl1Ovv_P@ */ Scalar_BOOLEAN 0 EcuIntgdSwGend_CM_boolean 0.0 1.0 /end CHARACTERISTIC
/begin CHARACTERISTIC EIP_StOfCanOvrdCtrlModPrioOvs_P "State Of Can Override Control Mode Priority Override Switch Parameter" VALUE 0x400443CC /* @ECU_Address@EIP_StOfCanOvrdCtrlModPrioOvs_P@ */ Scalar_BOOLEAN 0 EcuIntgdSwGend_CM_boolean 0.0 1.0 /end CHARACTERISTIC
/begin CHARACTERISTIC EIP_StOfCanOvrdCtrlModPrioOvv_P "State Of Can Override Control Mode Priority Override Value Parameter" VALUE 0x400443D0 /* @ECU_Address@EIP_StOfCanOvrdCtrlModPrioOvv_P@ */ Scalar_BOOLEAN 0 EcuIntgdSwGend_CM_boolean 0.0 1.0 /end CHARACTERISTIC
/begin CHARACTERISTIC EIP_StOfCanPercCluSlipOvs_P "State Of Can Percent Clutch Slip Override Switch Parameter" VALUE 0x400443D4 /* @ECU_Address@EIP_StOfCanPercCluSlipOvs_P@ */ Scalar_BOOLEAN 0 EcuIntgdSwGend_CM_boolean 0.0 1.0 /end CHARACTERISTIC
/begin CHARACTERISTIC EIP_StOfCanPercCluSlipOvv_P "State Of Can Percent Clutch Slip Override Value Parameter" VALUE 0x400443D8 /* @ECU_Address@EIP_StOfCanPercCluSlipOvv_P@ */ Scalar_BOOLEAN 0 EcuIntgdSwGend_CM_boolean 0.0 1.0 /end CHARACTERISTIC
/begin CHARACTERISTIC EIP_StOfCanReqdPercFanSpdOvs_P "State Of Can Requested Percent Fan Speed Override Switch Parameter" VALUE 0x400443DC /* @ECU_Address@EIP_StOfCanReqdPercFanSpdOvs_P@ */ Scalar_BOOLEAN 0 EcuIntgdSwGend_CM_boolean 0.0 1.0 /end CHARACTERISTIC
/begin CHARACTERISTIC EIP_StOfCanReqdPercFanSpdOvv_P "State Of Can Requested Percent Fan Speed Override Value Parameter" VALUE 0x400443E0 /* @ECU_Address@EIP_StOfCanReqdPercFanSpdOvv_P@ */ Scalar_BOOLEAN 0 EcuIntgdSwGend_CM_boolean 0.0 1.0 /end CHARACTERISTIC
/begin CHARACTERISTIC EIP_StOfCanTSC1MessageCntrOvs_P "State Of Can TSC1 Message Counter Override Switch Parameter" VALUE 0x400443E4 /* @ECU_Address@EIP_StOfCanTSC1MessageCntrOvs_P@ */ Scalar_BOOLEAN 0 EcuIntgdSwGend_CM_boolean 0.0 1.0 /end CHARACTERISTIC
/begin CHARACTERISTIC EIP_StOfCanTSC1MessageCntrOvv_P "State Of Can TSC1 Message Counter Override Value Parameter" VALUE 0x400443E8 /* @ECU_Address@EIP_StOfCanTSC1MessageCntrOvv_P@ */ Scalar_BOOLEAN 0 EcuIntgdSwGend_CM_boolean 0.0 1.0 /end CHARACTERISTIC
/begin CHARACTERISTIC EIP_StOfCanTachographVehSpdOvs_P "State of Tachograph Vehicle Speed - Override Switch" VALUE 0x400443EC /* @ECU_Address@EIP_StOfCanTachographVehSpdOvs_P@ */ Scalar_BOOLEAN 0 EcuIntgdSwGend_CM_boolean 0.0 1.0 /end CHARACTERISTIC
/begin CHARACTERISTIC EIP_StOfCanTachographVehSpdOvv_P "State of Tachograph Vehicle Speed - Override Value" VALUE 0x400443F0 /* @ECU_Address@EIP_StOfCanTachographVehSpdOvv_P@ */ Scalar_BOOLEAN 0 EcuIntgdSwGend_CM_boolean 0.0 1.0 /end CHARACTERISTIC
/begin CHARACTERISTIC EIP_StOfCanTrfCaseStsOvs_P "Ecu Input Processing State Of Can Transfer Case Status Override Switch Parameter" VALUE 0x400443F4 /* @ECU_Address@EIP_StOfCanTrfCaseStsOvs_P@ */ Scalar_BOOLEAN 0 EcuIntgdSwGend_CM_boolean 0.0 1.0 /end CHARACTERISTIC
/begin CHARACTERISTIC EIP_StOfCanTrfCaseStsOvv_P "Ecu Input Processing State Of Can Transfer Case Status Override Value Parameter" VALUE 0x400443F8 /* @ECU_Address@EIP_StOfCanTrfCaseStsOvv_P@ */ Scalar_BOOLEAN 0 EcuIntgdSwGend_CM_boolean 0.0 1.0 /end CHARACTERISTIC
/begin CHARACTERISTIC EIP_StOfCanTrsmActGearRatOvs_P "State Of Can Transmission Actual Gear Ratio Override Switch Parameter" VALUE 0x400443FC /* @ECU_Address@EIP_StOfCanTrsmActGearRatOvs_P@ */ Scalar_BOOLEAN 0 EcuIntgdSwGend_CM_boolean 0.0 1.0 /end CHARACTERISTIC
/begin CHARACTERISTIC EIP_StOfCanTrsmActGearRatOvv_P "State Of Can Transmission Actual Gear Ratio Override Value Parameter" VALUE 0x40044400 /* @ECU_Address@EIP_StOfCanTrsmActGearRatOvv_P@ */ Scalar_BOOLEAN 0 EcuIntgdSwGend_CM_boolean 0.0 1.0 /end CHARACTERISTIC
/begin CHARACTERISTIC EIP_StOfCanTrsmCurrentGearOvs_P "Engine Input Processing State Of Can Transmission Current Gear Override Switch Parameter" VALUE 0x40044404 /* @ECU_Address@EIP_StOfCanTrsmCurrentGearOvs_P@ */ Scalar_BOOLEAN 0 EcuIntgdSwGend_CM_boolean 0.0 1.0 /end CHARACTERISTIC
/begin CHARACTERISTIC EIP_StOfCanTrsmCurrentGearOvv_P "Engine Input Processing State Of Can Transmission Current Gear Override Value Parameter" VALUE 0x40044408 /* @ECU_Address@EIP_StOfCanTrsmCurrentGearOvv_P@ */ Scalar_BOOLEAN 0 EcuIntgdSwGend_CM_boolean 0.0 1.0 /end CHARACTERISTIC
/begin CHARACTERISTIC EIP_StOfCanTrsmEngCrkEnaOvs_P "Ecu Input Processing State Of Can Transmission Engine Crank Enable Override Switch Parameter" VALUE 0x4004440C /* @ECU_Address@EIP_StOfCanTrsmEngCrkEnaOvs_P@ */ Scalar_BOOLEAN 0 EcuIntgdSwGend_CM_boolean 0.0 1.0 /end CHARACTERISTIC
/begin CHARACTERISTIC EIP_StOfCanTrsmEngCrkEnaOvv_P "Ecu Input Processing State Of Can Transmission Engine Crank Enable Override Value Parameter" VALUE 0x40044410 /* @ECU_Address@EIP_StOfCanTrsmEngCrkEnaOvv_P@ */ Scalar_BOOLEAN 0 EcuIntgdSwGend_CM_boolean 0.0 1.0 /end CHARACTERISTIC
/begin CHARACTERISTIC EIP_StOfCanTrsmOilLvlReqOvs_P "State Of Can Transmission Oil Level Request Override Switch Parameter" VALUE 0x40044414 /* @ECU_Address@EIP_StOfCanTrsmOilLvlReqOvs_P@ */ Scalar_BOOLEAN 0 EcuIntgdSwGend_CM_boolean 0.0 1.0 /end CHARACTERISTIC
/begin CHARACTERISTIC EIP_StOfCanTrsmOilLvlReqOvv_P "State Of Can Transmission Oil Level Request Override Value Parameter" VALUE 0x40044418 /* @ECU_Address@EIP_StOfCanTrsmOilLvlReqOvv_P@ */ Scalar_BOOLEAN 0 EcuIntgdSwGend_CM_boolean 0.0 1.0 /end CHARACTERISTIC
/begin CHARACTERISTIC EIP_StOfCanTrsmOutpShaftSpdOvs_P "State of Transmission Outputshaft Speed - Override Switch Parameter" VALUE 0x4004441C /* @ECU_Address@EIP_StOfCanTrsmOutpShaftSpdOvs_P@ */ Scalar_BOOLEAN 0 EcuIntgdSwGend_CM_boolean 0.0 1.0 /end CHARACTERISTIC
/begin CHARACTERISTIC EIP_StOfCanTrsmOutpShaftSpdOvv_P "State of Transmission Outputshaft Speed - Override Value Parameter" VALUE 0x40044420 /* @ECU_Address@EIP_StOfCanTrsmOutpShaftSpdOvv_P@ */ Scalar_BOOLEAN 0 EcuIntgdSwGend_CM_boolean 0.0 1.0 /end CHARACTERISTIC
/begin CHARACTERISTIC EIP_StOfCanTrsmSeldGearOvs_P "State Of Can Transmission Selected Gear Override Switch Parameter" VALUE 0x40044424 /* @ECU_Address@EIP_StOfCanTrsmSeldGearOvs_P@ */ Scalar_BOOLEAN 0 EcuIntgdSwGend_CM_boolean 0.0 1.0 /end CHARACTERISTIC
/begin CHARACTERISTIC EIP_StOfCanTrsmSeldGearOvv_P "State Of Can Transmission Selected Gear Override Value Parameter" VALUE 0x40044428 /* @ECU_Address@EIP_StOfCanTrsmSeldGearOvv_P@ */ Scalar_BOOLEAN 0 EcuIntgdSwGend_CM_boolean 0.0 1.0 /end CHARACTERISTIC
/begin CHARACTERISTIC EIP_StOfCanTrsmTqCnvLockUpEngdOvs_P "Engine Input Processing State Of Can Transmission Torque Convertor Lock Up Engaged Override Switch Parameter" VALUE 0x4004442C /* @ECU_Address@EIP_StOfCanTrsmTqCnvLockUpEngdOvs_P@ */ Scalar_BOOLEAN 0 EcuIntgdSwGend_CM_boolean 0.0 1.0 /end CHARACTERISTIC
/begin CHARACTERISTIC EIP_StOfCanTrsmTqCnvLockUpEngdOvv_P "Engine Input Processing State Of Can Transmission Torque Convertor Lock Up Engaged Override Value Parameter" VALUE 0x40044430 /* @ECU_Address@EIP_StOfCanTrsmTqCnvLockUpEngdOvv_P@ */ Scalar_BOOLEAN 0 EcuIntgdSwGend_CM_boolean 0.0 1.0 /end CHARACTERISTIC
/begin CHARACTERISTIC EIP_StOfCanTrsmTqCnvrRatOvs_P "Ecu Input Processing State Of Can Transmission Torque Converter Ratio Override Switch Parameter" VALUE 0x40044434 /* @ECU_Address@EIP_StOfCanTrsmTqCnvrRatOvs_P@ */ Scalar_BOOLEAN 0 EcuIntgdSwGend_CM_boolean 0.0 1.0 /end CHARACTERISTIC
/begin CHARACTERISTIC EIP_StOfCanTrsmTqCnvrRatOvv_P "Ecu Input Processing State Of Can Transmission Torque Converter Ratio Override Value Parameter" VALUE 0x40044438 /* @ECU_Address@EIP_StOfCanTrsmTqCnvrRatOvv_P@ */ Scalar_BOOLEAN 0 EcuIntgdSwGend_CM_boolean 0.0 1.0 /end CHARACTERISTIC
/begin CHARACTERISTIC EIP_StOfCanVehLimSpdGovrDecSwtOvs_P "State of Can Vehicle Limiting Speed Governor Decrement Swich Override Switch Parameter" VALUE 0x4004443C /* @ECU_Address@EIP_StOfCanVehLimSpdGovrDecSwtOvs_P@ */ Scalar_BOOLEAN 0 EcuIntgdSwGend_CM_boolean 0.0 1.0 /end CHARACTERISTIC
/begin CHARACTERISTIC EIP_StOfCanVehLimSpdGovrDecSwtOvv_P "State of Can Vehicle Limiting Speed Governor Decrement Swich Override Value Parameter" VALUE 0x40044440 /* @ECU_Address@EIP_StOfCanVehLimSpdGovrDecSwtOvv_P@ */ Scalar_BOOLEAN 0 EcuIntgdSwGend_CM_boolean 0.0 1.0 /end CHARACTERISTIC
/begin CHARACTERISTIC EIP_StOfCanVehLimSpdGovrEnaSwtOvs_P "State of Vehicle Limiting Speed Governor Enable Switch Override Switch Parameter" VALUE 0x40044444 /* @ECU_Address@EIP_StOfCanVehLimSpdGovrEnaSwtOvs_P@ */ Scalar_BOOLEAN 0 EcuIntgdSwGend_CM_boolean 0.0 1.0 /end CHARACTERISTIC
/begin CHARACTERISTIC EIP_StOfCanVehLimSpdGovrEnaSwtOvv_P "State of Vehicle Limiting Speed Governor Enable Switch Override Value Parameter" VALUE 0x40044448 /* @ECU_Address@EIP_StOfCanVehLimSpdGovrEnaSwtOvv_P@ */ Scalar_BOOLEAN 0 EcuIntgdSwGend_CM_boolean 0.0 1.0 /end CHARACTERISTIC
/begin CHARACTERISTIC EIP_StOfCanVehLimSpdGovrInctSwtOvs_P "State of Can Vehicle Limiting Speed Governor Increment Switch Override Switch Parameter" VALUE 0x4004444C /* @ECU_Address@EIP_StOfCanVehLimSpdGovrInctSwtOvs_P@ */ Scalar_BOOLEAN 0 EcuIntgdSwGend_CM_boolean 0.0 1.0 /end CHARACTERISTIC
/begin CHARACTERISTIC EIP_StOfCanVehLimSpdGovrInctSwtOvv_P "State of Can Vehicle Limiting Speed Governor Increment Switch Override Value Parameter" VALUE 0x40044450 /* @ECU_Address@EIP_StOfCanVehLimSpdGovrInctSwtOvv_P@ */ Scalar_BOOLEAN 0 EcuIntgdSwGend_CM_boolean 0.0 1.0 /end CHARACTERISTIC
/begin CHARACTERISTIC EIP_StOfCanWhlBasVehSpdOvs_P "State of Wheel Based Vehicle Speed - Override Switch Parameter" VALUE 0x40044454 /* @ECU_Address@EIP_StOfCanWhlBasVehSpdOvs_P@ */ Scalar_BOOLEAN 0 EcuIntgdSwGend_CM_boolean 0.0 1.0 /end CHARACTERISTIC
/begin CHARACTERISTIC EIP_StOfCanWhlBasVehSpdOvv_P "State of Wheel Based Vehicle Speed - Override Value Parameter" VALUE 0x40044458 /* @ECU_Address@EIP_StOfCanWhlBasVehSpdOvv_P@ */ Scalar_BOOLEAN 0 EcuIntgdSwGend_CM_boolean 0.0 1.0 /end CHARACTERISTIC
/begin CHARACTERISTIC EIP_WgCfg_P "Wastegate Configuration Parameter" VALUE 0x400446AC /* @ECU_Address@EIP_WgCfg_P@ */ Scalar_BOOLEAN 0 EcuIntgdSwGend_CM_boolean 0.0 1.0 /end CHARACTERISTIC
/begin CHARACTERISTIC EIP_bAcvCylBalnOvs_P "Cylinder Balance Active - Override Switch Parameter" VALUE 0x400446B8 /* @ECU_Address@EIP_bAcvCylBalnOvs_P@ */ Scalar_BOOLEAN 0 EcuIntgdSwGend_CM_boolean 0.0 1.0 /end CHARACTERISTIC
/begin CHARACTERISTIC EIP_bAcvCylBalnOvv_P "Cylinder Balance Active - Override Value Parameter" VALUE 0x400446BC /* @ECU_Address@EIP_bAcvCylBalnOvv_P@ */ Scalar_BOOLEAN 0 EcuIntgdSwGend_CM_boolean 0.0 1.0 /end CHARACTERISTIC
/begin CHARACTERISTIC EIP_bAcvEmgcyShtdwnForOvspdOvs_P "Emergency Shutdown for Overspeed Active  - Override Switch Parameter" VALUE 0x400446C0 /* @ECU_Address@EIP_bAcvEmgcyShtdwnForOvspdOvs_P@ */ Scalar_BOOLEAN 0 EcuIntgdSwGend_CM_boolean 0.0 1.0 /end CHARACTERISTIC
/begin CHARACTERISTIC EIP_bAcvEmgcyShtdwnForOvspdOvv_P "Emergency Shutdown for Overspeed Active - Override Value Parameter" VALUE 0x400446C4 /* @ECU_Address@EIP_bAcvEmgcyShtdwnForOvspdOvv_P@ */ Scalar_BOOLEAN 0 EcuIntgdSwGend_CM_boolean 0.0 1.0 /end CHARACTERISTIC
/begin CHARACTERISTIC EIP_bAcvErrCylMisfRednOvs_P "Error Cylinder Misfire Reduction Active - Override Switch Parameter" VALUE 0x400446C8 /* @ECU_Address@EIP_bAcvErrCylMisfRednOvs_P@ */ Scalar_BOOLEAN 0 EcuIntgdSwGend_CM_boolean 0.0 1.0 /end CHARACTERISTIC
/begin CHARACTERISTIC EIP_bAcvErrCylMisfRednOvv_P "Error Cylinder Misfire Reduction Active - Override Value Parameter" VALUE 0x400446CC /* @ECU_Address@EIP_bAcvErrCylMisfRednOvv_P@ */ Scalar_BOOLEAN 0 EcuIntgdSwGend_CM_boolean 0.0 1.0 /end CHARACTERISTIC
/begin CHARACTERISTIC EIP_bAcvErrCylMisfShtdwnOvs_P "Error Cylinder Misfire Shutdown Active - Override Switch Parameter" VALUE 0x400446D0 /* @ECU_Address@EIP_bAcvErrCylMisfShtdwnOvs_P@ */ Scalar_BOOLEAN 0 EcuIntgdSwGend_CM_boolean 0.0 1.0 /end CHARACTERISTIC
/begin CHARACTERISTIC EIP_bAcvErrCylMisfShtdwnOvv_P "Error Cylinder Misfire Shutdown Active - Override Value Parameter" VALUE 0x400446D4 /* @ECU_Address@EIP_bAcvErrCylMisfShtdwnOvv_P@ */ Scalar_BOOLEAN 0 EcuIntgdSwGend_CM_boolean 0.0 1.0 /end CHARACTERISTIC
/begin CHARACTERISTIC EIP_bAcvErrCylMisfWarnOvs_P "Error Cylinder Misfire Warning Active - Override Switch Parameter" VALUE 0x400446D8 /* @ECU_Address@EIP_bAcvErrCylMisfWarnOvs_P@ */ Scalar_BOOLEAN 0 EcuIntgdSwGend_CM_boolean 0.0 1.0 /end CHARACTERISTIC
/begin CHARACTERISTIC EIP_bAcvErrCylMisfWarnOvv_P "Error Cylinder Misfire Warning Active - Override Value Parameter" VALUE 0x400446DC /* @ECU_Address@EIP_bAcvErrCylMisfWarnOvv_P@ */ Scalar_BOOLEAN 0 EcuIntgdSwGend_CM_boolean 0.0 1.0 /end CHARACTERISTIC
/begin CHARACTERISTIC EIP_bAcvErrInjrShtdwnOvs_P "Error Injection Shutdown Active - Override Switch Parameter" VALUE 0x400446E0 /* @ECU_Address@EIP_bAcvErrInjrShtdwnOvs_P@ */ Scalar_BOOLEAN 0 EcuIntgdSwGend_CM_boolean 0.0 1.0 /end CHARACTERISTIC
/begin CHARACTERISTIC EIP_bAcvErrInjrShtdwnOvv_P "Error Injection Shutdown Active - Override Value Parameter" VALUE 0x400446E4 /* @ECU_Address@EIP_bAcvErrInjrShtdwnOvv_P@ */ Scalar_BOOLEAN 0 EcuIntgdSwGend_CM_boolean 0.0 1.0 /end CHARACTERISTIC
/begin CHARACTERISTIC EIP_bErrAccr1And2OorOvs_P "Error Accelerator 1 and 2 Out of Range Total Loss - Override Switch Parameter" VALUE 0x40044730 /* @ECU_Address@EIP_bErrAccr1And2OorOvs_P@ */ Scalar_BOOLEAN 0 EcuIntgdSwGend_CM_boolean 0.0 1.0 /end CHARACTERISTIC
/begin CHARACTERISTIC EIP_bErrAccr1And2OorOvv_P "Error Accelerator 1 and 2 Out of Range Total Loss - Override Value Parameter" VALUE 0x40044734 /* @ECU_Address@EIP_bErrAccr1And2OorOvv_P@ */ Scalar_BOOLEAN 0 EcuIntgdSwGend_CM_boolean 0.0 1.0 /end CHARACTERISTIC
/begin CHARACTERISTIC EIP_bErrAccrRedncyOvs_P "Error Accelerator Redundancy - Override Switch Parameter" VALUE 0x40044738 /* @ECU_Address@EIP_bErrAccrRedncyOvs_P@ */ Scalar_BOOLEAN 0 EcuIntgdSwGend_CM_boolean 0.0 1.0 /end CHARACTERISTIC
/begin CHARACTERISTIC EIP_bErrAccrRedncyOvv_P "Error Accelerator Redundancy - Override Value Parameter" VALUE 0x4004473C /* @ECU_Address@EIP_bErrAccrRedncyOvv_P@ */ Scalar_BOOLEAN 0 EcuIntgdSwGend_CM_boolean 0.0 1.0 /end CHARACTERISTIC
/begin CHARACTERISTIC EIP_bErrLvlOilSnsrOvs_P "Error Oil Level Sensor - Override Switch Parameter" VALUE 0x400447F8 /* @ECU_Address@EIP_bErrLvlOilSnsrOvs_P@ */ Scalar_BOOLEAN 0 EcuIntgdSwGend_CM_boolean 0.0 1.0 /end CHARACTERISTIC
/begin CHARACTERISTIC EIP_bErrLvlOilSnsrOvv_P "Error Oil Level Sensor - Override Value Parameter" VALUE 0x400447FC /* @ECU_Address@EIP_bErrLvlOilSnsrOvv_P@ */ Scalar_BOOLEAN 0 EcuIntgdSwGend_CM_boolean 0.0 1.0 /end CHARACTERISTIC
/begin CHARACTERISTIC EIP_bErrPAirBoostSnsrOvs_P "Error Air Boost Pressure Sensor - Override Switch Parameter" VALUE 0x40044800 /* @ECU_Address@EIP_bErrPAirBoostSnsrOvs_P@ */ Scalar_BOOLEAN 0 EcuIntgdSwGend_CM_boolean 0.0 1.0 /end CHARACTERISTIC
/begin CHARACTERISTIC EIP_bErrPAirBoostSnsrOvv_P "Error Air Boost Pressure Sensor - Override Value Parameter" VALUE 0x40044804 /* @ECU_Address@EIP_bErrPAirBoostSnsrOvv_P@ */ Scalar_BOOLEAN 0 EcuIntgdSwGend_CM_boolean 0.0 1.0 /end CHARACTERISTIC
/begin CHARACTERISTIC EIP_bErrPAmbAirSnsrOvs_P "Error Ambient Air Pressure Sensor - Override Switch Parameter" VALUE 0x40044808 /* @ECU_Address@EIP_bErrPAmbAirSnsrOvs_P@ */ Scalar_BOOLEAN 0 EcuIntgdSwGend_CM_boolean 0.0 1.0 /end CHARACTERISTIC
/begin CHARACTERISTIC EIP_bErrPAmbAirSnsrOvv_P "Error Ambient Air Pressure Sensor - Override Value Parameter" VALUE 0x4004480C /* @ECU_Address@EIP_bErrPAmbAirSnsrOvv_P@ */ Scalar_BOOLEAN 0 EcuIntgdSwGend_CM_boolean 0.0 1.0 /end CHARACTERISTIC
/begin CHARACTERISTIC EIP_bErrPFuSnsrOvs_P "Error Fuel Pressure Sensor - Override Switch Parameter" VALUE 0x40044818 /* @ECU_Address@EIP_bErrPFuSnsrOvs_P@ */ Scalar_BOOLEAN 0 EcuIntgdSwGend_CM_boolean 0.0 1.0 /end CHARACTERISTIC
/begin CHARACTERISTIC EIP_bErrPFuSnsrOvv_P "Error Fuel Pressure Sensor - Override Value Parameter" VALUE 0x4004481C /* @ECU_Address@EIP_bErrPFuSnsrOvv_P@ */ Scalar_BOOLEAN 0 EcuIntgdSwGend_CM_boolean 0.0 1.0 /end CHARACTERISTIC
/begin CHARACTERISTIC EIP_bErrPOilSnsrOvs_P "Error Oil Pressure Sensor - Override Switch Parameter" VALUE 0x40044820 /* @ECU_Address@EIP_bErrPOilSnsrOvs_P@ */ Scalar_BOOLEAN 0 EcuIntgdSwGend_CM_boolean 0.0 1.0 /end CHARACTERISTIC
/begin CHARACTERISTIC EIP_bErrPOilSnsrOvv_P "Error Oil Pressure Sensor - Override Value Parameter" VALUE 0x40044824 /* @ECU_Address@EIP_bErrPOilSnsrOvv_P@ */ Scalar_BOOLEAN 0 EcuIntgdSwGend_CM_boolean 0.0 1.0 /end CHARACTERISTIC
/begin CHARACTERISTIC EIP_bErrPRailSnsrOvs_P "Error Rail Pressure Sensor - Override Switch Parameter" VALUE 0x40044828 /* @ECU_Address@EIP_bErrPRailSnsrOvs_P@ */ Scalar_BOOLEAN 0 EcuIntgdSwGend_CM_boolean 0.0 1.0 /end CHARACTERISTIC
/begin CHARACTERISTIC EIP_bErrPRailSnsrOvv_P "Error Rail Pressure Sensor - Override Value Parameter" VALUE 0x4004482C /* @ECU_Address@EIP_bErrPRailSnsrOvv_P@ */ Scalar_BOOLEAN 0 EcuIntgdSwGend_CM_boolean 0.0 1.0 /end CHARACTERISTIC
/begin CHARACTERISTIC EIP_bErrTAirBoostSnsrOvs_P "Error Air Boost Temperature Sensor - Override Switch Parameter" VALUE 0x40044858 /* @ECU_Address@EIP_bErrTAirBoostSnsrOvs_P@ */ Scalar_BOOLEAN 0 EcuIntgdSwGend_CM_boolean 0.0 1.0 /end CHARACTERISTIC
/begin CHARACTERISTIC EIP_bErrTAirBoostSnsrOvv_P "Error Air Boost Temperature Sensor - Override Value Parameter" VALUE 0x4004485C /* @ECU_Address@EIP_bErrTAirBoostSnsrOvv_P@ */ Scalar_BOOLEAN 0 EcuIntgdSwGend_CM_boolean 0.0 1.0 /end CHARACTERISTIC
/begin CHARACTERISTIC EIP_bErrTAmbAirSnsrOvs_P "Error Ambient Air Temperature Sensor - Override Switch Parameter" VALUE 0x40044860 /* @ECU_Address@EIP_bErrTAmbAirSnsrOvs_P@ */ Scalar_BOOLEAN 0 EcuIntgdSwGend_CM_boolean 0.0 1.0 /end CHARACTERISTIC
/begin CHARACTERISTIC EIP_bErrTAmbAirSnsrOvv_P "Error Ambient Air Temperature Sensor - Override Value Parameter" VALUE 0x40044864 /* @ECU_Address@EIP_bErrTAmbAirSnsrOvv_P@ */ Scalar_BOOLEAN 0 EcuIntgdSwGend_CM_boolean 0.0 1.0 /end CHARACTERISTIC
/begin CHARACTERISTIC EIP_bErrTCooltSnsrOvs_P "Error Coolant Temperature Sensor - Override Switch Parameter" VALUE 0x40044868 /* @ECU_Address@EIP_bErrTCooltSnsrOvs_P@ */ Scalar_BOOLEAN 0 EcuIntgdSwGend_CM_boolean 0.0 1.0 /end CHARACTERISTIC
/begin CHARACTERISTIC EIP_bErrTCooltSnsrOvv_P "Error Coolant Temperature Sensor - Override Value Parameter" VALUE 0x4004486C /* @ECU_Address@EIP_bErrTCooltSnsrOvv_P@ */ Scalar_BOOLEAN 0 EcuIntgdSwGend_CM_boolean 0.0 1.0 /end CHARACTERISTIC
/begin CHARACTERISTIC EIP_bErrTEcuSnsrOvs_P "Error ECU Temperature Sensor - Override Switch Parameter" VALUE 0x40044870 /* @ECU_Address@EIP_bErrTEcuSnsrOvs_P@ */ Scalar_BOOLEAN 0 EcuIntgdSwGend_CM_boolean 0.0 1.0 /end CHARACTERISTIC
/begin CHARACTERISTIC EIP_bErrTEcuSnsrOvv_P "Error ECU Temperature Sensor - Override Value Parameter" VALUE 0x40044874 /* @ECU_Address@EIP_bErrTEcuSnsrOvv_P@ */ Scalar_BOOLEAN 0 EcuIntgdSwGend_CM_boolean 0.0 1.0 /end CHARACTERISTIC
/begin CHARACTERISTIC EIP_bErrTFuSnsrOvs_P "Error Fuel Temperature Sensor - Override Switch Parameter" VALUE 0x40044878 /* @ECU_Address@EIP_bErrTFuSnsrOvs_P@ */ Scalar_BOOLEAN 0 EcuIntgdSwGend_CM_boolean 0.0 1.0 /end CHARACTERISTIC
/begin CHARACTERISTIC EIP_bErrTFuSnsrOvv_P "Error Fuel Temperature Sensor - Override Value Parameter" VALUE 0x4004487C /* @ECU_Address@EIP_bErrTFuSnsrOvv_P@ */ Scalar_BOOLEAN 0 EcuIntgdSwGend_CM_boolean 0.0 1.0 /end CHARACTERISTIC
/begin CHARACTERISTIC EIP_bErrTOilSnsrOvs_P "Error Oil Temperature Sensor - Override Switch Parameter" VALUE 0x40044880 /* @ECU_Address@EIP_bErrTOilSnsrOvs_P@ */ Scalar_BOOLEAN 0 EcuIntgdSwGend_CM_boolean 0.0 1.0 /end CHARACTERISTIC
/begin CHARACTERISTIC EIP_bErrTOilSnsrOvv_P "Error Oil Temperature Sensor - Override Value Parameter" VALUE 0x40044884 /* @ECU_Address@EIP_bErrTOilSnsrOvv_P@ */ Scalar_BOOLEAN 0 EcuIntgdSwGend_CM_boolean 0.0 1.0 /end CHARACTERISTIC
/begin CHARACTERISTIC EOP_CanPAirBoostOvs_P "SPN 102 - Engine Intake Manifold 1 Pressure - Override Switch" VALUE 0x40044ABC /* @ECU_Address@EOP_CanPAirBoostOvs_P@ */ Scalar_BOOLEAN 0 EcuIntgdSwGend_CM_boolean 0.0 1.0 /end CHARACTERISTIC
/begin CHARACTERISTIC EOP_CanPBaroOvs_P "SPN 108 - Barometric Pressure - Override Switch" VALUE 0x40044AC4 /* @ECU_Address@EOP_CanPBaroOvs_P@ */ Scalar_BOOLEAN 0 EcuIntgdSwGend_CM_boolean 0.0 1.0 /end CHARACTERISTIC
/begin CHARACTERISTIC EOP_CanPOilOvs_P "SPN 100 - Engine Oil Pressure - Override Switch" VALUE 0x40044AD4 /* @ECU_Address@EOP_CanPOilOvs_P@ */ Scalar_BOOLEAN 0 EcuIntgdSwGend_CM_boolean 0.0 1.0 /end CHARACTERISTIC
/begin CHARACTERISTIC EOP_CanTAirBoostOvs_P "SPN 105 - Engine Intake Manifold 1 Temperature - Override Switch" VALUE 0x40044B14 /* @ECU_Address@EOP_CanTAirBoostOvs_P@ */ Scalar_BOOLEAN 0 EcuIntgdSwGend_CM_boolean 0.0 1.0 /end CHARACTERISTIC
/begin CHARACTERISTIC EIP_CanActMaxAvlRtdrOvv_P "Actual Maximum Available Retarder - Override Value" VALUE 0x40044014 /* @ECU_Address@EIP_CanActMaxAvlRtdrOvv_P@ */ Scalar_BYTE 0 EcuIntgdSwGend_CM_int8__ -125.0 125.0 /end CHARACTERISTIC
/begin CHARACTERISTIC EIP_CanEngAuxShtdwnSwtOvv_P "Engine Auxiliary Shutdown Switch - Override Value" VALUE 0x40044034 /* @ECU_Address@EIP_CanEngAuxShtdwnSwtOvv_P@ */ Scalar_BYTE 0 EcuIntgdSwGend_CM_int8 0.0 3.0 /end CHARACTERISTIC
/begin CHARACTERISTIC EIP_CanEngTqLimReqMaxCntnsOvv_P "Engine Torque Limit Request - Maximum Continuous - Override Value" VALUE 0x40044084 /* @ECU_Address@EIP_CanEngTqLimReqMaxCntnsOvv_P@ */ Scalar_BYTE 0 EcuIntgdSwGend_CM_int8__ -125.0 125.0 /end CHARACTERISTIC
/begin CHARACTERISTIC EIP_CanEstimdEngParasiticTqOvv_P "Estimated Engine Parasitic Losses - Override Value" VALUE 0x40044090 /* @ECU_Address@EIP_CanEstimdEngParasiticTqOvv_P@ */ Scalar_BYTE 0 EcuIntgdSwGend_CM_int8__ -125.0 125.0 /end CHARACTERISTIC
/begin CHARACTERISTIC EIP_VehSpdSelnSrc1_P "Vehicle Speed Selection Source 1" VALUE 0x4004469C /* @ECU_Address@EIP_VehSpdSelnSrc1_P@ */ Scalar_BYTE 0 EcuIntgdSwGend_CM_int8 0.0 3.0 /end CHARACTERISTIC
/begin CHARACTERISTIC EIP_VehSpdSelnSrc2_P "Vehicle Speed Selection Source 2" VALUE 0x400446A0 /* @ECU_Address@EIP_VehSpdSelnSrc2_P@ */ Scalar_BYTE 0 EcuIntgdSwGend_CM_int8 0.0 3.0 /end CHARACTERISTIC
/begin CHARACTERISTIC EIP_CanABSActvOvv_P "Anti-Lock Braking (ABS) Active - Override Value" VALUE 0x40043FFC /* @ECU_Address@EIP_CanABSActvOvv_P@ */ Scalar_UBYTE 0 EcuIntgdSwGend_CM_uint8 0.0 3.0 /end CHARACTERISTIC
/begin CHARACTERISTIC EIP_CanASRBrkCtrlActvOvv_P "ASR Brake Control Active - Override Value" VALUE 0x40044004 /* @ECU_Address@EIP_CanASRBrkCtrlActvOvv_P@ */ Scalar_UBYTE 0 EcuIntgdSwGend_CM_uint8 0.0 3.0 /end CHARACTERISTIC
/begin CHARACTERISTIC EIP_CanASREngCtrlActvOvv_P "ASR Engine Control Active - Override Value" VALUE 0x4004400C /* @ECU_Address@EIP_CanASREngCtrlActvOvv_P@ */ Scalar_UBYTE 0 EcuIntgdSwGend_CM_uint8 0.0 3.0 /end CHARACTERISTIC
/begin CHARACTERISTIC EIP_CanCrsCtrlEnaSwtOvv_P "Cruise Control Enable Switch Override Value Parameter" VALUE 0x4004401C /* @ECU_Address@EIP_CanCrsCtrlEnaSwtOvv_P@ */ Scalar_UBYTE 0 EcuIntgdSwGend_CM_uint8 0.0 3.0 /end CHARACTERISTIC
/begin CHARACTERISTIC EIP_CanCrsCtrlResuSwtOvv_P "Cruise Control Resume Switch From CAN Override Value Parameter" VALUE 0x40044024 /* @ECU_Address@EIP_CanCrsCtrlResuSwtOvv_P@ */ Scalar_UBYTE 0 EcuIntgdSwGend_CM_uint8 0.0 3.0 /end CHARACTERISTIC
/begin CHARACTERISTIC EIP_CanCrsCtrlSetSwtOvv_P "Cruise Control Set Switch From CAN Override Value Parameter" VALUE 0x4004402C /* @ECU_Address@EIP_CanCrsCtrlSetSwtOvv_P@ */ Scalar_UBYTE 0 EcuIntgdSwGend_CM_uint8 0.0 3.0 /end CHARACTERISTIC
/begin CHARACTERISTIC EIP_CanEngOvrdCtrlModOvv_P "Engine Override Control Mode - Override Value Parameter" VALUE 0x4004403C /* @ECU_Address@EIP_CanEngOvrdCtrlModOvv_P@ */ Scalar_UBYTE 0 EcuIntgdSwGend_CM_uint8 0.0 3.0 /end CHARACTERISTIC
/begin CHARACTERISTIC EIP_CanEngPtoGovrAccrSwtOvv_P "CAN Pto Governor - Accelerator Switch - Override Value Parameter" VALUE 0x40044044 /* @ECU_Address@EIP_CanEngPtoGovrAccrSwtOvv_P@ */ Scalar_UBYTE 0 EcuIntgdSwGend_CM_uint8 0.0 3.0 /end CHARACTERISTIC
/begin CHARACTERISTIC EIP_CanEngPtoGovrCoastSwtOvv_P "CAN Pto Governor - Coast Switch - Override Value Parameter" VALUE 0x4004404C /* @ECU_Address@EIP_CanEngPtoGovrCoastSwtOvv_P@ */ Scalar_UBYTE 0 EcuIntgdSwGend_CM_uint8 0.0 3.0 /end CHARACTERISTIC
/begin CHARACTERISTIC EIP_CanEngPtoGovrEnaSwtOvv_P "CAN Pto Governor - Enable Switch - Override Value Parameter" VALUE 0x40044054 /* @ECU_Address@EIP_CanEngPtoGovrEnaSwtOvv_P@ */ Scalar_UBYTE 0 EcuIntgdSwGend_CM_uint8 0.0 3.0 /end CHARACTERISTIC
/begin CHARACTERISTIC EIP_CanEngPtoGovrResuSwtOvv_P "CAN Pto Governor - Resume Switch - Override Value Parameter" VALUE 0x4004405C /* @ECU_Address@EIP_CanEngPtoGovrResuSwtOvv_P@ */ Scalar_UBYTE 0 EcuIntgdSwGend_CM_uint8 0.0 3.0 /end CHARACTERISTIC
/begin CHARACTERISTIC EIP_CanEngPtoGovrSetSwtOvv_P "CAN Pto Governor - Set Switch - Override Value Parameter" VALUE 0x40044064 /* @ECU_Address@EIP_CanEngPtoGovrSetSwtOvv_P@ */ Scalar_UBYTE 0 EcuIntgdSwGend_CM_uint8 0.0 3.0 /end CHARACTERISTIC
/begin CHARACTERISTIC EIP_CanEngRemPtoGovrProgdSpdCtrlSwtOvv_P "CAN Pto Governor - Programmed Speed Control Switch - Override Value Parameter" VALUE 0x4004406C /* @ECU_Address@EIP_CanEngRemPtoGovrProgdSpdCtrlSwtOvv_P@ */ Scalar_UBYTE 0 EcuIntgdSwGend_CM_uint8 0.0 3.0 /end CHARACTERISTIC
/begin CHARACTERISTIC EIP_CanOvrdCtrlModPrioOvv_P "Override Control Mode Priority - Override Value" VALUE 0x400440A8 /* @ECU_Address@EIP_CanOvrdCtrlModPrioOvv_P@ */ Scalar_UBYTE 0 EcuIntgdSwGend_CM_uint8 0.0 3.0 /end CHARACTERISTIC
/begin CHARACTERISTIC EIP_CanTSC1MessageCntrOvv_P "TSC1 Message Counter - Override Value" VALUE 0x400440C0 /* @ECU_Address@EIP_CanTSC1MessageCntrOvv_P@ */ Scalar_UBYTE 0 EcuIntgdSwGend_CM_uint8 0.0 15.0 /end CHARACTERISTIC
/begin CHARACTERISTIC EIP_CanTrfCaseStsOvv_P "Transfer case status - Override Value" VALUE 0x400440CC /* @ECU_Address@EIP_CanTrfCaseStsOvv_P@ */ Scalar_UBYTE 0 EcuIntgdSwGend_CM_uint8 0.0 7.0 /end CHARACTERISTIC
/begin CHARACTERISTIC EIP_CanTrsmEngCrkEnaOvv_P "Transmission Engine Crank Enable - Override Value" VALUE 0x400440E0 /* @ECU_Address@EIP_CanTrsmEngCrkEnaOvv_P@ */ Scalar_UBYTE 0 EcuIntgdSwGend_CM_uint8 0.0 3.0 /end CHARACTERISTIC
/begin CHARACTERISTIC EIP_CanTrsmOilLvlReqOvv_P "Transmission Oil Level Request - Override Value" VALUE 0x400440E8 /* @ECU_Address@EIP_CanTrsmOilLvlReqOvv_P@ */ Scalar_UBYTE 0 EcuIntgdSwGend_CM_uint8__ 0.0 3.0 /end CHARACTERISTIC
/begin CHARACTERISTIC EIP_CanTrsmTqCnvLockUpEngdOvv_P "Transmission Torque Converter Lockup Engaged - Override Value" VALUE 0x400440FC /* @ECU_Address@EIP_CanTrsmTqCnvLockUpEngdOvv_P@ */ Scalar_UBYTE 0 EcuIntgdSwGend_CM_uint8 0.0 3.0 /end CHARACTERISTIC
/begin CHARACTERISTIC EIP_CanVehLimSpdGovrDecSwtOvv_P "Vehicle Limiting Speed Governor Increment Switch Override Value Parameter" VALUE 0x4004410C /* @ECU_Address@EIP_CanVehLimSpdGovrDecSwtOvv_P@ */ Scalar_UBYTE 0 EcuIntgdSwGend_CM_uint8 0.0 3.0 /end CHARACTERISTIC
/begin CHARACTERISTIC EIP_CanVehLimSpdGovrEnaSwtOvv_P "Vehicle Limiting Speed Governor Enable Switch Override Value Parameter" VALUE 0x40044114 /* @ECU_Address@EIP_CanVehLimSpdGovrEnaSwtOvv_P@ */ Scalar_UBYTE 0 EcuIntgdSwGend_CM_uint8 0.0 3.0 /end CHARACTERISTIC
/begin CHARACTERISTIC EIP_CanVehLimSpdGovrInctSwtOvv_P "Vehicle Limiting Speed Governor Decrement Switch Override Value Parameter" VALUE 0x4004411C /* @ECU_Address@EIP_CanVehLimSpdGovrInctSwtOvv_P@ */ Scalar_UBYTE 0 EcuIntgdSwGend_CM_uint8 0.0 3.0 /end CHARACTERISTIC
/begin MEASUREMENT EOP_CanTAirBoost "SPN 105 - Engine Intake Manifold 1 Temperature" FLOAT32_IEEE EcuIntgdSwGend_CM_single_degC 0 0 -40.0 210.0 ECU_ADDRESS 0x4000E05C /* @ECU_Address@EOP_CanTAirBoost@ */ /end MEASUREMENT
/begin MEASUREMENT EOP_CanPBaro "SPN 108 - Barometric Pressure" FLOAT32_IEEE EcuIntgdSwGend_CM_single_kPa 0 0 0.0 125.0 ECU_ADDRESS 0x4000DF0C /* @ECU_Address@EOP_CanPBaro@ */ /end MEASUREMENT
/begin MEASUREMENT EOP_CanPAirBoost "SPN 102 - Engine Intake Manifold 1 Pressure" FLOAT32_IEEE EcuIntgdSwGend_CM_single_kPa 0 0 0.0 500.0 ECU_ADDRESS 0x4000DC20 /* @ECU_Address@EOP_CanPAirBoost@ */ /end MEASUREMENT
/begin MEASUREMENT EOP_CanPOil "SPN 100 - Engine Oil Pressure" FLOAT32_IEEE EcuIntgdSwGend_CM_single_kPa 0 0 0.0 1000.0 ECU_ADDRESS 0x4000DCE4 /* @ECU_Address@EOP_CanPOil@ */ /end MEASUREMENT
/begin MEASUREMENT EIP_UClmp30Fild "Filtered Battery Voltage" FLOAT32_IEEE EcuIntgdSwGend_CM_single_V 0 0 0.0 50.0 ECU_ADDRESS 0x4000E6C0 /* @ECU_Address@EIP_UClmp30Fild@ */ /end MEASUREMENT
/begin MEASUREMENT EIP_TiElpdErrUClmp30 "Elapsed Time for Error Battery Voltage Sensor" FLOAT32_IEEE EcuIntgdSwGend_CM_single_ms 0 0 0.0 250000.0 ECU_ADDRESS 0x4000E60C /* @ECU_Address@EIP_TiElpdErrUClmp30@ */ /end MEASUREMENT
/begin MEASUREMENT EIP_VehV "Vehicle Speed" FLOAT32_IEEE EcuIntgdSwGend_CM_single_km_h 0 0 0.0 250.0 ECU_ADDRESS 0x4000DA28 /* @ECU_Address@EIP_VehV@ */ /end MEASUREMENT
/begin MEASUREMENT EIP_PAirBoostGrdtAbsOut "Air Boost Pressure Gradient Absolute Output" FLOAT32_IEEE EcuIntgdSwGend_CM_single_mbar 0 0 0.0 20000.0 ECU_ADDRESS 0x4000E6E4 /* @ECU_Address@EIP_PAirBoostGrdtAbsOut@ */ /end MEASUREMENT
/begin MEASUREMENT EIP_PAmbAirGrdtAbsOut "Ambient Air Pressure Gradient Absolute Output" FLOAT32_IEEE EcuIntgdSwGend_CM_single_mbar 0 0 0.0 20000.0 ECU_ADDRESS 0x4000DD68 /* @ECU_Address@EIP_PAmbAirGrdtAbsOut@ */ /end MEASUREMENT
/begin MEASUREMENT EIP_PRailGrdtAbsOut "Rail Pressure Gradient Absolute Output" FLOAT32_IEEE EcuIntgdSwGend_CM_single_bar 0 0 0.0 20000.0 ECU_ADDRESS 0x4000DAB8 /* @ECU_Address@EIP_PRailGrdtAbsOut@ */ /end MEASUREMENT
/begin MEASUREMENT EIP_PFuGrdtAbsOut "Fuel Pressure Gradient Absolute Output" FLOAT32_IEEE EcuIntgdSwGend_CM_single_mbar 0 0 0.0 20000.0 ECU_ADDRESS 0x4000D83C /* @ECU_Address@EIP_PFuGrdtAbsOut@ */ /end MEASUREMENT
/begin MEASUREMENT EIP_POilGrdtAbsOut "Oil Pressure Gradient Absolute Output" FLOAT32_IEEE EcuIntgdSwGend_CM_single_mbar 0 0 0.0 20000.0 ECU_ADDRESS 0x4000D9F4 /* @ECU_Address@EIP_POilGrdtAbsOut@ */ /end MEASUREMENT
/begin MEASUREMENT EIP_PercgAccrDiff "Acelerator Pedal Percentage Difference" FLOAT32_IEEE EcuIntgdSwGend_CM_single__ 0 0 -100.0 100.0 ECU_ADDRESS 0x4000E75C /* @ECU_Address@EIP_PercgAccrDiff@ */ /end MEASUREMENT
/begin MEASUREMENT EIP_TAirBoostGrdtAbsOut "Air Boost Temperature Gradient Absolute Output" FLOAT32_IEEE EcuIntgdSwGend_CM_single 0 0 0.0 20000.0 ECU_ADDRESS 0x4000DEE0 /* @ECU_Address@EIP_TAirBoostGrdtAbsOut@ */ /end MEASUREMENT
/begin MEASUREMENT EIP_TOilGrdtAbsOut "Oil Temperature Gradient Absolute Output" FLOAT32_IEEE EcuIntgdSwGend_CM_single 0 0 0.0 20000.0 ECU_ADDRESS 0x4000DB88 /* @ECU_Address@EIP_TOilGrdtAbsOut@ */ /end MEASUREMENT
/begin MEASUREMENT EIP_TCooltGrdtAbsOut "Coolant High Temperature Gradient Absolute Output" FLOAT32_IEEE EcuIntgdSwGend_CM_single 0 0 0.0 20000.0 ECU_ADDRESS 0x4000D688 /* @ECU_Address@EIP_TCooltGrdtAbsOut@ */ /end MEASUREMENT
/begin MEASUREMENT EIP_TFuGrdtAbsOut "Fuel Temperature Gradient Absolute Output" FLOAT32_IEEE EcuIntgdSwGend_CM_single 0 0 0.0 20000.0 ECU_ADDRESS 0x4000E720 /* @ECU_Address@EIP_TFuGrdtAbsOut@ */ /end MEASUREMENT
/begin MEASUREMENT EIP_TEcuGrdtAbsOut "Ecu Temperature Gradient Absolute Output" FLOAT32_IEEE EcuIntgdSwGend_CM_single 0 0 0.0 20000.0 ECU_ADDRESS 0x4000DC4C /* @ECU_Address@EIP_TEcuGrdtAbsOut@ */ /end MEASUREMENT
/begin MEASUREMENT EIP_TAmbAirGrdtAbsOut "Ambient Air Temperature Gradient Absolute Output" FLOAT32_IEEE EcuIntgdSwGend_CM_single 0 0 0.0 20000.0 ECU_ADDRESS 0x4000DB00 /* @ECU_Address@EIP_TAmbAirGrdtAbsOut@ */ /end MEASUREMENT
/begin MEASUREMENT EIP_LvlOilGrdtAbsOut "Oil Level Gradient Absolute Output" FLOAT32_IEEE EcuIntgdSwGend_CM_single__ 0 0 0.0 20000.0 ECU_ADDRESS 0x4000E4F0 /* @ECU_Address@EIP_LvlOilGrdtAbsOut@ */ /end MEASUREMENT
/begin MEASUREMENT EIP_TiElpdStrtReqSwt "Elapsed Time for Strart Request Switch" FLOAT32_IEEE EcuIntgdSwGend_CM_single_ms 0 0 0.0 50000.0 ECU_ADDRESS 0x4000D7B4 /* @ECU_Address@EIP_TiElpdStrtReqSwt@ */ /end MEASUREMENT
/begin MEASUREMENT EIP_TiElpdDecCrsCtrlBtn "Elapsed Time for Decrement Cruise Control Button" FLOAT32_IEEE EcuIntgdSwGend_CM_single_ms 0 0 0.0 50000.0 ECU_ADDRESS 0x4000E5A4 /* @ECU_Address@EIP_TiElpdDecCrsCtrlBtn@ */ /end MEASUREMENT
/begin MEASUREMENT EIP_TiElpdIncCrsCtrlBtn "Elapsed Time for Cruise Control Button" FLOAT32_IEEE EcuIntgdSwGend_CM_single_ms 0 0 0.0 50000.0 ECU_ADDRESS 0x4000DAC8 /* @ECU_Address@EIP_TiElpdIncCrsCtrlBtn@ */ /end MEASUREMENT
/begin MEASUREMENT EIP_TiElpdHandBrkPrkg "Elapsed Time for Hand Brake Parking" FLOAT32_IEEE EcuIntgdSwGend_CM_single_ms 0 0 0.0 50000.0 ECU_ADDRESS 0x4000DE54 /* @ECU_Address@EIP_TiElpdHandBrkPrkg@ */ /end MEASUREMENT
/begin MEASUREMENT EIP_TiElpdEngBrkReq1Btn "Elapsed Time for Engine Brake Require 1 Button" FLOAT32_IEEE EcuIntgdSwGend_CM_single_ms 0 0 0.0 50000.0 ECU_ADDRESS 0x4000D700 /* @ECU_Address@EIP_TiElpdEngBrkReq1Btn@ */ /end MEASUREMENT
/begin MEASUREMENT EIP_TiElpdEngBrkReq2Btn "Elapsed Time for Engine Brake Require 2 Button" FLOAT32_IEEE EcuIntgdSwGend_CM_single_ms 0 0 0.0 50000.0 ECU_ADDRESS 0x4000DC74 /* @ECU_Address@EIP_TiElpdEngBrkReq2Btn@ */ /end MEASUREMENT
/begin MEASUREMENT EIP_TiElpdBrkPedl "Elapsed Time for Brake Pedal" FLOAT32_IEEE EcuIntgdSwGend_CM_single_ms 0 0 0.0 50000.0 ECU_ADDRESS 0x4000DFAC /* @ECU_Address@EIP_TiElpdBrkPedl@ */ /end MEASUREMENT
/begin MEASUREMENT EIP_TiElpdIgnSwt "Elapsed Time for Ingnition Switch" FLOAT32_IEEE EcuIntgdSwGend_CM_single_ms 0 0 0.0 50000.0 ECU_ADDRESS 0x4000E2C4 /* @ECU_Address@EIP_TiElpdIgnSwt@ */ /end MEASUREMENT
/begin MEASUREMENT EIP_TiElpdCrsCtrlOnOffBtn "Elapsed Time for Cruise Control On Off Button" FLOAT32_IEEE EcuIntgdSwGend_CM_single_ms 0 0 0.0 50000.0 ECU_ADDRESS 0x4000D800 /* @ECU_Address@EIP_TiElpdCrsCtrlOnOffBtn@ */ /end MEASUREMENT
/begin MEASUREMENT EIP_TiElpdAcvCmbtSwt "Elapsed Time for Combat Switch Active" FLOAT32_IEEE EcuIntgdSwGend_CM_single_ms 0 0 0.0 250000.0 ECU_ADDRESS 0x4000DF7C /* @ECU_Address@EIP_TiElpdAcvCmbtSwt@ */ /end MEASUREMENT
/begin MEASUREMENT EIP_TiElpdTroubleshootingBtn "Elapsed Time for Troubleshooting Button" FLOAT32_IEEE EcuIntgdSwGend_CM_single_ms 0 0 0.0 50000.0 ECU_ADDRESS 0x4000E740 /* @ECU_Address@EIP_TiElpdTroubleshootingBtn@ */ /end MEASUREMENT
/begin MEASUREMENT EIP_CanReqdPercFanSpd "Engine Input Processing Requested Percent Fan Speed" FLOAT32_IEEE EcuIntgdSwGend_CM_single__ 0 0 0.0 100.0 ECU_ADDRESS 0x4000D8E4 /* @ECU_Address@EIP_CanReqdPercFanSpd@ */ /end MEASUREMENT
/begin MEASUREMENT EIP_CanTrsmOutpShaftSpd "Engine Input Processing Transmission Output Shaft Speed" FLOAT32_IEEE EcuIntgdSwGend_CM_single_rpm 0 0 0.0 8100.0 ECU_ADDRESS 0x4000DE70 /* @ECU_Address@EIP_CanTrsmOutpShaftSpd@ */ /end MEASUREMENT
/begin MEASUREMENT EIP_CanPercCluSlip "Engine Input Processing Percent Clutch Slip" FLOAT32_IEEE EcuIntgdSwGend_CM_single__ 0 0 0.0 100.0 ECU_ADDRESS 0x4000DC5C /* @ECU_Address@EIP_CanPercCluSlip@ */ /end MEASUREMENT
/begin MEASUREMENT EIP_CanTrsmActGearRat "Engine Input Processing Transmission Actual Gear Ratio" FLOAT32_IEEE EcuIntgdSwGend_CM_single 0 0 0.0 64255.0 ECU_ADDRESS 0x4000DF94 /* @ECU_Address@EIP_CanTrsmActGearRat@ */ /end MEASUREMENT
/begin MEASUREMENT EIP_CanTrsmTqCnvrRat "Engine Input Processing Transmission Torque Converter Ratio" FLOAT32_IEEE EcuIntgdSwGend_CM_single 0 0 0.0 64255.0 ECU_ADDRESS 0x4000E17C /* @ECU_Address@EIP_CanTrsmTqCnvrRat@ */ /end MEASUREMENT
/begin MEASUREMENT EIP_CanEstimdPercFanSpd "Engine Input Processing Estimated Percent Fan Speed" FLOAT32_IEEE EcuIntgdSwGend_CM_single__ 0 0 0.0 100.0 ECU_ADDRESS 0x4000E074 /* @ECU_Address@EIP_CanEstimdPercFanSpd@ */ /end MEASUREMENT
/begin MEASUREMENT EIP_CanEngReqTqHiResl "Engine Input Processing Engine Requested Torque - High Resolution" FLOAT32_IEEE EcuIntgdSwGend_CM_single__ 0 0 0.0 0.875 ECU_ADDRESS 0x4000DC38 /* @ECU_Address@EIP_CanEngReqTqHiResl@ */ /end MEASUREMENT
/begin MEASUREMENT EIP_CanEngTqReq "Engine Input Processing Engine Requested Torque/Torque Limit" FLOAT32_IEEE EcuIntgdSwGend_CM_single__ 0 0 -125.0 125.0 ECU_ADDRESS 0x4000E07C /* @ECU_Address@EIP_CanEngTqReq@ */ /end MEASUREMENT
/begin MEASUREMENT EIP_CanEngSpdReq "Engine Input Processing Engine Requested Speed/Speed Limit" FLOAT32_IEEE EcuIntgdSwGend_CM_single_rpm 0 0 0.0 8100.0 ECU_ADDRESS 0x4000DD78 /* @ECU_Address@EIP_CanEngSpdReq@ */ /end MEASUREMENT
/begin MEASUREMENT EIP_CanFuLvl1 "Engine Input Processing - Fuel Level 1" FLOAT32_IEEE EcuIntgdSwGend_CM_single__ 0 0 0.0 100.0 ECU_ADDRESS 0x4000E768 /* @ECU_Address@EIP_CanFuLvl1@ */ /end MEASUREMENT
/begin MEASUREMENT EIP_NrErrCylMisfCount "Cylinder Misfire Error Count Number" FLOAT32_IEEE EcuIntgdSwGend_CM_single 0 0 0.0 15.0 ECU_ADDRESS 0x4000DE64 /* @ECU_Address@EIP_NrErrCylMisfCount@ */ /end MEASUREMENT
/begin MEASUREMENT EIP_NrErrInjrCount "Injection Error Count Number" FLOAT32_IEEE EcuIntgdSwGend_CM_single 0 0 0.0 8.0 ECU_ADDRESS 0x4000DCC8 /* @ECU_Address@EIP_NrErrInjrCount@ */ /end MEASUREMENT
/begin MEASUREMENT DTqC_TiTrbChrgOilLeakgIdle "Elapsed Time Signal of Turbo Oil Leakage" FLOAT32_IEEE EcuIntgdSwGend_CM_single_ms 0 0 0.0 250000.0 ECU_ADDRESS 0x4000DD00 /* @ECU_Address@DTqC_TiTrbChrgOilLeakgIdle@ */ /end MEASUREMENT
/begin MEASUREMENT DTqC_NEngIdleGearRef "Reference Idle Speed for Active Index Gear Map Out" FLOAT32_IEEE EcuIntgdSwGend_CM_single 0 0 0.0 6000.0 ECU_ADDRESS 0x4000E38C /* @ECU_Address@DTqC_NEngIdleGearRef@ */ /end MEASUREMENT
/begin MEASUREMENT DTqC_TCooltNEngIdleRef "Coolant Temperature for Reference Engine Idle Speed Map" FLOAT32_IEEE EcuIntgdSwGend_CM_single 0 0 -1000.0 1000.0 ECU_ADDRESS 0x4000E680 /* @ECU_Address@DTqC_TCooltNEngIdleRef@ */ /end MEASUREMENT
/begin MEASUREMENT DTqC_TOilNEngIdleRef "Oil Temperature for Reference Engine Idle Speed Map Out" FLOAT32_IEEE EcuIntgdSwGend_CM_single 0 0 -1000.0 1000.0 ECU_ADDRESS 0x4000E360 /* @ECU_Address@DTqC_TOilNEngIdleRef@ */ /end MEASUREMENT
/begin MEASUREMENT DTqC_PAmbAirNEngIdleRef "Amibent Air Pressure for Reference Engine Idle Speed Map Out" FLOAT32_IEEE EcuIntgdSwGend_CM_single 0 0 0.0 2000.0 ECU_ADDRESS 0x4000E274 /* @ECU_Address@DTqC_PAmbAirNEngIdleRef@ */ /end MEASUREMENT
/begin MEASUREMENT DTqC_DrvrDmdPercTq "Driver Demand Percentage Torque" FLOAT32_IEEE EcuIntgdSwGend_CM_single__ 0 0 0.0 100.0 ECU_ADDRESS 0x4000E078 /* @ECU_Address@DTqC_DrvrDmdPercTq@ */ /end MEASUREMENT
/begin MEASUREMENT DTqC_EngPercTqPoint1 "Engine Percent Torque Point 1 " FLOAT32_IEEE EcuIntgdSwGend_CM_single__ 0 0 0.0 125.0 ECU_ADDRESS 0x4000E63C /* @ECU_Address@DTqC_EngPercTqPoint1@ */ /end MEASUREMENT
/begin MEASUREMENT DTqC_EngPercTqPoint2 "Engine Percent Torque Point 2" FLOAT32_IEEE EcuIntgdSwGend_CM_single__ 0 0 0.0 125.0 ECU_ADDRESS 0x4000DF30 /* @ECU_Address@DTqC_EngPercTqPoint2@ */ /end MEASUREMENT
/begin MEASUREMENT DTqC_EngPercTqPoint3 "Engine Percent Torque Point 3" FLOAT32_IEEE EcuIntgdSwGend_CM_single__ 0 0 0.0 125.0 ECU_ADDRESS 0x4000E644 /* @ECU_Address@DTqC_EngPercTqPoint3@ */ /end MEASUREMENT
/begin MEASUREMENT DTqC_EngPercTqPoint4 "Engine Percent Torque Point 4" FLOAT32_IEEE EcuIntgdSwGend_CM_single__ 0 0 0.0 125.0 ECU_ADDRESS 0x4000E648 /* @ECU_Address@DTqC_EngPercTqPoint4@ */ /end MEASUREMENT
/begin MEASUREMENT DTqC_EngPercTqPoint5 "Engine Percent Torque Point 5" FLOAT32_IEEE EcuIntgdSwGend_CM_single__ 0 0 0.0 125.0 ECU_ADDRESS 0x4000E64C /* @ECU_Address@DTqC_EngPercTqPoint5@ */ /end MEASUREMENT
/begin MEASUREMENT DTqC_ErrNIdle "Idle Speed Reference and Engine Speed Differences" FLOAT32_IEEE EcuIntgdSwGend_CM_single_rpm 0 0 -3300.0 3300.0 ECU_ADDRESS 0x4000DC60 /* @ECU_Address@DTqC_ErrNIdle@ */ /end MEASUREMENT
/begin MEASUREMENT DTqC_CoeffPForSpdCtlMapOut "Proportional Coefficient Map Out Signal for Speed Controller" FLOAT32_IEEE EcuIntgdSwGend_CM_single 0 0 -100000.0 100000.0 ECU_ADDRESS 0x4000DD38 /* @ECU_Address@DTqC_CoeffPForSpdCtlMapOut@ */ /end MEASUREMENT
/begin MEASUREMENT DTqC_FacSclForPIDKpCoeff "Factor Scaling for PID Proportional Coefficient Signal" FLOAT32_IEEE EcuIntgdSwGend_CM_single 0 0 -100.0 100.0 ECU_ADDRESS 0x4000D6B4 /* @ECU_Address@DTqC_FacSclForPIDKpCoeff@ */ /end MEASUREMENT
/begin MEASUREMENT DTqC_CoeffPForSpdCtl "Proportional Coefficient Signal for Speed Controller" FLOAT32_IEEE EcuIntgdSwGend_CM_single 0 0 -100.0 100.0 ECU_ADDRESS 0x4000DD24 /* @ECU_Address@DTqC_CoeffPForSpdCtl@ */ /end MEASUREMENT
/begin MEASUREMENT DTqC_CoeffDForSpdCtlMapOut "Derivative Coefficient Map Out Signal for Speed Controller" FLOAT32_IEEE EcuIntgdSwGend_CM_single 0 0 -100000.0 100000.0 ECU_ADDRESS 0x4000DD34 /* @ECU_Address@DTqC_CoeffDForSpdCtlMapOut@ */ /end MEASUREMENT
/begin MEASUREMENT DTqC_FacSclForPIDKdCoeff "Factor Scaling for PID Derivative Coefficient Signal" FLOAT32_IEEE EcuIntgdSwGend_CM_single 0 0 -100.0 100.0 ECU_ADDRESS 0x4000DC58 /* @ECU_Address@DTqC_FacSclForPIDKdCoeff@ */ /end MEASUREMENT
/begin MEASUREMENT DTqC_CoeffDForSpdCtl "Derivative Coefficient Signal for Speed Controller" FLOAT32_IEEE EcuIntgdSwGend_CM_single 0 0 -100.0 100.0 ECU_ADDRESS 0x4000DAA8 /* @ECU_Address@DTqC_CoeffDForSpdCtl@ */ /end MEASUREMENT
/begin MEASUREMENT DTqC_CoeffFiltForSpdCtlMapOut "Filter Coefficient Map Out Signal for Speed Controller" FLOAT32_IEEE EcuIntgdSwGend_CM_single 0 0 -100000.0 100000.0 ECU_ADDRESS 0x4000E14C /* @ECU_Address@DTqC_CoeffFiltForSpdCtlMapOut@ */ /end MEASUREMENT
/begin MEASUREMENT DTqC_FacSclForPIDFiltKdCoeff "Factor Scaling for PID Derivative Filter Coefficient Signal" FLOAT32_IEEE EcuIntgdSwGend_CM_single 0 0 -100.0 100.0 ECU_ADDRESS 0x4000D750 /* @ECU_Address@DTqC_FacSclForPIDFiltKdCoeff@ */ /end MEASUREMENT
/begin MEASUREMENT DTqC_CoeffFiltForSpdCtl "Filter Coefficient Signal for Speed Controller" FLOAT32_IEEE EcuIntgdSwGend_CM_single 0 0 -100.0 100.0 ECU_ADDRESS 0x4000DCDC /* @ECU_Address@DTqC_CoeffFiltForSpdCtl@ */ /end MEASUREMENT
/begin MEASUREMENT DTqC_TqDesSatPIDMax "Idle Engine Speed PID Controlller Max Saturation Parameter" FLOAT32_IEEE EcuIntgdSwGend_CM_single_N_m 0 0 -1000.0 10000.0 ECU_ADDRESS 0x4000DA44 /* @ECU_Address@DTqC_TqDesSatPIDMax@ */ /end MEASUREMENT
/begin MEASUREMENT DTqC_IdleSpdCtrlFF "Idle Speed Controller FeedForward Out" FLOAT32_IEEE EcuIntgdSwGend_CM_single_N_m 0 0 -10000.0 10000.0 ECU_ADDRESS 0x4000D7EC /* @ECU_Address@DTqC_IdleSpdCtrlFF@ */ /end MEASUREMENT
/begin MEASUREMENT DTqC_IdleSpdCtlTqBrk "Idle Speed Controller Brake Torque" FLOAT32_IEEE EcuIntgdSwGend_CM_single_N_m 0 0 -10000.0 10000.0 ECU_ADDRESS 0x4000E0C8 /* @ECU_Address@DTqC_IdleSpdCtlTqBrk@ */ /end MEASUREMENT
/begin MEASUREMENT DTqC_CabPtoTq "Desired Torque Calculation - Cabin Pto Torque" FLOAT32_IEEE EcuIntgdSwGend_CM_single_N_m 0 0 -10000.0 3000.0 ECU_ADDRESS 0x4000DB14 /* @ECU_Address@DTqC_CabPtoTq@ */ /end MEASUREMENT
/begin MEASUREMENT DTqC_CrsCtrlTq "Desired Torque Calculation - Cruise Control Torque" FLOAT32_IEEE EcuIntgdSwGend_CM_single_N_m 0 0 -10000.0 3000.0 ECU_ADDRESS 0x4000DB30 /* @ECU_Address@DTqC_CrsCtrlTq@ */ /end MEASUREMENT
/begin MEASUREMENT DTqC_DrvrDmdTq "Driver Demand Torque" FLOAT32_IEEE EcuIntgdSwGend_CM_single_N_m 0 0 -10000.0 10000.0 ECU_ADDRESS 0x4000E2E8 /* @ECU_Address@DTqC_DrvrDmdTq@ */ /end MEASUREMENT
/begin MEASUREMENT DTqC_TSC1SpdModTqReq "TSC1 Speed Mode Torque Request" FLOAT32_IEEE EcuIntgdSwGend_CM_single_N_m 0 0 -10000.0 10000.0 ECU_ADDRESS 0x4000E650 /* @ECU_Address@DTqC_TSC1SpdModTqReq@ */ /end MEASUREMENT
/begin MEASUREMENT DTqC_CanEngTqReqNm "Engine Torque Request Nm" FLOAT32_IEEE EcuIntgdSwGend_CM_single_N_m 0 0 -10000.0 10000.0 ECU_ADDRESS 0x4000DBDC /* @ECU_Address@DTqC_CanEngTqReqNm@ */ /end MEASUREMENT
/begin MEASUREMENT DTqC_TSC1TqModTqReq "TSC1 Torque Mode Torque Request" FLOAT32_IEEE EcuIntgdSwGend_CM_single_N_m 0 0 -10000.0 10000.0 ECU_ADDRESS 0x4000E460 /* @ECU_Address@DTqC_TSC1TqModTqReq@ */ /end MEASUREMENT
/begin MEASUREMENT DTqC_TSC1MaxEngSpd "TSC1 Message Max Engine Speed Request" FLOAT32_IEEE EcuIntgdSwGend_CM_single_rpm 0 0 0.0 5000.0 ECU_ADDRESS 0x4000DC04 /* @ECU_Address@DTqC_TSC1MaxEngSpd@ */ /end MEASUREMENT
/begin MEASUREMENT DTqC_NEngSoftLim "" FLOAT32_IEEE EcuIntgdSwGend_CM_single_rpm 0 0 0.0 3000.0 ECU_ADDRESS 0x4000D87C /* @ECU_Address@DTqC_NEngSoftLim@ */ /end MEASUREMENT
/begin MEASUREMENT DTqC_TqEngSpdSoftLim "" FLOAT32_IEEE EcuIntgdSwGend_CM_single_N_m 0 0 -10000.0 10000.0 ECU_ADDRESS 0x4000E3E4 /* @ECU_Address@DTqC_TqEngSpdSoftLim@ */ /end MEASUREMENT
/begin MEASUREMENT DTqC_TSC1MaxTq "TSC1 Message Max Torque Request" FLOAT32_IEEE EcuIntgdSwGend_CM_single_N_m 0 0 0.0 10000.0 ECU_ADDRESS 0x4000E48C /* @ECU_Address@DTqC_TSC1MaxTq@ */ /end MEASUREMENT
/begin MEASUREMENT DTqC_CoeffIForSpdCtlMapOut "Integrator Coefficient Map Out Signal for Speed Controller" FLOAT32_IEEE EcuIntgdSwGend_CM_single 0 0 -100000.0 100000.0 ECU_ADDRESS 0x4000E468 /* @ECU_Address@DTqC_CoeffIForSpdCtlMapOut@ */ /end MEASUREMENT
/begin MEASUREMENT DTqC_FacSclForPIDKiCoeff "Factor Scaling for PID Integrator Coefficient Signal" FLOAT32_IEEE EcuIntgdSwGend_CM_single 0 0 -100.0 100.0 ECU_ADDRESS 0x4000D768 /* @ECU_Address@DTqC_FacSclForPIDKiCoeff@ */ /end MEASUREMENT
/begin MEASUREMENT DTqC_CoeffIForSpdCtl "Integrator Coefficient Signal for Speed Controller" FLOAT32_IEEE EcuIntgdSwGend_CM_single 0 0 -100.0 100.0 ECU_ADDRESS 0x4000DC8C /* @ECU_Address@DTqC_CoeffIForSpdCtl@ */ /end MEASUREMENT
/begin MEASUREMENT CrsCtrl_EngBrkLvl "Engine Brake Level via Cruise Control" FLOAT32_IEEE EcuIntgdSwGend_CM_single 0 0 0.0 2.0 ECU_ADDRESS 0x4000DF54 /* @ECU_Address@CrsCtrl_EngBrkLvl@ */ /end MEASUREMENT
/begin MEASUREMENT CrsCtrl_CoeffDForVVehCtl "Coefficient Derrivate For Vehicle Velocity Control" FLOAT32_IEEE EcuIntgdSwGend_CM_single 0 0 0.0 10000.0 ECU_ADDRESS 0x4000DBD0 /* @ECU_Address@CrsCtrl_CoeffDForVVehCtl@ */ /end MEASUREMENT
/begin MEASUREMENT CrsCtrl_CoeffFiltForVVehCtl "Coefficient Filter for Vehicle Velocity Control" FLOAT32_IEEE EcuIntgdSwGend_CM_single 0 0 0.0 10000.0 ECU_ADDRESS 0x4000E390 /* @ECU_Address@CrsCtrl_CoeffFiltForVVehCtl@ */ /end MEASUREMENT
/begin MEASUREMENT CrsCtrl_CoeffPForVVehCtl "Derivative Coefficient Map for Vehicle Velocity" FLOAT32_IEEE EcuIntgdSwGend_CM_single 0 0 0.0 10000.0 ECU_ADDRESS 0x4000DB0C /* @ECU_Address@CrsCtrl_CoeffPForVVehCtl@ */ /end MEASUREMENT
/begin MEASUREMENT CrsCtrl_SatPIDMax "PID Maximum Saturation" FLOAT32_IEEE EcuIntgdSwGend_CM_single_N_m 0 0 0.0 10000.0 ECU_ADDRESS 0x4000D7D0 /* @ECU_Address@CrsCtrl_SatPIDMax@ */ /end MEASUREMENT
/begin MEASUREMENT CrsCtrl_TrfCaseStsFac "Transfer Case Status Factor" FLOAT32_IEEE EcuIntgdSwGend_CM_single 0 0 0.0 100.0 ECU_ADDRESS 0x4000D7C0 /* @ECU_Address@CrsCtrl_TrfCaseStsFac@ */ /end MEASUREMENT
/begin MEASUREMENT CrsCtrl_TrsmTqCnvrRatFac "Transmission Torque Convertor Ratio Factor" FLOAT32_IEEE EcuIntgdSwGend_CM_single 0 0 0.0 100.0 ECU_ADDRESS 0x4000DF14 /* @ECU_Address@CrsCtrl_TrsmTqCnvrRatFac@ */ /end MEASUREMENT
/begin MEASUREMENT CrsCtrl_CoeffIForVVehCtl "Coefficient Integral for Vehicle Velocity Control" FLOAT32_IEEE EcuIntgdSwGend_CM_single 0 0 0.0 10000.0 ECU_ADDRESS 0x4000E36C /* @ECU_Address@CrsCtrl_CoeffIForVVehCtl@ */ /end MEASUREMENT
/begin MEASUREMENT EIP_VehVFromGear "Vehicle Speed From Gear" SWORD EcuIntgdSwGend_CM_int16_km_h 0 0 0.0 250.0 ECU_ADDRESS 0x4000E2BA /* @ECU_Address@EIP_VehVFromGear@ */ /end MEASUREMENT
/begin MEASUREMENT EIP_VehVSelnFromInpSrc1 "Velocity Selection From Input Source 1" SWORD EcuIntgdSwGend_CM_int16_km_h 0 0 0.0 250.0 ECU_ADDRESS 0x4000DCF0 /* @ECU_Address@EIP_VehVSelnFromInpSrc1@ */ /end MEASUREMENT
/begin MEASUREMENT EIP_VehVSelnFromInpSrc2 "Velocity Selection From Input Source 2" SWORD EcuIntgdSwGend_CM_int16_km_h 0 0 0.0 250.0 ECU_ADDRESS 0x4000DBAC /* @ECU_Address@EIP_VehVSelnFromInpSrc2@ */ /end MEASUREMENT
/begin MEASUREMENT EIP_VehVFromSrc1AndSrc2 "Vehicle Speed From Source 1 and Source 2" SWORD EcuIntgdSwGend_CM_int16_km_h 0 0 0.0 250.0 ECU_ADDRESS 0x4000E02E /* @ECU_Address@EIP_VehVFromSrc1AndSrc2@ */ /end MEASUREMENT
/begin MEASUREMENT EIP_VehVRaw "Vehicle Speed Raw Value" SWORD EcuIntgdSwGend_CM_int16_km_h 0 0 0.0 250.0 ECU_ADDRESS 0x4000DA08 /* @ECU_Address@EIP_VehVRaw@ */ /end MEASUREMENT
/begin MEASUREMENT EIP_CanTrsmCurrentGear "Engine Input Processing Transmission Current Gear" SWORD EcuIntgdSwGend_CM_int16 0 0 -125.0 251.0 ECU_ADDRESS 0x4000E566 /* @ECU_Address@EIP_CanTrsmCurrentGear@ */ /end MEASUREMENT
/begin MEASUREMENT EIP_CanTrsmSeldGear "Engine Input Processing Transmission Selected Gear" SWORD EcuIntgdSwGend_CM_int16 0 0 -125.0 251.0 ECU_ADDRESS 0x4000E116 /* @ECU_Address@EIP_CanTrsmSeldGear@ */ /end MEASUREMENT
/begin MEASUREMENT EIP_CanWhlBasVehSpd "Engine Input Processing - Wheel Based Vehicle Speed" SWORD EcuIntgdSwGend_CM_int16_km_h 0 0 0.0 251.0 ECU_ADDRESS 0x4000D73E /* @ECU_Address@EIP_CanWhlBasVehSpd@ */ /end MEASUREMENT
/begin MEASUREMENT EIP_CanTachographVehSpd "Engine Input Processing - Tachograph Vehicle Speed" SWORD EcuIntgdSwGend_CM_int16_km_h 0 0 0.0 251.0 ECU_ADDRESS 0x4000DFD0 /* @ECU_Address@EIP_CanTachographVehSpd@ */ /end MEASUREMENT
/begin MEASUREMENT EIP_CanTrsmOilLvlReq "Engine Input Processing Transmission Oil Level Request" UBYTE EcuIntgdSwGend_CM_uint8__ 0 0 0.0 3.0 ECU_ADDRESS 0x4000DF98 /* @ECU_Address@EIP_CanTrsmOilLvlReq@ */ /end MEASUREMENT
/begin MEASUREMENT EIP_CanASREngCtrlActv "Engine Input Processing ASR Engine Control Active" UBYTE EcuIntgdSwGend_CM_uint8 0 0 0.0 3.0 ECU_ADDRESS 0x4000E2C1 /* @ECU_Address@EIP_CanASREngCtrlActv@ */ /end MEASUREMENT
/begin MEASUREMENT EIP_CanASRBrkCtrlActv "Engine Input Processing ASR Brake Control Active" UBYTE EcuIntgdSwGend_CM_uint8 0 0 0.0 3.0 ECU_ADDRESS 0x4000E112 /* @ECU_Address@EIP_CanASRBrkCtrlActv@ */ /end MEASUREMENT
/begin MEASUREMENT EIP_CanABSActv "Engine Input Processing Anti-Lock Braking (ABS) Active" UBYTE EcuIntgdSwGend_CM_uint8 0 0 0.0 3.0 ECU_ADDRESS 0x4000DEB4 /* @ECU_Address@EIP_CanABSActv@ */ /end MEASUREMENT
/begin MEASUREMENT EIP_CanTrsmEngCrkEna "Engine Input Processing Transmission Engine Crank Enable" UBYTE EcuIntgdSwGend_CM_uint8 0 0 0.0 3.0 ECU_ADDRESS 0x4000DF70 /* @ECU_Address@EIP_CanTrsmEngCrkEna@ */ /end MEASUREMENT
/begin MEASUREMENT EIP_CanTrsmTqCnvLockUpEngd "Engine Input Processing Transmission Torque Converter Lockup Engaged" UBYTE EcuIntgdSwGend_CM_uint8 0 0 0.0 3.0 ECU_ADDRESS 0x4000D7F1 /* @ECU_Address@EIP_CanTrsmTqCnvLockUpEngd@ */ /end MEASUREMENT
/begin MEASUREMENT EIP_CanTrfCaseSts "Engine Input Processing Transfer case status" UBYTE EcuIntgdSwGend_CM_uint8 0 0 0.0 7.0 ECU_ADDRESS 0x4000DA9D /* @ECU_Address@EIP_CanTrfCaseSts@ */ /end MEASUREMENT
/begin MEASUREMENT EIP_CanTSC1MessageCntr "Engine Input Processing TSC1 Message Counter" UBYTE EcuIntgdSwGend_CM_uint8 0 0 0.0 15.0 ECU_ADDRESS 0x4000E0D8 /* @ECU_Address@EIP_CanTSC1MessageCntr@ */ /end MEASUREMENT
/begin MEASUREMENT EIP_CanEngOvrdCtrlMod "Engine Input Processing Engine Override Control Mode" UBYTE EcuIntgdSwGend_CM_uint8 0 0 0.0 3.0 ECU_ADDRESS 0x4000E4ED /* @ECU_Address@EIP_CanEngOvrdCtrlMod@ */ /end MEASUREMENT
/begin MEASUREMENT EIP_CanOvrdCtrlModPrio "Engine Input Processing Override Control Mode Priority" UBYTE EcuIntgdSwGend_CM_uint8 0 0 0.0 3.0 ECU_ADDRESS 0x4000D6C1 /* @ECU_Address@EIP_CanOvrdCtrlModPrio@ */ /end MEASUREMENT
/begin MEASUREMENT EIP_CanEngPtoGovrEnaSwt "CAN Pto Governor - Enable Switch" UBYTE EcuIntgdSwGend_CM_uint8 0 0 0.0 3.0 ECU_ADDRESS 0x4000DF1C /* @ECU_Address@EIP_CanEngPtoGovrEnaSwt@ */ /end MEASUREMENT
/begin MEASUREMENT EIP_CanEngRemPtoGovrProgdSpdCtrlSwt "CAN Pto Governor - Programmed Speed Control Switch" UBYTE EcuIntgdSwGend_CM_uint8 0 0 0.0 3.0 ECU_ADDRESS 0x4000DDE4 /* @ECU_Address@EIP_CanEngRemPtoGovrProgdSpdCtrlSwt@ */ /end MEASUREMENT
/begin MEASUREMENT EIP_CanEngPtoGovrSetSwt "CAN Pto Governor - Set Switch" UBYTE EcuIntgdSwGend_CM_uint8 0 0 0.0 3.0 ECU_ADDRESS 0x4000DD20 /* @ECU_Address@EIP_CanEngPtoGovrSetSwt@ */ /end MEASUREMENT
/begin MEASUREMENT EIP_CanEngPtoGovrCoastSwt "CAN Pto Governor - Coast Switch" UBYTE EcuIntgdSwGend_CM_uint8 0 0 0.0 3.0 ECU_ADDRESS 0x4000E0F4 /* @ECU_Address@EIP_CanEngPtoGovrCoastSwt@ */ /end MEASUREMENT
/begin MEASUREMENT EIP_CanEngPtoGovrResuSwt "CAN Pto Governor - Resume Switch" UBYTE EcuIntgdSwGend_CM_uint8 0 0 0.0 3.0 ECU_ADDRESS 0x4000E1FE /* @ECU_Address@EIP_CanEngPtoGovrResuSwt@ */ /end MEASUREMENT
/begin MEASUREMENT EIP_CanEngPtoGovrAccrSwt "CAN Pto Governor - Accelerator Switch" UBYTE EcuIntgdSwGend_CM_uint8 0 0 0.0 3.0 ECU_ADDRESS 0x4000E637 /* @ECU_Address@EIP_CanEngPtoGovrAccrSwt@ */ /end MEASUREMENT
/begin MEASUREMENT EIP_CanCrsCtrlSetSwt "Cruise Control Set Switch From CAN" UBYTE EcuIntgdSwGend_CM_uint8 0 0 0.0 3.0 ECU_ADDRESS 0x4000E240 /* @ECU_Address@EIP_CanCrsCtrlSetSwt@ */ /end MEASUREMENT
/begin MEASUREMENT EIP_CanCrsCtrlResuSwt "Cruise Control Resume Switch From CAN" UBYTE EcuIntgdSwGend_CM_uint8 0 0 0.0 3.0 ECU_ADDRESS 0x4000E714 /* @ECU_Address@EIP_CanCrsCtrlResuSwt@ */ /end MEASUREMENT
/begin MEASUREMENT EIP_CanCrsCtrlEnaSwt "Cruise Control Enable Switch" UBYTE EcuIntgdSwGend_CM_uint8 0 0 0.0 3.0 ECU_ADDRESS 0x4000E3E0 /* @ECU_Address@EIP_CanCrsCtrlEnaSwt@ */ /end MEASUREMENT
/begin MEASUREMENT EIP_CanVehLimSpdGovrEnaSwt "Vehicle Limiting Speed Governor Enable Switch" UBYTE EcuIntgdSwGend_CM_uint8 0 0 0.0 3.0 ECU_ADDRESS 0x4000E288 /* @ECU_Address@EIP_CanVehLimSpdGovrEnaSwt@ */ /end MEASUREMENT
/begin MEASUREMENT EIP_CanVehLimSpdGovrInctSwt "Vehicle Limiting Speed Governor Decrement Switch" UBYTE EcuIntgdSwGend_CM_uint8 0 0 0.0 3.0 ECU_ADDRESS 0x4000DD40 /* @ECU_Address@EIP_CanVehLimSpdGovrInctSwt@ */ /end MEASUREMENT
/begin MEASUREMENT EIP_CanVehLimSpdGovrDecSwt "Vehicle Limiting Speed Governor Increment Switch" UBYTE EcuIntgdSwGend_CM_uint8 0 0 0.0 3.0 ECU_ADDRESS 0x4000DF10 /* @ECU_Address@EIP_CanVehLimSpdGovrDecSwt@ */ /end MEASUREMENT
/begin MEASUREMENT EIP_CanEngTqLimReqMaxCntns "Engine Input Processing Engine Torque Limit Request - Maximum Continuous" SBYTE EcuIntgdSwGend_CM_int8__ 0 0 -125.0 125.0 ECU_ADDRESS 0x4000D85A /* @ECU_Address@EIP_CanEngTqLimReqMaxCntns@ */ /end MEASUREMENT
/begin MEASUREMENT EIP_CanEngAuxShtdwnSwt "Engine Input Processing Engine Auxiliary Shutdown Switch" SBYTE EcuIntgdSwGend_CM_int8 0 0 0.0 3.0 ECU_ADDRESS 0x4000DF99 /* @ECU_Address@EIP_CanEngAuxShtdwnSwt@ */ /end MEASUREMENT
/begin MEASUREMENT EIP_CanEstimdEngParasiticTq "Engine Input Processing Estimated Engine Parasitic Losses" SBYTE EcuIntgdSwGend_CM_int8__ 0 0 -125.0 125.0 ECU_ADDRESS 0x4000DF3D /* @ECU_Address@EIP_CanEstimdEngParasiticTq@ */ /end MEASUREMENT
/begin MEASUREMENT EIP_CanActMaxAvlRtdr "Engine Input Processing Actual Maximum Available Retarder" SBYTE EcuIntgdSwGend_CM_int8__ 0 0 -125.0 125.0 ECU_ADDRESS 0x4000E5FC /* @ECU_Address@EIP_CanActMaxAvlRtdr@ */ /end MEASUREMENT
/begin MEASUREMENT EIP_InjrCfg "Injector Configuration Signal" UBYTE EcuIntgdSwGend_CM_boolean 0 0 0.0 1.0 ECU_ADDRESS 0x4000E270 /* @ECU_Address@EIP_InjrCfg@ */ /end MEASUREMENT
/begin MEASUREMENT EIP_WgCfg "Wastegate Configuration Signal" UBYTE EcuIntgdSwGend_CM_boolean 0 0 0.0 1.0 ECU_ADDRESS 0x4000E0A4 /* @ECU_Address@EIP_WgCfg@ */ /end MEASUREMENT
/begin MEASUREMENT EIP_EngBrkCfg "Engine Brake Configuration" UBYTE EcuIntgdSwGend_CM_boolean 0 0 0.0 1.0 ECU_ADDRESS 0x4000D8B0 /* @ECU_Address@EIP_EngBrkCfg@ */ /end MEASUREMENT
/begin MEASUREMENT EIP_EngBrkLvlCfg "Engine Brake Level Configration" UBYTE EcuIntgdSwGend_CM_boolean 0 0 0.0 1.0 ECU_ADDRESS 0x4000E186 /* @ECU_Address@EIP_EngBrkLvlCfg@ */ /end MEASUREMENT
/begin MEASUREMENT EIP_StOfVehVSelnFromInpSrc1 "State of Velocity Selection From Input Source 1" UBYTE EcuIntgdSwGend_CM_boolean 0 0 0.0 1.0 ECU_ADDRESS 0x4000E100 /* @ECU_Address@EIP_StOfVehVSelnFromInpSrc1@ */ /end MEASUREMENT
/begin MEASUREMENT EIP_StOfVehVSelnFromInpSrc2 "State of Velocity Selection From Input Source 2" UBYTE EcuIntgdSwGend_CM_boolean 0 0 0.0 1.0 ECU_ADDRESS 0x4000DE15 /* @ECU_Address@EIP_StOfVehVSelnFromInpSrc2@ */ /end MEASUREMENT
/begin MEASUREMENT EIP_bErrVehV "Vehicle Speed Error" UBYTE EcuIntgdSwGend_CM_boolean 0 0 0.0 1.0 ECU_ADDRESS 0x4000DA89 /* @ECU_Address@EIP_bErrVehV@ */ /end MEASUREMENT
/begin MEASUREMENT EIP_bErrPAirBoostRng "Error Air Boost Pressure Range" UBYTE EcuIntgdSwGend_CM_boolean 0 0 0.0 1.0 ECU_ADDRESS 0x4000E160 /* @ECU_Address@EIP_bErrPAirBoostRng@ */ /end MEASUREMENT
/begin MEASUREMENT EIP_bErrPAirBoostGrdt "Error Air Boost Pressure Gradient" UBYTE EcuIntgdSwGend_CM_boolean 0 0 0.0 1.0 ECU_ADDRESS 0x4000D9BF /* @ECU_Address@EIP_bErrPAirBoostGrdt@ */ /end MEASUREMENT
/begin MEASUREMENT EIP_bErrPAirBoostSnsr "Error Air Boost Pressure Sensor" UBYTE EcuIntgdSwGend_CM_boolean 0 0 0.0 1.0 ECU_ADDRESS 0x4000E684 /* @ECU_Address@EIP_bErrPAirBoostSnsr@ */ /end MEASUREMENT
/begin MEASUREMENT EIP_bErrPAmbAirRng "Error Ambient Air Pressure Range" UBYTE EcuIntgdSwGend_CM_boolean 0 0 0.0 1.0 ECU_ADDRESS 0x4000DA94 /* @ECU_Address@EIP_bErrPAmbAirRng@ */ /end MEASUREMENT
/begin MEASUREMENT EIP_bErrPAmbAirGrdt "Error Ambient Air Pressure Gradient" UBYTE EcuIntgdSwGend_CM_boolean 0 0 0.0 1.0 ECU_ADDRESS 0x4000E0F6 /* @ECU_Address@EIP_bErrPAmbAirGrdt@ */ /end MEASUREMENT
/begin MEASUREMENT EIP_bErrPAmbAirSnsr "Error Ambient Air Pressure Sensor" UBYTE EcuIntgdSwGend_CM_boolean 0 0 0.0 1.0 ECU_ADDRESS 0x4000DCD6 /* @ECU_Address@EIP_bErrPAmbAirSnsr@ */ /end MEASUREMENT
/begin MEASUREMENT EIP_bErrPRailRng "Error Rail Pressure Range" UBYTE EcuIntgdSwGend_CM_boolean 0 0 0.0 1.0 ECU_ADDRESS 0x4000E528 /* @ECU_Address@EIP_bErrPRailRng@ */ /end MEASUREMENT
/begin MEASUREMENT EIP_bErrPRailGrdt "Error Rail Pressure Gradient" UBYTE EcuIntgdSwGend_CM_boolean 0 0 0.0 1.0 ECU_ADDRESS 0x4000DCCC /* @ECU_Address@EIP_bErrPRailGrdt@ */ /end MEASUREMENT
/begin MEASUREMENT EIP_bErrPFuRng "Error Fuel Pressure Range" UBYTE EcuIntgdSwGend_CM_boolean 0 0 0.0 1.0 ECU_ADDRESS 0x4000D9BC /* @ECU_Address@EIP_bErrPFuRng@ */ /end MEASUREMENT
/begin MEASUREMENT EIP_bErrPFuGrdt "Error Fuel Pressure Gradient" UBYTE EcuIntgdSwGend_CM_boolean 0 0 0.0 1.0 ECU_ADDRESS 0x4000DDA0 /* @ECU_Address@EIP_bErrPFuGrdt@ */ /end MEASUREMENT
/begin MEASUREMENT EIP_bErrPOilRng "Error Oil Pressure Range" UBYTE EcuIntgdSwGend_CM_boolean 0 0 0.0 1.0 ECU_ADDRESS 0x4000DCB0 /* @ECU_Address@EIP_bErrPOilRng@ */ /end MEASUREMENT
/begin MEASUREMENT EIP_bErrPOilGrdt "Error Oil Pressure Gradient" UBYTE EcuIntgdSwGend_CM_boolean 0 0 0.0 1.0 ECU_ADDRESS 0x4000E02C /* @ECU_Address@EIP_bErrPOilGrdt@ */ /end MEASUREMENT
/begin MEASUREMENT EIP_bErrPOilSnsr "Error Oil Pressure Sensor" UBYTE EcuIntgdSwGend_CM_boolean 0 0 0.0 1.0 ECU_ADDRESS 0x4000DC34 /* @ECU_Address@EIP_bErrPOilSnsr@ */ /end MEASUREMENT
/begin MEASUREMENT EIP_bErrPFuSnsr "Error Fuel Pressure Sensor" UBYTE EcuIntgdSwGend_CM_boolean 0 0 0.0 1.0 ECU_ADDRESS 0x4000D968 /* @ECU_Address@EIP_bErrPFuSnsr@ */ /end MEASUREMENT
/begin MEASUREMENT EIP_bErrPRailSnsr "Error Rail Pressure Sensor" UBYTE EcuIntgdSwGend_CM_boolean 0 0 0.0 1.0 ECU_ADDRESS 0x4000E238 /* @ECU_Address@EIP_bErrPRailSnsr@ */ /end MEASUREMENT
/begin MEASUREMENT EIP_bErrAccrDervDiff "Error Accelerator Derivative Difference" UBYTE EcuIntgdSwGend_CM_boolean 0 0 0.0 1.0 ECU_ADDRESS 0x4000E227 /* @ECU_Address@EIP_bErrAccrDervDiff@ */ /end MEASUREMENT
/begin MEASUREMENT EIP_bPercgAccrDiffDetn "Acceleartor Percentage Difference Detection" UBYTE EcuIntgdSwGend_CM_boolean 0 0 0.0 1.0 ECU_ADDRESS 0x4000DF13 /* @ECU_Address@EIP_bPercgAccrDiffDetn@ */ /end MEASUREMENT
/begin MEASUREMENT EIP_bErrAccr1Oor "Error Accelerator 1 Out of Range" UBYTE EcuIntgdSwGend_CM_boolean 0 0 0.0 1.0 ECU_ADDRESS 0x4000E108 /* @ECU_Address@EIP_bErrAccr1Oor@ */ /end MEASUREMENT
/begin MEASUREMENT EIP_bErrAccr1 "Error Accelerator 1" UBYTE EcuIntgdSwGend_CM_boolean 0 0 0.0 1.0 ECU_ADDRESS 0x4000D974 /* @ECU_Address@EIP_bErrAccr1@ */ /end MEASUREMENT
/begin MEASUREMENT EIP_bErrAccr2Oor "Error Accelerator 2 Out of Range" UBYTE EcuIntgdSwGend_CM_boolean 0 0 0.0 1.0 ECU_ADDRESS 0x4000D8A8 /* @ECU_Address@EIP_bErrAccr2Oor@ */ /end MEASUREMENT
/begin MEASUREMENT EIP_bErrAccr2 "Error Accelerator 2" UBYTE EcuIntgdSwGend_CM_boolean 0 0 0.0 1.0 ECU_ADDRESS 0x4000D975 /* @ECU_Address@EIP_bErrAccr2@ */ /end MEASUREMENT
/begin MEASUREMENT EIP_bErrAccrRedncy "Error Accelerator Redundancy" UBYTE EcuIntgdSwGend_CM_boolean 0 0 0.0 1.0 ECU_ADDRESS 0x4000DE86 /* @ECU_Address@EIP_bErrAccrRedncy@ */ /end MEASUREMENT
/begin MEASUREMENT EIP_bErrAccrTotLoss "Error Accelerator Total Loss " UBYTE EcuIntgdSwGend_CM_boolean 0 0 0.0 1.0 ECU_ADDRESS 0x4000E544 /* @ECU_Address@EIP_bErrAccrTotLoss@ */ /end MEASUREMENT
/begin MEASUREMENT EIP_bAcvEmgcyShtdwnForOvspd "Emergency Shutdown for Overspeed Active" UBYTE EcuIntgdSwGend_CM_boolean 0 0 0.0 1.0 ECU_ADDRESS 0x4000DF08 /* @ECU_Address@EIP_bAcvEmgcyShtdwnForOvspd@ */ /end MEASUREMENT
/begin MEASUREMENT EIP_bErrTAirBoostRng "Error Air Boost Temperature Range" UBYTE EcuIntgdSwGend_CM_boolean 0 0 0.0 1.0 ECU_ADDRESS 0x4000E198 /* @ECU_Address@EIP_bErrTAirBoostRng@ */ /end MEASUREMENT
/begin MEASUREMENT EIP_bErrTAirBoostGrdt "Error Air Boost Temperature Gradient" UBYTE EcuIntgdSwGend_CM_boolean 0 0 0.0 1.0 ECU_ADDRESS 0x4000D9B6 /* @ECU_Address@EIP_bErrTAirBoostGrdt@ */ /end MEASUREMENT
/begin MEASUREMENT EIP_bErrTAirBoostSnsr "Error Air Boost Temperature Sensor" UBYTE EcuIntgdSwGend_CM_boolean 0 0 0.0 1.0 ECU_ADDRESS 0x4000E67B /* @ECU_Address@EIP_bErrTAirBoostSnsr@ */ /end MEASUREMENT
/begin MEASUREMENT EIP_bErrTOilRng "Error Oil Temperature Range" UBYTE EcuIntgdSwGend_CM_boolean 0 0 0.0 1.0 ECU_ADDRESS 0x4000DC78 /* @ECU_Address@EIP_bErrTOilRng@ */ /end MEASUREMENT
/begin MEASUREMENT EIP_bErrTOilGrdt "Error Oil Temperature Gradient" UBYTE EcuIntgdSwGend_CM_boolean 0 0 0.0 1.0 ECU_ADDRESS 0x4000D875 /* @ECU_Address@EIP_bErrTOilGrdt@ */ /end MEASUREMENT
/begin MEASUREMENT EIP_bErrTOilCoh "Error Oil Temperature Coherance" UBYTE EcuIntgdSwGend_CM_boolean 0 0 0.0 1.0 ECU_ADDRESS 0x4000DFFD /* @ECU_Address@EIP_bErrTOilCoh@ */ /end MEASUREMENT
/begin MEASUREMENT EIP_bErrTOilSnsr "Error Oil Temperature Sensor" UBYTE EcuIntgdSwGend_CM_boolean 0 0 0.0 1.0 ECU_ADDRESS 0x4000E558 /* @ECU_Address@EIP_bErrTOilSnsr@ */ /end MEASUREMENT
/begin MEASUREMENT EIP_bErrTCooltRng "Error Coolant Temperature Range" UBYTE EcuIntgdSwGend_CM_boolean 0 0 0.0 1.0 ECU_ADDRESS 0x4000D6D8 /* @ECU_Address@EIP_bErrTCooltRng@ */ /end MEASUREMENT
/begin MEASUREMENT EIP_bErrTCooltGrdt "Error Coolant Temperature Gradient" UBYTE EcuIntgdSwGend_CM_boolean 0 0 0.0 1.0 ECU_ADDRESS 0x4000E624 /* @ECU_Address@EIP_bErrTCooltGrdt@ */ /end MEASUREMENT
/begin MEASUREMENT EIP_bErrTCooltSnsr "Error Coolant Temperature Sensor" UBYTE EcuIntgdSwGend_CM_boolean 0 0 0.0 1.0 ECU_ADDRESS 0x4000E1A4 /* @ECU_Address@EIP_bErrTCooltSnsr@ */ /end MEASUREMENT
/begin MEASUREMENT EIP_bErrTFuRng "Error Fuel Temperature Range" UBYTE EcuIntgdSwGend_CM_boolean 0 0 0.0 1.0 ECU_ADDRESS 0x4000DCE0 /* @ECU_Address@EIP_bErrTFuRng@ */ /end MEASUREMENT
/begin MEASUREMENT EIP_bErrTFuGrdt "Error Fuel Temperature Gradient" UBYTE EcuIntgdSwGend_CM_boolean 0 0 0.0 1.0 ECU_ADDRESS 0x4000E0F5 /* @ECU_Address@EIP_bErrTFuGrdt@ */ /end MEASUREMENT
/begin MEASUREMENT EIP_bErrTEcuRng "Error ECU Temperature Range" UBYTE EcuIntgdSwGend_CM_boolean 0 0 0.0 1.0 ECU_ADDRESS 0x4000E5F4 /* @ECU_Address@EIP_bErrTEcuRng@ */ /end MEASUREMENT
/begin MEASUREMENT EIP_bErrTEcuGrdt "Error ECU Temperature Gradient" UBYTE EcuIntgdSwGend_CM_boolean 0 0 0.0 1.0 ECU_ADDRESS 0x4000E5A8 /* @ECU_Address@EIP_bErrTEcuGrdt@ */ /end MEASUREMENT
/begin MEASUREMENT EIP_bErrTAmbAirRng "Error Ambient Air Temperature Range" UBYTE EcuIntgdSwGend_CM_boolean 0 0 0.0 1.0 ECU_ADDRESS 0x4000DF3C /* @ECU_Address@EIP_bErrTAmbAirRng@ */ /end MEASUREMENT
/begin MEASUREMENT EIP_bErrTAmbAirGrdt "Error Ambient Air Temperature Gradient" UBYTE EcuIntgdSwGend_CM_boolean 0 0 0.0 1.0 ECU_ADDRESS 0x4000D9B4 /* @ECU_Address@EIP_bErrTAmbAirGrdt@ */ /end MEASUREMENT
/begin MEASUREMENT EIP_bErrTAmbAirSnsr "Error Ambient Air Temperature Sensor" UBYTE EcuIntgdSwGend_CM_boolean 0 0 0.0 1.0 ECU_ADDRESS 0x4000E67A /* @ECU_Address@EIP_bErrTAmbAirSnsr@ */ /end MEASUREMENT
/begin MEASUREMENT EIP_bErrTEcuSnsr "Error ECU Temperature Sensor" UBYTE EcuIntgdSwGend_CM_boolean 0 0 0.0 1.0 ECU_ADDRESS 0x4000E114 /* @ECU_Address@EIP_bErrTEcuSnsr@ */ /end MEASUREMENT
/begin MEASUREMENT EIP_bErrTFuSnsr "Error Fuel Temperature Sensor" UBYTE EcuIntgdSwGend_CM_boolean 0 0 0.0 1.0 ECU_ADDRESS 0x4000DCD5 /* @ECU_Address@EIP_bErrTFuSnsr@ */ /end MEASUREMENT
/begin MEASUREMENT EIP_bErrLvlOilRng "Error Oil Level Range" UBYTE EcuIntgdSwGend_CM_boolean 0 0 0.0 1.0 ECU_ADDRESS 0x4000E736 /* @ECU_Address@EIP_bErrLvlOilRng@ */ /end MEASUREMENT
/begin MEASUREMENT EIP_bErrLvlOilGrdt "Error Oil Level Gradient" UBYTE EcuIntgdSwGend_CM_boolean 0 0 0.0 1.0 ECU_ADDRESS 0x4000DFD2 /* @ECU_Address@EIP_bErrLvlOilGrdt@ */ /end MEASUREMENT
/begin MEASUREMENT EIP_bErrLvlOilSnsr "Error Oil Level Sensor" UBYTE EcuIntgdSwGend_CM_boolean 0 0 0.0 1.0 ECU_ADDRESS 0x4000DBCC /* @ECU_Address@EIP_bErrLvlOilSnsr@ */ /end MEASUREMENT
/begin MEASUREMENT EIP_StOfCanReqdPercFanSpd "State Of Can Requested Percent Fan Speed" UBYTE EcuIntgdSwGend_CM_boolean 0 0 0.0 1.0 ECU_ADDRESS 0x4000DE75 /* @ECU_Address@EIP_StOfCanReqdPercFanSpd@ */ /end MEASUREMENT
/begin MEASUREMENT EIP_StOfCanTrsmOilLvlReq "State Of Can Transmission Oil Level Request" UBYTE EcuIntgdSwGend_CM_boolean 0 0 0.0 1.0 ECU_ADDRESS 0x4000D6F0 /* @ECU_Address@EIP_StOfCanTrsmOilLvlReq@ */ /end MEASUREMENT
/begin MEASUREMENT EIP_StOfCanEngTqLimReqMaxCntns "State Of Can Engine Torque Limit Request - Maximum Continuous" UBYTE EcuIntgdSwGend_CM_boolean 0 0 0.0 1.0 ECU_ADDRESS 0x4000E2C9 /* @ECU_Address@EIP_StOfCanEngTqLimReqMaxCntns@ */ /end MEASUREMENT
/begin MEASUREMENT EIP_StOfCanASREngCtrlActv "State Of Can Acceleration Slip Regulation (ASR) Engine Control Active" UBYTE EcuIntgdSwGend_CM_boolean 0 0 0.0 1.0 ECU_ADDRESS 0x4000E0B0 /* @ECU_Address@EIP_StOfCanASREngCtrlActv@ */ /end MEASUREMENT
/begin MEASUREMENT EIP_StOfCanASRBrkCtrlActv "State Of Can Acceleration Slip Regulation (ASR) Brake Control Active" UBYTE EcuIntgdSwGend_CM_boolean 0 0 0.0 1.0 ECU_ADDRESS 0x4000E044 /* @ECU_Address@EIP_StOfCanASRBrkCtrlActv@ */ /end MEASUREMENT
/begin MEASUREMENT EIP_StOfCanABSActv "Engine Input Processing State Of Anti-Lock Braking (ABS) Active" UBYTE EcuIntgdSwGend_CM_boolean 0 0 0.0 1.0 ECU_ADDRESS 0x4000E39D /* @ECU_Address@EIP_StOfCanABSActv@ */ /end MEASUREMENT
/begin MEASUREMENT EIP_StOfCanEngAuxShtdwnSwt "State Of Can Engine Auxiliary Shutdown Switch" UBYTE EcuIntgdSwGend_CM_boolean 0 0 0.0 1.0 ECU_ADDRESS 0x4000E34C /* @ECU_Address@EIP_StOfCanEngAuxShtdwnSwt@ */ /end MEASUREMENT
/begin MEASUREMENT EIP_StOfCanTrsmEngCrkEna "Ecu Input Processing State Of Can Transmission Engine Crank Enable" UBYTE EcuIntgdSwGend_CM_boolean 0 0 0.0 1.0 ECU_ADDRESS 0x4000DC85 /* @ECU_Address@EIP_StOfCanTrsmEngCrkEna@ */ /end MEASUREMENT
/begin MEASUREMENT EIP_StOfCanEstimdEngParasiticTq "State Of Can Estimated Engine Parasitic Torque" UBYTE EcuIntgdSwGend_CM_boolean 0 0 0.0 1.0 ECU_ADDRESS 0x4000DE90 /* @ECU_Address@EIP_StOfCanEstimdEngParasiticTq@ */ /end MEASUREMENT
/begin MEASUREMENT EIP_StOfCanActMaxAvlRtdr "State of Can Actual Maximum Available Retarder" UBYTE EcuIntgdSwGend_CM_boolean 0 0 0.0 1.0 ECU_ADDRESS 0x4000E290 /* @ECU_Address@EIP_StOfCanActMaxAvlRtdr@ */ /end MEASUREMENT
/begin MEASUREMENT EIP_StOfCanTrsmTqCnvLockUpEngd "Engine Input Processing State Of Can Transmission Torque Convertor Lock Up Engaged" UBYTE EcuIntgdSwGend_CM_boolean 0 0 0.0 1.0 ECU_ADDRESS 0x4000E2F4 /* @ECU_Address@EIP_StOfCanTrsmTqCnvLockUpEngd@ */ /end MEASUREMENT
/begin MEASUREMENT EIP_StOfCanTrsmOutpShaftSpd "Engine Input Processing - State of Transmission Outputshaft Speed" UBYTE EcuIntgdSwGend_CM_boolean 0 0 0.0 1.0 ECU_ADDRESS 0x4000E389 /* @ECU_Address@EIP_StOfCanTrsmOutpShaftSpd@ */ /end MEASUREMENT
/begin MEASUREMENT EIP_StOfCanPercCluSlip "State Of Can Percent Clutch Slip" UBYTE EcuIntgdSwGend_CM_boolean 0 0 0.0 1.0 ECU_ADDRESS 0x4000E670 /* @ECU_Address@EIP_StOfCanPercCluSlip@ */ /end MEASUREMENT
/begin MEASUREMENT EIP_StOfCanTrsmCurrentGear "Engine Input Processing State Of Can Transmission Current Gear" UBYTE EcuIntgdSwGend_CM_boolean 0 0 0.0 1.0 ECU_ADDRESS 0x4000E794 /* @ECU_Address@EIP_StOfCanTrsmCurrentGear@ */ /end MEASUREMENT
/begin MEASUREMENT EIP_StOfCanTrsmSeldGear "State Of Can Transmission Selected Gear" UBYTE EcuIntgdSwGend_CM_boolean 0 0 0.0 1.0 ECU_ADDRESS 0x4000E11A /* @ECU_Address@EIP_StOfCanTrsmSeldGear@ */ /end MEASUREMENT
/begin MEASUREMENT EIP_StOfCanTrsmActGearRat "State Of Can Transmission Actual Gear Ratio" UBYTE EcuIntgdSwGend_CM_boolean 0 0 0.0 1.0 ECU_ADDRESS 0x4000DD90 /* @ECU_Address@EIP_StOfCanTrsmActGearRat@ */ /end MEASUREMENT
/begin MEASUREMENT EIP_StOfCanTrsmTqCnvrRat "Ecu Input Processing State Of Can Transmission Torque Converter Ratio" UBYTE EcuIntgdSwGend_CM_boolean 0 0 0.0 1.0 ECU_ADDRESS 0x4000E679 /* @ECU_Address@EIP_StOfCanTrsmTqCnvrRat@ */ /end MEASUREMENT
/begin MEASUREMENT EIP_StOfCanEstimdPercFanSpd "State Of Can Estimated Percent Fan Speed" UBYTE EcuIntgdSwGend_CM_boolean 0 0 0.0 1.0 ECU_ADDRESS 0x4000E03C /* @ECU_Address@EIP_StOfCanEstimdPercFanSpd@ */ /end MEASUREMENT
/begin MEASUREMENT EIP_StOfCanTrfCaseSts "Ecu Input Processing State Of Can Transfer Case Status" UBYTE EcuIntgdSwGend_CM_boolean 0 0 0.0 1.0 ECU_ADDRESS 0x4000DDD2 /* @ECU_Address@EIP_StOfCanTrfCaseSts@ */ /end MEASUREMENT
/begin MEASUREMENT EIP_StOfCanEngReqTqHiResl "State Of Can Engine Request Torque High Resolution" UBYTE EcuIntgdSwGend_CM_boolean 0 0 0.0 1.0 ECU_ADDRESS 0x4000D9F0 /* @ECU_Address@EIP_StOfCanEngReqTqHiResl@ */ /end MEASUREMENT
/begin MEASUREMENT EIP_StOfCanTSC1MessageCntr "State Of Can TSC1 Message Counter" UBYTE EcuIntgdSwGend_CM_boolean 0 0 0.0 1.0 ECU_ADDRESS 0x4000E4AA /* @ECU_Address@EIP_StOfCanTSC1MessageCntr@ */ /end MEASUREMENT
/begin MEASUREMENT EIP_StOfCanEngTqReq "State Of Can Engine Torque Request" UBYTE EcuIntgdSwGend_CM_boolean 0 0 0.0 1.0 ECU_ADDRESS 0x4000DB98 /* @ECU_Address@EIP_StOfCanEngTqReq@ */ /end MEASUREMENT
/begin MEASUREMENT EIP_StOfCanEngOvrdCtrlMod "Engine Input Processing - State Of Engine Override Control Mode" UBYTE EcuIntgdSwGend_CM_boolean 0 0 0.0 1.0 ECU_ADDRESS 0x4000E2A8 /* @ECU_Address@EIP_StOfCanEngOvrdCtrlMod@ */ /end MEASUREMENT
/begin MEASUREMENT EIP_StOfCanOvrdCtrlModPrio "State Of Can Override Control Mode Priority" UBYTE EcuIntgdSwGend_CM_boolean 0 0 0.0 1.0 ECU_ADDRESS 0x4000DFE4 /* @ECU_Address@EIP_StOfCanOvrdCtrlModPrio@ */ /end MEASUREMENT
/begin MEASUREMENT EIP_StOfCanEngSpdReq "State Of Can Engine Speed Request" UBYTE EcuIntgdSwGend_CM_boolean 0 0 0.0 1.0 ECU_ADDRESS 0x4000DB48 /* @ECU_Address@EIP_StOfCanEngSpdReq@ */ /end MEASUREMENT
/begin MEASUREMENT EIP_StOfCanWhlBasVehSpd "Engine Input Processing - State of Wheel Based Vehicle Speed" UBYTE EcuIntgdSwGend_CM_boolean 0 0 0.0 1.0 ECU_ADDRESS 0x4000D748 /* @ECU_Address@EIP_StOfCanWhlBasVehSpd@ */ /end MEASUREMENT
/begin MEASUREMENT EIP_StOfCanTachographVehSpd "Engine Input Processing State of Tachograph Vehicle Speed" UBYTE EcuIntgdSwGend_CM_boolean 0 0 0.0 1.0 ECU_ADDRESS 0x4000D70C /* @ECU_Address@EIP_StOfCanTachographVehSpd@ */ /end MEASUREMENT
/begin MEASUREMENT EIP_StOfCanEngPtoGovrEnaSwt "Engine Input Processing State Of Can Engine Pto Governor Enable Switch" UBYTE EcuIntgdSwGend_CM_boolean 0 0 0.0 1.0 ECU_ADDRESS 0x4000E47C /* @ECU_Address@EIP_StOfCanEngPtoGovrEnaSwt@ */ /end MEASUREMENT
/begin MEASUREMENT EIP_StOfCanEngRemPtoGovrSpdCtrlSwt "Engine Input Processing State Of Can Engine Remote Pto Governor Speed Control Switch" UBYTE EcuIntgdSwGend_CM_boolean 0 0 0.0 1.0 ECU_ADDRESS 0x4000E69C /* @ECU_Address@EIP_StOfCanEngRemPtoGovrSpdCtrlSwt@ */ /end MEASUREMENT
/begin MEASUREMENT EIP_StOfCanEngPtoGovrSetSwt "Engine Input Processing State Of Can Engine Pto Governor Set Switch" UBYTE EcuIntgdSwGend_CM_boolean 0 0 0.0 1.0 ECU_ADDRESS 0x4000E2B8 /* @ECU_Address@EIP_StOfCanEngPtoGovrSetSwt@ */ /end MEASUREMENT
/begin MEASUREMENT EIP_StOfCanEngPtoGovrCoastSwt "Engine Input Processing State Of Can Engine Pto Governor Coast Switch" UBYTE EcuIntgdSwGend_CM_boolean 0 0 0.0 1.0 ECU_ADDRESS 0x4000E185 /* @ECU_Address@EIP_StOfCanEngPtoGovrCoastSwt@ */ /end MEASUREMENT
/begin MEASUREMENT EIP_StOfCanEngPtoGovrResuSwt "Engine Input Processing State Of Can Engine Pto Governor Resume Switch" UBYTE EcuIntgdSwGend_CM_boolean 0 0 0.0 1.0 ECU_ADDRESS 0x4000DD48 /* @ECU_Address@EIP_StOfCanEngPtoGovrResuSwt@ */ /end MEASUREMENT
/begin MEASUREMENT EIP_StOfCanEngPtoGovrAccrSwt "Engine Input Processing State Of Can Engine Pto Governor Accelerate Switch" UBYTE EcuIntgdSwGend_CM_boolean 0 0 0.0 1.0 ECU_ADDRESS 0x4000E494 /* @ECU_Address@EIP_StOfCanEngPtoGovrAccrSwt@ */ /end MEASUREMENT
/begin MEASUREMENT EIP_StOfCanFuLvl1 "Engine Input Processing - State Of Fuel Level 1" UBYTE EcuIntgdSwGend_CM_boolean 0 0 0.0 1.0 ECU_ADDRESS 0x4000DE5A /* @ECU_Address@EIP_StOfCanFuLvl1@ */ /end MEASUREMENT
/begin MEASUREMENT EIP_StOfCanCrsCtrlSetSwt "State Of Can Cruise Control Set Switch" UBYTE EcuIntgdSwGend_CM_boolean 0 0 0.0 1.0 ECU_ADDRESS 0x4000DF19 /* @ECU_Address@EIP_StOfCanCrsCtrlSetSwt@ */ /end MEASUREMENT
/begin MEASUREMENT EIP_StOfCanCrsCtrlResuSwt "State Of Can Cruise Control Resume Switch" UBYTE EcuIntgdSwGend_CM_boolean 0 0 0.0 1.0 ECU_ADDRESS 0x4000E500 /* @ECU_Address@EIP_StOfCanCrsCtrlResuSwt@ */ /end MEASUREMENT
/begin MEASUREMENT EIP_StOfCanCrsCtrlEnaSwt "State Of Can Cruise Control Enable Switch" UBYTE EcuIntgdSwGend_CM_boolean 0 0 0.0 1.0 ECU_ADDRESS 0x4000DB5E /* @ECU_Address@EIP_StOfCanCrsCtrlEnaSwt@ */ /end MEASUREMENT
/begin MEASUREMENT EIP_StOfCanVehLimSpdGovrEnaSwt "State of Vehicle Limiting Speed Governor Enable Switch" UBYTE EcuIntgdSwGend_CM_boolean 0 0 0.0 1.0 ECU_ADDRESS 0x4000DD88 /* @ECU_Address@EIP_StOfCanVehLimSpdGovrEnaSwt@ */ /end MEASUREMENT
/begin MEASUREMENT EIP_StOfCanVehLimSpdGovrInctSwt "State of Can Vehicle Limiting Speed Governor Increment Switch" UBYTE EcuIntgdSwGend_CM_boolean 0 0 0.0 1.0 ECU_ADDRESS 0x4000D878 /* @ECU_Address@EIP_StOfCanVehLimSpdGovrInctSwt@ */ /end MEASUREMENT
/begin MEASUREMENT EIP_StOfCanVehLimSpdGovrDecSwt "State of Can Vehicle Limiting Speed Governor Decrement Swich" UBYTE EcuIntgdSwGend_CM_boolean 0 0 0.0 1.0 ECU_ADDRESS 0x4000E420 /* @ECU_Address@EIP_StOfCanVehLimSpdGovrDecSwt@ */ /end MEASUREMENT
/begin MEASUREMENT EIP_bAcvCylBaln "Cylinder Balance Active" UBYTE EcuIntgdSwGend_CM_boolean 0 0 0.0 1.0 ECU_ADDRESS 0x4000E787 /* @ECU_Address@EIP_bAcvCylBaln@ */ /end MEASUREMENT
/begin MEASUREMENT EIP_bErrCyl5Misf "Error Cylinder Misfire for Cylinder 5" UBYTE EcuIntgdSwGend_CM_boolean 0 0 0.0 1.0 ECU_ADDRESS 0x4000E409 /* @ECU_Address@EIP_bErrCyl5Misf@ */ /end MEASUREMENT
/begin MEASUREMENT EIP_bErrCyl6Misf "Error Cylinder Misfire for Cylinder 6" UBYTE EcuIntgdSwGend_CM_boolean 0 0 0.0 1.0 ECU_ADDRESS 0x4000E144 /* @ECU_Address@EIP_bErrCyl6Misf@ */ /end MEASUREMENT
/begin MEASUREMENT EIP_bErrCylMisfWarnBfrDeb "Error Cylinder Misfire Warning Before Debouncer" UBYTE EcuIntgdSwGend_CM_boolean 0 0 0.0 1.0 ECU_ADDRESS 0x4000D85B /* @ECU_Address@EIP_bErrCylMisfWarnBfrDeb@ */ /end MEASUREMENT
/begin MEASUREMENT EIP_bAcvErrCylMisfWarn "Error Cylinder Misfire Warning Active" UBYTE EcuIntgdSwGend_CM_boolean 0 0 0.0 1.0 ECU_ADDRESS 0x4000E065 /* @ECU_Address@EIP_bAcvErrCylMisfWarn@ */ /end MEASUREMENT
/begin MEASUREMENT EIP_bErrCylMisfRednBfrDeb "Error Cylinder Misfire Reduction Before Debouncer" UBYTE EcuIntgdSwGend_CM_boolean 0 0 0.0 1.0 ECU_ADDRESS 0x4000E1B5 /* @ECU_Address@EIP_bErrCylMisfRednBfrDeb@ */ /end MEASUREMENT
/begin MEASUREMENT EIP_bAcvErrCylMisfRedn "Error Cylinder Misfire Reduction Active" UBYTE EcuIntgdSwGend_CM_boolean 0 0 0.0 1.0 ECU_ADDRESS 0x4000DD74 /* @ECU_Address@EIP_bAcvErrCylMisfRedn@ */ /end MEASUREMENT
/begin MEASUREMENT EIP_bErrCylMisfShtdwnBfrDeb "Error Cylinder Misfire Shutdown Before Debouncer" UBYTE EcuIntgdSwGend_CM_boolean 0 0 0.0 1.0 ECU_ADDRESS 0x4000DA6D /* @ECU_Address@EIP_bErrCylMisfShtdwnBfrDeb@ */ /end MEASUREMENT
/begin MEASUREMENT EIP_bAcvErrCylMisfShtdwn "Error Cylinder Misfire Shutdown Active" UBYTE EcuIntgdSwGend_CM_boolean 0 0 0.0 1.0 ECU_ADDRESS 0x4000E5FE /* @ECU_Address@EIP_bAcvErrCylMisfShtdwn@ */ /end MEASUREMENT
/begin MEASUREMENT EIP_bErrInjrShtdwnBfrDeb "Error Injector Shutdown Before Debouncer" UBYTE EcuIntgdSwGend_CM_boolean 0 0 0.0 1.0 ECU_ADDRESS 0x4000E368 /* @ECU_Address@EIP_bErrInjrShtdwnBfrDeb@ */ /end MEASUREMENT
/begin MEASUREMENT EIP_bAcvErrInjrShtdwn "Error Injection Shutdown Active" UBYTE EcuIntgdSwGend_CM_boolean 0 0 0.0 1.0 ECU_ADDRESS 0x4000D9B0 /* @ECU_Address@EIP_bAcvErrInjrShtdwn@ */ /end MEASUREMENT
/begin MEASUREMENT DTqC_IdxGearTrbChrgOil "Gear Position for Turbo Charger Oil Leakage Activation" UBYTE EcuIntgdSwGend_CM_boolean 0 0 0.0 1.0 ECU_ADDRESS 0x4000D749 /* @ECU_Address@DTqC_IdxGearTrbChrgOil@ */ /end MEASUREMENT
/begin MEASUREMENT DTqC_VehVAcvnTrbChrgOilLeakg "Turbo Charger Oil Leakage Activation According to Vehicle Speed" UBYTE EcuIntgdSwGend_CM_boolean 0 0 0.0 1.0 ECU_ADDRESS 0x4000DE28 /* @ECU_Address@DTqC_VehVAcvnTrbChrgOilLeakg@ */ /end MEASUREMENT
/begin MEASUREMENT DTqC_bAcvGearChkForTrbChrgOilLeakg "Gear Check for Turbo Oil Leakage Protection" UBYTE EcuIntgdSwGend_CM_boolean 0 0 0.0 1.0 ECU_ADDRESS 0x4000E470 /* @ECU_Address@DTqC_bAcvGearChkForTrbChrgOilLeakg@ */ /end MEASUREMENT
/begin MEASUREMENT DTqC_bAcvTrbChrgOilLeakg "Turbo Oil Leakage Activation Signal" UBYTE EcuIntgdSwGend_CM_boolean 0 0 0.0 1.0 ECU_ADDRESS 0x4000E5E0 /* @ECU_Address@DTqC_bAcvTrbChrgOilLeakg@ */ /end MEASUREMENT
/begin MEASUREMENT DTqC_PtoCtrlAccrPedlOvrd "PTO Control Accelerator Pedal Override" UBYTE EcuIntgdSwGend_CM_boolean 0 0 0.0 1.0 ECU_ADDRESS 0x4000DFEC /* @ECU_Address@DTqC_PtoCtrlAccrPedlOvrd@ */ /end MEASUREMENT
/begin MEASUREMENT DTqC_CrsCtrlAccrPedlOvrd "PTO Control Accelerator Pedal Override" UBYTE EcuIntgdSwGend_CM_boolean 0 0 0.0 1.0 ECU_ADDRESS 0x4000DD6C /* @ECU_Address@DTqC_CrsCtrlAccrPedlOvrd@ */ /end MEASUREMENT
/begin MEASUREMENT DTqC_EngOvspdModeActvn "Engine Overspeed Mode Activation Flag" UBYTE EcuIntgdSwGend_CM_boolean 0 0 0.0 1.0 ECU_ADDRESS 0x4000E413 /* @ECU_Address@DTqC_EngOvspdModeActvn@ */ /end MEASUREMENT
/begin MEASUREMENT CrsCtrl_ErrCanTrtCaseSts "Transfer Case Status Error Signal" UBYTE EcuIntgdSwGend_CM_boolean 0 0 0.0 1.0 ECU_ADDRESS 0x4000E383 /* @ECU_Address@CrsCtrl_ErrCanTrtCaseSts@ */ /end MEASUREMENT
/begin MEASUREMENT CrsCtrl_ErrCanTrsmTqCnvrRat "Transmission Torque Convertor Ratio Error Signal" UBYTE EcuIntgdSwGend_CM_boolean 0 0 0.0 1.0 ECU_ADDRESS 0x4000DFFC /* @ECU_Address@CrsCtrl_ErrCanTrsmTqCnvrRat@ */ /end MEASUREMENT
/begin COMPU_METHOD EcuIntgdSwGend_CM_single_N_m "Q = V" RAT_FUNC "%8.6" "N*m" COEFFS 0 1 0 0 0 1 /end COMPU_METHOD
/begin COMPU_METHOD EcuIntgdSwGend_CM_single_rpm "Q = V" RAT_FUNC "%8.6" "rpm" COEFFS 0 1 0 0 0 1 /end COMPU_METHOD
/begin COMPU_METHOD EcuIntgdSwGend_CM_single_degC "Q = V" RAT_FUNC "%8.6" "degC" COEFFS 0 1 0 0 0 1 /end COMPU_METHOD
/begin COMPU_METHOD EcuIntgdSwGend_CM_single "Q = V" RAT_FUNC "%8.6" "" COEFFS 0 1 0 0 0 1 /end COMPU_METHOD
/begin COMPU_METHOD EcuIntgdSwGend_CM_single__ "Q = V" RAT_FUNC "%8.6" "%" COEFFS 0 1 0 0 0 1 /end COMPU_METHOD
/begin COMPU_METHOD EcuIntgdSwGend_CM_single_ms "Q = V" RAT_FUNC "%8.6" "ms" COEFFS 0 1 0 0 0 1 /end COMPU_METHOD
/begin COMPU_METHOD EcuIntgdSwGend_CM_single_mbar "Q = V" RAT_FUNC "%8.6" "mbar" COEFFS 0 1 0 0 0 1 /end COMPU_METHOD
/begin COMPU_METHOD EcuIntgdSwGend_CM_single_bar "Q = V" RAT_FUNC "%8.6" "bar" COEFFS 0 1 0 0 0 1 /end COMPU_METHOD
/begin COMPU_METHOD EcuIntgdSwGend_CM_single_V "Q = V" RAT_FUNC "%8.6" "V" COEFFS 0 1 0 0 0 1 /end COMPU_METHOD
/begin COMPU_METHOD EcuIntgdSwGend_CM_single_km_h "Q = V" RAT_FUNC "%8.6" "km/h" COEFFS 0 1 0 0 0 1 /end COMPU_METHOD
/begin COMPU_METHOD EcuIntgdSwGend_CM_int16 "Q = V" RAT_FUNC "%5.0" "" COEFFS 0 1 0 0 0 1 /end COMPU_METHOD
/begin COMPU_METHOD EcuIntgdSwGend_CM_single_mbar_sec "Q = V" RAT_FUNC "%8.6" "mbar/sec" COEFFS 0 1 0 0 0 1 /end COMPU_METHOD
/begin COMPU_METHOD EcuIntgdSwGend_CM_single_bar_sec "Q = V" RAT_FUNC "%8.6" "bar/sec" COEFFS 0 1 0 0 0 1 /end COMPU_METHOD
/begin COMPU_METHOD EcuIntgdSwGend_CM_single_degC_sec "Q = V" RAT_FUNC "%8.6" "degC/sec" COEFFS 0 1 0 0 0 1 /end COMPU_METHOD
/begin COMPU_METHOD EcuIntgdSwGend_CM_single_kPa "Q = V" RAT_FUNC "%8.6" "kPa" COEFFS 0 1 0 0 0 1 /end COMPU_METHOD
/begin COMPU_METHOD EcuIntgdSwGend_CM_int16__ "Q = V" RAT_FUNC "%5.0" "%" COEFFS 0 1 0 0 0 1 /end COMPU_METHOD
/begin COMPU_METHOD EcuIntgdSwGend_CM_int16_km_h "Q = V" RAT_FUNC "%5.0" "km/h" COEFFS 0 1 0 0 0 1 /end COMPU_METHOD
/begin COMPU_METHOD EcuIntgdSwGend_CM_boolean "Q = V" RAT_FUNC "%1.0" "" COEFFS 0 1 0 0 0 1 /end COMPU_METHOD
/begin COMPU_METHOD EcuIntgdSwGend_CM_int8 "Q = V" RAT_FUNC "%3.0" "" COEFFS 0 1 0 0 0 1 /end COMPU_METHOD
/begin COMPU_METHOD EcuIntgdSwGend_CM_int8__ "Q = V" RAT_FUNC "%3.0" "%" COEFFS 0 1 0 0 0 1 /end COMPU_METHOD
/begin COMPU_METHOD EcuIntgdSwGend_CM_uint8 "Q = V" RAT_FUNC "%3.0" "" COEFFS 0 1 0 0 0 1 /end COMPU_METHOD
/begin COMPU_METHOD EcuIntgdSwGend_CM_uint8__ "Q = V" RAT_FUNC "%3.0" "%" COEFFS 0 1 0 0 0 1 /end COMPU_METHOD
/begin GROUP S20_CruiseControlPIDController "EcuIntgdSwGend/ControlSoftware/CrsCtrl/CruiseControl/CruiseControlPIDController" /begin SUB_GROUP S24_PID_Controller /end SUB_GROUP
 /begin REF_CHARACTERISTIC CrsCtrl_CoeffDForVVehCtl_M CrsCtrl_CoeffFiltForVVehCtl_M CrsCtrl_CoeffIForVVehCtl_M CrsCtrl_CoeffPForVVehCtl_M CrsCtrl_PIDCoeffDOvs_P CrsCtrl_PIDCoeffDOvv_P CrsCtrl_PIDCoeffFiltOvs_P CrsCtrl_PIDCoeffFiltOvv_P CrsCtrl_PIDCoeffIOvs_P CrsCtrl_PIDCoeffIOvv_P CrsCtrl_PIDCoeffPOvs_P CrsCtrl_PIDCoeffPOvv_P CrsCtrl_PIDMin_P CrsCtrl_SatPIDMax_M CrsCtrl_TrfCaseStsFac_M CrsCtrl_TrsmTqCnvrRatFac_M EG_NmrSng1_C EG_VldInpSt_C /end REF_CHARACTERISTIC
 /begin REF_MEASUREMENT CrsCtrl_CoeffDForVVehCtl CrsCtrl_CoeffFiltForVVehCtl CrsCtrl_CoeffIForVVehCtl CrsCtrl_CoeffPForVVehCtl CrsCtrl_ErrCanTrsmTqCnvrRat CrsCtrl_ErrCanTrtCaseSts CrsCtrl_SatPIDMax CrsCtrl_TrfCaseStsFac CrsCtrl_TrsmTqCnvrRatFac /end REF_MEASUREMENT
/end GROUP
/begin GROUP S20_Pos_Edge1 "EcuIntgdSwGend/ControlSoftware/CrsCtrl/CruiseControl/Pos_Edge1" /begin REF_CHARACTERISTIC EG_NmrSng0_C /end REF_CHARACTERISTIC /end GROUP
/begin GROUP S21_Engine_Brake_Level_Activation_Condition "EcuIntgdSwGend/ControlSoftware/CrsCtrl/Engine Brake Activation via Cruise Control/Engine Brake Level Activation Condition"
 /begin SUB_GROUP S30_Engine_Brake_Level_1_Activation_Condition S30_Engine_Brake_Level_2_Activation_Condition /end SUB_GROUP
 /begin REF_CHARACTERISTIC CrsCtrl_EngBrkLvl1Cfg_C CrsCtrl_EngBrkLvl2Cfg_C /end REF_CHARACTERISTIC
/end GROUP
/begin GROUP S21_Engine_Brake_Level_Set "EcuIntgdSwGend/ControlSoftware/CrsCtrl/Engine Brake Activation via Cruise Control/Engine Brake Level Set"
 /begin REF_CHARACTERISTIC CrsCtrl_EngBrkLvl0_C CrsCtrl_EngBrkLvl1_C CrsCtrl_EngBrkLvl2_C /end REF_CHARACTERISTIC
 /begin REF_MEASUREMENT CrsCtrl_EngBrkLvl /end REF_MEASUREMENT
/end GROUP
/begin GROUP S38_Accelarator_Pedal_Override_Modes "EcuIntgdSwGend/ControlSoftware/DesTqClcn/Desired Torque Calculation CAN Signals/Accelarator Pedal Override Modes" /begin REF_CHARACTERISTIC EG_CrsCtrlActvd_C /end REF_CHARACTERISTIC /begin REF_MEASUREMENT DTqC_CrsCtrlAccrPedlOvrd DTqC_PtoCtrlAccrPedlOvrd /end REF_MEASUREMENT /end GROUP
/begin GROUP S38_EC1___Engine_Configuration_1 "EcuIntgdSwGend/ControlSoftware/DesTqClcn/Desired Torque Calculation CAN Signals/EC1 - Engine Configuration 1"
 /begin REF_CHARACTERISTIC DTqC_EngSpdPoint1_P DTqC_EngSpdPoint2_P DTqC_EngSpdPoint3_P DTqC_EngSpdPoint4_P DTqC_EngSpdPoint5_P DTqC_EngSpdPoint6_P DTqC_EngSpdPoint7_P DTqC_EngTqPoint1_P DTqC_EngTqPoint2_P DTqC_EngTqPoint3_P DTqC_EngTqPoint4_P DTqC_EngTqPoint5_P EG_NmrSng100_C /end REF_CHARACTERISTIC
 /begin REF_MEASUREMENT DTqC_DrvrDmdPercTq DTqC_EngPercTqPoint1 DTqC_EngPercTqPoint2 DTqC_EngPercTqPoint3 DTqC_EngPercTqPoint4 DTqC_EngPercTqPoint5 /end REF_MEASUREMENT
/end GROUP
/begin GROUP S40_Engine_Idle_Reference "EcuIntgdSwGend/ControlSoftware/DesTqClcn/Idle Speed Reference Selector/Engine Idle Reference"
 /begin REF_CHARACTERISTIC DTqC_NEngIdleGearRef_M DTqC_PAmbAirNEngIdleRef_M DTqC_TCooltNEngIdleRef_M DTqC_TOilNEngIdleRef_M /end REF_CHARACTERISTIC
 /begin REF_MEASUREMENT DTqC_NEngIdleGearRef DTqC_PAmbAirNEngIdleRef DTqC_TCooltNEngIdleRef DTqC_TOilNEngIdleRef /end REF_MEASUREMENT
/end GROUP
/begin GROUP S40_Turbo_Oil_Leakage_Protection "EcuIntgdSwGend/ControlSoftware/DesTqClcn/Idle Speed Reference Selector/Turbo Oil Leakage Protection"
 /begin REF_CHARACTERISTIC DTqC_TiTrbChrgOilLeakgIdleRef_P DTqC_VehVAcvnTrbChrgOilLeakg_P EG_ModEngCtlIdleSpd_C /end REF_CHARACTERISTIC
 /begin REF_MEASUREMENT DTqC_IdxGearTrbChrgOil DTqC_TiTrbChrgOilLeakgIdle DTqC_VehVAcvnTrbChrgOilLeakg DTqC_bAcvGearChkForTrbChrgOilLeakg DTqC_bAcvTrbChrgOilLeakg /end REF_MEASUREMENT
/end GROUP
/begin GROUP S42_Driver_Demand_Torque_Calculation "EcuIntgdSwGend/ControlSoftware/DesTqClcn/Running Mode/Driver Demand Torque Calculation" /begin SUB_GROUP S51_N_Map_Interpolation_for_Brake_Torque /end SUB_GROUP
 /begin REF_CHARACTERISTIC DTqC_AccrPedlOvrdForCrsCtrl_P DTqC_AccrPedlOvrdForPto_P DTqC_RateLoLimForPTOAccrOvrd_P DTqC_RateUpLimForPTOAccrOvrd_P EG_CrsCtrlActvd_C /end REF_CHARACTERISTIC
 /begin REF_MEASUREMENT DTqC_CabPtoTq DTqC_CrsCtrlTq DTqC_DrvrDmdTq /end REF_MEASUREMENT
/end GROUP
/begin GROUP S42_EndSpeed_Governor "EcuIntgdSwGend/ControlSoftware/DesTqClcn/Running Mode/EndSpeed Governor"
 /begin SUB_GROUP S52_EndSpeed_Soft_Limit_Governor S52_Engine_Speed_Hysteresis_for_Hard_Limitation S52_Engine_Speed_Hysteresis_for_Soft_Limitation /end SUB_GROUP
 /begin REF_CHARACTERISTIC DTqC_NEngHardLimActvnThdOffs_P DTqC_NEngHardLimDeacThdOffs_P DTqC_NEngHardLimTqOffs_C DTqC_NEngSoftLimActvnThdOffs_P DTqC_NEngSoftLimAcvThd_P DTqC_NEngSoftLimDeacThdOffs_P DTqC_PtoCtrlNEngMaxSpdHys_P /end REF_CHARACTERISTIC
 /begin REF_MEASUREMENT DTqC_EngOvspdModeActvn DTqC_NEngSoftLim DTqC_TqEngSpdSoftLim /end REF_MEASUREMENT
/end GROUP
/begin GROUP S42_Idle_Speed_Controller "EcuIntgdSwGend/ControlSoftware/DesTqClcn/Running Mode/Idle Speed Controller" /begin SUB_GROUP S53_PID_Controller1 /end SUB_GROUP
 /begin REF_CHARACTERISTIC DTqC_CoeffDForSpdCtl_M DTqC_CoeffFiltForSpdCtl_M DTqC_CoeffFiltKdSpdCtlOvs_P DTqC_CoeffFiltKdSpdCtlOvv_P DTqC_CoeffIForSpdCtl_M DTqC_CoeffPForSpdCtl_M DTqC_FacSclPIDCoeff_P DTqC_IdleSpdCtrlFF_M DTqC_KdSpdCtlOvs_P DTqC_KdSpdCtlOvv_P DTqC_KiSpdCtlOvs_P DTqC_KiSpdCtlOvv_P DTqC_KpSpdCtlOvs_P DTqC_KpSpdCtlOvv_P DTqC_TqDesSatMax_M DTqC_TqDesSatPIDMin_P /end REF_CHARACTERISTIC
 /begin REF_MEASUREMENT DTqC_CoeffDForSpdCtl DTqC_CoeffDForSpdCtlMapOut DTqC_CoeffFiltForSpdCtl DTqC_CoeffFiltForSpdCtlMapOut DTqC_CoeffIForSpdCtl DTqC_CoeffIForSpdCtlMapOut DTqC_CoeffPForSpdCtl DTqC_CoeffPForSpdCtlMapOut DTqC_ErrNIdle DTqC_FacSclForPIDFiltKdCoeff DTqC_FacSclForPIDKdCoeff DTqC_FacSclForPIDKiCoeff DTqC_FacSclForPIDKpCoeff DTqC_IdleSpdCtlTqBrk DTqC_IdleSpdCtrlFF DTqC_TqDesSatPIDMax /end REF_MEASUREMENT
/end GROUP
/begin GROUP S42_TSC1_Control_Purpose "EcuIntgdSwGend/ControlSoftware/DesTqClcn/Running Mode/TSC1 Control Purpose" /begin SUB_GROUP S54_TSC1_Request_for_Speed_Control /end SUB_GROUP
 /begin REF_CHARACTERISTIC EG_NmrSng100_C EG_TSC1SpdCtrlMod_C EG_TSC1TqCtrlMod_C EG_TSC1TqSpdLimMod_C /end REF_CHARACTERISTIC
 /begin REF_MEASUREMENT DTqC_CanEngTqReqNm DTqC_TSC1MaxEngSpd DTqC_TSC1MaxTq DTqC_TSC1SpdModTqReq DTqC_TSC1TqModTqReq /end REF_MEASUREMENT
/end GROUP
/begin GROUP S81_Shutdown_For_Injector_Error "EcuIntgdSwGend/ControlSoftware/EcuInpPrcsg/Actuator Defect Signals/Shutdown For Injector Error" /begin SUB_GROUP S98_Debouncer4 /end SUB_GROUP
 /begin REF_CHARACTERISTIC EG_NmrSng0_C EG_TsSw_C EIP_NrErrInjrShtdwn_P EIP_TiAcvErrInjrShtdwnDeb_P EIP_bAcvErrInjrShtdwnOvs_P EIP_bAcvErrInjrShtdwnOvv_P /end REF_CHARACTERISTIC
 /begin REF_MEASUREMENT EIP_NrErrInjrCount EIP_bAcvErrInjrShtdwn EIP_bErrInjrShtdwnBfrDeb /end REF_MEASUREMENT
/end GROUP
/begin GROUP S82_Cylinder_Balancing "EcuIntgdSwGend/ControlSoftware/EcuInpPrcsg/Additionals/Cylinder Balancing"
 /begin SUB_GROUP S100_Cylinder_1_Speed_Error_Calculation S100_Cylinder_2_Speed_Error_Calculation S100_Cylinder_3_Speed_Error_Calculation S100_Cylinder_4_Speed_Error_Calculation S100_Cylinder_5_Speed_Error_Calculation S100_Cylinder_6_Speed_Error_Calculation S100_Debouncer6 /end SUB_GROUP
 /begin REF_CHARACTERISTIC EG_NmrSng0_C EG_TsSw_C EIP_NmrSgn0ForCylBaln_C EIP_TiIdleModDeb_P EIP_bAcvCylBalnOvs_P EIP_bAcvCylBalnOvv_P /end REF_CHARACTERISTIC
 /begin REF_MEASUREMENT EIP_bAcvCylBaln /end REF_MEASUREMENT
/end GROUP
/begin GROUP S82_Misfire_Detection "EcuIntgdSwGend/ControlSoftware/EcuInpPrcsg/Additionals/Misfire Detection"
 /begin SUB_GROUP S101_Injector_1_Misfire S101_Injector_2_Misfire S101_Injector_3_Misfire S101_Injector_4_Misfire S101_Injector_5_Misfire S101_Injector_6_Misfire /end SUB_GROUP
/end GROUP
/begin GROUP S82_Shutdown_For_Cylinder_Misfire_Error "EcuIntgdSwGend/ControlSoftware/EcuInpPrcsg/Additionals/Shutdown For Cylinder Misfire Error" /begin SUB_GROUP S102_Debouncer S102_Debouncer1 S102_Debouncer2 /end SUB_GROUP
 /begin REF_CHARACTERISTIC EG_DiErrCyl_C EG_NmrSng0_C EG_TsSw_C EIP_NrErrCylMisfRedn_P EIP_NrErrCylMisfShtdwn_P EIP_NrErrCylMisfWarn_P EIP_TiAcvErrCylMisfRednDeb_P EIP_TiAcvErrCylMisfShtdwnDeb_P EIP_TiAcvErrCylMisfWarnDeb_P EIP_bAcvErrCylMisfRednOvs_P EIP_bAcvErrCylMisfRednOvv_P EIP_bAcvErrCylMisfShtdwnOvs_P EIP_bAcvErrCylMisfShtdwnOvv_P EIP_bAcvErrCylMisfWarnOvs_P EIP_bAcvErrCylMisfWarnOvv_P /end REF_CHARACTERISTIC
 /begin REF_MEASUREMENT EIP_NrErrCylMisfCount EIP_bAcvErrCylMisfRedn EIP_bAcvErrCylMisfShtdwn EIP_bAcvErrCylMisfWarn EIP_bErrCyl5Misf EIP_bErrCyl6Misf EIP_bErrCylMisfRednBfrDeb EIP_bErrCylMisfShtdwnBfrDeb EIP_bErrCylMisfWarnBfrDeb /end REF_MEASUREMENT
/end GROUP
/begin GROUP S83_SPN_1624___Tachograph_vehicle_speed "EcuIntgdSwGend/ControlSoftware/EcuInpPrcsg/CAN Signals/SPN 1624 - Tachograph vehicle speed"
 /begin REF_CHARACTERISTIC EIP_CanTachographVehSpdOvs_P EIP_CanTachographVehSpdOvv_P EIP_StOfCanTachographVehSpdOvs_P EIP_StOfCanTachographVehSpdOvv_P /end REF_CHARACTERISTIC
 /begin REF_MEASUREMENT EIP_CanTachographVehSpd EIP_StOfCanTachographVehSpd /end REF_MEASUREMENT
/end GROUP
/begin GROUP S83_SPN_1653___Vehicle_Limiting_Speed_Governor_Enable_Switch "EcuIntgdSwGend/ControlSoftware/EcuInpPrcsg/CAN Signals/SPN 1653 - Vehicle Limiting Speed Governor Enable Switch"
 /begin REF_CHARACTERISTIC EIP_CanVehLimSpdGovrEnaSwtOvs_P EIP_CanVehLimSpdGovrEnaSwtOvv_P EIP_StOfCanVehLimSpdGovrEnaSwtOvs_P EIP_StOfCanVehLimSpdGovrEnaSwtOvv_P /end REF_CHARACTERISTIC
 /begin REF_MEASUREMENT EIP_CanVehLimSpdGovrEnaSwt EIP_StOfCanVehLimSpdGovrEnaSwt /end REF_MEASUREMENT
/end GROUP
/begin GROUP S83_SPN_1654___Vehicle_Limiting_Speed_Governor_Increment_Switch "EcuIntgdSwGend/ControlSoftware/EcuInpPrcsg/CAN Signals/SPN 1654 - Vehicle Limiting Speed Governor Increment Switch"
 /begin REF_CHARACTERISTIC EIP_CanVehLimSpdGovrInctSwtOvs_P EIP_CanVehLimSpdGovrInctSwtOvv_P EIP_StOfCanVehLimSpdGovrInctSwtOvs_P EIP_StOfCanVehLimSpdGovrInctSwtOvv_P /end REF_CHARACTERISTIC
 /begin REF_MEASUREMENT EIP_CanVehLimSpdGovrInctSwt EIP_StOfCanVehLimSpdGovrInctSwt /end REF_MEASUREMENT
/end GROUP
/begin GROUP S83_SPN_1655___Vehicle_Limiting_Speed_Governor_Decrement_Switch "EcuIntgdSwGend/ControlSoftware/EcuInpPrcsg/CAN Signals/SPN 1655 - Vehicle Limiting Speed Governor Decrement Switch"
 /begin REF_CHARACTERISTIC EIP_CanVehLimSpdGovrDecSwtOvs_P EIP_CanVehLimSpdGovrDecSwtOvv_P EIP_StOfCanVehLimSpdGovrDecSwtOvs_P EIP_StOfCanVehLimSpdGovrDecSwtOvv_P /end REF_CHARACTERISTIC
 /begin REF_MEASUREMENT EIP_CanVehLimSpdGovrDecSwt EIP_StOfCanVehLimSpdGovrDecSwt /end REF_MEASUREMENT
/end GROUP
/begin GROUP S83_SPN_1717___Actual_Maximum_Available_Retarder___Percent_Torque "EcuIntgdSwGend/ControlSoftware/EcuInpPrcsg/CAN Signals/SPN 1717 - Actual Maximum Available Retarder - Percent Torque"
 /begin REF_CHARACTERISTIC EIP_CanActMaxAvlRtdrOvs_P EIP_CanActMaxAvlRtdrOvv_P EIP_StOfCanActMaxAvlRtdrOvs_P EIP_StOfCanActMaxAvlRtdrOvv_P /end REF_CHARACTERISTIC
 /begin REF_MEASUREMENT EIP_CanActMaxAvlRtdr EIP_StOfCanActMaxAvlRtdr /end REF_MEASUREMENT
/end GROUP
/begin GROUP S83_SPN_1787___Engine_Torque_Limit_Request___Maximum_Continuous "EcuIntgdSwGend/ControlSoftware/EcuInpPrcsg/CAN Signals/SPN 1787 - Engine Torque Limit Request - Maximum Continuous"
 /begin REF_CHARACTERISTIC EIP_CanEngTqLimReqMaxCntnsOvs_P EIP_CanEngTqLimReqMaxCntnsOvv_P EIP_StOfCanEngTqLimReqMaxCntnsOvs_P EIP_StOfCanEngTqLimReqMaxCntnsOvv_P /end REF_CHARACTERISTIC
 /begin REF_MEASUREMENT EIP_CanEngTqLimReqMaxCntns EIP_StOfCanEngTqLimReqMaxCntns /end REF_MEASUREMENT
/end GROUP
/begin GROUP S83_SPN_191___Transmission_Output_Shaft_Speed "EcuIntgdSwGend/ControlSoftware/EcuInpPrcsg/CAN Signals/SPN 191 - Transmission Output Shaft Speed"
 /begin REF_CHARACTERISTIC EIP_CanTrsmOutpShaftSpdOvs_P EIP_CanTrsmOutpShaftSpdOvv_P EIP_StOfCanTrsmOutpShaftSpdOvs_P EIP_StOfCanTrsmOutpShaftSpdOvv_P /end REF_CHARACTERISTIC
 /begin REF_MEASUREMENT EIP_CanTrsmOutpShaftSpd EIP_StOfCanTrsmOutpShaftSpd /end REF_MEASUREMENT
/end GROUP
/begin GROUP S83_SPN_2900___Transmission_Engine_Crank_Enable "EcuIntgdSwGend/ControlSoftware/EcuInpPrcsg/CAN Signals/SPN 2900 - Transmission Engine Crank Enable"
 /begin REF_CHARACTERISTIC EIP_CanTrsmEngCrkEnaOvs_P EIP_CanTrsmEngCrkEnaOvv_P EIP_StOfCanTrsmEngCrkEnaOvs_P EIP_StOfCanTrsmEngCrkEnaOvv_P /end REF_CHARACTERISTIC
 /begin REF_MEASUREMENT EIP_CanTrsmEngCrkEna EIP_StOfCanTrsmEngCrkEna /end REF_MEASUREMENT
/end GROUP
/begin GROUP S83_SPN_2978___Estimated_Engine_Parasitic_Losses___Percent_Torque "EcuIntgdSwGend/ControlSoftware/EcuInpPrcsg/CAN Signals/SPN 2978 - Estimated Engine Parasitic Losses - Percent Torque"
 /begin REF_CHARACTERISTIC EIP_CanEstimdEngParasiticTqOvs_P EIP_CanEstimdEngParasiticTqOvv_P EIP_StOfCanEstimdEngParasiticTqOvs_P EIP_StOfCanEstimdEngParasiticTqOvv_P /end REF_CHARACTERISTIC
 /begin REF_MEASUREMENT EIP_CanEstimdEngParasiticTq EIP_StOfCanEstimdEngParasiticTq /end REF_MEASUREMENT
/end GROUP
/begin GROUP S83_SPN_3030___Transmission_Torque_Converter_Ratio "EcuIntgdSwGend/ControlSoftware/EcuInpPrcsg/CAN Signals/SPN 3030 - Transmission Torque Converter Ratio"
 /begin REF_CHARACTERISTIC EIP_CanTrsmTqCnvrRatOvs_P EIP_CanTrsmTqCnvrRatOvv_P EIP_StOfCanTrsmTqCnvrRatOvs_P EIP_StOfCanTrsmTqCnvrRatOvv_P /end REF_CHARACTERISTIC
 /begin REF_MEASUREMENT EIP_CanTrsmTqCnvrRat EIP_StOfCanTrsmTqCnvrRat /end REF_MEASUREMENT
/end GROUP
/begin GROUP S83_SPN_3645___Transfer_Case_Status "EcuIntgdSwGend/ControlSoftware/EcuInpPrcsg/CAN Signals/SPN 3645 - Transfer Case Status"
 /begin REF_CHARACTERISTIC EIP_CanTrfCaseStsOvs_P EIP_CanTrfCaseStsOvv_P EIP_StOfCanTrfCaseStsOvs_P EIP_StOfCanTrfCaseStsOvv_P /end REF_CHARACTERISTIC
 /begin REF_MEASUREMENT EIP_CanTrfCaseSts EIP_StOfCanTrfCaseSts /end REF_MEASUREMENT
/end GROUP
/begin GROUP S83_SPN_3809___Transmission_Oil_Level_Request "EcuIntgdSwGend/ControlSoftware/EcuInpPrcsg/CAN Signals/SPN 3809 - Transmission Oil Level Request"
 /begin REF_CHARACTERISTIC EIP_CanTrsmOilLvlReqOvs_P EIP_CanTrsmOilLvlReqOvv_P EIP_StOfCanTrsmOilLvlReqOvs_P EIP_StOfCanTrsmOilLvlReqOvv_P /end REF_CHARACTERISTIC
 /begin REF_MEASUREMENT EIP_CanTrsmOilLvlReq EIP_StOfCanTrsmOilLvlReq /end REF_MEASUREMENT
/end GROUP
/begin GROUP S83_SPN_4191___Engine_Requested_Torque___High_Resolution "EcuIntgdSwGend/ControlSoftware/EcuInpPrcsg/CAN Signals/SPN 4191 - Engine Requested Torque - High Resolution"
 /begin REF_CHARACTERISTIC EIP_CanEngReqTqHiReslOvs_P EIP_CanEngReqTqHiReslOvv_P EIP_StOfCanEngReqTqHiReslOvs_P EIP_StOfCanEngReqTqHiReslOvv_P /end REF_CHARACTERISTIC
 /begin REF_MEASUREMENT EIP_CanEngReqTqHiResl EIP_StOfCanEngReqTqHiResl /end REF_MEASUREMENT
/end GROUP
/begin GROUP S83_SPN_4206___Message_Counter "EcuIntgdSwGend/ControlSoftware/EcuInpPrcsg/CAN Signals/SPN 4206 - Message Counter"
 /begin REF_CHARACTERISTIC EIP_CanTSC1MessageCntrOvs_P EIP_CanTSC1MessageCntrOvv_P EIP_StOfCanTSC1MessageCntrOvs_P EIP_StOfCanTSC1MessageCntrOvv_P /end REF_CHARACTERISTIC
 /begin REF_MEASUREMENT EIP_CanTSC1MessageCntr EIP_StOfCanTSC1MessageCntr /end REF_MEASUREMENT
/end GROUP
/begin GROUP S83_SPN_518___Engine_Requested_Torque__Torque_Limit "EcuIntgdSwGend/ControlSoftware/EcuInpPrcsg/CAN Signals/SPN 518 - Engine Requested Torque//Torque Limit"
 /begin REF_CHARACTERISTIC EIP_CanEngTqReqOvs_P EIP_CanEngTqReqOvv_P EIP_StOfCanEngTqReqOvs_P EIP_StOfCanEngTqReqOvv_P /end REF_CHARACTERISTIC
 /begin REF_MEASUREMENT EIP_CanEngTqReq EIP_StOfCanEngTqReq /end REF_MEASUREMENT
/end GROUP
/begin GROUP S83_SPN_522___Percent_Clutch_Slip "EcuIntgdSwGend/ControlSoftware/EcuInpPrcsg/CAN Signals/SPN 522 - Percent Clutch Slip"
 /begin REF_CHARACTERISTIC EIP_CanPercCluSlipOvs_P EIP_CanPercCluSlipOvv_P EIP_StOfCanPercCluSlipOvs_P EIP_StOfCanPercCluSlipOvv_P /end REF_CHARACTERISTIC
 /begin REF_MEASUREMENT EIP_CanPercCluSlip EIP_StOfCanPercCluSlip /end REF_MEASUREMENT
/end GROUP
/begin GROUP S83_SPN_523___Transmission_Current_Gear "EcuIntgdSwGend/ControlSoftware/EcuInpPrcsg/CAN Signals/SPN 523 - Transmission Current Gear"
 /begin REF_CHARACTERISTIC EIP_CanTrsmCurrentGearOvs_P EIP_CanTrsmCurrentGearOvv_P EIP_StOfCanTrsmCurrentGearOvs_P EIP_StOfCanTrsmCurrentGearOvv_P /end REF_CHARACTERISTIC
 /begin REF_MEASUREMENT EIP_CanTrsmCurrentGear EIP_StOfCanTrsmCurrentGear /end REF_MEASUREMENT
/end GROUP
/begin GROUP S83_SPN_524___Transmission_Selected_Gear "EcuIntgdSwGend/ControlSoftware/EcuInpPrcsg/CAN Signals/SPN 524 - Transmission Selected Gear"
 /begin REF_CHARACTERISTIC EIP_CanTrsmSeldGearOvs_P EIP_CanTrsmSeldGearOvv_P EIP_StOfCanTrsmSeldGearOvs_P EIP_StOfCanTrsmSeldGearOvv_P /end REF_CHARACTERISTIC
 /begin REF_MEASUREMENT EIP_CanTrsmSeldGear EIP_StOfCanTrsmSeldGear /end REF_MEASUREMENT
/end GROUP
/begin GROUP S83_SPN_526___Transmission_Actual_Gear_Ratio "EcuIntgdSwGend/ControlSoftware/EcuInpPrcsg/CAN Signals/SPN 526 - Transmission Actual Gear Ratio"
 /begin REF_CHARACTERISTIC EIP_CanTrsmActGearRatOvs_P EIP_CanTrsmActGearRatOvv_P EIP_StOfCanTrsmActGearRatOvs_P EIP_StOfCanTrsmActGearRatOvv_P /end REF_CHARACTERISTIC
 /begin REF_MEASUREMENT EIP_CanTrsmActGearRat EIP_StOfCanTrsmActGearRat /end REF_MEASUREMENT
/end GROUP
/begin GROUP S83_SPN_561___ASR_Engine_Control_Active "EcuIntgdSwGend/ControlSoftware/EcuInpPrcsg/CAN Signals/SPN 561 - ASR Engine Control Active"
 /begin REF_CHARACTERISTIC EIP_CanASREngCtrlActvOvs_P EIP_CanASREngCtrlActvOvv_P EIP_StOfCanASREngCtrlActvOvs_P EIP_StOfCanASREngCtrlActvOvv_P /end REF_CHARACTERISTIC
 /begin REF_MEASUREMENT EIP_CanASREngCtrlActv EIP_StOfCanASREngCtrlActv /end REF_MEASUREMENT
/end GROUP
/begin GROUP S83_SPN_562___ASR_Brake_Control_Active "EcuIntgdSwGend/ControlSoftware/EcuInpPrcsg/CAN Signals/SPN 562 - ASR Brake Control Active"
 /begin REF_CHARACTERISTIC EIP_CanASRBrkCtrlActvOvs_P EIP_CanASRBrkCtrlActvOvv_P EIP_StOfCanASRBrkCtrlActvOvs_P EIP_StOfCanASRBrkCtrlActvOvv_P /end REF_CHARACTERISTIC
 /begin REF_MEASUREMENT EIP_CanASRBrkCtrlActv EIP_StOfCanASRBrkCtrlActv /end REF_MEASUREMENT
/end GROUP
/begin GROUP S83_SPN_563___Anti_Lock_Braking__ABS__Active "EcuIntgdSwGend/ControlSoftware/EcuInpPrcsg/CAN Signals/SPN 563 - Anti-Lock Braking (ABS) Active"
 /begin REF_CHARACTERISTIC EIP_CanABSActvOvs_P EIP_CanABSActvOvv_P EIP_StOfCanABSActvOvs_P EIP_StOfCanABSActvOvv_P /end REF_CHARACTERISTIC
 /begin REF_MEASUREMENT EIP_CanABSActv EIP_StOfCanABSActv /end REF_MEASUREMENT
/end GROUP
/begin GROUP S83_SPN_573___Transmission_Torque_Converter_Lockup_Engaged "EcuIntgdSwGend/ControlSoftware/EcuInpPrcsg/CAN Signals/SPN 573 - Transmission Torque Converter Lockup Engaged"
 /begin REF_CHARACTERISTIC EIP_CanTrsmTqCnvLockUpEngdOvs_P EIP_CanTrsmTqCnvLockUpEngdOvv_P EIP_StOfCanTrsmTqCnvLockUpEngdOvs_P EIP_StOfCanTrsmTqCnvLockUpEngdOvv_P /end REF_CHARACTERISTIC
 /begin REF_MEASUREMENT EIP_CanTrsmTqCnvLockUpEngd EIP_StOfCanTrsmTqCnvLockUpEngd /end REF_MEASUREMENT
/end GROUP
/begin GROUP S83_SPN_596___Cruise_Control_Enable_Switch "EcuIntgdSwGend/ControlSoftware/EcuInpPrcsg/CAN Signals/SPN 596 - Cruise Control Enable Switch"
 /begin REF_CHARACTERISTIC EIP_CanCrsCtrlEnaSwtOvs_P EIP_CanCrsCtrlEnaSwtOvv_P EIP_StOfCanCrsCtrlEnaSwtOvs_P EIP_StOfCanCrsCtrlEnaSwtOvv_P /end REF_CHARACTERISTIC
 /begin REF_MEASUREMENT EIP_CanCrsCtrlEnaSwt EIP_StOfCanCrsCtrlEnaSwt /end REF_MEASUREMENT
/end GROUP
/begin GROUP S83_SPN_599___Cruise_Control_Set_Switch "EcuIntgdSwGend/ControlSoftware/EcuInpPrcsg/CAN Signals/SPN 599 - Cruise Control Set Switch"
 /begin REF_CHARACTERISTIC EIP_CanCrsCtrlSetSwtOvs_P EIP_CanCrsCtrlSetSwtOvv_P EIP_StOfCanCrsCtrlSetSwtOvs_P EIP_StOfCanCrsCtrlSetSwtOvv_P /end REF_CHARACTERISTIC
 /begin REF_MEASUREMENT EIP_CanCrsCtrlSetSwt EIP_StOfCanCrsCtrlSetSwt /end REF_MEASUREMENT
/end GROUP
/begin GROUP S83_SPN_601___Cruise_Control_Resume_Switch "EcuIntgdSwGend/ControlSoftware/EcuInpPrcsg/CAN Signals/SPN 601 - Cruise Control Resume Switch"
 /begin REF_CHARACTERISTIC EIP_CanCrsCtrlResuSwtOvs_P EIP_CanCrsCtrlResuSwtOvv_P EIP_StOfCanCrsCtrlResuSwtOvs_P EIP_StOfCanCrsCtrlResuSwtOvv_P /end REF_CHARACTERISTIC
 /begin REF_MEASUREMENT EIP_CanCrsCtrlResuSwt EIP_StOfCanCrsCtrlResuSwt /end REF_MEASUREMENT
/end GROUP
/begin GROUP S83_SPN_695___Engine_Override_Control_Mode "EcuIntgdSwGend/ControlSoftware/EcuInpPrcsg/CAN Signals/SPN 695 - Engine Override Control Mode"
 /begin REF_CHARACTERISTIC EIP_CanEngOvrdCtrlModOvs_P EIP_CanEngOvrdCtrlModOvv_P EIP_StOfCanEngOvrdCtrlModOvs_P EIP_StOfCanEngOvrdCtrlModOvv_P /end REF_CHARACTERISTIC
 /begin REF_MEASUREMENT EIP_CanEngOvrdCtrlMod EIP_StOfCanEngOvrdCtrlMod /end REF_MEASUREMENT
/end GROUP
/begin GROUP S83_SPN_84___Wheel_Based_Vehicle_Speed "EcuIntgdSwGend/ControlSoftware/EcuInpPrcsg/CAN Signals/SPN 84 - Wheel-Based Vehicle Speed"
 /begin REF_CHARACTERISTIC EIP_CanWhlBasVehSpdOvs_P EIP_CanWhlBasVehSpdOvv_P EIP_StOfCanWhlBasVehSpdOvs_P EIP_StOfCanWhlBasVehSpdOvv_P /end REF_CHARACTERISTIC
 /begin REF_MEASUREMENT EIP_CanWhlBasVehSpd EIP_StOfCanWhlBasVehSpd /end REF_MEASUREMENT
/end GROUP
/begin GROUP S83_SPN_897___Override_Control_Mode_Priority "EcuIntgdSwGend/ControlSoftware/EcuInpPrcsg/CAN Signals/SPN 897 - Override Control Mode Priority"
 /begin REF_CHARACTERISTIC EIP_CanOvrdCtrlModPrioOvs_P EIP_CanOvrdCtrlModPrioOvv_P EIP_StOfCanOvrdCtrlModPrioOvs_P EIP_StOfCanOvrdCtrlModPrioOvv_P /end REF_CHARACTERISTIC
 /begin REF_MEASUREMENT EIP_CanOvrdCtrlModPrio EIP_StOfCanOvrdCtrlModPrio /end REF_MEASUREMENT
/end GROUP
/begin GROUP S83_SPN_898___Engine_Requested_Speed__Speed_Limit "EcuIntgdSwGend/ControlSoftware/EcuInpPrcsg/CAN Signals/SPN 898 - Engine Requested Speed//Speed Limit"
 /begin REF_CHARACTERISTIC EIP_CanEngSpdReqOvs_P EIP_CanEngSpdReqOvv_P EIP_StOfCanEngSpdReqOvs_P EIP_StOfCanEngSpdReqOvv_P /end REF_CHARACTERISTIC
 /begin REF_MEASUREMENT EIP_CanEngSpdReq EIP_StOfCanEngSpdReq /end REF_MEASUREMENT
/end GROUP
/begin GROUP S83_SPN_96___Fuel_Level_1 "EcuIntgdSwGend/ControlSoftware/EcuInpPrcsg/CAN Signals/SPN 96 - Fuel Level 1"
 /begin REF_CHARACTERISTIC EIP_CanFuLvl1Ovs_P EIP_CanFuLvl1Ovv_P EIP_StOfCanFuLvl1Ovs_P EIP_StOfCanFuLvl1Ovv_P /end REF_CHARACTERISTIC
 /begin REF_MEASUREMENT EIP_CanFuLvl1 EIP_StOfCanFuLvl1 /end REF_MEASUREMENT
/end GROUP
/begin GROUP S83_SPN_970___Engine_Auxiliary_Shutdown_Switch "EcuIntgdSwGend/ControlSoftware/EcuInpPrcsg/CAN Signals/SPN 970 - Engine Auxiliary Shutdown Switch"
 /begin REF_CHARACTERISTIC EIP_CanEngAuxShtdwnSwtOvs_P EIP_CanEngAuxShtdwnSwtOvv_P EIP_StOfCanEngAuxShtdwnSwtOvs_P EIP_StOfCanEngAuxShtdwnSwtOvv_P /end REF_CHARACTERISTIC
 /begin REF_MEASUREMENT EIP_CanEngAuxShtdwnSwt EIP_StOfCanEngAuxShtdwnSwt /end REF_MEASUREMENT
/end GROUP
/begin GROUP S83_SPN_975___Estimated_Percent_Fan_Speed "EcuIntgdSwGend/ControlSoftware/EcuInpPrcsg/CAN Signals/SPN 975 - Estimated Percent Fan Speed"
 /begin REF_CHARACTERISTIC EIP_CanEstimdPercFanSpdOvs_P EIP_CanEstimdPercFanSpdOvv_P EIP_StOfCanEstimdPercFanSpdOvs_P EIP_StOfCanEstimdPercFanSpdOvv_P /end REF_CHARACTERISTIC
 /begin REF_MEASUREMENT EIP_CanEstimdPercFanSpd EIP_StOfCanEstimdPercFanSpd /end REF_MEASUREMENT
/end GROUP
/begin GROUP S83_SPN_979___Engine_Remote_PTO_Governor_Pregrogrammed_Speed_Control_Switch "EcuIntgdSwGend/ControlSoftware/EcuInpPrcsg/CAN Signals/SPN 979 - Engine Remote PTO Governor Pregrogrammed Speed Control Switch"
 /begin REF_CHARACTERISTIC EIP_CanEngRemPtoGovrProgdSpdCtrlSwtOvs_P EIP_CanEngRemPtoGovrProgdSpdCtrlSwtOvv_P EIP_StOfCanEngRemPtoGovrSpdCtrlSwtOvs_P EIP_StOfCanEngRemPtoGovrSpdCtrlSwtOvv_P /end REF_CHARACTERISTIC
 /begin REF_MEASUREMENT EIP_CanEngRemPtoGovrProgdSpdCtrlSwt EIP_StOfCanEngRemPtoGovrSpdCtrlSwt /end REF_MEASUREMENT
/end GROUP
/begin GROUP S83_SPN_980___Engine_PTO_Governor_Enable_Switch "EcuIntgdSwGend/ControlSoftware/EcuInpPrcsg/CAN Signals/SPN 980 - Engine PTO Governor Enable Switch"
 /begin REF_CHARACTERISTIC EIP_CanEngPtoGovrEnaSwtOvs_P EIP_CanEngPtoGovrEnaSwtOvv_P EIP_StOfCanEngPtoGovrEnaSwtOvs_P EIP_StOfCanEngPtoGovrEnaSwtOvv_P /end REF_CHARACTERISTIC
 /begin REF_MEASUREMENT EIP_CanEngPtoGovrEnaSwt EIP_StOfCanEngPtoGovrEnaSwt /end REF_MEASUREMENT
/end GROUP
/begin GROUP S83_SPN_981___Engine_PTO_Governor_Accelerate_Switch "EcuIntgdSwGend/ControlSoftware/EcuInpPrcsg/CAN Signals/SPN 981 - Engine PTO Governor Accelerate Switch"
 /begin REF_CHARACTERISTIC EIP_CanEngPtoGovrAccrSwtOvs_P EIP_CanEngPtoGovrAccrSwtOvv_P EIP_StOfCanEngPtoGovrAccrSwtOvs_P EIP_StOfCanEngPtoGovrAccrSwtOvv_P /end REF_CHARACTERISTIC
 /begin REF_MEASUREMENT EIP_CanEngPtoGovrAccrSwt EIP_StOfCanEngPtoGovrAccrSwt /end REF_MEASUREMENT
/end GROUP
/begin GROUP S83_SPN_982___Engine_PTO_Governor_Resume_Switch "EcuIntgdSwGend/ControlSoftware/EcuInpPrcsg/CAN Signals/SPN 982 - Engine PTO Governor Resume Switch"
 /begin REF_CHARACTERISTIC EIP_CanEngPtoGovrResuSwtOvs_P EIP_CanEngPtoGovrResuSwtOvv_P EIP_StOfCanEngPtoGovrResuSwtOvs_P EIP_StOfCanEngPtoGovrResuSwtOvv_P /end REF_CHARACTERISTIC
 /begin REF_MEASUREMENT EIP_CanEngPtoGovrResuSwt EIP_StOfCanEngPtoGovrResuSwt /end REF_MEASUREMENT
/end GROUP
/begin GROUP S83_SPN_983___Engine_PTO_Governor_Coast__Decelerate_Switch "EcuIntgdSwGend/ControlSoftware/EcuInpPrcsg/CAN Signals/SPN 983 - Engine PTO Governor Coast//Decelerate Switch"
 /begin REF_CHARACTERISTIC EIP_CanEngPtoGovrCoastSwtOvs_P EIP_CanEngPtoGovrCoastSwtOvv_P EIP_StOfCanEngPtoGovrCoastSwtOvs_P EIP_StOfCanEngPtoGovrCoastSwtOvv_P /end REF_CHARACTERISTIC
 /begin REF_MEASUREMENT EIP_CanEngPtoGovrCoastSwt EIP_StOfCanEngPtoGovrCoastSwt /end REF_MEASUREMENT
/end GROUP
/begin GROUP S83_SPN_984___Engine_PTO_Governor_Set_Switch "EcuIntgdSwGend/ControlSoftware/EcuInpPrcsg/CAN Signals/SPN 984 - Engine PTO Governor Set Switch"
 /begin REF_CHARACTERISTIC EIP_CanEngPtoGovrSetSwtOvs_P EIP_CanEngPtoGovrSetSwtOvv_P EIP_StOfCanEngPtoGovrSetSwtOvs_P EIP_StOfCanEngPtoGovrSetSwtOvv_P /end REF_CHARACTERISTIC
 /begin REF_MEASUREMENT EIP_CanEngPtoGovrSetSwt EIP_StOfCanEngPtoGovrSetSwt /end REF_MEASUREMENT
/end GROUP
/begin GROUP S83_SPN_986___Requested_Percent_Fan_Speed "EcuIntgdSwGend/ControlSoftware/EcuInpPrcsg/CAN Signals/SPN 986 - Requested Percent Fan Speed"
 /begin REF_CHARACTERISTIC EIP_CanReqdPercFanSpdOvs_P EIP_CanReqdPercFanSpdOvv_P EIP_StOfCanReqdPercFanSpdOvs_P EIP_StOfCanReqdPercFanSpdOvv_P /end REF_CHARACTERISTIC
 /begin REF_MEASUREMENT EIP_CanReqdPercFanSpd EIP_StOfCanReqdPercFanSpd /end REF_MEASUREMENT
/end GROUP
/begin GROUP S85_Debouncer1 "EcuIntgdSwGend/ControlSoftware/EcuInpPrcsg/Driver Commands/Debouncer1" /begin REF_MEASUREMENT EIP_TiElpdStrtReqSwt /end REF_MEASUREMENT /end GROUP
/begin GROUP S85_Debouncer10 "EcuIntgdSwGend/ControlSoftware/EcuInpPrcsg/Driver Commands/Debouncer10" /begin REF_MEASUREMENT EIP_TiElpdHandBrkPrkg /end REF_MEASUREMENT /end GROUP
/begin GROUP S85_Debouncer11 "EcuIntgdSwGend/ControlSoftware/EcuInpPrcsg/Driver Commands/Debouncer11" /begin REF_MEASUREMENT EIP_TiElpdEngBrkReq1Btn /end REF_MEASUREMENT /end GROUP
/begin GROUP S85_Debouncer12 "EcuIntgdSwGend/ControlSoftware/EcuInpPrcsg/Driver Commands/Debouncer12" /begin REF_MEASUREMENT EIP_TiElpdEngBrkReq2Btn /end REF_MEASUREMENT /end GROUP
/begin GROUP S85_Debouncer2 "EcuIntgdSwGend/ControlSoftware/EcuInpPrcsg/Driver Commands/Debouncer2" /begin REF_MEASUREMENT EIP_TiElpdBrkPedl /end REF_MEASUREMENT /end GROUP
/begin GROUP S85_Debouncer3 "EcuIntgdSwGend/ControlSoftware/EcuInpPrcsg/Driver Commands/Debouncer3" /begin REF_MEASUREMENT EIP_TiElpdIgnSwt /end REF_MEASUREMENT /end GROUP
/begin GROUP S85_Debouncer4 "EcuIntgdSwGend/ControlSoftware/EcuInpPrcsg/Driver Commands/Debouncer4" /begin REF_MEASUREMENT EIP_TiElpdCrsCtrlOnOffBtn /end REF_MEASUREMENT /end GROUP
/begin GROUP S85_Debouncer5 "EcuIntgdSwGend/ControlSoftware/EcuInpPrcsg/Driver Commands/Debouncer5" /begin REF_MEASUREMENT EIP_TiElpdDecCrsCtrlBtn /end REF_MEASUREMENT /end GROUP
/begin GROUP S85_Debouncer6 "EcuIntgdSwGend/ControlSoftware/EcuInpPrcsg/Driver Commands/Debouncer6" /begin REF_MEASUREMENT EIP_TiElpdAcvCmbtSwt /end REF_MEASUREMENT /end GROUP
/begin GROUP S85_Debouncer7 "EcuIntgdSwGend/ControlSoftware/EcuInpPrcsg/Driver Commands/Debouncer7" /begin REF_MEASUREMENT EIP_TiElpdIncCrsCtrlBtn /end REF_MEASUREMENT /end GROUP
/begin GROUP S85_Debouncer8 "EcuIntgdSwGend/ControlSoftware/EcuInpPrcsg/Driver Commands/Debouncer8" /begin REF_MEASUREMENT EIP_TiElpdTroubleshootingBtn /end REF_MEASUREMENT /end GROUP
/begin GROUP S86_Engine_Brake_Configuration "EcuIntgdSwGend/ControlSoftware/EcuInpPrcsg/ECU Configuration/Engine Brake Configuration" /begin REF_CHARACTERISTIC EIP_EngBrkCfg_P /end REF_CHARACTERISTIC /begin REF_MEASUREMENT EIP_EngBrkCfg /end REF_MEASUREMENT /end GROUP
/begin GROUP S86_Engine_Brake_Level_Configuration "EcuIntgdSwGend/ControlSoftware/EcuInpPrcsg/ECU Configuration/Engine Brake Level Configuration" /begin REF_CHARACTERISTIC EIP_EngBrkLvlCfg_P /end REF_CHARACTERISTIC /begin REF_MEASUREMENT EIP_EngBrkLvlCfg /end REF_MEASUREMENT /end GROUP
/begin GROUP S86_Injector_Configuration "EcuIntgdSwGend/ControlSoftware/EcuInpPrcsg/ECU Configuration/Injector Configuration" /begin REF_CHARACTERISTIC EIP_InjrCfg_C /end REF_CHARACTERISTIC /begin REF_MEASUREMENT EIP_InjrCfg /end REF_MEASUREMENT /end GROUP
/begin GROUP S86_Wastegate_Configuration "EcuIntgdSwGend/ControlSoftware/EcuInpPrcsg/ECU Configuration/Wastegate Configuration" /begin REF_CHARACTERISTIC EIP_WgCfg_P /end REF_CHARACTERISTIC /begin REF_MEASUREMENT EIP_WgCfg /end REF_MEASUREMENT /end GROUP
/begin GROUP S87_Battery_Voltage_Diagnostics_Info "EcuIntgdSwGend/ControlSoftware/EcuInpPrcsg/Electrical Contact Signals/Battery Voltage Diagnostics Info"
 /begin REF_CHARACTERISTIC EG_DiagcSnsrFltInfoNone_C EG_DiagcSnsrInfoUClmp30_C EG_Mask32Bit0_C EG_Mask32Bit256_C EG_Mask32Bit512_C /end REF_CHARACTERISTIC
/end GROUP
/begin GROUP S87_Debouncer "EcuIntgdSwGend/ControlSoftware/EcuInpPrcsg/Electrical Contact Signals/Debouncer" /begin REF_MEASUREMENT EIP_TiElpdErrUClmp30 /end REF_MEASUREMENT /end GROUP
/begin GROUP S87_LowPassFilter1 "EcuIntgdSwGend/ControlSoftware/EcuInpPrcsg/Electrical Contact Signals/LowPassFilter1" /begin REF_CHARACTERISTIC EG_NmrSng0_C EG_bFlgTrue_C /end REF_CHARACTERISTIC /begin REF_MEASUREMENT EIP_UClmp30Fild /end REF_MEASUREMENT /end GROUP
/begin GROUP S90_Level_Sensor_Errors "EcuIntgdSwGend/ControlSoftware/EcuInpPrcsg/Level Sensor Signals/Level Sensor Errors"
 /begin SUB_GROUP S187_Debouncer1 S187_Level_Sensor_Diagnostics_Info S187_LowPassFilter2 /end SUB_GROUP
 /begin REF_CHARACTERISTIC EG_NmrSng0_C EG_TsSw20_C EIP_GrdtLvlOil_P EIP_LvlOilMax_P EIP_LvlOilMin_P EIP_TcLvlOilFil_P EIP_TiLvlOilSnsrDeb_P EIP_bErrLvlOilSnsrOvs_P EIP_bErrLvlOilSnsrOvv_P /end REF_CHARACTERISTIC
 /begin REF_MEASUREMENT EIP_LvlOilGrdtAbsOut EIP_bErrLvlOilGrdt EIP_bErrLvlOilRng EIP_bErrLvlOilSnsr /end REF_MEASUREMENT
/end GROUP
/begin GROUP S92_Accelerator_Pedal_Sensor_Monitoring "EcuIntgdSwGend/ControlSoftware/EcuInpPrcsg/Position & Speed Sensor Signals/Accelerator Pedal Sensor Monitoring"
 /begin SUB_GROUP S193_Debouncer1 S193_Debouncer5 S193_Debouncer6 S193_Derv S193_Derv1 S193_Derv2 S193_Derv3 /end SUB_GROUP
 /begin REF_CHARACTERISTIC EG_NmrSng0_C EG_TsSw_C EIP_PercgAccr1Max_P EIP_PercgAccr1Min_P EIP_PercgAccr2Max_P EIP_PercgAccr2Min_P EIP_PercgAccrDiffThd_P EIP_TiDebAccrDervThd_P EIP_bErrAccr1And2OorOvs_P EIP_bErrAccr1And2OorOvv_P EIP_bErrAccrRedncyOvs_P EIP_bErrAccrRedncyOvv_P /end REF_CHARACTERISTIC
 /begin REF_MEASUREMENT EIP_PercgAccrDiff EIP_bErrAccr1 EIP_bErrAccr1Oor EIP_bErrAccr2 EIP_bErrAccr2Oor EIP_bErrAccrDervDiff EIP_bErrAccrRedncy EIP_bErrAccrTotLoss EIP_bPercgAccrDiffDetn /end REF_MEASUREMENT
/end GROUP
/begin GROUP S92_Accelerator_Under_Over_Condition "EcuIntgdSwGend/ControlSoftware/EcuInpPrcsg/Position & Speed Sensor Signals/Accelerator Under Over Condition" /begin SUB_GROUP S194_SetRstLtch1 S194_SetRstLtch2 /end SUB_GROUP
 /begin REF_CHARACTERISTIC EIP_PercgAccrMaxHysThd_P EIP_PercgAccrMaxThd_P EIP_PercgAccrMax_P EIP_PercgAccrMinHysThd_P EIP_PercgAccrMinThd_P EIP_PercgAccrMin_P /end REF_CHARACTERISTIC
/end GROUP
/begin GROUP S92_Engine_Shutdown_Overspeed "EcuIntgdSwGend/ControlSoftware/EcuInpPrcsg/Position & Speed Sensor Signals/Engine Shutdown Overspeed" /begin SUB_GROUP S195_Debouncer3 /end SUB_GROUP
 /begin REF_CHARACTERISTIC EG_NmrSng0_C EG_TsSw_C EIP_NEngEmgcyShtdwnForOvspd_P EIP_TiAcvEmgcyShtdwnForOvspdDeb_P EIP_bAcvEmgcyShtdwnForOvspdOvs_P EIP_bAcvEmgcyShtdwnForOvspdOvv_P /end REF_CHARACTERISTIC
 /begin REF_MEASUREMENT EIP_bAcvEmgcyShtdwnForOvspd /end REF_MEASUREMENT
/end GROUP
/begin GROUP S92_LowPassFilter "EcuIntgdSwGend/ControlSoftware/EcuInpPrcsg/Position & Speed Sensor Signals/LowPassFilter" /begin REF_CHARACTERISTIC EG_NmrSng0_C EG_bFlgTrue_C /end REF_CHARACTERISTIC /end GROUP
/begin GROUP S92_LowPassFilter1 "EcuIntgdSwGend/ControlSoftware/EcuInpPrcsg/Position & Speed Sensor Signals/LowPassFilter1" /begin REF_CHARACTERISTIC EG_NmrSng0_C EG_bFlgTrue_C /end REF_CHARACTERISTIC /end GROUP
/begin GROUP S92_LowPassFilter2 "EcuIntgdSwGend/ControlSoftware/EcuInpPrcsg/Position & Speed Sensor Signals/LowPassFilter2" /begin REF_CHARACTERISTIC EG_NmrSng0_C EG_bFlgTrue_C /end REF_CHARACTERISTIC /end GROUP
/begin GROUP S92_LowPassFilter3 "EcuIntgdSwGend/ControlSoftware/EcuInpPrcsg/Position & Speed Sensor Signals/LowPassFilter3" /begin REF_CHARACTERISTIC EG_NmrSng0_C EG_bFlgTrue_C /end REF_CHARACTERISTIC /end GROUP
/begin GROUP S92_LowPassFilter4 "EcuIntgdSwGend/ControlSoftware/EcuInpPrcsg/Position & Speed Sensor Signals/LowPassFilter4" /begin REF_CHARACTERISTIC EG_NmrSng0_C EG_bFlgTrue_C /end REF_CHARACTERISTIC /end GROUP
/begin GROUP S93_Pressure_Sensor_Errors "EcuIntgdSwGend/ControlSoftware/EcuInpPrcsg/Pressure Sensor Signals/Pressure Sensor Errors"
 /begin SUB_GROUP S212_Debouncer S212_Debouncer2 S212_Debouncer3 S212_Debouncer4 S212_Debouncer5 S212_LowPassFilter1 S212_LowPassFilter4 S212_LowPassFilter5 S212_LowPassFilter6 S212_LowPassFilter7 S212_Pressure_Sensor_Diagnostic_Info /end SUB_GROUP
 /begin REF_CHARACTERISTIC EG_NmrSng0_C EG_NmrSng1000_C EG_TsSw_C EIP_GrdtPAirBoost_P EIP_GrdtPAmbAir_P EIP_GrdtPFu_P EIP_GrdtPOil_P EIP_GrdtPRail_P EIP_PAirBoostMax_P EIP_PAirBoostMin_P EIP_PAmbAirMax_P EIP_PAmbAirMin_P EIP_PFuMax_P EIP_PFuMin_P EIP_POilMax_P EIP_POilMin_P EIP_PRailMax_P EIP_PRailMin_P EIP_TcPAirBoostFil_P EIP_TcPAmbAirFil_P EIP_TcPFuFil_P EIP_TcPOilFil_P EIP_TcPRailFil_P EIP_TiPAirBoostSnsrDeb_P EIP_TiPAmbAirSnsrDeb_P EIP_TiPFuSnsrDeb_P EIP_TiPOilSnsrDeb_P EIP_TiPRailSnsrDeb_P EIP_bErrPAirBoostSnsrOvs_P EIP_bErrPAirBoostSnsrOvv_P EIP_bErrPAmbAirSnsrOvs_P EIP_bErrPAmbAirSnsrOvv_P EIP_bErrPFuSnsrOvs_P EIP_bErrPFuSnsrOvv_P EIP_bErrPOilSnsrOvs_P EIP_bErrPOilSnsrOvv_P EIP_bErrPRailSnsrOvs_P EIP_bErrPRailSnsrOvv_P /end REF_CHARACTERISTIC
 /begin REF_MEASUREMENT EIP_PAirBoostGrdtAbsOut EIP_PAmbAirGrdtAbsOut EIP_PFuGrdtAbsOut EIP_POilGrdtAbsOut EIP_PRailGrdtAbsOut EIP_bErrPAirBoostGrdt EIP_bErrPAirBoostRng EIP_bErrPAirBoostSnsr EIP_bErrPAmbAirGrdt EIP_bErrPAmbAirRng EIP_bErrPAmbAirSnsr EIP_bErrPFuGrdt EIP_bErrPFuRng EIP_bErrPFuSnsr EIP_bErrPOilGrdt EIP_bErrPOilRng EIP_bErrPOilSnsr EIP_bErrPRailGrdt EIP_bErrPRailRng EIP_bErrPRailSnsr /end REF_MEASUREMENT
/end GROUP
/begin GROUP S96_Temperature_Sensor_Errors "EcuIntgdSwGend/ControlSoftware/EcuInpPrcsg/Temperature Sensor Signals/Temperature Sensor Errors"
 /begin SUB_GROUP S234_Debouncer S234_Debouncer1 S234_Debouncer3 S234_Debouncer4 S234_Debouncer5 S234_Debouncer7 S234_LowPassFilter1 S234_LowPassFilter2 S234_LowPassFilter4 S234_LowPassFilter5 S234_LowPassFilter6 S234_LowPassFilter8 S234_Temperature_Sensor_Diagnostic_Info /end SUB_GROUP
 /begin REF_CHARACTERISTIC EG_NmrSng0_C EG_TsSw20_C EIP_GrdtTAirBoost_P EIP_GrdtTAmbAir_P EIP_GrdtTCoolt_P EIP_GrdtTEcu_P EIP_GrdtTFu_P EIP_GrdtTOil_P EIP_TAirBoostMax_P EIP_TAirBoostMin_P EIP_TAmbAirMax_P EIP_TAmbAirMin_P EIP_TCooltMax_P EIP_TCooltMin_P EIP_TCooltTOilCohThd_P EIP_TEcuMax_P EIP_TEcuMin_P EIP_TFuMax_P EIP_TFuMin_P EIP_TOilMax_P EIP_TOilMin_P EIP_TcTAirBoostFil_P EIP_TcTAmbAirFil_P EIP_TcTCooltFil_P EIP_TcTEcuFil_P EIP_TcTFuFil_P EIP_TcTOilFil_P EIP_TiTAirBoostSnsrDeb_P EIP_TiTAmbAirSnsrDeb_P EIP_TiTCooltSnsrDeb_P EIP_TiTEcuSnsrDeb_P EIP_TiTFuSnsrDeb_P EIP_TiTOilSnsrDeb_P EIP_bErrTAirBoostSnsrOvs_P EIP_bErrTAirBoostSnsrOvv_P EIP_bErrTAmbAirSnsrOvs_P EIP_bErrTAmbAirSnsrOvv_P EIP_bErrTCooltSnsrOvs_P EIP_bErrTCooltSnsrOvv_P EIP_bErrTEcuSnsrOvs_P EIP_bErrTEcuSnsrOvv_P EIP_bErrTFuSnsrOvs_P EIP_bErrTFuSnsrOvv_P EIP_bErrTOilSnsrOvs_P EIP_bErrTOilSnsrOvv_P /end REF_CHARACTERISTIC
 /begin REF_MEASUREMENT EIP_TAirBoostGrdtAbsOut EIP_TAmbAirGrdtAbsOut EIP_TCooltGrdtAbsOut EIP_TEcuGrdtAbsOut EIP_TFuGrdtAbsOut EIP_TOilGrdtAbsOut EIP_bErrTAirBoostGrdt EIP_bErrTAirBoostRng EIP_bErrTAirBoostSnsr EIP_bErrTAmbAirGrdt EIP_bErrTAmbAirRng EIP_bErrTAmbAirSnsr EIP_bErrTCooltGrdt EIP_bErrTCooltRng EIP_bErrTCooltSnsr EIP_bErrTEcuGrdt EIP_bErrTEcuRng EIP_bErrTEcuSnsr EIP_bErrTFuGrdt EIP_bErrTFuRng EIP_bErrTFuSnsr EIP_bErrTOilCoh EIP_bErrTOilGrdt EIP_bErrTOilRng EIP_bErrTOilSnsr /end REF_MEASUREMENT
/end GROUP
/begin GROUP S97_Gear_Based_Vehicle_Speed_Calculation "EcuIntgdSwGend/ControlSoftware/EcuInpPrcsg/Vehicle Velocity Calculation/Gear Based Vehicle Speed Calculation" /begin REF_CHARACTERISTIC EIP_GearSpdCnvnFacForTrsm_P /end REF_CHARACTERISTIC /begin REF_MEASUREMENT EIP_VehVFromGear /end REF_MEASUREMENT /end GROUP
/begin GROUP S97_LowPassFilter "EcuIntgdSwGend/ControlSoftware/EcuInpPrcsg/Vehicle Velocity Calculation/LowPassFilter" /begin REF_CHARACTERISTIC EG_NmrSng0_C EG_bFlgTrue_C /end REF_CHARACTERISTIC /begin REF_MEASUREMENT EIP_VehV /end REF_MEASUREMENT /end GROUP
/begin GROUP S97_Selection_Of_Source_1_and_Source_2 "EcuIntgdSwGend/ControlSoftware/EcuInpPrcsg/Vehicle Velocity Calculation/Selection Of Source 1 and Source 2"
 /begin REF_CHARACTERISTIC EIP_VehSpdSelnNoSrc_C EIP_VehSpdSelnSrc1_P EIP_VehSpdSelnSrc2_P /end REF_CHARACTERISTIC
 /begin REF_MEASUREMENT EIP_StOfVehVSelnFromInpSrc1 EIP_StOfVehVSelnFromInpSrc2 EIP_VehVSelnFromInpSrc1 EIP_VehVSelnFromInpSrc2 /end REF_MEASUREMENT
/end GROUP
/begin GROUP S97_Vehicle_Velocity_Calculation "EcuIntgdSwGend/ControlSoftware/EcuInpPrcsg/Vehicle Velocity Calculation/Vehicle Velocity Calculation" /begin SUB_GROUP S263_Debouncer /end SUB_GROUP
 /begin REF_CHARACTERISTIC EG_NmrInt0_C EG_NmrSng100_C EG_NmrSng10_C EG_TsSw_C EIP_TiVehVDevErrThd_P EIP_VehVDevErrThd_P EIP_VldInpSt_C /end REF_CHARACTERISTIC
 /begin REF_MEASUREMENT EIP_VehVFromSrc1AndSrc2 EIP_VehVRaw EIP_bErrVehV /end REF_MEASUREMENT
/end GROUP
/begin GROUP S269_Neg_Edge "EcuIntgdSwGend/ControlSoftware/EcuModSeln/Cruise Control to Stop Transition/Neg_Edge" /begin REF_CHARACTERISTIC EG_NmrSng0_C /end REF_CHARACTERISTIC /end GROUP
/begin GROUP S274_Neg_Edge "EcuIntgdSwGend/ControlSoftware/EcuModSeln/Idle Speed to Stop Transition/Neg_Edge" /begin REF_CHARACTERISTIC EG_NmrSng0_C /end REF_CHARACTERISTIC /end GROUP
/begin GROUP S277_Neg_Edge "EcuIntgdSwGend/ControlSoftware/EcuModSeln/Overspeed to Stop Transition/Neg_Edge" /begin REF_CHARACTERISTIC EG_NmrSng0_C /end REF_CHARACTERISTIC /end GROUP
/begin GROUP S280_Neg_Edge "EcuIntgdSwGend/ControlSoftware/EcuModSeln/PTO to Stop Transition/Neg_Edge" /begin REF_CHARACTERISTIC EG_NmrSng0_C /end REF_CHARACTERISTIC /end GROUP
/begin GROUP S283_Neg_Edge "EcuIntgdSwGend/ControlSoftware/EcuModSeln/Start to Stop Transition/Neg_Edge" /begin REF_CHARACTERISTIC EG_NmrSng0_C /end REF_CHARACTERISTIC /end GROUP
/begin GROUP S288_Neg_Edge "EcuIntgdSwGend/ControlSoftware/EcuModSeln/TSC1 to Stop Transition/Neg_Edge" /begin REF_CHARACTERISTIC EG_NmrSng0_C /end REF_CHARACTERISTIC /end GROUP
/begin GROUP S292_Neg_Edge "EcuIntgdSwGend/ControlSoftware/EcuModSeln/Torque to Stop Transition/Neg_Edge" /begin REF_CHARACTERISTIC EG_NmrSng0_C /end REF_CHARACTERISTIC /end GROUP
/begin GROUP S302_SPN_100___Engine_Oil_Pressure "EcuIntgdSwGend/ControlSoftware/EcuOutpPrcsg/CAN Signals/SPN 100 - Engine Oil Pressure" /begin REF_CHARACTERISTIC EG_mBar2kPa_C EOP_CanPOilOvs_P EOP_CanPOilOvv_P /end REF_CHARACTERISTIC /begin REF_MEASUREMENT EOP_CanPOil /end REF_MEASUREMENT /end GROUP
/begin GROUP S302_SPN_102___Engine_Intake_Manifold_1_Pressure "EcuIntgdSwGend/ControlSoftware/EcuOutpPrcsg/CAN Signals/SPN 102 - Engine Intake Manifold 1 Pressure" /begin REF_CHARACTERISTIC EG_mBar2kPa_C EOP_CanPAirBoostOvs_P EOP_CanPAirBoostOvv_P /end REF_CHARACTERISTIC /begin REF_MEASUREMENT EOP_CanPAirBoost /end REF_MEASUREMENT /end GROUP
/begin GROUP S302_SPN_105___Engine_Intake_Manifold_1_Temperature "EcuIntgdSwGend/ControlSoftware/EcuOutpPrcsg/CAN Signals/SPN 105 - Engine Intake Manifold 1 Temperature" /begin REF_CHARACTERISTIC EOP_CanTAirBoostOvs_P EOP_CanTAirBoostOvv_P /end REF_CHARACTERISTIC /begin REF_MEASUREMENT EOP_CanTAirBoost /end REF_MEASUREMENT /end GROUP
/begin GROUP S302_SPN_108___Barometric_Pressure "EcuIntgdSwGend/ControlSoftware/EcuOutpPrcsg/CAN Signals/SPN 108 - Barometric Pressure" /begin REF_CHARACTERISTIC EG_mBar2kPa_C EOP_CanPBaroOvs_P EOP_CanPBaroOvv_P /end REF_CHARACTERISTIC /begin REF_MEASUREMENT EOP_CanPBaro /end REF_MEASUREMENT /end GROUP
/begin GROUP S54_TSC1_Request_for_Speed_Control "EcuIntgdSwGend/ControlSoftware/DesTqClcn/Running Mode/TSC1 Control Purpose/TSC1 Request for Speed Control" /begin REF_CHARACTERISTIC DTqC_FacSclPIDCoeff_P /end REF_CHARACTERISTIC /end GROUP
/end MODULE
/end PROJECT
