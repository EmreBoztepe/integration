ASAP2_VERSION 1 6
/begin PROJECT ECEMTAG_CR8 ""
/begin MODULE DIM ""
/begin MOD_COMMON "Mod Common Comment Here" DEPOSIT ABSOLUTE BYTE_ORDER MSB_FIRST /end MOD_COMMON
/begin RECORD_LAYOUT FLOAT32_IEEE FNC_VALUES 1 FLOAT32_IEEE ROW_DIR DIRECT /end RECORD_LAYOUT
/begin RECORD_LAYOUT ULONG FNC_VALUES 1 ULONG ROW_DIR DIRECT /end RECORD_LAYOUT
/begin RECORD_LAYOUT UWORD FNC_VALUES 1 UWORD ROW_DIR DIRECT /end RECORD_LAYOUT
/begin RECORD_LAYOUT SWORD FNC_VALUES 1 SWORD ROW_DIR DIRECT /end RECORD_LAYOUT
/begin RECORD_LAYOUT UBYTE FNC_VALUES 1 UBYTE ROW_DIR DIRECT /end RECORD_LAYOUT
/begin RECORD_LAYOUT SBYTE FNC_VALUES 1 SBYTE ROW_DIR DIRECT /end RECORD_LAYOUT
/******************************* From MATLAB ***************************************/ /* MATLAB_SECTION_START_1 */
/begin RECORD_LAYOUT Scalar_BOOLEAN FNC_VALUES 1 UBYTE ROW_DIR DIRECT /end RECORD_LAYOUT
/begin RECORD_LAYOUT Scalar_UBYTE FNC_VALUES 1 UBYTE ROW_DIR DIRECT /end RECORD_LAYOUT
/begin RECORD_LAYOUT Scalar_BYTE FNC_VALUES 1 SBYTE ROW_DIR DIRECT /end RECORD_LAYOUT
/begin RECORD_LAYOUT Scalar_SWORD FNC_VALUES 1 SWORD ROW_DIR DIRECT /end RECORD_LAYOUT
/begin RECORD_LAYOUT Scalar_ULONG FNC_VALUES 1 ULONG ROW_DIR DIRECT /end RECORD_LAYOUT
/begin RECORD_LAYOUT Scalar_LONG FNC_VALUES 1 SLONG ROW_DIR DIRECT /end RECORD_LAYOUT
/begin RECORD_LAYOUT Scalar_FLOAT32_IEEE FNC_VALUES 1 FLOAT32_IEEE ROW_DIR DIRECT /end RECORD_LAYOUT
/begin RECORD_LAYOUT Scalar_FLOAT64_IEEE FNC_VALUES 1 FLOAT64_IEEE ROW_DIR DIRECT /end RECORD_LAYOUT
/begin RECORD_LAYOUT Lookup1D_BOOLEAN FNC_VALUES 1 UBYTE ROW_DIR DIRECT /end RECORD_LAYOUT
/begin RECORD_LAYOUT Lookup1D_X_BOOLEAN AXIS_PTS_X 1 UBYTE INDEX_INCR DIRECT /end RECORD_LAYOUT
/begin RECORD_LAYOUT Lookup1D_BYTE FNC_VALUES 1 SBYTE ROW_DIR DIRECT /end RECORD_LAYOUT
/begin RECORD_LAYOUT Lookup1D_X_BYTE AXIS_PTS_X 1 SBYTE INDEX_INCR DIRECT /end RECORD_LAYOUT
/begin RECORD_LAYOUT Lookup1D_UBYTE FNC_VALUES 1 UBYTE ROW_DIR DIRECT /end RECORD_LAYOUT
/begin RECORD_LAYOUT Lookup1D_X_UBYTE AXIS_PTS_X 1 UBYTE INDEX_INCR DIRECT /end RECORD_LAYOUT
/begin RECORD_LAYOUT Lookup1D_UWORD FNC_VALUES 1 UWORD ROW_DIR DIRECT /end RECORD_LAYOUT
/begin RECORD_LAYOUT Lookup1D_FLOAT32_IEEE FNC_VALUES 1 FLOAT32_IEEE ROW_DIR DIRECT /end RECORD_LAYOUT
/begin RECORD_LAYOUT Lookup1D_X_FLOAT32_IEEE AXIS_PTS_X 1 FLOAT32_IEEE INDEX_INCR DIRECT /end RECORD_LAYOUT
/begin RECORD_LAYOUT Lookup2D_FLOAT32_IEEE FNC_VALUES 1 FLOAT32_IEEE ROW_DIR DIRECT /end RECORD_LAYOUT
/begin RECORD_LAYOUT Lookup2D_X_FLOAT32_IEEE AXIS_PTS_X 1 FLOAT32_IEEE INDEX_INCR DIRECT /end RECORD_LAYOUT
/begin CHARACTERISTIC IC_DurMaiLimd_M "Limited Main Injection Duration Map" CURVE 0x40044DE0 /* @ECU_Address@IC_DurMaiLimd_M@ */ Lookup1D_FLOAT32_IEEE 0 EcuIntgdSwGend_CM_single_us 0.0 5000.0
 /begin AXIS_DESCR COM_AXIS EIP_PRail EcuIntgdSwGend_CM_single_bar 16 0.0 2500.0 AXIS_PTS_REF IC_PRailMaiLimd_A /end AXIS_DESCR
/end CHARACTERISTIC
/begin AXIS_PTS IC_PRailMaiLimd_A "Rail Pressure Limited Main Injection Duration Map Axis" 0x40045DB4 /* @ECU_Address@IC_PRailMaiLimd_A@ */ EIP_PRail Lookup1D_X_FLOAT32_IEEE 0 EcuIntgdSwGend_CM_single_bar 16 0.0 2500.0 /end AXIS_PTS
/begin CHARACTERISTIC IC_DurPltLimd_M "Limited Pilot Injection Duration Map" CURVE 0x40044E58 /* @ECU_Address@IC_DurPltLimd_M@ */ Lookup1D_FLOAT32_IEEE 0 EcuIntgdSwGend_CM_single_us 0.0 5000.0
 /begin AXIS_DESCR COM_AXIS EIP_PRail EcuIntgdSwGend_CM_single_bar 16 0.0 2500.0 AXIS_PTS_REF IC_PRailMaiLimd_A /end AXIS_DESCR
/end CHARACTERISTIC
/begin CHARACTERISTIC IC_PAmbAirCorrForMainSOI_M "Ambient Air Pressure Correction Map for Main Start of Injection" CURVE 0x40045D3C /* @ECU_Address@IC_PAmbAirCorrForMainSOI_M@ */ Lookup1D_FLOAT32_IEEE 0 EcuIntgdSwGend_CM_single_deg -100.0 500.0
 /begin AXIS_DESCR COM_AXIS EIP_PAmbAir EcuIntgdSwGend_CM_single_mbar 5 0.0 3000.0 AXIS_PTS_REF IC_PAmbAirForSoiMainInjCorr_A /end AXIS_DESCR
/end CHARACTERISTIC
/begin AXIS_PTS IC_PAmbAirForSoiMainInjCorr_A "Ambient Air Pressure Map Axis for Main Start of Injection Correction" 0x40045D64 /* @ECU_Address@IC_PAmbAirForSoiMainInjCorr_A@ */ EIP_PAmbAir Lookup1D_X_FLOAT32_IEEE 0 EcuIntgdSwGend_CM_single_mbar 5 0.0 3000.0 /end AXIS_PTS
/begin CHARACTERISTIC IC_SoiMaiLimd_M "Limited Start of Main Injection Map" CURVE 0x40045E0C /* @ECU_Address@IC_SoiMaiLimd_M@ */ Lookup1D_FLOAT32_IEEE 0 EcuIntgdSwGend_CM_single_deg -100.0 500.0
 /begin AXIS_DESCR COM_AXIS EIP_NEng EcuIntgdSwGend_CM_single_rpm 24 0.0 3200.0 AXIS_PTS_REF IC_NEngMaiLimd_A /end AXIS_DESCR
/end CHARACTERISTIC
/begin AXIS_PTS IC_NEngMaiLimd_A "Engine Speed Map Axis for Limited Main Injection Duration Maps" 0x40045CB0 /* @ECU_Address@IC_NEngMaiLimd_A@ */ EIP_NEng Lookup1D_X_FLOAT32_IEEE 0 EcuIntgdSwGend_CM_single_rpm 24 0.0 3200.0 /end AXIS_PTS
/begin CHARACTERISTIC IC_TAirBoostCorrForMainSOI_M "Start of Main Injection Correction wrt Air Boost Temperature Map" CURVE 0x40048334 /* @ECU_Address@IC_TAirBoostCorrForMainSOI_M@ */ Lookup1D_FLOAT32_IEEE 0 EcuIntgdSwGend_CM_single_deg -100.0 500.0
 /begin AXIS_DESCR COM_AXIS EIP_TAirBoost EcuIntgdSwGend_CM_single_degC 5 -40.0 250.0 AXIS_PTS_REF IC_TAirBoostForSoiMainInjCorr_A /end AXIS_DESCR
/end CHARACTERISTIC
/begin AXIS_PTS IC_TAirBoostForSoiMainInjCorr_A "Start of Main Injection Correction wrt Air Boost Temperature Map Axis" 0x4004835C /* @ECU_Address@IC_TAirBoostForSoiMainInjCorr_A@ */ EIP_TAirBoost Lookup1D_X_FLOAT32_IEEE 0 EcuIntgdSwGend_CM_single_degC 5 -40.0 250.0 /end AXIS_PTS
/begin CHARACTERISTIC IC_TAmbAirCorrForMainSOI_M "Start of Main Injection Correction wrt Ambient Air Temperature Map" CURVE 0x40048384 /* @ECU_Address@IC_TAmbAirCorrForMainSOI_M@ */ Lookup1D_FLOAT32_IEEE 0 EcuIntgdSwGend_CM_single_deg -100.0 500.0
 /begin AXIS_DESCR COM_AXIS EIP_TAmbAir EcuIntgdSwGend_CM_single_degC 5 -40.0 250.0 AXIS_PTS_REF IC_TAmbAirForSoiMainInjCorr_A /end AXIS_DESCR
/end CHARACTERISTIC
/begin AXIS_PTS IC_TAmbAirForSoiMainInjCorr_A "Start of Main Injection Correction wrt Ambient Air Temperature Map Axis" 0x400483AC /* @ECU_Address@IC_TAmbAirForSoiMainInjCorr_A@ */ EIP_TAmbAir Lookup1D_X_FLOAT32_IEEE 0 EcuIntgdSwGend_CM_single_degC 5 -40.0 250.0 /end AXIS_PTS
/begin CHARACTERISTIC IC_TCooltCorrForMainSOI_M "Start of Main Injection Correction wrt Coolant Temperature Map" CURVE 0x400483D4 /* @ECU_Address@IC_TCooltCorrForMainSOI_M@ */ Lookup1D_FLOAT32_IEEE 0 EcuIntgdSwGend_CM_single_deg -100.0 500.0
 /begin AXIS_DESCR COM_AXIS EIP_TCoolt EcuIntgdSwGend_CM_single_degC 5 -40.0 250.0 AXIS_PTS_REF IC_TCooltForSoiMainInjCorr_A /end AXIS_DESCR
/end CHARACTERISTIC
/begin AXIS_PTS IC_TCooltForSoiMainInjCorr_A "Start of Main Injection Correction wrt Coolant Temperature Map Axis" 0x400483FC /* @ECU_Address@IC_TCooltForSoiMainInjCorr_A@ */ EIP_TCoolt Lookup1D_X_FLOAT32_IEEE 0 EcuIntgdSwGend_CM_single_degC 5 -40.0 250.0 /end AXIS_PTS
/begin CHARACTERISTIC IC_TOilCorrForMainSOI_M "Start of Main Injection Correction wrt Oil Temperature Map" CURVE 0x40048430 /* @ECU_Address@IC_TOilCorrForMainSOI_M@ */ Lookup1D_FLOAT32_IEEE 0 EcuIntgdSwGend_CM_single_deg -100.0 500.0
 /begin AXIS_DESCR COM_AXIS EIP_TOil EcuIntgdSwGend_CM_single_degC 5 -40.0 250.0 AXIS_PTS_REF IC_TOilForSoiMainInjCorr_A /end AXIS_DESCR
/end CHARACTERISTIC
/begin AXIS_PTS IC_TOilForSoiMainInjCorr_A "Start of Main Injection Correction wrt Oil Temperature Map Axis" 0x40048458 /* @ECU_Address@IC_TOilForSoiMainInjCorr_A@ */ EIP_TOil Lookup1D_X_FLOAT32_IEEE 0 EcuIntgdSwGend_CM_single_degC 5 -40.0 250.0 /end AXIS_PTS
/begin CHARACTERISTIC IC_PAmbAirCorrForPilotSOI_M "Ambient Air Pressure Correction Map for Pilot Start of Injection" CURVE 0x40045D50 /* @ECU_Address@IC_PAmbAirCorrForPilotSOI_M@ */ Lookup1D_FLOAT32_IEEE 0 EcuIntgdSwGend_CM_single_deg -100.0 500.0
 /begin AXIS_DESCR COM_AXIS EIP_PAmbAir EcuIntgdSwGend_CM_single_mbar 5 0.0 10000.0 AXIS_PTS_REF IC_PAmbAirForSoiPltinjCorr_A /end AXIS_DESCR
/end CHARACTERISTIC
/begin AXIS_PTS IC_PAmbAirForSoiPltinjCorr_A "Ambient Air Pressure Map Axis for for Pilot Start of Injection Correction" 0x40045D78 /* @ECU_Address@IC_PAmbAirForSoiPltinjCorr_A@ */ EIP_PAmbAir Lookup1D_X_FLOAT32_IEEE 0 EcuIntgdSwGend_CM_single_mbar 5 0.0 10000.0 /end AXIS_PTS
/begin CHARACTERISTIC IC_SoiPltLimd_M "Limited Start of Pilot Injection Map" CURVE 0x400482D4 /* @ECU_Address@IC_SoiPltLimd_M@ */ Lookup1D_FLOAT32_IEEE 0 EcuIntgdSwGend_CM_single_deg -100.0 5000.0
 /begin AXIS_DESCR COM_AXIS EIP_NEng EcuIntgdSwGend_CM_single_rpm 24 0.0 3200.0 AXIS_PTS_REF IC_NEngMaiLimd_A /end AXIS_DESCR
/end CHARACTERISTIC
/begin CHARACTERISTIC IC_TAirBoostCorrForPilotSOI_M "Start of Pilot Injection Correction wrt Air Boost Temperature Map" CURVE 0x40048348 /* @ECU_Address@IC_TAirBoostCorrForPilotSOI_M@ */ Lookup1D_FLOAT32_IEEE 0 EcuIntgdSwGend_CM_single_deg -100.0 500.0
 /begin AXIS_DESCR COM_AXIS EIP_TAirBoost EcuIntgdSwGend_CM_single_degC 5 -40.0 250.0 AXIS_PTS_REF IC_TAirBoostForSoiPltinjCorr_A /end AXIS_DESCR
/end CHARACTERISTIC
/begin AXIS_PTS IC_TAirBoostForSoiPltinjCorr_A "Start of Pilot Injection Correction wrt Air Boost Temperature Map Axis" 0x40048370 /* @ECU_Address@IC_TAirBoostForSoiPltinjCorr_A@ */ EIP_TAirBoost Lookup1D_X_FLOAT32_IEEE 0 EcuIntgdSwGend_CM_single_degC 5 -40.0 250.0 /end AXIS_PTS
/begin CHARACTERISTIC IC_TAmbAirCorrForPilotSOI_M "Start of Pilot Injection Correction wrt Ambient Air Temperature Map" CURVE 0x40048398 /* @ECU_Address@IC_TAmbAirCorrForPilotSOI_M@ */ Lookup1D_FLOAT32_IEEE 0 EcuIntgdSwGend_CM_single_deg -100.0 500.0
 /begin AXIS_DESCR COM_AXIS EIP_TAmbAir EcuIntgdSwGend_CM_single_degC 5 -40.0 250.0 AXIS_PTS_REF IC_TAmbAirForSoiPltinjCorr_A /end AXIS_DESCR
/end CHARACTERISTIC
/begin AXIS_PTS IC_TAmbAirForSoiPltinjCorr_A "Start of Pilot Injection Correction wrt Ambient Air Temperature Map Axis" 0x400483C0 /* @ECU_Address@IC_TAmbAirForSoiPltinjCorr_A@ */ EIP_TAmbAir Lookup1D_X_FLOAT32_IEEE 0 EcuIntgdSwGend_CM_single_degC 5 -40.0 250.0 /end AXIS_PTS
/begin CHARACTERISTIC IC_TCooltCorrForPilotSOI_M "Start of Pilot Injection Correction wrt Coolant Temperature Map" CURVE 0x400483E8 /* @ECU_Address@IC_TCooltCorrForPilotSOI_M@ */ Lookup1D_FLOAT32_IEEE 0 EcuIntgdSwGend_CM_single_deg -100.0 500.0
 /begin AXIS_DESCR COM_AXIS EIP_TCoolt EcuIntgdSwGend_CM_single_degC 5 -40.0 250.0 AXIS_PTS_REF IC_TCooltForSoiPltinjCorr_A /end AXIS_DESCR
/end CHARACTERISTIC
/begin AXIS_PTS IC_TCooltForSoiPltinjCorr_A "Start of Pilot Injection Correction wrt Coolant Temperature Map Axis" 0x40048410 /* @ECU_Address@IC_TCooltForSoiPltinjCorr_A@ */ EIP_TCoolt Lookup1D_X_FLOAT32_IEEE 0 EcuIntgdSwGend_CM_single_degC 5 -40.0 250.0 /end AXIS_PTS
/begin CHARACTERISTIC IC_TOilCorrForPilotSOI_M "Start of Pilot Injection Correction wrt Oil Temperature Map" CURVE 0x40048444 /* @ECU_Address@IC_TOilCorrForPilotSOI_M@ */ Lookup1D_FLOAT32_IEEE 0 EcuIntgdSwGend_CM_single_deg -100.0 500.0
 /begin AXIS_DESCR COM_AXIS EIP_TOil EcuIntgdSwGend_CM_single_degC 5 -40.0 250.0 AXIS_PTS_REF IC_TOilForSoiPltinjCorr_A /end AXIS_DESCR
/end CHARACTERISTIC
/begin AXIS_PTS IC_TOilForSoiPltinjCorr_A "Start of Pilot Injection Correction wrt Oil Temperature Map Axis" 0x4004846C /* @ECU_Address@IC_TOilForSoiPltinjCorr_A@ */ EIP_TOil Lookup1D_X_FLOAT32_IEEE 0 EcuIntgdSwGend_CM_single_degC 5 -40.0 250.0 /end AXIS_PTS
/begin CHARACTERISTIC RPG_PRailSetPoint1_M "Rail Pressure Set Point Calculation Map 1" MAP 0x40049984 /* @ECU_Address@RPG_PRailSetPoint1_M@ */ Lookup2D_FLOAT32_IEEE 0 EcuIntgdSwGend_CM_single_bar 0.0 2500.0
 /begin AXIS_DESCR COM_AXIS TL_TqIndcdLimd EcuIntgdSwGend_CM_single_N_m 15 0.0 10000.0 AXIS_PTS_REF RPG_TqIndcdLimdForPRailSetPoint_A /end AXIS_DESCR
 /begin AXIS_DESCR COM_AXIS EIP_NEng EcuIntgdSwGend_CM_single_rpm 15 0.0 3500.0 AXIS_PTS_REF RPG_NEngCorrForPRailSetPoint_A /end AXIS_DESCR
/end CHARACTERISTIC
/begin AXIS_PTS RPG_TqIndcdLimdForPRailSetPoint_A "Limited Indicated Torque Map Axis for Rail Pressure Set Point Calcluation Maps" 0x4004AFF4 /* @ECU_Address@RPG_TqIndcdLimdForPRailSetPoint_A@ */ TL_TqIndcdLimd Lookup2D_X_FLOAT32_IEEE 0 EcuIntgdSwGend_CM_single_N_m 15 0.0 10000.0 /end AXIS_PTS
/begin AXIS_PTS RPG_NEngCorrForPRailSetPoint_A "Engine Speed Correction Map Axis for Rail Pressure Set Point Calculation" 0x40049688 /* @ECU_Address@RPG_NEngCorrForPRailSetPoint_A@ */ EIP_NEng Lookup2D_X_FLOAT32_IEEE 0 EcuIntgdSwGend_CM_single_rpm 15 0.0 3500.0 /end AXIS_PTS
/begin CHARACTERISTIC RPG_PRailSetPoint2_M "Rail Pressure Set Point Calculation Map 2" MAP 0x40049D08 /* @ECU_Address@RPG_PRailSetPoint2_M@ */ Lookup2D_FLOAT32_IEEE 0 EcuIntgdSwGend_CM_single_bar 0.0 2500.0
 /begin AXIS_DESCR COM_AXIS TL_TqIndcdLimd EcuIntgdSwGend_CM_single_N_m 15 0.0 10000.0 AXIS_PTS_REF RPG_TqIndcdLimdForPRailSetPoint_A /end AXIS_DESCR
 /begin AXIS_DESCR COM_AXIS EIP_NEng EcuIntgdSwGend_CM_single_rpm 15 0.0 3500.0 AXIS_PTS_REF RPG_NEngCorrForPRailSetPoint_A /end AXIS_DESCR
/end CHARACTERISTIC
/begin CHARACTERISTIC RPG_PRailSetPoint3_M "Rail Pressure Set Point Calculation Map 3" MAP 0x4004A08C /* @ECU_Address@RPG_PRailSetPoint3_M@ */ Lookup2D_FLOAT32_IEEE 0 EcuIntgdSwGend_CM_single_bar 0.0 2500.0
 /begin AXIS_DESCR COM_AXIS TL_TqIndcdLimd EcuIntgdSwGend_CM_single_N_m 15 0.0 10000.0 AXIS_PTS_REF RPG_TqIndcdLimdForPRailSetPoint_A /end AXIS_DESCR
 /begin AXIS_DESCR COM_AXIS EIP_NEng EcuIntgdSwGend_CM_single_rpm 15 0.0 3500.0 AXIS_PTS_REF RPG_NEngCorrForPRailSetPoint_A /end AXIS_DESCR
/end CHARACTERISTIC
/begin CHARACTERISTIC SpdLimr_CoeffDForVehVCtrl_M "Coefficient Derrivate For Vehicle Velocity Control Map" CURVE 0x4004B0F0 /* @ECU_Address@SpdLimr_CoeffDForVehVCtrl_M@ */ Lookup1D_FLOAT32_IEEE 0 EcuIntgdSwGend_CM_single 0.0 10000.0
 /begin AXIS_DESCR COM_AXIS SpdLimr_ErrVehVRef EcuIntgdSwGend_CM_single 20 -300.0 300.0 AXIS_PTS_REF SpdLimr_ErrVehV_A /end AXIS_DESCR
/end CHARACTERISTIC
/begin AXIS_PTS SpdLimr_ErrVehV_A "Vehicle Speed Error Map Axis" 0x4004B25C /* @ECU_Address@SpdLimr_ErrVehV_A@ */ SpdLimr_ErrVehVRef Lookup1D_X_FLOAT32_IEEE 0 EcuIntgdSwGend_CM_single 20 -300.0 300.0 /end AXIS_PTS
/begin CHARACTERISTIC SpdLimr_CoeffFiltForVehVCtrl_M "Coefficient Filter for Vehicle Velocity Control Map" CURVE 0x4004B140 /* @ECU_Address@SpdLimr_CoeffFiltForVehVCtrl_M@ */ Lookup1D_FLOAT32_IEEE 0 EcuIntgdSwGend_CM_single 0.0 10000.0
 /begin AXIS_DESCR COM_AXIS SpdLimr_ErrVehVRef EcuIntgdSwGend_CM_single 20 -300.0 300.0 AXIS_PTS_REF SpdLimr_ErrVehV_A /end AXIS_DESCR
/end CHARACTERISTIC
/begin CHARACTERISTIC SpdLimr_CoeffIForVehVCtrl_M "Coefficient Integral For Vehicle Velocity Control Map" CURVE 0x4004B190 /* @ECU_Address@SpdLimr_CoeffIForVehVCtrl_M@ */ Lookup1D_FLOAT32_IEEE 0 EcuIntgdSwGend_CM_single 0.0 10000.0
 /begin AXIS_DESCR COM_AXIS SpdLimr_ErrVehVRef EcuIntgdSwGend_CM_single 20 -300.0 300.0 AXIS_PTS_REF SpdLimr_ErrVehV_A /end AXIS_DESCR
/end CHARACTERISTIC
/begin CHARACTERISTIC SpdLimr_CoeffPForVehVCtrl_M "Coefficient Proportional For Vehicle Velocity Control Map" CURVE 0x4004B1E0 /* @ECU_Address@SpdLimr_CoeffPForVehVCtrl_M@ */ Lookup1D_FLOAT32_IEEE 0 EcuIntgdSwGend_CM_single 0.0 10000.0
 /begin AXIS_DESCR COM_AXIS SpdLimr_ErrVehVRef EcuIntgdSwGend_CM_single 20 -300.0 300.0 AXIS_PTS_REF SpdLimr_ErrVehV_A /end AXIS_DESCR
/end CHARACTERISTIC
/begin CHARACTERISTIC SpdLimr_PIDMax_M "Maximum Value of PIF Map" MAP 0x4004B2FC /* @ECU_Address@SpdLimr_PIDMax_M@ */ Lookup2D_FLOAT32_IEEE 0 EcuIntgdSwGend_CM_single_N_m 0.0 5000.0
 /begin AXIS_DESCR COM_AXIS EIP_CanTrsmCurrentGear EcuIntgdSwGend_CM_single 6 0.0 255.0 AXIS_PTS_REF SpdLimr_CurrentGear_A /end AXIS_DESCR
 /begin AXIS_DESCR COM_AXIS EIP_NEng EcuIntgdSwGend_CM_single_rpm 6 0.0 3000.0 AXIS_PTS_REF SpdLimr_NEngForPIDMax_A /end AXIS_DESCR
/end CHARACTERISTIC
/begin AXIS_PTS SpdLimr_CurrentGear_A "Current Gear Map Axis" 0x4004B230 /* @ECU_Address@SpdLimr_CurrentGear_A@ */ EIP_CanTrsmCurrentGear Lookup2D_X_FLOAT32_IEEE 0 EcuIntgdSwGend_CM_single 6 0.0 255.0 /end AXIS_PTS
/begin AXIS_PTS SpdLimr_NEngForPIDMax_A "Engine Speed for PID Max Map Axis" 0x4004B2C4 /* @ECU_Address@SpdLimr_NEngForPIDMax_A@ */ EIP_NEng Lookup2D_X_FLOAT32_IEEE 0 EcuIntgdSwGend_CM_single_rpm 6 0.0 3000.0 /end AXIS_PTS
/begin CHARACTERISTIC SpdLimr_TrfCaseStsFac_M "Speed Limiter Transfer Case Status Factor Map" CURVE 0x4004B3C0 /* @ECU_Address@SpdLimr_TrfCaseStsFac_M@ */ Lookup1D_FLOAT32_IEEE 0 EcuIntgdSwGend_CM_single 0.0 100.0
 /begin AXIS_DESCR COM_AXIS EIP_CanTrfCaseSts EcuIntgdSwGend_CM_single 8 0.0 8.0 AXIS_PTS_REF SpdLimr_TrfCaseStsFacForFF_A /end AXIS_DESCR
/end CHARACTERISTIC
/begin AXIS_PTS SpdLimr_TrfCaseStsFacForFF_A "Speed Limiter Transfer Case Status Factor for Feedforward Map Axis" 0x4004B3A0 /* @ECU_Address@SpdLimr_TrfCaseStsFacForFF_A@ */ EIP_CanTrfCaseSts Lookup1D_X_FLOAT32_IEEE 0 EcuIntgdSwGend_CM_single 8 0.0 8.0 /end AXIS_PTS
/begin CHARACTERISTIC SpdLimr_TrsmTqCnvrRatFac_M "Speed Limiter Transmission Torque Convertor Ratio Factor Map" CURVE 0x4004B3E0 /* @ECU_Address@SpdLimr_TrsmTqCnvrRatFac_M@ */ Lookup1D_FLOAT32_IEEE 0 EcuIntgdSwGend_CM_single 0.0 100.0
 /begin AXIS_DESCR COM_AXIS EIP_CanTrsmTqCnvrRat EcuIntgdSwGend_CM_single 8 0.0 100.0 AXIS_PTS_REF SpdLimr_TrsmTqCnvrRatForFF_A /end AXIS_DESCR
/end CHARACTERISTIC
/begin AXIS_PTS SpdLimr_TrsmTqCnvrRatForFF_A "Speed Limiter Transmission Torque Convertor Ratio Factor for Feedforward Map Axis" 0x4004B400 /* @ECU_Address@SpdLimr_TrsmTqCnvrRatForFF_A@ */ EIP_CanTrsmTqCnvrRat Lookup1D_X_FLOAT32_IEEE 0 EcuIntgdSwGend_CM_single 8 0.0 100.0 /end AXIS_PTS
/begin CHARACTERISTIC TL_PercgTqLimnForTFu_M "Torque Limitation Percentage Map for Fuel Temperature" MAP 0x4004BD64 /* @ECU_Address@TL_PercgTqLimnForTFu_M@ */ Lookup2D_FLOAT32_IEEE 0 EcuIntgdSwGend_CM_single__ 0.0 100.0
 /begin AXIS_DESCR COM_AXIS EIP_TFu EcuIntgdSwGend_CM_single_degC 10 -50.0 200.0 AXIS_PTS_REF TL_TFu_A /end AXIS_DESCR
 /begin AXIS_DESCR COM_AXIS EIP_NEng EcuIntgdSwGend_CM_single_rpm 10 0.0 5000.0 AXIS_PTS_REF TL_NEng_A /end AXIS_DESCR
/end CHARACTERISTIC
/begin AXIS_PTS TL_TFu_A "Axis Values of Fuel Temperature for Fuel Temperature Dependent Limitation Map" 0x4004C1D8 /* @ECU_Address@TL_TFu_A@ */ EIP_TFu Lookup2D_X_FLOAT32_IEEE 0 EcuIntgdSwGend_CM_single_degC 10 -50.0 200.0 /end AXIS_PTS
/begin AXIS_PTS TL_NEng_A "Axis Values of Engine Speed for Torque Limitation Maps" 0x4004B4EC /* @ECU_Address@TL_NEng_A@ */ EIP_NEng Lookup2D_X_FLOAT32_IEEE 0 EcuIntgdSwGend_CM_single_rpm 10 0.0 5000.0 /end AXIS_PTS
/begin CHARACTERISTIC TL_PercgTqLimnForTAir_M "Torque Limitation Percentage Map for AirBoost Temperature" MAP 0x4004BA44 /* @ECU_Address@TL_PercgTqLimnForTAir_M@ */ Lookup2D_FLOAT32_IEEE 0 EcuIntgdSwGend_CM_single__ 0.0 100.0
 /begin AXIS_DESCR COM_AXIS TL_TAir EcuIntgdSwGend_CM_single_degC 10 -50.0 200.0 AXIS_PTS_REF TL_TAir_A /end AXIS_DESCR
 /begin AXIS_DESCR COM_AXIS EIP_NEng EcuIntgdSwGend_CM_single_rpm 10 0.0 5000.0 AXIS_PTS_REF TL_NEng_A /end AXIS_DESCR
/end CHARACTERISTIC
/begin AXIS_PTS TL_TAir_A "Axis Values of Air Temperature for Air Temperature Dependent Limitation Map" 0x4004C188 /* @ECU_Address@TL_TAir_A@ */ TL_TAir Lookup2D_X_FLOAT32_IEEE 0 EcuIntgdSwGend_CM_single_degC 10 -50.0 200.0 /end AXIS_PTS
/begin CHARACTERISTIC TL_PercgTqLimnForPAmbAir_M "Torque Limitation Percentage Map for Ambient Air Pressure" MAP 0x4004B724 /* @ECU_Address@TL_PercgTqLimnForPAmbAir_M@ */ Lookup2D_FLOAT32_IEEE 0 EcuIntgdSwGend_CM_single__ 0.0 100.0
 /begin AXIS_DESCR COM_AXIS EIP_PAmbAir EcuIntgdSwGend_CM_single_mbar 10 0.0 10000.0 AXIS_PTS_REF TL_PAmbAir_A /end AXIS_DESCR
 /begin AXIS_DESCR COM_AXIS EIP_NEng EcuIntgdSwGend_CM_single_rpm 10 0.0 5000.0 AXIS_PTS_REF TL_NEng_A /end AXIS_DESCR
/end CHARACTERISTIC
/begin AXIS_PTS TL_PAmbAir_A "Axis Values of Ambient Air Pressure for Ambient Air Pressure Dependent Limitation Map" 0x4004B564 /* @ECU_Address@TL_PAmbAir_A@ */ EIP_PAmbAir Lookup2D_X_FLOAT32_IEEE 0 EcuIntgdSwGend_CM_single_mbar 10 0.0 10000.0 /end AXIS_PTS
/begin CHARACTERISTIC TL_PercgTqLimnForTCoolt_M "Torque Limitation Percentage Map for Coolant High Temperature" MAP 0x4004BBD4 /* @ECU_Address@TL_PercgTqLimnForTCoolt_M@ */ Lookup2D_FLOAT32_IEEE 0 EcuIntgdSwGend_CM_single__ 0.0 100.0
 /begin AXIS_DESCR COM_AXIS EIP_TCoolt EcuIntgdSwGend_CM_single_degC 10 -50.0 200.0 AXIS_PTS_REF TL_TCoolt_A /end AXIS_DESCR
 /begin AXIS_DESCR COM_AXIS EIP_NEng EcuIntgdSwGend_CM_single_rpm 10 0.0 5000.0 AXIS_PTS_REF TL_NEng_A /end AXIS_DESCR
/end CHARACTERISTIC
/begin AXIS_PTS TL_TCoolt_A "Axis Values of Coolant High Temperature for Coolant High Dependent Temperature Limitation Map" 0x4004C1B0 /* @ECU_Address@TL_TCoolt_A@ */ EIP_TCoolt Lookup2D_X_FLOAT32_IEEE 0 EcuIntgdSwGend_CM_single_degC 10 -50.0 200.0 /end AXIS_PTS
/begin CHARACTERISTIC TL_PercgTqLimnForPBoostAir_M "Torque Limitation Percentage Map for AirBoost Pressure" MAP 0x4004B8B4 /* @ECU_Address@TL_PercgTqLimnForPBoostAir_M@ */ Lookup2D_FLOAT32_IEEE 0 EcuIntgdSwGend_CM_single__ 0.0 100.0
 /begin AXIS_DESCR COM_AXIS EIP_PAirBoost EcuIntgdSwGend_CM_single_mbar 10 0.0 10000.0 AXIS_PTS_REF TL_PAirBoost_A /end AXIS_DESCR
 /begin AXIS_DESCR COM_AXIS EIP_NEng EcuIntgdSwGend_CM_single_rpm 10 0.0 5000.0 AXIS_PTS_REF TL_NEng_A /end AXIS_DESCR
/end CHARACTERISTIC
/begin AXIS_PTS TL_PAirBoost_A "Axis Values of AirBoost Pressure for AirBoost Pressure Dependet Limitation Map" 0x4004B53C /* @ECU_Address@TL_PAirBoost_A@ */ EIP_PAirBoost Lookup2D_X_FLOAT32_IEEE 0 EcuIntgdSwGend_CM_single_mbar 10 0.0 10000.0 /end AXIS_PTS
/begin CHARACTERISTIC TL_PercgTqLimnForTOil_M "Torque Limitation Percentage Map for Oil Temperature" MAP 0x4004BEF4 /* @ECU_Address@TL_PercgTqLimnForTOil_M@ */ Lookup2D_FLOAT32_IEEE 0 EcuIntgdSwGend_CM_single__ 0.0 100.0
 /begin AXIS_DESCR COM_AXIS EIP_TOil EcuIntgdSwGend_CM_single_degC 10 -50.0 200.0 AXIS_PTS_REF TL_TOil_A /end AXIS_DESCR
 /begin AXIS_DESCR COM_AXIS EIP_NEng EcuIntgdSwGend_CM_single_rpm 10 0.0 5000.0 AXIS_PTS_REF TL_NEng_A /end AXIS_DESCR
/end CHARACTERISTIC
/begin AXIS_PTS TL_TOil_A "Axis Values of Oil Temperature for Oil Temperature Dependent Limitation Map" 0x4004C200 /* @ECU_Address@TL_TOil_A@ */ EIP_TOil Lookup2D_X_FLOAT32_IEEE 0 EcuIntgdSwGend_CM_single_degC 10 -50.0 200.0 /end AXIS_PTS
/begin CHARACTERISTIC TL_SurgeLineTqLimd_M "Surge Line Torque Limitation Map" MAP 0x4004C088 /* @ECU_Address@TL_SurgeLineTqLimd_M@ */ Lookup2D_FLOAT32_IEEE 0 EcuIntgdSwGend_CM_single__ 0.0 100.0
 /begin AXIS_DESCR COM_AXIS EIP_NEng EcuIntgdSwGend_CM_single_rpm 8 0.0 3500.0 AXIS_PTS_REF TL_NEngForSurgeLine_A /end AXIS_DESCR
 /begin AXIS_DESCR COM_AXIS WgC_DifSurgeLine EcuIntgdSwGend_CM_single 8 -10.0 10.0 AXIS_PTS_REF TL_DifSurgeLine_A /end AXIS_DESCR
/end CHARACTERISTIC
/begin AXIS_PTS TL_NEngForSurgeLine_A "Engine Speed Map Axis for Surge Line" 0x4004B46C /* @ECU_Address@TL_NEngForSurgeLine_A@ */ EIP_NEng Lookup2D_X_FLOAT32_IEEE 0 EcuIntgdSwGend_CM_single_rpm 8 0.0 3500.0 /end AXIS_PTS
/begin AXIS_PTS TL_DifSurgeLine_A "Map Axis of Surge Line Difference" 0x4004B428 /* @ECU_Address@TL_DifSurgeLine_A@ */ WgC_DifSurgeLine Lookup2D_X_FLOAT32_IEEE 0 EcuIntgdSwGend_CM_single 8 -10.0 10.0 /end AXIS_PTS
/begin CHARACTERISTIC TL_PercgTqLimnForNExhTrbChrg_M "Torque Limitation Percentage Map for Turbo Charger Speed" MAP 0x4004B594 /* @ECU_Address@TL_PercgTqLimnForNExhTrbChrg_M@ */ Lookup2D_FLOAT32_IEEE 0 EcuIntgdSwGend_CM_single__ 0.0 100.0
 /begin AXIS_DESCR COM_AXIS WgC_NTrbChrg EcuIntgdSwGend_CM_single_rpm 10 0.0 120000.0 AXIS_PTS_REF TL_NTrbChrg_A /end AXIS_DESCR
 /begin AXIS_DESCR COM_AXIS EIP_NEng EcuIntgdSwGend_CM_single_rpm 10 0.0 5000.0 AXIS_PTS_REF TL_NEng_A /end AXIS_DESCR
/end CHARACTERISTIC
/begin AXIS_PTS TL_NTrbChrg_A "Axis Values of Turbo Charger Speed for Turbo Charger Dependent Limitation Map" 0x4004B514 /* @ECU_Address@TL_NTrbChrg_A@ */ WgC_NTrbChrg Lookup2D_X_FLOAT32_IEEE 0 EcuIntgdSwGend_CM_single_rpm 10 0.0 120000.0 /end AXIS_PTS
/begin CHARACTERISTIC EOP_AccrPedl1IdleCndThd_P "Accelerator Pedal Idle Condition Threshold" VALUE 0x40044948 /* @ECU_Address@EOP_AccrPedl1IdleCndThd_P@ */ Scalar_FLOAT32_IEEE 0 EcuIntgdSwGend_CM_single 0.0 100.0 /end CHARACTERISTIC
/begin CHARACTERISTIC EOP_CanAccrPedlPosn1Ovv_P "SPN 91 - Accelerator Pedal Position 1 - Override Value" VALUE 0x40044974 /* @ECU_Address@EOP_CanAccrPedlPosn1Ovv_P@ */ Scalar_FLOAT32_IEEE 0 EcuIntgdSwGend_CM_single__ 0.0 100.0 /end CHARACTERISTIC
/begin CHARACTERISTIC EOP_CanActEngPercTqOvv_P "SPN 513 - Actual Engine Percent Torque - Override Value" VALUE 0x4004497C /* @ECU_Address@EOP_CanActEngPercTqOvv_P@ */ Scalar_FLOAT32_IEEE 0 EcuIntgdSwGend_CM_single__ 0.0 125.0 /end CHARACTERISTIC
/begin CHARACTERISTIC EOP_CanBattVolt1Ovv_P "SPN 168 - Battery Potential - Power Input 1 - Override Value" VALUE 0x4004498C /* @ECU_Address@EOP_CanBattVolt1Ovv_P@ */ Scalar_FLOAT32_IEEE 0 EcuIntgdSwGend_CM_single_V 0.0 3213.0 /end CHARACTERISTIC
/begin CHARACTERISTIC EOP_CanDrvrDmdPercTqOvv_P "SPN 512 - Driver Demand Percent Torque - Override Value" VALUE 0x400449D8 /* @ECU_Address@EOP_CanDrvrDmdPercTqOvv_P@ */ Scalar_FLOAT32_IEEE 0 EcuIntgdSwGend_CM_single__ 0.0 125.0 /end CHARACTERISTIC
/begin CHARACTERISTIC EOP_CanEngDftTqLimOvv_P "SPN 1846 - Engine Default Torque Limit - Override Value" VALUE 0x400449E0 /* @ECU_Address@EOP_CanEngDftTqLimOvv_P@ */ Scalar_FLOAT32_IEEE 0 EcuIntgdSwGend_CM_single_N_m 0.0 64255.0 /end CHARACTERISTIC
/begin CHARACTERISTIC EOP_CanEngFuRateOvv_P "SPN 183 - Engine Fuel Rate - Override Value" VALUE 0x400449E8 /* @ECU_Address@EOP_CanEngFuRateOvv_P@ */ Scalar_FLOAT32_IEEE 0 EcuIntgdSwGend_CM_single_L_h 0.0 3213.0 /end CHARACTERISTIC
/begin CHARACTERISTIC EOP_CanEngHrOvv_P "SPN 247 - Engine Total Hours of Operation - Override Value" VALUE 0x400449F0 /* @ECU_Address@EOP_CanEngHrOvv_P@ */ Scalar_FLOAT32_IEEE 0 EcuIntgdSwGend_CM_single_h 0.0 2.10554061E+8 /end CHARACTERISTIC
/begin CHARACTERISTIC EOP_CanEngParasiticLossOvv_P "SPN 2978 - Estimated Engine Parasitic Losses - Override Value" VALUE 0x400449F8 /* @ECU_Address@EOP_CanEngParasiticLossOvv_P@ */ Scalar_FLOAT32_IEEE 0 EcuIntgdSwGend_CM_single__ 0.0 255.0 /end CHARACTERISTIC
/begin CHARACTERISTIC EOP_CanEngPercTqPoint1Ovv_P "SPN 539 - Engine Percent Torque Point 1 - Override Value" VALUE 0x40044A00 /* @ECU_Address@EOP_CanEngPercTqPoint1Ovv_P@ */ Scalar_FLOAT32_IEEE 0 EcuIntgdSwGend_CM_single__ 0.0 125.0 /end CHARACTERISTIC
/begin CHARACTERISTIC EOP_CanEngPercTqPoint2Ovv_P "SPN 539 - Engine Percent Torque Point 2 - Override Value" VALUE 0x40044A08 /* @ECU_Address@EOP_CanEngPercTqPoint2Ovv_P@ */ Scalar_FLOAT32_IEEE 0 EcuIntgdSwGend_CM_single__ 0.0 125.0 /end CHARACTERISTIC
/begin CHARACTERISTIC EOP_CanEngPercTqPoint3Ovv_P "SPN 539 - Engine Percent Torque Point 3 - Override Value" VALUE 0x40044A10 /* @ECU_Address@EOP_CanEngPercTqPoint3Ovv_P@ */ Scalar_FLOAT32_IEEE 0 EcuIntgdSwGend_CM_single__ 0.0 125.0 /end CHARACTERISTIC
/begin CHARACTERISTIC EOP_CanEngPercTqPoint4Ovv_P "SPN 539 - Engine Percent Torque Point 4 - Override Value" VALUE 0x40044A18 /* @ECU_Address@EOP_CanEngPercTqPoint4Ovv_P@ */ Scalar_FLOAT32_IEEE 0 EcuIntgdSwGend_CM_single__ 0.0 125.0 /end CHARACTERISTIC
/begin CHARACTERISTIC EOP_CanEngPercTqPoint5Ovv_P "SPN 539 - Engine Percent Torque Point 5 - Override Value" VALUE 0x40044A20 /* @ECU_Address@EOP_CanEngPercTqPoint5Ovv_P@ */ Scalar_FLOAT32_IEEE 0 EcuIntgdSwGend_CM_single__ 0.0 125.0 /end CHARACTERISTIC
/begin CHARACTERISTIC EOP_CanEngRatedPwrOvv_P "SPN 166 - Engine Rated Power - Override Value" VALUE 0x40044A28 /* @ECU_Address@EOP_CanEngRatedPwrOvv_P@ */ Scalar_FLOAT32_IEEE 0 EcuIntgdSwGend_CM_single_kW 0.0 32128.0 /end CHARACTERISTIC
/begin CHARACTERISTIC EOP_CanEngRatedSpdOvv_P "SPN 189 - Engine Rated Speed - Override Value" VALUE 0x40044A30 /* @ECU_Address@EOP_CanEngRatedSpdOvv_P@ */ Scalar_FLOAT32_IEEE 0 EcuIntgdSwGend_CM_single_rpm 0.0 8032.0 /end CHARACTERISTIC
/begin CHARACTERISTIC EOP_CanEngRefTqOvv_P "SPN 544 - Engine Reference Torque - Override Value" VALUE 0x40044A38 /* @ECU_Address@EOP_CanEngRefTqOvv_P@ */ Scalar_FLOAT32_IEEE 0 EcuIntgdSwGend_CM_single_N_m 0.0 64255.0 /end CHARACTERISTIC
/begin CHARACTERISTIC EOP_CanEngSpdOvv_P "SPN 190 - Engine Speed - Override Value" VALUE 0x40044A48 /* @ECU_Address@EOP_CanEngSpdOvv_P@ */ Scalar_FLOAT32_IEEE 0 EcuIntgdSwGend_CM_single_rpm 0.0 8032.0 /end CHARACTERISTIC
/begin CHARACTERISTIC EOP_CanEngSpdPoint1Ovv_P "SPN 188 - Engine Speed Point 1 - Override Value" VALUE 0x40044A50 /* @ECU_Address@EOP_CanEngSpdPoint1Ovv_P@ */ Scalar_FLOAT32_IEEE 0 EcuIntgdSwGend_CM_single_rpm 0.0 8031.0 /end CHARACTERISTIC
/begin CHARACTERISTIC EOP_CanEngSpdPoint2Ovv_P "SPN 528 - Engine Speed Point 2 - Override Value" VALUE 0x40044A58 /* @ECU_Address@EOP_CanEngSpdPoint2Ovv_P@ */ Scalar_FLOAT32_IEEE 0 EcuIntgdSwGend_CM_single_rpm 0.0 8031.0 /end CHARACTERISTIC
/begin CHARACTERISTIC EOP_CanEngSpdPoint3Ovv_P "SPN 529 - Engine Speed Point 3 - Override Value" VALUE 0x40044A60 /* @ECU_Address@EOP_CanEngSpdPoint3Ovv_P@ */ Scalar_FLOAT32_IEEE 0 EcuIntgdSwGend_CM_single_rpm 0.0 8031.0 /end CHARACTERISTIC
/begin CHARACTERISTIC EOP_CanEngSpdPoint4Ovv_P "SPN 530 - Engine Speed Point 4 - Override Value" VALUE 0x40044A68 /* @ECU_Address@EOP_CanEngSpdPoint4Ovv_P@ */ Scalar_FLOAT32_IEEE 0 EcuIntgdSwGend_CM_single_rpm 0.0 8031.0 /end CHARACTERISTIC
/begin CHARACTERISTIC EOP_CanEngSpdPoint5Ovv_P "SPN 531 - Engine Speed Point 5 - Override Value" VALUE 0x40044A70 /* @ECU_Address@EOP_CanEngSpdPoint5Ovv_P@ */ Scalar_FLOAT32_IEEE 0 EcuIntgdSwGend_CM_single_rpm 0.0 8031.0 /end CHARACTERISTIC
/begin CHARACTERISTIC EOP_CanEngSpdPoint6Ovv_P "SPN 532 - Engine Speed Point 6 - Override Value" VALUE 0x40044A78 /* @ECU_Address@EOP_CanEngSpdPoint6Ovv_P@ */ Scalar_FLOAT32_IEEE 0 EcuIntgdSwGend_CM_single_rpm 0.0 8031.0 /end CHARACTERISTIC
/begin CHARACTERISTIC EOP_CanEngSpdPoint7Ovv_P "SPN 533 - Engine Speed Point 7 - Override Value" VALUE 0x40044A80 /* @ECU_Address@EOP_CanEngSpdPoint7Ovv_P@ */ Scalar_FLOAT32_IEEE 0 EcuIntgdSwGend_CM_single_rpm 0.0 8031.0 /end CHARACTERISTIC
/begin CHARACTERISTIC EOP_CanEngTotFuQntyOvv_P "SPN 250 - Engine Total Fuel Used - Override Value" VALUE 0x40044A98 /* @ECU_Address@EOP_CanEngTotFuQntyOvv_P@ */ Scalar_FLOAT32_IEEE 0 EcuIntgdSwGend_CM_single_L 0.0 2.105540608E+9 /end CHARACTERISTIC
/begin CHARACTERISTIC EOP_CanEngTqModOvv_P "SPN 899 - Engine Torque Mode - Override Value" VALUE 0x40044AA0 /* @ECU_Address@EOP_CanEngTqModOvv_P@ */ Scalar_FLOAT32_IEEE 0 EcuIntgdSwGend_CM_single 0.0 15.0 /end CHARACTERISTIC
/begin CHARACTERISTIC EOP_CanLvlOilOvv_P "SPN 98 - Engine Oil Level - Override Value" VALUE 0x40044AB0 /* @ECU_Address@EOP_CanLvlOilOvv_P@ */ Scalar_FLOAT32_IEEE 0 EcuIntgdSwGend_CM_single__ 0.0 100.0 /end CHARACTERISTIC
/begin CHARACTERISTIC EOP_CanNomFricPercTqOvv_P "SPN 514 - Nominal Friction - Percent Torque - Override Value" VALUE 0x40044AB8 /* @ECU_Address@EOP_CanNomFricPercTqOvv_P@ */ Scalar_FLOAT32_IEEE 0 EcuIntgdSwGend_CM_single__ 0.0 100.0 /end CHARACTERISTIC
/begin CHARACTERISTIC EOP_CanPFuOvv_P "SPN 94 - Engine Fuel Delivery Pressure - Override Value" VALUE 0x40044AD0 /* @ECU_Address@EOP_CanPFuOvv_P@ */ Scalar_FLOAT32_IEEE 0 EcuIntgdSwGend_CM_single_kPa 0.0 1000.0 /end CHARACTERISTIC
/begin CHARACTERISTIC EOP_CanPRailOvv_P "SPN 157 - Engine Injector Metering Rail 1 Pressure - Override Value" VALUE 0x40044AE0 /* @ECU_Address@EOP_CanPRailOvv_P@ */ Scalar_FLOAT32_IEEE 0 EcuIntgdSwGend_CM_single_MPa 0.0 251.0 /end CHARACTERISTIC
/begin CHARACTERISTIC EOP_CanPercLoadAtCurrentSpdOvv_P "SPN 92 - Engine Percent Load At Current Speed - Override Value" VALUE 0x40044AF0 /* @ECU_Address@EOP_CanPercLoadAtCurrentSpdOvv_P@ */ Scalar_FLOAT32_IEEE 0 EcuIntgdSwGend_CM_single__ 0.0 250.0 /end CHARACTERISTIC
/begin CHARACTERISTIC EOP_CanPosOfWg1Ovv_P "SPN 1188 - Engine Turbocharger Wastegate Actuator 1 Position - Override Value" VALUE 0x40044AF8 /* @ECU_Address@EOP_CanPosOfWg1Ovv_P@ */ Scalar_FLOAT32_IEEE 0 EcuIntgdSwGend_CM_single__ 0.0 100.0 /end CHARACTERISTIC
/begin CHARACTERISTIC EOP_CanSoiMaiInjOvv_P "SPN1436 - Engine Actual Ignition Timing - Override Value" VALUE 0x40044B08 /* @ECU_Address@EOP_CanSoiMaiInjOvv_P@ */ Scalar_FLOAT32_IEEE 0 EcuIntgdSwGend_CM_single_deg -200.0 302.0 /end CHARACTERISTIC
/begin CHARACTERISTIC EOP_CanTAirBoostHiReslOvv_P "SPN 1636 - Engine Intake Manifold 1 Temperature (High Resolution) - Override Value" VALUE 0x40044B10 /* @ECU_Address@EOP_CanTAirBoostHiReslOvv_P@ */ Scalar_FLOAT32_IEEE 0 EcuIntgdSwGend_CM_single_degC -273.0 1735.0 /end CHARACTERISTIC
/begin CHARACTERISTIC EOP_CanTAmbAirOvv_P "SPN 171 - Ambient Air Temperature - Override Value" VALUE 0x40044B20 /* @ECU_Address@EOP_CanTAmbAirOvv_P@ */ Scalar_FLOAT32_IEEE 0 EcuIntgdSwGend_CM_single -40.0 250.0 /end CHARACTERISTIC
/begin CHARACTERISTIC EOP_CanTCooltOvv_P "SPN 1637 - Engine Coolant Temperature (High Resolution) - Override Value" VALUE 0x40044B28 /* @ECU_Address@EOP_CanTCooltOvv_P@ */ Scalar_FLOAT32_IEEE 0 EcuIntgdSwGend_CM_single_degC -273.0 1735.0 /end CHARACTERISTIC
/begin CHARACTERISTIC EOP_CanTEcuOvv_P "SPN 1136 - Engine ECU Temperature - Override Value" VALUE 0x40044B30 /* @ECU_Address@EOP_CanTEcuOvv_P@ */ Scalar_FLOAT32_IEEE 0 EcuIntgdSwGend_CM_single_degC -273.0 1735.0 /end CHARACTERISTIC
/begin CHARACTERISTIC EOP_CanTFuOvv_P "SPN 174 - Engine Fuel Temperature - Override Value" VALUE 0x40044B38 /* @ECU_Address@EOP_CanTFuOvv_P@ */ Scalar_FLOAT32_IEEE 0 EcuIntgdSwGend_CM_single_degC -40.0 210.0 /end CHARACTERISTIC
/begin CHARACTERISTIC EOP_CanTOilOvv_P "SPN 175 - Engine Oil Temperature - Override Value" VALUE 0x40044B40 /* @ECU_Address@EOP_CanTOilOvv_P@ */ Scalar_FLOAT32_IEEE 0 EcuIntgdSwGend_CM_single_degC -273.0 1735.0 /end CHARACTERISTIC
/begin CHARACTERISTIC EOP_CanWhlBasVehSpdOvv_P "SPN 84 - Wheel-Based Vehicle Speed - Override Value" VALUE 0x40044B48 /* @ECU_Address@EOP_CanWhlBasVehSpdOvv_P@ */ Scalar_FLOAT32_IEEE 0 EcuIntgdSwGend_CM_single_km_h 0.0 250.0 /end CHARACTERISTIC
/begin CHARACTERISTIC EOP_EngRatedPwr_P "Engine Rated Power Parameter" VALUE 0x40044BFC /* @ECU_Address@EOP_EngRatedPwr_P@ */ Scalar_FLOAT32_IEEE 0 EcuIntgdSwGend_CM_single_kW 0.0 32128.0 /end CHARACTERISTIC
/begin CHARACTERISTIC EOP_EngRatedSpd_P "Engine Rated Speed Parameter" VALUE 0x40044C00 /* @ECU_Address@EOP_EngRatedSpd_P@ */ Scalar_FLOAT32_IEEE 0 EcuIntgdSwGend_CM_single_rpm 0.0 8032.0 /end CHARACTERISTIC
/begin CHARACTERISTIC EngBrk_NEngActvThd_P "Engine Speed Activation Threshold Parameter" VALUE 0x40044D60 /* @ECU_Address@EngBrk_NEngActvThd_P@ */ Scalar_FLOAT32_IEEE 0 EcuIntgdSwGend_CM_single_rpm 0.0 3000.0 /end CHARACTERISTIC
/begin CHARACTERISTIC EngBrk_NEngDeacThd_P "Engine Speed Deactivation Threshold Parameter" VALUE 0x40044D64 /* @ECU_Address@EngBrk_NEngDeacThd_P@ */ Scalar_FLOAT32_IEEE 0 EcuIntgdSwGend_CM_single_rpm 0.0 3000.0 /end CHARACTERISTIC
/begin CHARACTERISTIC EngBrk_PAirBoostMaxThd_P "Air Boost Pressure Maximum Threshold Parameter" VALUE 0x40044D68 /* @ECU_Address@EngBrk_PAirBoostMaxThd_P@ */ Scalar_FLOAT32_IEEE 0 EcuIntgdSwGend_CM_single_mbar 0.0 15000.0 /end CHARACTERISTIC
/begin CHARACTERISTIC EngBrk_PercgAccrThd_P "Percentage Accelerate Threshold Parameter" VALUE 0x40044D6C /* @ECU_Address@EngBrk_PercgAccrThd_P@ */ Scalar_FLOAT32_IEEE 0 EcuIntgdSwGend_CM_single__ 0.0 100.0 /end CHARACTERISTIC
/begin CHARACTERISTIC EngBrk_VehVMinThd_P "Vehicle Velocity Minimum Threshold Prameter" VALUE 0x40044D78 /* @ECU_Address@EngBrk_VehVMinThd_P@ */ Scalar_FLOAT32_IEEE 0 EcuIntgdSwGend_CM_single_km 0.0 150.0 /end CHARACTERISTIC
/begin CHARACTERISTIC IC_FacCyl1SatMax_P "Cylinder Balancing PID Controller Maximum Saturation Factor Parameter for Cylinder 1" VALUE 0x40044E98 /* @ECU_Address@IC_FacCyl1SatMax_P@ */ Scalar_FLOAT32_IEEE 0 EcuIntgdSwGend_CM_single -0.15 0.15 /end CHARACTERISTIC
/begin CHARACTERISTIC IC_FacCyl1SatMin_P "Cylinder Balancing PID Controller Minimum Saturation Factor Parameter for Cylinder 1" VALUE 0x40044E9C /* @ECU_Address@IC_FacCyl1SatMin_P@ */ Scalar_FLOAT32_IEEE 0 EcuIntgdSwGend_CM_single -0.15 0.15 /end CHARACTERISTIC
/begin CHARACTERISTIC IC_FacCyl2SatMax_P "Cylinder Balancing PID Controller Maximum Saturation Factor Parameter for Cylinder 2" VALUE 0x40044EA0 /* @ECU_Address@IC_FacCyl2SatMax_P@ */ Scalar_FLOAT32_IEEE 0 EcuIntgdSwGend_CM_single -0.15 0.15 /end CHARACTERISTIC
/begin CHARACTERISTIC IC_FacCyl2SatMin_P "Cylinder Balancing PID Controller Minimum Saturation Factor Parameter for Cylinder 2" VALUE 0x40044EA4 /* @ECU_Address@IC_FacCyl2SatMin_P@ */ Scalar_FLOAT32_IEEE 0 EcuIntgdSwGend_CM_single -0.15 0.15 /end CHARACTERISTIC
/begin CHARACTERISTIC IC_FacCyl3SatMax_P "Cylinder Balancing PID Controller Maximum Saturation Factor Parameter for Cylinder 3" VALUE 0x40044EA8 /* @ECU_Address@IC_FacCyl3SatMax_P@ */ Scalar_FLOAT32_IEEE 0 EcuIntgdSwGend_CM_single -0.15 0.15 /end CHARACTERISTIC
/begin CHARACTERISTIC IC_FacCyl3SatMin_P "Cylinder Balancing PID Controller Minimum Saturation Factor Parameter for Cylinder 3" VALUE 0x40044EAC /* @ECU_Address@IC_FacCyl3SatMin_P@ */ Scalar_FLOAT32_IEEE 0 EcuIntgdSwGend_CM_single -0.15 0.15 /end CHARACTERISTIC
/begin CHARACTERISTIC IC_FacCyl4SatMax_P "Cylinder Balancing PID Controller Maximum Saturation Factor Parameter for Cylinder 4" VALUE 0x40044EB0 /* @ECU_Address@IC_FacCyl4SatMax_P@ */ Scalar_FLOAT32_IEEE 0 EcuIntgdSwGend_CM_single -0.15 0.15 /end CHARACTERISTIC
/begin CHARACTERISTIC IC_FacCyl4SatMin_P "Cylinder Balancing PID Controller Minimum Saturation Factor Parameter for Cylinder 4" VALUE 0x40044EB4 /* @ECU_Address@IC_FacCyl4SatMin_P@ */ Scalar_FLOAT32_IEEE 0 EcuIntgdSwGend_CM_single -0.15 0.15 /end CHARACTERISTIC
/begin CHARACTERISTIC IC_FacCyl5SatMax_P "Cylinder Balancing PID Controller Maximum Saturation Factor Parameter for Cylinder 5" VALUE 0x40044EB8 /* @ECU_Address@IC_FacCyl5SatMax_P@ */ Scalar_FLOAT32_IEEE 0 EcuIntgdSwGend_CM_single -0.15 0.15 /end CHARACTERISTIC
/begin CHARACTERISTIC IC_FacCyl5SatMin_P "Cylinder Balancing PID Controller Minimum Saturation Factor Parameter for Cylinder 5" VALUE 0x40044EBC /* @ECU_Address@IC_FacCyl5SatMin_P@ */ Scalar_FLOAT32_IEEE 0 EcuIntgdSwGend_CM_single -0.15 0.15 /end CHARACTERISTIC
/begin CHARACTERISTIC IC_FacCyl6SatMax_P "Cylinder Balancing PID Controller Maximum Saturation Factor Parameter for Cylinder 6" VALUE 0x40044EC0 /* @ECU_Address@IC_FacCyl6SatMax_P@ */ Scalar_FLOAT32_IEEE 0 EcuIntgdSwGend_CM_single -0.15 0.15 /end CHARACTERISTIC
/begin CHARACTERISTIC IC_FacCyl6SatMin_P "Cylinder Balancing PID Controller Minimum Saturation Factor Parameter for Cylinder 6" VALUE 0x40044EC4 /* @ECU_Address@IC_FacCyl6SatMin_P@ */ Scalar_FLOAT32_IEEE 0 EcuIntgdSwGend_CM_single -0.15 0.15 /end CHARACTERISTIC
/begin CHARACTERISTIC IC_KdCoeffCyl1_P "Cylinder Balancing PID Controller D Filter Coefficient for Cylinder 1 Parameter" VALUE 0x40045AAC /* @ECU_Address@IC_KdCoeffCyl1_P@ */ Scalar_FLOAT32_IEEE 0 EcuIntgdSwGend_CM_single -100.0 100.0 /end CHARACTERISTIC
/begin CHARACTERISTIC IC_KdCoeffCyl2_P "Cylinder Balancing PID Controller D Filter Coefficient for Cylinder 2 Parameter" VALUE 0x40045AB0 /* @ECU_Address@IC_KdCoeffCyl2_P@ */ Scalar_FLOAT32_IEEE 0 EcuIntgdSwGend_CM_single -100.0 100.0 /end CHARACTERISTIC
/begin CHARACTERISTIC IC_KdCoeffCyl3_P "Cylinder Balancing PID Controller D Filter Coefficient for Cylinder 3 Parameter" VALUE 0x40045AB4 /* @ECU_Address@IC_KdCoeffCyl3_P@ */ Scalar_FLOAT32_IEEE 0 EcuIntgdSwGend_CM_single -100.0 100.0 /end CHARACTERISTIC
/begin CHARACTERISTIC IC_KdCoeffCyl4_P "Cylinder Balancing PID Controller D Filter Coefficient for Cylinder 4 Parameter" VALUE 0x40045AB8 /* @ECU_Address@IC_KdCoeffCyl4_P@ */ Scalar_FLOAT32_IEEE 0 EcuIntgdSwGend_CM_single -100.0 100.0 /end CHARACTERISTIC
/begin CHARACTERISTIC IC_KdCoeffCyl5_P "Cylinder Balancing PID Controller D Filter Coefficient for Cylinder 5 Parameter" VALUE 0x40045ABC /* @ECU_Address@IC_KdCoeffCyl5_P@ */ Scalar_FLOAT32_IEEE 0 EcuIntgdSwGend_CM_single -100.0 100.0 /end CHARACTERISTIC
/begin CHARACTERISTIC IC_KdCoeffCyl6_P "Cylinder Balancing PID Controller D Filter Coefficient for Cylinder 6 Parameter" VALUE 0x40045AC0 /* @ECU_Address@IC_KdCoeffCyl6_P@ */ Scalar_FLOAT32_IEEE 0 EcuIntgdSwGend_CM_single -100.0 100.0 /end CHARACTERISTIC
/begin CHARACTERISTIC IC_KdCyl1_P "Cylinder Balancing PID Controller D Coefficient for Cylinder 1 Parameter" VALUE 0x40045AC4 /* @ECU_Address@IC_KdCyl1_P@ */ Scalar_FLOAT32_IEEE 0 EcuIntgdSwGend_CM_single -100.0 100.0 /end CHARACTERISTIC
/begin CHARACTERISTIC IC_KdCyl2_P "Cylinder Balancing PID Controller D Coefficient for Cylinder 2 Parameter" VALUE 0x40045AC8 /* @ECU_Address@IC_KdCyl2_P@ */ Scalar_FLOAT32_IEEE 0 EcuIntgdSwGend_CM_single -100.0 100.0 /end CHARACTERISTIC
/begin CHARACTERISTIC IC_KdCyl3_P "Cylinder Balancing PID Controller D Coefficient for Cylinder 3 Parameter" VALUE 0x40045ACC /* @ECU_Address@IC_KdCyl3_P@ */ Scalar_FLOAT32_IEEE 0 EcuIntgdSwGend_CM_single -100.0 100.0 /end CHARACTERISTIC
/begin CHARACTERISTIC IC_KdCyl4_P "Cylinder Balancing PID Controller D Coefficient for Cylinder 4 Parameter" VALUE 0x40045AD0 /* @ECU_Address@IC_KdCyl4_P@ */ Scalar_FLOAT32_IEEE 0 EcuIntgdSwGend_CM_single -100.0 100.0 /end CHARACTERISTIC
/begin CHARACTERISTIC IC_KdCyl5_P "Cylinder Balancing PID Controller D Coefficient for Cylinder 5 Parameter" VALUE 0x40045AD4 /* @ECU_Address@IC_KdCyl5_P@ */ Scalar_FLOAT32_IEEE 0 EcuIntgdSwGend_CM_single -100.0 100.0 /end CHARACTERISTIC
/begin CHARACTERISTIC IC_KdCyl6_P "Cylinder Balancing PID Controller D Coefficient for Cylinder 6 Parameter" VALUE 0x40045AD8 /* @ECU_Address@IC_KdCyl6_P@ */ Scalar_FLOAT32_IEEE 0 EcuIntgdSwGend_CM_single -100.0 100.0 /end CHARACTERISTIC
/begin CHARACTERISTIC IC_KiCyl1_P "Cylinder Balancing PID Controller I Coefficient for Cylinder 1 Parameter" VALUE 0x40045ADC /* @ECU_Address@IC_KiCyl1_P@ */ Scalar_FLOAT32_IEEE 0 EcuIntgdSwGend_CM_single -100.0 100.0 /end CHARACTERISTIC
/begin CHARACTERISTIC IC_KiCyl2_P "Cylinder Balancing PID Controller I Coefficient for Cylinder 2 Parameter" VALUE 0x40045AE0 /* @ECU_Address@IC_KiCyl2_P@ */ Scalar_FLOAT32_IEEE 0 EcuIntgdSwGend_CM_single -100.0 100.0 /end CHARACTERISTIC
/begin CHARACTERISTIC IC_KiCyl3_P "Cylinder Balancing PID Controller I Coefficient for Cylinder 3 Parameter" VALUE 0x40045AE4 /* @ECU_Address@IC_KiCyl3_P@ */ Scalar_FLOAT32_IEEE 0 EcuIntgdSwGend_CM_single -100.0 100.0 /end CHARACTERISTIC
/begin CHARACTERISTIC IC_KiCyl4_P "Cylinder Balancing PID Controller I Coefficient for Cylinder 4 Parameter" VALUE 0x40045AE8 /* @ECU_Address@IC_KiCyl4_P@ */ Scalar_FLOAT32_IEEE 0 EcuIntgdSwGend_CM_single -100.0 100.0 /end CHARACTERISTIC
/begin CHARACTERISTIC IC_KiCyl5_P "Cylinder Balancing PID Controller I Coefficient for Cylinder 5 Parameter" VALUE 0x40045AEC /* @ECU_Address@IC_KiCyl5_P@ */ Scalar_FLOAT32_IEEE 0 EcuIntgdSwGend_CM_single -100.0 100.0 /end CHARACTERISTIC
/begin CHARACTERISTIC IC_KiCyl6_P "Cylinder Balancing PID Controller I Coefficient for Cylinder 6 Parameter" VALUE 0x40045AF0 /* @ECU_Address@IC_KiCyl6_P@ */ Scalar_FLOAT32_IEEE 0 EcuIntgdSwGend_CM_single -100.0 100.0 /end CHARACTERISTIC
/begin CHARACTERISTIC IC_KpCyl1_P "Cylinder Balancing PID Controller P Coefficient for Cylinder 1 Parameter" VALUE 0x40045AF4 /* @ECU_Address@IC_KpCyl1_P@ */ Scalar_FLOAT32_IEEE 0 EcuIntgdSwGend_CM_single -100.0 100.0 /end CHARACTERISTIC
/begin CHARACTERISTIC IC_KpCyl2_P "Cylinder Balancing PID Controller P Coefficient for Cylinder 2 Parameter" VALUE 0x40045AF8 /* @ECU_Address@IC_KpCyl2_P@ */ Scalar_FLOAT32_IEEE 0 EcuIntgdSwGend_CM_single -100.0 100.0 /end CHARACTERISTIC
/begin CHARACTERISTIC IC_KpCyl3_P "Cylinder Balancing PID Controller P Coefficient for Cylinder 3 Parameter" VALUE 0x40045AFC /* @ECU_Address@IC_KpCyl3_P@ */ Scalar_FLOAT32_IEEE 0 EcuIntgdSwGend_CM_single -100.0 100.0 /end CHARACTERISTIC
/begin CHARACTERISTIC IC_KpCyl4_P "Cylinder Balancing PID Controller P Coefficient for Cylinder 4 Parameter" VALUE 0x40045B00 /* @ECU_Address@IC_KpCyl4_P@ */ Scalar_FLOAT32_IEEE 0 EcuIntgdSwGend_CM_single -100.0 100.0 /end CHARACTERISTIC
/begin CHARACTERISTIC IC_KpCyl5_P "Cylinder Balancing PID Controller P Coefficient for Cylinder 5 Parameter" VALUE 0x40045B04 /* @ECU_Address@IC_KpCyl5_P@ */ Scalar_FLOAT32_IEEE 0 EcuIntgdSwGend_CM_single -100.0 100.0 /end CHARACTERISTIC
/begin CHARACTERISTIC IC_KpCyl6_P "Cylinder Balancing PID Controller P Coefficient for Cylinder 6 Parameter" VALUE 0x40045B08 /* @ECU_Address@IC_KpCyl6_P@ */ Scalar_FLOAT32_IEEE 0 EcuIntgdSwGend_CM_single -100.0 100.0 /end CHARACTERISTIC
/begin CHARACTERISTIC IC_SoiMaiInjOvv_P "Start of Main Injection  - Override Value Parameter" VALUE 0x40045E00 /* @ECU_Address@IC_SoiMaiInjOvv_P@ */ Scalar_FLOAT32_IEEE 0 EcuIntgdSwGend_CM_single_deg -100.0 100.0 /end CHARACTERISTIC
/begin CHARACTERISTIC IC_SoiMaiLimdHi_P "High Limited Start of Main Injection Parameter" VALUE 0x40045E04 /* @ECU_Address@IC_SoiMaiLimdHi_P@ */ Scalar_FLOAT32_IEEE 0 EcuIntgdSwGend_CM_single_deg -100.0 1000.0 /end CHARACTERISTIC
/begin CHARACTERISTIC IC_SoiMaiLimdLo_P "Low LimitedStart of Main Injection Parameter" VALUE 0x40045E08 /* @ECU_Address@IC_SoiMaiLimdLo_P@ */ Scalar_FLOAT32_IEEE 0 EcuIntgdSwGend_CM_single_deg -100.0 1000.0 /end CHARACTERISTIC
/begin CHARACTERISTIC IC_SoiPltInjOvv_P "Start of Pilot Injection  - Override Value Parameter" VALUE 0x40047BC0 /* @ECU_Address@IC_SoiPltInjOvv_P@ */ Scalar_FLOAT32_IEEE 0 EcuIntgdSwGend_CM_single_deg -100.0 100.0 /end CHARACTERISTIC
/begin CHARACTERISTIC IC_SoiPltLimdHi_P "High Limited Start of Pilot Injection Parameter" VALUE 0x400482CC /* @ECU_Address@IC_SoiPltLimdHi_P@ */ Scalar_FLOAT32_IEEE 0 EcuIntgdSwGend_CM_single_deg -100.0 1000.0 /end CHARACTERISTIC
/begin CHARACTERISTIC IC_SoiPltLimdLo_P "Low Limited Start of Pilot Injection Parameter" VALUE 0x400482D0 /* @ECU_Address@IC_SoiPltLimdLo_P@ */ Scalar_FLOAT32_IEEE 0 EcuIntgdSwGend_CM_single_deg -100.0 1000.0 /end CHARACTERISTIC
/begin CHARACTERISTIC RPG_PRailSetPointOvv_P "Rail Pressure Set Point - Override Value Parameter" VALUE 0x4004A414 /* @ECU_Address@RPG_PRailSetPointOvv_P@ */ Scalar_FLOAT32_IEEE 0 EcuIntgdSwGend_CM_single_bar 0.0 5000.0 /end CHARACTERISTIC
/begin CHARACTERISTIC RPG_TCooltMap1Thd_P "Coolant High Temperature Map 1 Threshold Parameter" VALUE 0x4004AEC8 /* @ECU_Address@RPG_TCooltMap1Thd_P@ */ Scalar_FLOAT32_IEEE 0 EcuIntgdSwGend_CM_single_degC -40.0 250.0 /end CHARACTERISTIC
/begin CHARACTERISTIC RPG_TCooltMap2Thd_P "Coolant High Temperature Map 2 Threshold Parameter" VALUE 0x4004AECC /* @ECU_Address@RPG_TCooltMap2Thd_P@ */ Scalar_FLOAT32_IEEE 0 EcuIntgdSwGend_CM_single_degC -40.0 250.0 /end CHARACTERISTIC
/begin CHARACTERISTIC RPG_TCooltMap3Thd_P "Coolant High Temperature Map 3 Threshold Parameter" VALUE 0x4004AED0 /* @ECU_Address@RPG_TCooltMap3Thd_P@ */ Scalar_FLOAT32_IEEE 0 EcuIntgdSwGend_CM_single_degC -40.0 250.0 /end CHARACTERISTIC
/begin CHARACTERISTIC SC_LvlFuPreTestMin_P "" VALUE 0x4004B040 /* @ECU_Address@SC_LvlFuPreTestMin_P@ */ Scalar_FLOAT32_IEEE 0 EcuIntgdSwGend_CM_single__ 0.0 100.0 /end CHARACTERISTIC
/begin CHARACTERISTIC SC_LvlOilPreTestMin_P "" VALUE 0x4004B048 /* @ECU_Address@SC_LvlOilPreTestMin_P@ */ Scalar_FLOAT32_IEEE 0 EcuIntgdSwGend_CM_single__ 0.0 100.0 /end CHARACTERISTIC
/begin CHARACTERISTIC SC_NEngThdForOvrHeatProtn_P "Engine Speed Threshold Parameter for OverHeat Protection" VALUE 0x4004B058 /* @ECU_Address@SC_NEngThdForOvrHeatProtn_P@ */ Scalar_FLOAT32_IEEE 0 EcuIntgdSwGend_CM_single_rpm 0.0 800.0 /end CHARACTERISTIC
/begin CHARACTERISTIC SC_NEngThdForStrtTurn_P "Engine Speed Threshold Parameter for Engine Not Turn" VALUE 0x4004B05C /* @ECU_Address@SC_NEngThdForStrtTurn_P@ */ Scalar_FLOAT32_IEEE 0 EcuIntgdSwGend_CM_single_rpm 0.0 200.0 /end CHARACTERISTIC
/begin CHARACTERISTIC SC_TiAcvnErrPCVDeb_P "PCV Error Debouncer Activation Timer Parameter" VALUE 0x4004B064 /* @ECU_Address@SC_TiAcvnErrPCVDeb_P@ */ Scalar_FLOAT32_IEEE 0 EcuIntgdSwGend_CM_single_ms 0.0 50000.0 /end CHARACTERISTIC
/begin CHARACTERISTIC SC_TiAcvnErrVCVDeb_P "VCV Error Debouncer Activation Timer Parameter" VALUE 0x4004B068 /* @ECU_Address@SC_TiAcvnErrVCVDeb_P@ */ Scalar_FLOAT32_IEEE 0 EcuIntgdSwGend_CM_single_ms 0.0 50000.0 /end CHARACTERISTIC
/begin CHARACTERISTIC SC_TiAcvnLvlFuDeb_P "Fuel Level Debouncer Activation Timer Parameter" VALUE 0x4004B06C /* @ECU_Address@SC_TiAcvnLvlFuDeb_P@ */ Scalar_FLOAT32_IEEE 0 EcuIntgdSwGend_CM_single_ms 0.0 50000.0 /end CHARACTERISTIC
/begin CHARACTERISTIC SC_TiAcvnLvlOilDeb_P "Oil Level Debouncer Activation Timer Parameter" VALUE 0x4004B070 /* @ECU_Address@SC_TiAcvnLvlOilDeb_P@ */ Scalar_FLOAT32_IEEE 0 EcuIntgdSwGend_CM_single_ms 0.0 50000.0 /end CHARACTERISTIC
/begin CHARACTERISTIC SC_TiEngNotTurnTiEna_P "Timer Time Parameter of Engine Not Turn" VALUE 0x4004B098 /* @ECU_Address@SC_TiEngNotTurnTiEna_P@ */ Scalar_FLOAT32_IEEE 0 EcuIntgdSwGend_CM_single_ms 0.0 100000.0 /end CHARACTERISTIC
/begin CHARACTERISTIC SC_TiForEngProtn_P "Timer Parameter for Engine OverHeat Protection" VALUE 0x4004B09C /* @ECU_Address@SC_TiForEngProtn_P@ */ Scalar_FLOAT32_IEEE 0 EcuIntgdSwGend_CM_single_ms 0.0 100000.0 /end CHARACTERISTIC
/begin CHARACTERISTIC SpdLimr_IntglRstErrVehThd_P "Integral Reset Vehicle Speed Error Threshold" VALUE 0x4004B2AC /* @ECU_Address@SpdLimr_IntglRstErrVehThd_P@ */ Scalar_FLOAT32_IEEE 0 EcuIntgdSwGend_CM_single_km_h -100.0 100.0 /end CHARACTERISTIC
/begin CHARACTERISTIC SpdLimr_PIDCoeffDOvv_P "PID Derivative Coefficient for Cruise Control - Override Value" VALUE 0x4004B2E0 /* @ECU_Address@SpdLimr_PIDCoeffDOvv_P@ */ Scalar_FLOAT32_IEEE 0 EcuIntgdSwGend_CM_single 0.0 1000.0 /end CHARACTERISTIC
/begin CHARACTERISTIC SpdLimr_PIDCoeffFiltOvv_P "PID Filter Coefficient for Cruise Control - Override Value" VALUE 0x4004B2E8 /* @ECU_Address@SpdLimr_PIDCoeffFiltOvv_P@ */ Scalar_FLOAT32_IEEE 0 EcuIntgdSwGend_CM_single 0.0 1000.0 /end CHARACTERISTIC
/begin CHARACTERISTIC SpdLimr_PIDCoeffIOvv_P "PID Integrator Coefficient for Cruise Control - Override Value" VALUE 0x4004B2F0 /* @ECU_Address@SpdLimr_PIDCoeffIOvv_P@ */ Scalar_FLOAT32_IEEE 0 EcuIntgdSwGend_CM_single 0.0 1000.0 /end CHARACTERISTIC
/begin CHARACTERISTIC SpdLimr_PIDCoeffPOvv_P "PID Proportional Coefficient for Cruise Control - Override Value" VALUE 0x4004B2F8 /* @ECU_Address@SpdLimr_PIDCoeffPOvv_P@ */ Scalar_FLOAT32_IEEE 0 EcuIntgdSwGend_CM_single 0.0 1000.0 /end CHARACTERISTIC
/begin CHARACTERISTIC SpdLimr_PIDMin_P "Minimum Value of PID Parameter" VALUE 0x4004B38C /* @ECU_Address@SpdLimr_PIDMin_P@ */ Scalar_FLOAT32_IEEE 0 EcuIntgdSwGend_CM_single_N_m -5000.0 5000.0 /end CHARACTERISTIC
/begin CHARACTERISTIC TL_NEngAcvTqLimnForNExhTrbChrg_P "Engine Speed Torque Limitation Activation Threshold for Turbo Charger Speed" VALUE 0x4004B450 /* @ECU_Address@TL_NEngAcvTqLimnForNExhTrbChrg_P@ */ Scalar_FLOAT32_IEEE 0 EcuIntgdSwGend_CM_single_rpm 0.0 5000.0 /end CHARACTERISTIC
/begin CHARACTERISTIC TL_NEngAcvTqLimnForPAirAmb_P "Engine Speed Torque Limitation Activation Threshold for Ambient Air Pressure" VALUE 0x4004B454 /* @ECU_Address@TL_NEngAcvTqLimnForPAirAmb_P@ */ Scalar_FLOAT32_IEEE 0 EcuIntgdSwGend_CM_single_rpm 0.0 5000.0 /end CHARACTERISTIC
/begin CHARACTERISTIC TL_NEngAcvTqLimnForPAirBoost_P "Engine Speed Torque Limitation Activation Threshold for AirBoost Pressure" VALUE 0x4004B458 /* @ECU_Address@TL_NEngAcvTqLimnForPAirBoost_P@ */ Scalar_FLOAT32_IEEE 0 EcuIntgdSwGend_CM_single_rpm 0.0 5000.0 /end CHARACTERISTIC
/begin CHARACTERISTIC TL_NEngAcvTqLimnForTAir_P "Engine Speed Torque Limitation Activation Threshold for Air Boost Temperature" VALUE 0x4004B45C /* @ECU_Address@TL_NEngAcvTqLimnForTAir_P@ */ Scalar_FLOAT32_IEEE 0 EcuIntgdSwGend_CM_single_rpm 0.0 5000.0 /end CHARACTERISTIC
/begin CHARACTERISTIC TL_NEngAcvTqLimnForTCoolt_P "Engine Speed Torque Limitation Activation Threshold for Coolant High Temperature" VALUE 0x4004B460 /* @ECU_Address@TL_NEngAcvTqLimnForTCoolt_P@ */ Scalar_FLOAT32_IEEE 0 EcuIntgdSwGend_CM_single_rpm 0.0 5000.0 /end CHARACTERISTIC
/begin CHARACTERISTIC TL_NEngAcvTqLimnForTFu_P "Engine Speed Torque Limitation Activation Threshold for Fuel Temperature" VALUE 0x4004B464 /* @ECU_Address@TL_NEngAcvTqLimnForTFu_P@ */ Scalar_FLOAT32_IEEE 0 EcuIntgdSwGend_CM_single_rpm 0.0 5000.0 /end CHARACTERISTIC
/begin CHARACTERISTIC TL_NEngAcvTqLimnForTOil_P "Engine Speed Torque Limitation Activation Threshold for Oil Temperature" VALUE 0x4004B468 /* @ECU_Address@TL_NEngAcvTqLimnForTOil_P@ */ Scalar_FLOAT32_IEEE 0 EcuIntgdSwGend_CM_single_rpm 0.0 5000.0 /end CHARACTERISTIC
/begin CHARACTERISTIC TL_PercgTqLimnForErrTCooltSnsr_P "Percentage Parameter of Torque Limitation for Coolant High Temperature Sensor Error Dependent" VALUE 0x4004B58C /* @ECU_Address@TL_PercgTqLimnForErrTCooltSnsr_P@ */ Scalar_FLOAT32_IEEE 0 EcuIntgdSwGend_CM_single__ 0.0 100.0 /end CHARACTERISTIC
/begin CHARACTERISTIC TL_PercgTqLimnForErrTOilSnsr_P "Percentage Parameter of Torque Limitation for Oil Temperature Sensor Error Dependent" VALUE 0x4004B590 /* @ECU_Address@TL_PercgTqLimnForErrTOilSnsr_P@ */ Scalar_FLOAT32_IEEE 0 EcuIntgdSwGend_CM_single__ 0.0 100.0 /end CHARACTERISTIC
/begin CHARACTERISTIC TL_TiTqLimnForNExhTrbChrgDeb_P "Time Value of Engine Dependent Activation for Turbo Charger Speed Limitation" VALUE 0x4004C228 /* @ECU_Address@TL_TiTqLimnForNExhTrbChrgDeb_P@ */ Scalar_FLOAT32_IEEE 0 EcuIntgdSwGend_CM_single_ms 0.0 100000.0 /end CHARACTERISTIC
/begin CHARACTERISTIC TL_TiTqLimnForPAirAmbDeb_P "Time Value of Engine Dependent Activation for Ambient Air Pressure Limitation" VALUE 0x4004C22C /* @ECU_Address@TL_TiTqLimnForPAirAmbDeb_P@ */ Scalar_FLOAT32_IEEE 0 EcuIntgdSwGend_CM_single_ms 0.0 100000.0 /end CHARACTERISTIC
/begin CHARACTERISTIC TL_TiTqLimnForPAirBoostDeb_P "Time Value of Engine Dependent Activation for Air Boost Pressure Limitation" VALUE 0x4004C230 /* @ECU_Address@TL_TiTqLimnForPAirBoostDeb_P@ */ Scalar_FLOAT32_IEEE 0 EcuIntgdSwGend_CM_single_ms 0.0 100000.0 /end CHARACTERISTIC
/begin CHARACTERISTIC TL_TiTqLimnForTAirDeb_P "Time Value of Engine Dependent Activation for Air Boost Temperature Limitation" VALUE 0x4004C234 /* @ECU_Address@TL_TiTqLimnForTAirDeb_P@ */ Scalar_FLOAT32_IEEE 0 EcuIntgdSwGend_CM_single_ms 0.0 100000.0 /end CHARACTERISTIC
/begin CHARACTERISTIC TL_TiTqLimnForTCooltDeb_P "Time Value of Engine Dependent Activation for Coolant High Temperature Limitation" VALUE 0x4004C238 /* @ECU_Address@TL_TiTqLimnForTCooltDeb_P@ */ Scalar_FLOAT32_IEEE 0 EcuIntgdSwGend_CM_single_ms 0.0 100000.0 /end CHARACTERISTIC
/begin CHARACTERISTIC TL_TiTqLimnForTFuDeb_P "Time Value of Engine Dependent Activation for Fuel Temperature Limitation" VALUE 0x4004C23C /* @ECU_Address@TL_TiTqLimnForTFuDeb_P@ */ Scalar_FLOAT32_IEEE 0 EcuIntgdSwGend_CM_single_ms 0.0 100000.0 /end CHARACTERISTIC
/begin CHARACTERISTIC TL_TiTqLimnForTOilDeb_P "Time Value of Engine Dependent Activation for Oil Temperature Limitation" VALUE 0x4004C240 /* @ECU_Address@TL_TiTqLimnForTOilDeb_P@ */ Scalar_FLOAT32_IEEE 0 EcuIntgdSwGend_CM_single_ms 0.0 100000.0 /end CHARACTERISTIC
/begin CHARACTERISTIC WM_MaskGEOvv_P "Global Enable Mask - Override Parameter" VALUE 0x40050800 /* @ECU_Address@WM_MaskGEOvv_P@ */ Scalar_ULONG 0 EcuIntgdSwGend_CM_uint32 0.0 4.294967295E+9 /end CHARACTERISTIC
/begin CHARACTERISTIC WM_MaskRTNForAcvLimp_P "Return To Normal Mask for Limp Activation Parameter" VALUE 0x4005082C /* @ECU_Address@WM_MaskRTNForAcvLimp_P@ */ Scalar_ULONG 0 EcuIntgdSwGend_CM_uint32 0.0 4.294967295E+9 /end CHARACTERISTIC
/begin CHARACTERISTIC WM_MaskRTNForEmgcyShtdwnForOvspd_P "Return To Normal Mask for Emergency Shutdown for Overspeed" VALUE 0x40050830 /* @ECU_Address@WM_MaskRTNForEmgcyShtdwnForOvspd_P@ */ Scalar_ULONG 0 EcuIntgdSwGend_CM_uint32 0.0 4.294967295E+9 /end CHARACTERISTIC
/begin CHARACTERISTIC WM_MaskRTNForErrCamCrankTotLoss_P "Return To Normal Mask for Cam Crank Total Loss" VALUE 0x40050834 /* @ECU_Address@WM_MaskRTNForErrCamCrankTotLoss_P@ */ Scalar_ULONG 0 EcuIntgdSwGend_CM_uint32 0.0 4.294967295E+9 /end CHARACTERISTIC
/begin CHARACTERISTIC WM_MaskRTNForErrInjrShtdwn_P "Return To Normal Mask for Injection Error Shutdown" VALUE 0x40050850 /* @ECU_Address@WM_MaskRTNForErrInjrShtdwn_P@ */ Scalar_ULONG 0 EcuIntgdSwGend_CM_uint32 0.0 4.294967295E+9 /end CHARACTERISTIC
/begin CHARACTERISTIC WM_MaskRTNForPRailNotCtldMsg_P "Return To Normal Mask for Rail Pressure is Not Controlled Message Parameter" VALUE 0x400508AC /* @ECU_Address@WM_MaskRTNForPRailNotCtldMsg_P@ */ Scalar_ULONG 0 EcuIntgdSwGend_CM_uint32 0.0 4.294967295E+9 /end CHARACTERISTIC
/begin CHARACTERISTIC WM_MaskRctnForAcvLimp_P "Mask Reaction for Limp Active Parameter" VALUE 0x400508B8 /* @ECU_Address@WM_MaskRctnForAcvLimp_P@ */ Scalar_ULONG 0 EcuIntgdSwGend_CM_uint32 0.0 4.294967295E+9 /end CHARACTERISTIC
/begin CHARACTERISTIC WM_MaskRctnForEmgcyShtdwnForOvspd_P "Mask Reaction for Emergency Shutdown for Overspeed Parameter" VALUE 0x400508BC /* @ECU_Address@WM_MaskRctnForEmgcyShtdwnForOvspd_P@ */ Scalar_ULONG 0 EcuIntgdSwGend_CM_uint32 0.0 4.294967295E+9 /end CHARACTERISTIC
/begin CHARACTERISTIC WM_MaskRctnForErrCamCrankTotLoss_P "Mask Reaction for Cam Crank Total Loss Parameter" VALUE 0x400508C0 /* @ECU_Address@WM_MaskRctnForErrCamCrankTotLoss_P@ */ Scalar_ULONG 0 EcuIntgdSwGend_CM_uint32 0.0 4.294967295E+9 /end CHARACTERISTIC
/begin CHARACTERISTIC WM_MaskRctnForErrInjrShtdwn_P "Mask Reaction for Injection Error Shutdown Parameter" VALUE 0x400508E4 /* @ECU_Address@WM_MaskRctnForErrInjrShtdwn_P@ */ Scalar_ULONG 0 EcuIntgdSwGend_CM_uint32 0.0 4.294967295E+9 /end CHARACTERISTIC
/begin CHARACTERISTIC WM_MaskRctnForPRailNotCtldMsg_P "Mask Reaction for Rail Pressure Is Not Controlled Message Parameter" VALUE 0x40050948 /* @ECU_Address@WM_MaskRctnForPRailNotCtldMsg_P@ */ Scalar_ULONG 0 EcuIntgdSwGend_CM_uint32 0.0 4.294967295E+9 /end CHARACTERISTIC
/begin CHARACTERISTIC WM_MaskRctnOvv_P "Mask Reaction - Override Parameter" VALUE 0x400509F8 /* @ECU_Address@WM_MaskRctnOvv_P@ */ Scalar_ULONG 0 EcuIntgdSwGend_CM_uint32 0.0 4.294967295E+9 /end CHARACTERISTIC
/begin CHARACTERISTIC EOP_CanCrsCtrlSetSpdOvv_P "SPN 84 - Cruise Control Set Speed - Override Value" VALUE 0x400449CA /* @ECU_Address@EOP_CanCrsCtrlSetSpdOvv_P@ */ Scalar_SWORD 0 EcuIntgdSwGend_CM_int16_km_h 0.0 250.0 /end CHARACTERISTIC
/begin CHARACTERISTIC EOP_BrkPedlNotAvl_P "Brake Pedal Not Available Parameter" VALUE 0x40044964 /* @ECU_Address@EOP_BrkPedlNotAvl_P@ */ Scalar_BOOLEAN 0 EcuIntgdSwGend_CM_boolean 0.0 1.0 /end CHARACTERISTIC
/begin CHARACTERISTIC EOP_CanAccrPedl1LoIdleSwtOvs_P "SPN 558 - Accelerator Pedal 1 Low Idle Switch - Override Switch" VALUE 0x40044968 /* @ECU_Address@EOP_CanAccrPedl1LoIdleSwtOvs_P@ */ Scalar_BOOLEAN 0 EcuIntgdSwGend_CM_boolean 0.0 1.0 /end CHARACTERISTIC
/begin CHARACTERISTIC EOP_CanAccrPedlPosn1Ovs_P "SPN 91 - Accelerator Pedal Position 1 - Override Switch" VALUE 0x40044970 /* @ECU_Address@EOP_CanAccrPedlPosn1Ovs_P@ */ Scalar_BOOLEAN 0 EcuIntgdSwGend_CM_boolean 0.0 1.0 /end CHARACTERISTIC
/begin CHARACTERISTIC EOP_CanActEngPercTqOvs_P "SPN 513 - Actual Engine Percent Torque - Override Switch" VALUE 0x40044978 /* @ECU_Address@EOP_CanActEngPercTqOvs_P@ */ Scalar_BOOLEAN 0 EcuIntgdSwGend_CM_boolean 0.0 1.0 /end CHARACTERISTIC
/begin CHARACTERISTIC EOP_CanAmberWarnLampOvs_P "SPN 624 - Amber Warning Lamp - Override Switch" VALUE 0x40044980 /* @ECU_Address@EOP_CanAmberWarnLampOvs_P@ */ Scalar_BOOLEAN 0 EcuIntgdSwGend_CM_boolean 0.0 1.0 /end CHARACTERISTIC
/begin CHARACTERISTIC EOP_CanAmberWarnLampOvv_P "SPN 624 - Amber Warning Lamp - Override Value" VALUE 0x40044984 /* @ECU_Address@EOP_CanAmberWarnLampOvv_P@ */ Scalar_BOOLEAN 0 EcuIntgdSwGend_CM_boolean 0.0 1.0 /end CHARACTERISTIC
/begin CHARACTERISTIC EOP_CanBattVolt1Ovs_P "SPN 168 - Battery Potential - Power Input 1 - Override Switch" VALUE 0x40044988 /* @ECU_Address@EOP_CanBattVolt1Ovs_P@ */ Scalar_BOOLEAN 0 EcuIntgdSwGend_CM_boolean 0.0 1.0 /end CHARACTERISTIC
/begin CHARACTERISTIC EOP_CanBrkSwtOvs_P "SPN 597 - Brake Switch - Override Switch" VALUE 0x40044990 /* @ECU_Address@EOP_CanBrkSwtOvs_P@ */ Scalar_BOOLEAN 0 EcuIntgdSwGend_CM_boolean 0.0 1.0 /end CHARACTERISTIC
/begin CHARACTERISTIC EOP_CanColdStrtLampOvs_P "SPN 1081 - Engine Wait to Start Lamp - Override Switch" VALUE 0x40044998 /* @ECU_Address@EOP_CanColdStrtLampOvs_P@ */ Scalar_BOOLEAN 0 EcuIntgdSwGend_CM_boolean 0.0 1.0 /end CHARACTERISTIC
/begin CHARACTERISTIC EOP_CanCrsCtrlActvOvs_P "SPN 595 - Cruise Control Active - Override Switch" VALUE 0x400449A0 /* @ECU_Address@EOP_CanCrsCtrlActvOvs_P@ */ Scalar_BOOLEAN 0 EcuIntgdSwGend_CM_boolean 0.0 1.0 /end CHARACTERISTIC
/begin CHARACTERISTIC EOP_CanCrsCtrlDecSwtOvs_P "SPN 600 - Cruise Control Coast (Decelerate) Switch - Override Switch" VALUE 0x400449A8 /* @ECU_Address@EOP_CanCrsCtrlDecSwtOvs_P@ */ Scalar_BOOLEAN 0 EcuIntgdSwGend_CM_boolean 0.0 1.0 /end CHARACTERISTIC
/begin CHARACTERISTIC EOP_CanCrsCtrlEnaSwtOvs_P "SPN 596 - Cruise Control Enable Switch - Override Switch" VALUE 0x400449B0 /* @ECU_Address@EOP_CanCrsCtrlEnaSwtOvs_P@ */ Scalar_BOOLEAN 0 EcuIntgdSwGend_CM_boolean 0.0 1.0 /end CHARACTERISTIC
/begin CHARACTERISTIC EOP_CanCrsCtrlIncSwtOvs_P "SPN 602 - Cruise Control Accelerate Switch - Override Switch" VALUE 0x400449B8 /* @ECU_Address@EOP_CanCrsCtrlIncSwtOvs_P@ */ Scalar_BOOLEAN 0 EcuIntgdSwGend_CM_boolean 0.0 1.0 /end CHARACTERISTIC
/begin CHARACTERISTIC EOP_CanCrsCtrlResSwtOvs_P "SPN 601 - Cruise Control Resume Switch - Override Switch" VALUE 0x400449C0 /* @ECU_Address@EOP_CanCrsCtrlResSwtOvs_P@ */ Scalar_BOOLEAN 0 EcuIntgdSwGend_CM_boolean 0.0 1.0 /end CHARACTERISTIC
/begin CHARACTERISTIC EOP_CanCrsCtrlSetSpdOvs_P "SPN 84 - Cruise Control Set Speed - Override Switch" VALUE 0x400449C8 /* @ECU_Address@EOP_CanCrsCtrlSetSpdOvs_P@ */ Scalar_BOOLEAN 0 EcuIntgdSwGend_CM_boolean 0.0 1.0 /end CHARACTERISTIC
/begin CHARACTERISTIC EOP_CanCrsCtrlSetSwtOvs_P "SPN 599 - Cruise Control Set Switch - Override Switch" VALUE 0x400449CC /* @ECU_Address@EOP_CanCrsCtrlSetSwtOvs_P@ */ Scalar_BOOLEAN 0 EcuIntgdSwGend_CM_boolean 0.0 1.0 /end CHARACTERISTIC
/begin CHARACTERISTIC EOP_CanDrvrDmdPercTqOvs_P "SPN 512 - Driver Demand Percent Torque - Override Switch" VALUE 0x400449D4 /* @ECU_Address@EOP_CanDrvrDmdPercTqOvs_P@ */ Scalar_BOOLEAN 0 EcuIntgdSwGend_CM_boolean 0.0 1.0 /end CHARACTERISTIC
/begin CHARACTERISTIC EOP_CanEngDftTqLimOvs_P "SPN 1846 - Engine Default Torque Limit - Override Switch" VALUE 0x400449DC /* @ECU_Address@EOP_CanEngDftTqLimOvs_P@ */ Scalar_BOOLEAN 0 EcuIntgdSwGend_CM_boolean 0.0 1.0 /end CHARACTERISTIC
/begin CHARACTERISTIC EOP_CanEngFuRateOvs_P "SPN 183 - Engine Fuel Rate - Override Switch" VALUE 0x400449E4 /* @ECU_Address@EOP_CanEngFuRateOvs_P@ */ Scalar_BOOLEAN 0 EcuIntgdSwGend_CM_boolean 0.0 1.0 /end CHARACTERISTIC
/begin CHARACTERISTIC EOP_CanEngHrOvs_P "SPN 247 - Engine Total Hours of Operation - Override Switch" VALUE 0x400449EC /* @ECU_Address@EOP_CanEngHrOvs_P@ */ Scalar_BOOLEAN 0 EcuIntgdSwGend_CM_boolean 0.0 1.0 /end CHARACTERISTIC
/begin CHARACTERISTIC EOP_CanEngParasiticLossOvs_P "SPN 2978 - Estimated Engine Parasitic Losses - Override Switch" VALUE 0x400449F4 /* @ECU_Address@EOP_CanEngParasiticLossOvs_P@ */ Scalar_BOOLEAN 0 EcuIntgdSwGend_CM_boolean 0.0 1.0 /end CHARACTERISTIC
/begin CHARACTERISTIC EOP_CanEngPercTqPoint1Ovs_P "SPN 539 - Engine Percent Torque Point 1 - Override Switch" VALUE 0x400449FC /* @ECU_Address@EOP_CanEngPercTqPoint1Ovs_P@ */ Scalar_BOOLEAN 0 EcuIntgdSwGend_CM_boolean 0.0 1.0 /end CHARACTERISTIC
/begin CHARACTERISTIC EOP_CanEngPercTqPoint2Ovs_P "SPN 539 - Engine Percent Torque Point 2 - Override Switch" VALUE 0x40044A04 /* @ECU_Address@EOP_CanEngPercTqPoint2Ovs_P@ */ Scalar_BOOLEAN 0 EcuIntgdSwGend_CM_boolean 0.0 1.0 /end CHARACTERISTIC
/begin CHARACTERISTIC EOP_CanEngPercTqPoint3Ovs_P "SPN 539 - Engine Percent Torque Point 3 - Override Switch" VALUE 0x40044A0C /* @ECU_Address@EOP_CanEngPercTqPoint3Ovs_P@ */ Scalar_BOOLEAN 0 EcuIntgdSwGend_CM_boolean 0.0 1.0 /end CHARACTERISTIC
/begin CHARACTERISTIC EOP_CanEngPercTqPoint4Ovs_P "SPN 539 - Engine Percent Torque Point 4 - Override Switch" VALUE 0x40044A14 /* @ECU_Address@EOP_CanEngPercTqPoint4Ovs_P@ */ Scalar_BOOLEAN 0 EcuIntgdSwGend_CM_boolean 0.0 1.0 /end CHARACTERISTIC
/begin CHARACTERISTIC EOP_CanEngPercTqPoint5Ovs_P "SPN 539 - Engine Percent Torque Point 5 - Override Switch" VALUE 0x40044A1C /* @ECU_Address@EOP_CanEngPercTqPoint5Ovs_P@ */ Scalar_BOOLEAN 0 EcuIntgdSwGend_CM_boolean 0.0 1.0 /end CHARACTERISTIC
/begin CHARACTERISTIC EOP_CanEngRatedPwrOvs_P "SPN 166 - Engine Rated Power - Override Switch" VALUE 0x40044A24 /* @ECU_Address@EOP_CanEngRatedPwrOvs_P@ */ Scalar_BOOLEAN 0 EcuIntgdSwGend_CM_boolean 0.0 1.0 /end CHARACTERISTIC
/begin CHARACTERISTIC EOP_CanEngRatedSpdOvs_P "SPN 189 - Engine Rated Speed - Override Switch" VALUE 0x40044A2C /* @ECU_Address@EOP_CanEngRatedSpdOvs_P@ */ Scalar_BOOLEAN 0 EcuIntgdSwGend_CM_boolean 0.0 1.0 /end CHARACTERISTIC
/begin CHARACTERISTIC EOP_CanEngRefTqOvs_P "SPN 544 - Engine Reference Torque - Override Switch" VALUE 0x40044A34 /* @ECU_Address@EOP_CanEngRefTqOvs_P@ */ Scalar_BOOLEAN 0 EcuIntgdSwGend_CM_boolean 0.0 1.0 /end CHARACTERISTIC
/begin CHARACTERISTIC EOP_CanEngShtdwnOvrdSwtOvs_P "SPN 1237 - Engine Shutdown Override Switch - Override Switch" VALUE 0x40044A3C /* @ECU_Address@EOP_CanEngShtdwnOvrdSwtOvs_P@ */ Scalar_BOOLEAN 0 EcuIntgdSwGend_CM_boolean 0.0 1.0 /end CHARACTERISTIC
/begin CHARACTERISTIC EOP_CanEngSpdOvs_P "SPN 190 - Engine Speed - Override Switch" VALUE 0x40044A44 /* @ECU_Address@EOP_CanEngSpdOvs_P@ */ Scalar_BOOLEAN 0 EcuIntgdSwGend_CM_boolean 0.0 1.0 /end CHARACTERISTIC
/begin CHARACTERISTIC EOP_CanEngSpdPoint1Ovs_P "SPN 188 - Engine Speed Point 1 - Override Switch" VALUE 0x40044A4C /* @ECU_Address@EOP_CanEngSpdPoint1Ovs_P@ */ Scalar_BOOLEAN 0 EcuIntgdSwGend_CM_boolean 0.0 1.0 /end CHARACTERISTIC
/begin CHARACTERISTIC EOP_CanEngSpdPoint2Ovs_P "SPN 528 - Engine Speed Point 2 - Override Switch" VALUE 0x40044A54 /* @ECU_Address@EOP_CanEngSpdPoint2Ovs_P@ */ Scalar_BOOLEAN 0 EcuIntgdSwGend_CM_boolean 0.0 1.0 /end CHARACTERISTIC
/begin CHARACTERISTIC EOP_CanEngSpdPoint3Ovs_P "SPN 529 - Engine Speed Point 3 - Override Switch" VALUE 0x40044A5C /* @ECU_Address@EOP_CanEngSpdPoint3Ovs_P@ */ Scalar_BOOLEAN 0 EcuIntgdSwGend_CM_boolean 0.0 1.0 /end CHARACTERISTIC
/begin CHARACTERISTIC EOP_CanEngSpdPoint4Ovs_P "SPN 530 - Engine Speed Point 4 - Override Switch" VALUE 0x40044A64 /* @ECU_Address@EOP_CanEngSpdPoint4Ovs_P@ */ Scalar_BOOLEAN 0 EcuIntgdSwGend_CM_boolean 0.0 1.0 /end CHARACTERISTIC
/begin CHARACTERISTIC EOP_CanEngSpdPoint5Ovs_P "SPN 531 - Engine Speed Point 5 - Override Switch" VALUE 0x40044A6C /* @ECU_Address@EOP_CanEngSpdPoint5Ovs_P@ */ Scalar_BOOLEAN 0 EcuIntgdSwGend_CM_boolean 0.0 1.0 /end CHARACTERISTIC
/begin CHARACTERISTIC EOP_CanEngSpdPoint6Ovs_P "SPN 532 - Engine Speed Point 6 - Override Switch" VALUE 0x40044A74 /* @ECU_Address@EOP_CanEngSpdPoint6Ovs_P@ */ Scalar_BOOLEAN 0 EcuIntgdSwGend_CM_boolean 0.0 1.0 /end CHARACTERISTIC
/begin CHARACTERISTIC EOP_CanEngSpdPoint7Ovs_P "SPN 533 - Engine Speed Point 7 - Override Switch" VALUE 0x40044A7C /* @ECU_Address@EOP_CanEngSpdPoint7Ovs_P@ */ Scalar_BOOLEAN 0 EcuIntgdSwGend_CM_boolean 0.0 1.0 /end CHARACTERISTIC
/begin CHARACTERISTIC EOP_CanEngStOvs_P "SPN 3543 - Engine Operating State - Override Switch" VALUE 0x40044A84 /* @ECU_Address@EOP_CanEngStOvs_P@ */ Scalar_BOOLEAN 0 EcuIntgdSwGend_CM_boolean 0.0 1.0 /end CHARACTERISTIC
/begin CHARACTERISTIC EOP_CanEngStrtrModOvs_P "SPN 1675 - Engine Starter Mode - Override Switch" VALUE 0x40044A8C /* @ECU_Address@EOP_CanEngStrtrModOvs_P@ */ Scalar_BOOLEAN 0 EcuIntgdSwGend_CM_boolean 0.0 1.0 /end CHARACTERISTIC
/begin CHARACTERISTIC EOP_CanEngTotFuQntyOvs_P "SPN 250 - Engine Total Fuel Used - Override Switch" VALUE 0x40044A94 /* @ECU_Address@EOP_CanEngTotFuQntyOvs_P@ */ Scalar_BOOLEAN 0 EcuIntgdSwGend_CM_boolean 0.0 1.0 /end CHARACTERISTIC
/begin CHARACTERISTIC EOP_CanEngTqModOvs_P "SPN 899 - Engine Torque Mode - Override Switch" VALUE 0x40044A9C /* @ECU_Address@EOP_CanEngTqModOvs_P@ */ Scalar_BOOLEAN 0 EcuIntgdSwGend_CM_boolean 0.0 1.0 /end CHARACTERISTIC
/begin CHARACTERISTIC EOP_CanHndBrkPrkgOvs_P "SPN 70 - Parking Brake Switch - Override Switch" VALUE 0x40044AA4 /* @ECU_Address@EOP_CanHndBrkPrkgOvs_P@ */ Scalar_BOOLEAN 0 EcuIntgdSwGend_CM_boolean 0.0 1.0 /end CHARACTERISTIC
/begin CHARACTERISTIC EOP_CanLvlOilOvs_P "SPN 98 - Engine Oil Level - Override Switch" VALUE 0x40044AAC /* @ECU_Address@EOP_CanLvlOilOvs_P@ */ Scalar_BOOLEAN 0 EcuIntgdSwGend_CM_boolean 0.0 1.0 /end CHARACTERISTIC
/begin CHARACTERISTIC EOP_CanNomFricPercTqOvs_P "SPN 514 - Nominal Friction - Percent Torque - Override Switch" VALUE 0x40044AB4 /* @ECU_Address@EOP_CanNomFricPercTqOvs_P@ */ Scalar_BOOLEAN 0 EcuIntgdSwGend_CM_boolean 0.0 1.0 /end CHARACTERISTIC
/begin CHARACTERISTIC EOP_CanPFuOvs_P "SPN 94 - Engine Fuel Delivery Pressure - Override Switch" VALUE 0x40044ACC /* @ECU_Address@EOP_CanPFuOvs_P@ */ Scalar_BOOLEAN 0 EcuIntgdSwGend_CM_boolean 0.0 1.0 /end CHARACTERISTIC
/begin CHARACTERISTIC EOP_CanPRailOvs_P "SPN 157 - Engine Injector Metering Rail 1 Pressure - Override Switch" VALUE 0x40044ADC /* @ECU_Address@EOP_CanPRailOvs_P@ */ Scalar_BOOLEAN 0 EcuIntgdSwGend_CM_boolean 0.0 1.0 /end CHARACTERISTIC
/begin CHARACTERISTIC EOP_CanPTOGovrStOvs_P "SPN 976 - PTO Governor State - Override Switch" VALUE 0x40044AE4 /* @ECU_Address@EOP_CanPTOGovrStOvs_P@ */ Scalar_BOOLEAN 0 EcuIntgdSwGend_CM_boolean 0.0 1.0 /end CHARACTERISTIC
/begin CHARACTERISTIC EOP_CanPercLoadAtCurrentSpdOvs_P "SPN 92 - Engine Percent Load At Current Speed - Override Switch" VALUE 0x40044AEC /* @ECU_Address@EOP_CanPercLoadAtCurrentSpdOvs_P@ */ Scalar_BOOLEAN 0 EcuIntgdSwGend_CM_boolean 0.0 1.0 /end CHARACTERISTIC
/begin CHARACTERISTIC EOP_CanPosOfWg1Ovs_P "SPN 1188 - Engine Turbocharger Wastegate Actuator 1 Position - Override Switch" VALUE 0x40044AF4 /* @ECU_Address@EOP_CanPosOfWg1Ovs_P@ */ Scalar_BOOLEAN 0 EcuIntgdSwGend_CM_boolean 0.0 1.0 /end CHARACTERISTIC
/begin CHARACTERISTIC EOP_CanRedStopLampOvs_P "SPN 623 - Red Stop Lamp - Override Switch" VALUE 0x40044AFC /* @ECU_Address@EOP_CanRedStopLampOvs_P@ */ Scalar_BOOLEAN 0 EcuIntgdSwGend_CM_boolean 0.0 1.0 /end CHARACTERISTIC
/begin CHARACTERISTIC EOP_CanRedStopLampOvv_P "SPN 623 - Red Stop Lamp - Override Value" VALUE 0x40044B00 /* @ECU_Address@EOP_CanRedStopLampOvv_P@ */ Scalar_BOOLEAN 0 EcuIntgdSwGend_CM_boolean 0.0 1.0 /end CHARACTERISTIC
/begin CHARACTERISTIC EOP_CanSoiMaiInjOvs_P "SPN1436 - Engine Actual Ignition Timing - Override Switch" VALUE 0x40044B04 /* @ECU_Address@EOP_CanSoiMaiInjOvs_P@ */ Scalar_BOOLEAN 0 EcuIntgdSwGend_CM_boolean_deg 0.0 1.0 /end CHARACTERISTIC
/begin CHARACTERISTIC EOP_CanTAirBoostHiReslOvs_P "SPN 1636 - Engine Intake Manifold 1 Temperature (High Resolution) - Override Switch" VALUE 0x40044B0C /* @ECU_Address@EOP_CanTAirBoostHiReslOvs_P@ */ Scalar_BOOLEAN 0 EcuIntgdSwGend_CM_boolean 0.0 1.0 /end CHARACTERISTIC
/begin CHARACTERISTIC EOP_CanTAmbAirOvs_P "SPN 171 - Ambient Air Temperature - Override Switch" VALUE 0x40044B1C /* @ECU_Address@EOP_CanTAmbAirOvs_P@ */ Scalar_BOOLEAN 0 EcuIntgdSwGend_CM_boolean 0.0 1.0 /end CHARACTERISTIC
/begin CHARACTERISTIC EOP_CanTCooltOvs_P "SPN 1637 - Engine Coolant Temperature (High Resolution) - Override Switch" VALUE 0x40044B24 /* @ECU_Address@EOP_CanTCooltOvs_P@ */ Scalar_BOOLEAN 0 EcuIntgdSwGend_CM_boolean 0.0 1.0 /end CHARACTERISTIC
/begin CHARACTERISTIC EOP_CanTEcuOvs_P "SPN 1136 - Engine ECU Temperature - Override Switch" VALUE 0x40044B2C /* @ECU_Address@EOP_CanTEcuOvs_P@ */ Scalar_BOOLEAN 0 EcuIntgdSwGend_CM_boolean 0.0 1.0 /end CHARACTERISTIC
/begin CHARACTERISTIC EOP_CanTFuOvs_P "SPN 174 - Engine Fuel Temperature - Override Switch" VALUE 0x40044B34 /* @ECU_Address@EOP_CanTFuOvs_P@ */ Scalar_BOOLEAN 0 EcuIntgdSwGend_CM_boolean 0.0 1.0 /end CHARACTERISTIC
/begin CHARACTERISTIC EOP_CanTOilOvs_P "SPN 175 - Engine Oil Temperature - Override Switch" VALUE 0x40044B3C /* @ECU_Address@EOP_CanTOilOvs_P@ */ Scalar_BOOLEAN 0 EcuIntgdSwGend_CM_boolean 0.0 1.0 /end CHARACTERISTIC
/begin CHARACTERISTIC EOP_CanWhlBasVehSpdOvs_P "SPN 84 - Wheel-Based Vehicle Speed - Override Switch" VALUE 0x40044B44 /* @ECU_Address@EOP_CanWhlBasVehSpdOvs_P@ */ Scalar_BOOLEAN 0 EcuIntgdSwGend_CM_boolean 0.0 1.0 /end CHARACTERISTIC
/begin CHARACTERISTIC EOP_CanWtrInFuOvs_P "SPN 97 - Water In Fuel Indicator - Override Switch" VALUE 0x40044B4C /* @ECU_Address@EOP_CanWtrInFuOvs_P@ */ Scalar_BOOLEAN 0 EcuIntgdSwGend_CM_boolean 0.0 1.0 /end CHARACTERISTIC
/begin CHARACTERISTIC EOP_CmbtSwtNotAvl_P "Combat Switch Not Available Parameter" VALUE 0x40044B54 /* @ECU_Address@EOP_CmbtSwtNotAvl_P@ */ Scalar_BOOLEAN 0 EcuIntgdSwGend_CM_boolean 0.0 1.0 /end CHARACTERISTIC
/begin CHARACTERISTIC EOP_ColdStrtLampNotAvl_P "Cold Start Lamp Not Available" VALUE 0x40044B58 /* @ECU_Address@EOP_ColdStrtLampNotAvl_P@ */ Scalar_BOOLEAN 0 EcuIntgdSwGend_CM_boolean 0.0 1.0 /end CHARACTERISTIC
/begin CHARACTERISTIC EOP_CrsCtrlDecSwtNotAvl_P "Cruise Control Coast (Decelerate) Switch Not Available Parameter" VALUE 0x40044B64 /* @ECU_Address@EOP_CrsCtrlDecSwtNotAvl_P@ */ Scalar_BOOLEAN 0 EcuIntgdSwGend_CM_boolean 0.0 1.0 /end CHARACTERISTIC
/begin CHARACTERISTIC EOP_CrsCtrlEnaSwtNotAvl_P "Cruise Control Enable Switch Not Available Parameter" VALUE 0x40044B68 /* @ECU_Address@EOP_CrsCtrlEnaSwtNotAvl_P@ */ Scalar_BOOLEAN 0 EcuIntgdSwGend_CM_boolean 0.0 1.0 /end CHARACTERISTIC
/begin CHARACTERISTIC EOP_CrsCtrlIncSwtNotAvl_P "Cruise Control Accelerate Switch Not Available Parameter" VALUE 0x40044B6C /* @ECU_Address@EOP_CrsCtrlIncSwtNotAvl_P@ */ Scalar_BOOLEAN 0 EcuIntgdSwGend_CM_boolean 0.0 1.0 /end CHARACTERISTIC
/begin CHARACTERISTIC EOP_CrsCtrlResSwtNotAvl_P "Cruise Control Resume Switch Not Avaible Parameter" VALUE 0x40044B70 /* @ECU_Address@EOP_CrsCtrlResSwtNotAvl_P@ */ Scalar_BOOLEAN 0 EcuIntgdSwGend_CM_boolean 0.0 1.0 /end CHARACTERISTIC
/begin CHARACTERISTIC EOP_CrsCtrlSetSwtNotAvl_P "" VALUE 0x40044B74 /* @ECU_Address@EOP_CrsCtrlSetSwtNotAvl_P@ */ Scalar_BOOLEAN 0 EcuIntgdSwGend_CM_boolean 0.0 1.0 /end CHARACTERISTIC
/begin CHARACTERISTIC EOP_EngStrtrModeNotAvl_P "Engine Starter Mode Not Available Parameter" VALUE 0x40044C04 /* @ECU_Address@EOP_EngStrtrModeNotAvl_P@ */ Scalar_BOOLEAN 0 EcuIntgdSwGend_CM_boolean 0.0 1.0 /end CHARACTERISTIC
/begin CHARACTERISTIC EOP_HndBrkPrkgNotAvl_P "Hand Brake Parking Switch Not Available" VALUE 0x40044C10 /* @ECU_Address@EOP_HndBrkPrkgNotAvl_P@ */ Scalar_BOOLEAN 0 EcuIntgdSwGend_CM_boolean 0.0 1.0 /end CHARACTERISTIC
/begin CHARACTERISTIC EngBrk_ActvCanOrDigInOvs_P "Digital Input or Can Input Active Override Switch Parameter" VALUE 0x40044D44 /* @ECU_Address@EngBrk_ActvCanOrDigInOvs_P@ */ Scalar_BOOLEAN 0 EcuIntgdSwGend_CM_boolean 0.0 1.0 /end CHARACTERISTIC
/begin CHARACTERISTIC EngBrk_ActvEngBrkSoln1Ovs_P "Engine Brake Selenoid 1 Override Switch Parameter" VALUE 0x40044D48 /* @ECU_Address@EngBrk_ActvEngBrkSoln1Ovs_P@ */ Scalar_BOOLEAN 0 EcuIntgdSwGend_CM_boolean 0.0 1.0 /end CHARACTERISTIC
/begin CHARACTERISTIC EngBrk_ActvEngBrkSoln1Ovv_P "Engine Brake Selenoid 1 Override Value Parameter" VALUE 0x40044D4C /* @ECU_Address@EngBrk_ActvEngBrkSoln1Ovv_P@ */ Scalar_BOOLEAN 0 EcuIntgdSwGend_CM_boolean 0.0 1.0 /end CHARACTERISTIC
/begin CHARACTERISTIC EngBrk_ActvEngBrkSoln2Ovs_P "Engine Brake Selenoid 2 Override Switch Parameter" VALUE 0x40044D50 /* @ECU_Address@EngBrk_ActvEngBrkSoln2Ovs_P@ */ Scalar_BOOLEAN 0 EcuIntgdSwGend_CM_boolean 0.0 1.0 /end CHARACTERISTIC
/begin CHARACTERISTIC EngBrk_ActvEngBrkSoln2Ovv_P "Engine Brake Selenoid 2 Override Value Switch" VALUE 0x40044D54 /* @ECU_Address@EngBrk_ActvEngBrkSoln2Ovv_P@ */ Scalar_BOOLEAN 0 EcuIntgdSwGend_CM_boolean 0.0 1.0 /end CHARACTERISTIC
/begin CHARACTERISTIC EngBrk_BrkPedlEvln_P "Brake Pedal Evaluation	Parameter" VALUE 0x40044D58 /* @ECU_Address@EngBrk_BrkPedlEvln_P@ */ Scalar_BOOLEAN 0 EcuIntgdSwGend_CM_boolean 0.0 1.0 /end CHARACTERISTIC
/begin CHARACTERISTIC EngBrk_CanABSAcvEvln_P "ABS Can Evaluation Parameter" VALUE 0x40044D5C /* @ECU_Address@EngBrk_CanABSAcvEvln_P@ */ Scalar_BOOLEAN 0 EcuIntgdSwGend_CM_boolean 0.0 1.0 /end CHARACTERISTIC
/begin CHARACTERISTIC EngBrk_TrsmCurrentGearEvln_P "Transmission Current Gear Evaluation Parameter" VALUE 0x40044D70 /* @ECU_Address@EngBrk_TrsmCurrentGearEvln_P@ */ Scalar_BOOLEAN 0 EcuIntgdSwGend_CM_boolean 0.0 1.0 /end CHARACTERISTIC
/begin CHARACTERISTIC EngBrk_TrsmLockUpEngdEvln_P "Transmission Lock Up Engaged Evaluation Parameter" VALUE 0x40044D74 /* @ECU_Address@EngBrk_TrsmLockUpEngdEvln_P@ */ Scalar_BOOLEAN 0 EcuIntgdSwGend_CM_boolean 0.0 1.0 /end CHARACTERISTIC
/begin CHARACTERISTIC IC_SoiMaiInjNotCorrdOvs_P "Start of Main Injection is Not Corrected - Override Switch Parameter" VALUE 0x40045DF8 /* @ECU_Address@IC_SoiMaiInjNotCorrdOvs_P@ */ Scalar_BOOLEAN 0 EcuIntgdSwGend_CM_boolean 0.0 1.0 /end CHARACTERISTIC
/begin CHARACTERISTIC IC_SoiMaiInjOvs_P "Start of Main Injection - Override Switch Parameter" VALUE 0x40045DFC /* @ECU_Address@IC_SoiMaiInjOvs_P@ */ Scalar_BOOLEAN 0 EcuIntgdSwGend_CM_boolean 0.0 1.0 /end CHARACTERISTIC
/begin CHARACTERISTIC IC_SoiPltInjNotCorrdOvs_P "Start of Pilot Injection is Not Corrected - Override Switch Parameter" VALUE 0x40047BB8 /* @ECU_Address@IC_SoiPltInjNotCorrdOvs_P@ */ Scalar_BOOLEAN 0 EcuIntgdSwGend_CM_boolean 0.0 1.0 /end CHARACTERISTIC
/begin CHARACTERISTIC IC_SoiPltInjOvs_P "Start of Pilot Injection - Override Switch Parameter" VALUE 0x40047BBC /* @ECU_Address@IC_SoiPltInjOvs_P@ */ Scalar_BOOLEAN 0 EcuIntgdSwGend_CM_boolean 0.0 1.0 /end CHARACTERISTIC
/begin CHARACTERISTIC RPG_PRailSetPointOvs_P "Rail Pressure Set Point - Override Switch Parameter" VALUE 0x4004A410 /* @ECU_Address@RPG_PRailSetPointOvs_P@ */ Scalar_BOOLEAN 0 EcuIntgdSwGend_CM_boolean 0.0 1.0 /end CHARACTERISTIC
/begin CHARACTERISTIC SC_LvlFuInhEnaSwt_P "" VALUE 0x4004B03C /* @ECU_Address@SC_LvlFuInhEnaSwt_P@ */ Scalar_BOOLEAN 0 EcuIntgdSwGend_CM_boolean 0.0 1.0 /end CHARACTERISTIC
/begin CHARACTERISTIC SC_LvlOilInhEnaSwt_P "" VALUE 0x4004B044 /* @ECU_Address@SC_LvlOilInhEnaSwt_P@ */ Scalar_BOOLEAN 0 EcuIntgdSwGend_CM_boolean 0.0 1.0 /end CHARACTERISTIC
/begin CHARACTERISTIC SC_bAcvStrtrOvrHeatProtnOvs_P "OverHeat Protection - Override Switch Parameter" VALUE 0x4004B0CC /* @ECU_Address@SC_bAcvStrtrOvrHeatProtnOvs_P@ */ Scalar_BOOLEAN 0 EcuIntgdSwGend_CM_boolean 0.0 1.0 /end CHARACTERISTIC
/begin CHARACTERISTIC SC_bAcvStrtrOvrHeatProtnOvv_P "OverHeat Protection - Override Value Parameter" VALUE 0x4004B0D0 /* @ECU_Address@SC_bAcvStrtrOvrHeatProtnOvv_P@ */ Scalar_BOOLEAN 0 EcuIntgdSwGend_CM_boolean 0.0 1.0 /end CHARACTERISTIC
/begin CHARACTERISTIC SC_bEngNotTurnOvs_P "Engine Not Turn Override Switch Parameter" VALUE 0x4004B0DC /* @ECU_Address@SC_bEngNotTurnOvs_P@ */ Scalar_BOOLEAN 0 EcuIntgdSwGend_CM_boolean 0.0 1.0 /end CHARACTERISTIC
/begin CHARACTERISTIC SC_bEngNotTurnOvv_P "Engine Not Turn Override Value Parameter" VALUE 0x4004B0E0 /* @ECU_Address@SC_bEngNotTurnOvv_P@ */ Scalar_BOOLEAN 0 EcuIntgdSwGend_CM_boolean 0.0 1.0 /end CHARACTERISTIC
/begin CHARACTERISTIC SpdLimr_PIDCoeffDOvs_P "PID Derivative Coefficient for Cruise Control - Override Switch" VALUE 0x4004B2DC /* @ECU_Address@SpdLimr_PIDCoeffDOvs_P@ */ Scalar_BOOLEAN 0 EcuIntgdSwGend_CM_boolean 0.0 1.0 /end CHARACTERISTIC
/begin CHARACTERISTIC SpdLimr_PIDCoeffFiltOvs_P "PID Filter Coefficient for Cruise Control - Override Switch" VALUE 0x4004B2E4 /* @ECU_Address@SpdLimr_PIDCoeffFiltOvs_P@ */ Scalar_BOOLEAN 0 EcuIntgdSwGend_CM_boolean 0.0 1.0 /end CHARACTERISTIC
/begin CHARACTERISTIC SpdLimr_PIDCoeffIOvs_P "PID Integrator Coefficient for Cruise Control - Override Switch" VALUE 0x4004B2EC /* @ECU_Address@SpdLimr_PIDCoeffIOvs_P@ */ Scalar_BOOLEAN 0 EcuIntgdSwGend_CM_boolean 0.0 1.0 /end CHARACTERISTIC
/begin CHARACTERISTIC SpdLimr_PIDCoeffPOvs_P "PID Proportional Coefficient for Cruise Control - Override Switch" VALUE 0x4004B2F4 /* @ECU_Address@SpdLimr_PIDCoeffPOvs_P@ */ Scalar_BOOLEAN 0 EcuIntgdSwGend_CM_boolean 0.0 1.0 /end CHARACTERISTIC
/begin CHARACTERISTIC TL_SnsrSwtForTAirLimn_P "Air Temperature Limitation Sensor Selection" VALUE 0x4004C084 /* @ECU_Address@TL_SnsrSwtForTAirLimn_P@ */ Scalar_BOOLEAN 0 EcuIntgdSwGend_CM_boolean 0.0 1.0 /end CHARACTERISTIC
/begin CHARACTERISTIC WM_MaskGEOvs_P "Global Enable Mask - Override Switch Parameter" VALUE 0x400507FC /* @ECU_Address@WM_MaskGEOvs_P@ */ Scalar_BOOLEAN 0 EcuIntgdSwGend_CM_boolean 0.0 1.0 /end CHARACTERISTIC
/begin CHARACTERISTIC WM_MaskRctnOvs_P "Mask Reaction - Override Switch" VALUE 0x400509F4 /* @ECU_Address@WM_MaskRctnOvs_P@ */ Scalar_BOOLEAN 0 EcuIntgdSwGend_CM_boolean 0.0 1.0 /end CHARACTERISTIC
/begin CHARACTERISTIC WM_bErrLvlOilSnsrLimp_P "Oil Level Sensor Limp Error Activation Parameter" VALUE 0x4005122C /* @ECU_Address@WM_bErrLvlOilSnsrLimp_P@ */ Scalar_BOOLEAN 0 EcuIntgdSwGend_CM_boolean 0.0 1.0 /end CHARACTERISTIC
/begin CHARACTERISTIC WM_bErrPAirBoostSnsrLimp_P "Air Boost Pressure Sensor Limp Error Activation Parameter" VALUE 0x40051230 /* @ECU_Address@WM_bErrPAirBoostSnsrLimp_P@ */ Scalar_BOOLEAN 0 EcuIntgdSwGend_CM_boolean 0.0 1.0 /end CHARACTERISTIC
/begin CHARACTERISTIC WM_bErrPAmbAirSnsrLimp_P "Ambient Air Pressure Sensor Limp Error Activation Parameter" VALUE 0x40051234 /* @ECU_Address@WM_bErrPAmbAirSnsrLimp_P@ */ Scalar_BOOLEAN 0 EcuIntgdSwGend_CM_boolean 0.0 1.0 /end CHARACTERISTIC
/begin CHARACTERISTIC WM_bErrPFuSnsrLimp_P "Fuel Pressure Sensor Limp Error Activation Parameter" VALUE 0x40051238 /* @ECU_Address@WM_bErrPFuSnsrLimp_P@ */ Scalar_BOOLEAN 0 EcuIntgdSwGend_CM_boolean 0.0 1.0 /end CHARACTERISTIC
/begin CHARACTERISTIC WM_bErrPOilSnsrLimp_P "Oil Pressure Sensor Limp Error Activation Parameter" VALUE 0x4005123C /* @ECU_Address@WM_bErrPOilSnsrLimp_P@ */ Scalar_BOOLEAN 0 EcuIntgdSwGend_CM_boolean 0.0 1.0 /end CHARACTERISTIC
/begin CHARACTERISTIC WM_bErrTAirBoostSnsrLimp_P "Air Boost Temperature Sensor Limp Error Activation Parameter" VALUE 0x40051240 /* @ECU_Address@WM_bErrTAirBoostSnsrLimp_P@ */ Scalar_BOOLEAN 0 EcuIntgdSwGend_CM_boolean 0.0 1.0 /end CHARACTERISTIC
/begin CHARACTERISTIC WM_bErrTAmbAirSnsrLimp_P "Ambient Air Temperature Sensor Limp Error Activation Parameter" VALUE 0x40051244 /* @ECU_Address@WM_bErrTAmbAirSnsrLimp_P@ */ Scalar_BOOLEAN 0 EcuIntgdSwGend_CM_boolean 0.0 1.0 /end CHARACTERISTIC
/begin CHARACTERISTIC WM_bErrTCooltSnsrLimp_P "Coolant Temperature Sensor Limp Error Activation Parameter" VALUE 0x40051248 /* @ECU_Address@WM_bErrTCooltSnsrLimp_P@ */ Scalar_BOOLEAN 0 EcuIntgdSwGend_CM_boolean 0.0 1.0 /end CHARACTERISTIC
/begin CHARACTERISTIC WM_bErrTEcuSnsrLimp_P "ECU Temperature Sensor Limp Error Activation Parameter" VALUE 0x4005124C /* @ECU_Address@WM_bErrTEcuSnsrLimp_P@ */ Scalar_BOOLEAN 0 EcuIntgdSwGend_CM_boolean 0.0 1.0 /end CHARACTERISTIC
/begin CHARACTERISTIC WM_bErrTFuSnsrLimp_P "Fuel Temperature Sensor Limp Error Activation Parameter" VALUE 0x40051250 /* @ECU_Address@WM_bErrTFuSnsrLimp_P@ */ Scalar_BOOLEAN 0 EcuIntgdSwGend_CM_boolean 0.0 1.0 /end CHARACTERISTIC
/begin CHARACTERISTIC WM_bErrTOilSnsrLimp_P "Oil Temperature Sensor Limp Error Activation Parameter" VALUE 0x40051254 /* @ECU_Address@WM_bErrTOilSnsrLimp_P@ */ Scalar_BOOLEAN 0 EcuIntgdSwGend_CM_boolean 0.0 1.0 /end CHARACTERISTIC
/begin CHARACTERISTIC WM_bErrUClmp30SnsrLimp_P "Batter Voltage Sensor Limp Error Activation Parameter" VALUE 0x40051258 /* @ECU_Address@WM_bErrUClmp30SnsrLimp_P@ */ Scalar_BOOLEAN 0 EcuIntgdSwGend_CM_boolean 0.0 1.0 /end CHARACTERISTIC
/begin CHARACTERISTIC WM_bErrWgLimp_P "Wastegate Sensor Limp Error Activation Parameter" VALUE 0x4005125C /* @ECU_Address@WM_bErrWgLimp_P@ */ Scalar_BOOLEAN 0 EcuIntgdSwGend_CM_boolean 0.0 1.0 /end CHARACTERISTIC
/begin CHARACTERISTIC EOP_CanBrkSwtOvv_P "SPN 597 - Brake Switch - Override Value" VALUE 0x40044994 /* @ECU_Address@EOP_CanBrkSwtOvv_P@ */ Scalar_BYTE 0 EcuIntgdSwGend_CM_int8 0.0 3.0 /end CHARACTERISTIC
/begin CHARACTERISTIC EOP_CanCrsCtrlActvOvv_P "SPN 595 - Cruise Control Active - Override Value" VALUE 0x400449A4 /* @ECU_Address@EOP_CanCrsCtrlActvOvv_P@ */ Scalar_BYTE 0 EcuIntgdSwGend_CM_int8 0.0 3.0 /end CHARACTERISTIC
/begin CHARACTERISTIC EOP_CanCrsCtrlDecSwtOvv_P "SPN 600 - Cruise Control Coast (Decelerate) Switch - Override Value" VALUE 0x400449AC /* @ECU_Address@EOP_CanCrsCtrlDecSwtOvv_P@ */ Scalar_BYTE 0 EcuIntgdSwGend_CM_int8 0.0 3.0 /end CHARACTERISTIC
/begin CHARACTERISTIC EOP_CanCrsCtrlEnaSwtOvv_P "SPN 596 - Cruise Control Enable Switch - Override Value" VALUE 0x400449B4 /* @ECU_Address@EOP_CanCrsCtrlEnaSwtOvv_P@ */ Scalar_BYTE 0 EcuIntgdSwGend_CM_int8 0.0 3.0 /end CHARACTERISTIC
/begin CHARACTERISTIC EOP_CanCrsCtrlIncSwtOvv_P "SPN 602 - Cruise Control Accelerate Switch - Override Value" VALUE 0x400449BC /* @ECU_Address@EOP_CanCrsCtrlIncSwtOvv_P@ */ Scalar_BYTE 0 EcuIntgdSwGend_CM_int8 0.0 3.0 /end CHARACTERISTIC
/begin CHARACTERISTIC EOP_CanCrsCtrlResSwtOvv_P "SPN 601 - Cruise Control Resume Switch - Override Value" VALUE 0x400449C4 /* @ECU_Address@EOP_CanCrsCtrlResSwtOvv_P@ */ Scalar_BYTE 0 EcuIntgdSwGend_CM_int8 0.0 3.0 /end CHARACTERISTIC
/begin CHARACTERISTIC EOP_CanCrsCtrlSetSwtOvv_P "SPN 599 - Cruise Control Set Switch - Override Value" VALUE 0x400449D0 /* @ECU_Address@EOP_CanCrsCtrlSetSwtOvv_P@ */ Scalar_BYTE 0 EcuIntgdSwGend_CM_int8 0.0 3.0 /end CHARACTERISTIC
/begin CHARACTERISTIC EOP_CanEngShtdwnOvrdSwtOvv_P "SPN 1237 - Engine Shutdown Override Switch - Override Value" VALUE 0x40044A40 /* @ECU_Address@EOP_CanEngShtdwnOvrdSwtOvv_P@ */ Scalar_BYTE 0 EcuIntgdSwGend_CM_int8 0.0 3.0 /end CHARACTERISTIC
/begin CHARACTERISTIC EOP_CanEngStrtrModOvv_P "SPN 1675 - Engine Starter Mode - Override Value" VALUE 0x40044A90 /* @ECU_Address@EOP_CanEngStrtrModOvv_P@ */ Scalar_BYTE 0 EcuIntgdSwGend_CM_int8 0.0 15.0 /end CHARACTERISTIC
/begin CHARACTERISTIC EOP_CanHndBrkPrkgOvv_P "SPN 70 - Parking Brake Switch - Override Value" VALUE 0x40044AA8 /* @ECU_Address@EOP_CanHndBrkPrkgOvv_P@ */ Scalar_BYTE 0 EcuIntgdSwGend_CM_int8 0.0 3.0 /end CHARACTERISTIC
/begin CHARACTERISTIC EOP_CanPTOGovrStOvv_P "SPN 976 - PTO Governor State - Override Value" VALUE 0x40044AE8 /* @ECU_Address@EOP_CanPTOGovrStOvv_P@ */ Scalar_BYTE 0 EcuIntgdSwGend_CM_int8 0.0 31.0 /end CHARACTERISTIC
/begin CHARACTERISTIC EOP_CanAccrPedl1LoIdleSwtOvv_P "SPN 558 - Accelerator Pedal 1 Low Idle Switch - Override Value" VALUE 0x4004496C /* @ECU_Address@EOP_CanAccrPedl1LoIdleSwtOvv_P@ */ Scalar_UBYTE 0 EcuIntgdSwGend_CM_uint8 0.0 1.0 /end CHARACTERISTIC
/begin CHARACTERISTIC EOP_CanColdStrtLampOvv_P "SPN 1081 - Engine Wait to Start Lamp - Override Value" VALUE 0x4004499C /* @ECU_Address@EOP_CanColdStrtLampOvv_P@ */ Scalar_UBYTE 0 EcuIntgdSwGend_CM_uint8 0.0 3.0 /end CHARACTERISTIC
/begin CHARACTERISTIC EOP_CanEngStOvv_P "SPN 3543 - Engine Operating State - Override Value" VALUE 0x40044A88 /* @ECU_Address@EOP_CanEngStOvv_P@ */ Scalar_UBYTE 0 EcuIntgdSwGend_CM_uint8 0.0 15.0 /end CHARACTERISTIC
/begin CHARACTERISTIC EOP_CanWtrInFuOvv_P "SPN 97 - Water In Fuel Indicator - Override Value" VALUE 0x40044B50 /* @ECU_Address@EOP_CanWtrInFuOvv_P@ */ Scalar_UBYTE 0 EcuIntgdSwGend_CM_uint8 0.0 3.0 /end CHARACTERISTIC
/begin MEASUREMENT WM_MaskRctn "Mask Reaction" ULONG EcuIntgdSwGend_CM_uint32 0 0 0.0 4.294967295E+9 ECU_ADDRESS 0x4000DBC8 /* @ECU_Address@WM_MaskRctn@ */ /end MEASUREMENT
/begin MEASUREMENT WM_MaskGE "Global Enable Mask" ULONG EcuIntgdSwGend_CM_uint32 0 0 0.0 4.294967295E+9 ECU_ADDRESS 0x4000D818 /* @ECU_Address@WM_MaskGE@ */ /end MEASUREMENT
/begin MEASUREMENT TL_PercgTqLimnForTCoolt "Torque Limitation Percentage Map Out for Coolant High Temperature" FLOAT32_IEEE EcuIntgdSwGend_CM_single__ 0 0 0.0 100.0 ECU_ADDRESS 0x4000DB04 /* @ECU_Address@TL_PercgTqLimnForTCoolt@ */ /end MEASUREMENT
/begin MEASUREMENT TL_PercgTqLimnForTFu "Torque Limitation Percentage Map Out for Fuel Temperature" FLOAT32_IEEE EcuIntgdSwGend_CM_single__ 0 0 0.0 100.0 ECU_ADDRESS 0x4000E3D0 /* @ECU_Address@TL_PercgTqLimnForTFu@ */ /end MEASUREMENT
/begin MEASUREMENT TL_PercgTqLimnForNExhTrbChrg "Torque Limitation Percentage Map Out for Turbo Charger Speed " FLOAT32_IEEE EcuIntgdSwGend_CM_single__ 0 0 0.0 100.0 ECU_ADDRESS 0x4000E3BC /* @ECU_Address@TL_PercgTqLimnForNExhTrbChrg@ */ /end MEASUREMENT
/begin MEASUREMENT TL_PercgTqLimnForPAirBoost "Torque Limitation Percentage Map Out for AirBoost Pressure" FLOAT32_IEEE EcuIntgdSwGend_CM_single__ 0 0 0.0 100.0 ECU_ADDRESS 0x4000E2E4 /* @ECU_Address@TL_PercgTqLimnForPAirBoost@ */ /end MEASUREMENT
/begin MEASUREMENT TL_TAir "Axis Values of Air Boost Temperature for Air Boost Temperature Dependent Limitation Map" FLOAT32_IEEE EcuIntgdSwGend_CM_single_degC 0 0 -50.0 200.0 ECU_ADDRESS 0x4000D7E0 /* @ECU_Address@TL_TAir@ */ /end MEASUREMENT
/begin MEASUREMENT TL_PercgTqLimnForTAir "Torque Limitation Percentage Map Out for AirBoost Temperature" FLOAT32_IEEE EcuIntgdSwGend_CM_single__ 0 0 0.0 100.0 ECU_ADDRESS 0x4000DC90 /* @ECU_Address@TL_PercgTqLimnForTAir@ */ /end MEASUREMENT
/begin MEASUREMENT TL_PercgTqLimnForPAmbAir "Torque Limitation Percentage Map Out for Ambient Air Pressure" FLOAT32_IEEE EcuIntgdSwGend_CM_single__ 0 0 0.0 100.0 ECU_ADDRESS 0x4000DDF4 /* @ECU_Address@TL_PercgTqLimnForPAmbAir@ */ /end MEASUREMENT
/begin MEASUREMENT TL_PercgTqLimnForTOil "Torque Limitation Percentage Map Out for Oil Temperature" FLOAT32_IEEE EcuIntgdSwGend_CM_single__ 0 0 0.0 100.0 ECU_ADDRESS 0x4000E5E4 /* @ECU_Address@TL_PercgTqLimnForTOil@ */ /end MEASUREMENT
/begin MEASUREMENT TL_PercgTqLimnForSurge "Limited Torque According to Surge Flag" FLOAT32_IEEE EcuIntgdSwGend_CM_single__ 0 0 0.0 100.0 ECU_ADDRESS 0x4000E41C /* @ECU_Address@TL_PercgTqLimnForSurge@ */ /end MEASUREMENT
/begin MEASUREMENT TL_TqLimnForSurge "Surge Line Torque Limitation Map" FLOAT32_IEEE EcuIntgdSwGend_CM_single_N_m 0 0 0.0 10000.0 ECU_ADDRESS 0x4000E104 /* @ECU_Address@TL_TqLimnForSurge@ */ /end MEASUREMENT
/begin MEASUREMENT TrC_RatAirFuCalc "Air Fuel Rate Calculation" FLOAT32_IEEE EcuIntgdSwGend_CM_single 0 0 0.0 100.0 ECU_ADDRESS 0x4000E464 /* @ECU_Address@TrC_RatAirFuCalc@ */ /end MEASUREMENT
/begin MEASUREMENT SC_TiElpdEnaAcvnStrtr "Timer Elapsed Time to Enable Activation Starter" FLOAT32_IEEE EcuIntgdSwGend_CM_single_ms 0 0 0.0 50000.0 ECU_ADDRESS 0x4000D71C /* @ECU_Address@SC_TiElpdEnaAcvnStrtr@ */ /end MEASUREMENT
/begin MEASUREMENT SC_TiElpdComplDebStrtLock "Debouncer Elapsed Time for Starter Locking" FLOAT32_IEEE EcuIntgdSwGend_CM_single_ms 0 0 0.0 50000.0 ECU_ADDRESS 0x4000E000 /* @ECU_Address@SC_TiElpdComplDebStrtLock@ */ /end MEASUREMENT
/begin MEASUREMENT SC_TiElpdEngAlrdyRunngThd "Engine Running Activation Elapsed Time for Engine Already Running" FLOAT32_IEEE EcuIntgdSwGend_CM_single_ms 0 0 0.0 100000.0 ECU_ADDRESS 0x4000DFE8 /* @ECU_Address@SC_TiElpdEngAlrdyRunngThd@ */ /end MEASUREMENT
/begin MEASUREMENT SC_TiElpdNEngStrtrInhThd "Debouncer Elapsed Time for Start Inhibition Engine Speed Threshold" FLOAT32_IEEE EcuIntgdSwGend_CM_single_ms 0 0 0.0 50000.0 ECU_ADDRESS 0x4000E59C /* @ECU_Address@SC_TiElpdNEngStrtrInhThd@ */ /end MEASUREMENT
/begin MEASUREMENT SC_TiElpdNEngRunDeacThd "Debouncer Elapsed Time for Engine Speed Deactivation Threshold" FLOAT32_IEEE EcuIntgdSwGend_CM_single_ms 0 0 0.0 50000.0 ECU_ADDRESS 0x4000E698 /* @ECU_Address@SC_TiElpdNEngRunDeacThd@ */ /end MEASUREMENT
/begin MEASUREMENT SpdLimr_TiElpdEngBrkLvl2Actvn "Elapsed Time Engine Brake Level 2 Activation" FLOAT32_IEEE EcuIntgdSwGend_CM_single_ms 0 0 0.0 10000.0 ECU_ADDRESS 0x4000E2DC /* @ECU_Address@SpdLimr_TiElpdEngBrkLvl2Actvn@ */ /end MEASUREMENT
/begin MEASUREMENT SpdLimr_TiElpdEngBrkLvl1Actvn "Elapsed Time Engine Brake Level 1 Activation" FLOAT32_IEEE EcuIntgdSwGend_CM_single_ms 0 0 0.0 10000.0 ECU_ADDRESS 0x4000D9B8 /* @ECU_Address@SpdLimr_TiElpdEngBrkLvl1Actvn@ */ /end MEASUREMENT
/begin MEASUREMENT SpdLimr_TrfCaseStsFac "Speed Limiter Transfer Case Status Factor" FLOAT32_IEEE EcuIntgdSwGend_CM_single 0 0 0.0 100.0 ECU_ADDRESS 0x4000D938 /* @ECU_Address@SpdLimr_TrfCaseStsFac@ */ /end MEASUREMENT
/begin MEASUREMENT SpdLimr_CoeffPForVehVCtrl "Coefficient Proportional For Vehicle Velocity Control" FLOAT32_IEEE EcuIntgdSwGend_CM_single 0 0 0.0 10000.0 ECU_ADDRESS 0x4000E304 /* @ECU_Address@SpdLimr_CoeffPForVehVCtrl@ */ /end MEASUREMENT
/begin MEASUREMENT SpdLimr_CoeffDForVehVCtrl "Coefficient Derrivate For Vehicle Velocity Control" FLOAT32_IEEE EcuIntgdSwGend_CM_single 0 0 0.0 10000.0 ECU_ADDRESS 0x4000DF6C /* @ECU_Address@SpdLimr_CoeffDForVehVCtrl@ */ /end MEASUREMENT
/begin MEASUREMENT SpdLimr_CoeffFiltForVehVCtrl "Coefficient Filter for Vehicle Velocity Control" FLOAT32_IEEE EcuIntgdSwGend_CM_single 0 0 0.0 10000.0 ECU_ADDRESS 0x4000D7BC /* @ECU_Address@SpdLimr_CoeffFiltForVehVCtrl@ */ /end MEASUREMENT
/begin MEASUREMENT SpdLimr_PIDMax "Maximum Value of PID" FLOAT32_IEEE EcuIntgdSwGend_CM_single_N_m 0 0 0.0 5000.0 ECU_ADDRESS 0x4000DBF0 /* @ECU_Address@SpdLimr_PIDMax@ */ /end MEASUREMENT
/begin MEASUREMENT SpdLimr_TrsmTqCnvrRatFac "Speed Limiter Transmission Torque Convertor Ratio Factor" FLOAT32_IEEE EcuIntgdSwGend_CM_single 0 0 0.0 100.0 ECU_ADDRESS 0x4000D9FC /* @ECU_Address@SpdLimr_TrsmTqCnvrRatFac@ */ /end MEASUREMENT
/begin MEASUREMENT SpdLimr_CoeffIForVehVCtrl "Coefficient Integral For Vehicle Velocity Control" FLOAT32_IEEE EcuIntgdSwGend_CM_single 0 0 0.0 10000.0 ECU_ADDRESS 0x4000DD1C /* @ECU_Address@SpdLimr_CoeffIForVehVCtrl@ */ /end MEASUREMENT
/begin MEASUREMENT RPG_PRailSetPointFromMap1 "Rail Pressure Set Point Calcuation From Map 1" FLOAT32_IEEE EcuIntgdSwGend_CM_single_bar 0 0 0.0 25000.0 ECU_ADDRESS 0x4000E1F8 /* @ECU_Address@RPG_PRailSetPointFromMap1@ */ /end MEASUREMENT
/begin MEASUREMENT RPG_PRailSetPointFromMap2 "Rail Pressure Set Point Calcuation From Map 2" FLOAT32_IEEE EcuIntgdSwGend_CM_single_bar 0 0 0.0 25000.0 ECU_ADDRESS 0x4000D690 /* @ECU_Address@RPG_PRailSetPointFromMap2@ */ /end MEASUREMENT
/begin MEASUREMENT RPG_PRailSetPoint1to2Intp "Rail Pressure Set Point Calcluation Map 1 to Map 2 Interpolation" FLOAT32_IEEE EcuIntgdSwGend_CM_single_bar 0 0 0.0 5000.0 ECU_ADDRESS 0x4000E61C /* @ECU_Address@RPG_PRailSetPoint1to2Intp@ */ /end MEASUREMENT
/begin MEASUREMENT RPG_PRailSetPointFromMap3 "Rail Pressure Set Point Calcuation From Map 3" FLOAT32_IEEE EcuIntgdSwGend_CM_single_bar 0 0 0.0 25000.0 ECU_ADDRESS 0x4000D694 /* @ECU_Address@RPG_PRailSetPointFromMap3@ */ /end MEASUREMENT
/begin MEASUREMENT RPG_PRailSetPoint2to3Intp "Rail Pressure Set Point Calcluation Map 2 to Map 3 Interpolation" FLOAT32_IEEE EcuIntgdSwGend_CM_single_bar 0 0 0.0 5000.0 ECU_ADDRESS 0x4000DEC0 /* @ECU_Address@RPG_PRailSetPoint2to3Intp@ */ /end MEASUREMENT
/begin MEASUREMENT RPG_PRailSetPoint "Rail Pressure Set Point" FLOAT32_IEEE EcuIntgdSwGend_CM_single_bar 0 0 0.0 5000.0 ECU_ADDRESS 0x4000DDE8 /* @ECU_Address@RPG_PRailSetPoint@ */ /end MEASUREMENT
/begin MEASUREMENT RPG_CoeffKiOut "Rail Pressure Controller Ki Coefficient Output" FLOAT32_IEEE EcuIntgdSwGend_CM_single 0 0 -1000.0 1000.0 ECU_ADDRESS 0x4000E4E0 /* @ECU_Address@RPG_CoeffKiOut@ */ /end MEASUREMENT
/begin MEASUREMENT RPG_CoeffKpOut "Rail Pressure Controller Kp Coefficient Output" FLOAT32_IEEE EcuIntgdSwGend_CM_single 0 0 -1000.0 1000.0 ECU_ADDRESS 0x4000E590 /* @ECU_Address@RPG_CoeffKpOut@ */ /end MEASUREMENT
/begin MEASUREMENT RPG_CoeffKdFbOut "Rail Pressure Controller Kd Coefficient Feedback Output" FLOAT32_IEEE EcuIntgdSwGend_CM_single 0 0 -1000.0 1000.0 ECU_ADDRESS 0x4000DFD4 /* @ECU_Address@RPG_CoeffKdFbOut@ */ /end MEASUREMENT
/begin MEASUREMENT RPG_CoeffKdOut "Rail Pressure Controller Kd Coefficient Output" FLOAT32_IEEE EcuIntgdSwGend_CM_single 0 0 -1000.0 1000.0 ECU_ADDRESS 0x4000DD98 /* @ECU_Address@RPG_CoeffKdOut@ */ /end MEASUREMENT
/begin MEASUREMENT RPG_CoeffKiClampPreSatOut "Rail Pressure Controller Ki Coefficient Output before Saturation" FLOAT32_IEEE EcuIntgdSwGend_CM_single 0 0 -1000.0 1000.0 ECU_ADDRESS 0x4000D80C /* @ECU_Address@RPG_CoeffKiClampPreSatOut@ */ /end MEASUREMENT
/begin MEASUREMENT RPG_PercgVolCtrlVlv "Fuel Metering Unit Valve (FMU) Percentage" FLOAT32_IEEE EcuIntgdSwGend_CM_single__ 0 0 0.0 100.0 ECU_ADDRESS 0x4000DA64 /* @ECU_Address@RPG_PercgVolCtrlVlv@ */ /end MEASUREMENT
/begin MEASUREMENT RPG_CoeffKiClampOut "Rail Pressure Controller Ki Clmaping Coefficient" FLOAT32_IEEE EcuIntgdSwGend_CM_single 0 0 -1000.0 1000.0 ECU_ADDRESS 0x4000D964 /* @ECU_Address@RPG_CoeffKiClampOut@ */ /end MEASUREMENT
/begin MEASUREMENT RPG_CoeffKiClampSwtchOut "Rail Pressure Controller Ki Coefficient after Clamping Switch Output" FLOAT32_IEEE EcuIntgdSwGend_CM_single 0 0 -1000.0 1000.0 ECU_ADDRESS 0x4000DED8 /* @ECU_Address@RPG_CoeffKiClampSwtchOut@ */ /end MEASUREMENT
/begin MEASUREMENT RPG_TiElpdCompNEngThdAcvnPRail "Debouncer Elapsed Time for Rail Pressure Correction Activation wrt Comparision with Engine Speed" FLOAT32_IEEE EcuIntgdSwGend_CM_single_ms 0 0 0.0 50000.0 ECU_ADDRESS 0x4000D7A0 /* @ECU_Address@RPG_TiElpdCompNEngThdAcvnPRail@ */ /end MEASUREMENT
/begin MEASUREMENT PtoCtrl_CoeffKpOut "PID Controller Proportional Out" FLOAT32_IEEE EcuIntgdSwGend_CM_single 0 0 -10000.0 10000.0 ECU_ADDRESS 0x4000D830 /* @ECU_Address@PtoCtrl_CoeffKpOut@ */ /end MEASUREMENT
/begin MEASUREMENT PtoCtrl_CoeffKdFbOut "PID Controller Derivative Feedback Out" FLOAT32_IEEE EcuIntgdSwGend_CM_single 0 0 -10000.0 10000.0 ECU_ADDRESS 0x4000E0A8 /* @ECU_Address@PtoCtrl_CoeffKdFbOut@ */ /end MEASUREMENT
/begin MEASUREMENT PtoCtrl_CoeffKdOut "PID Controller Derivative Out" FLOAT32_IEEE EcuIntgdSwGend_CM_single 0 0 -10000.0 10000.0 ECU_ADDRESS 0x4000E5B8 /* @ECU_Address@PtoCtrl_CoeffKdOut@ */ /end MEASUREMENT
/begin MEASUREMENT PtoCtrl_CoeffKiClampPreSatOut "PID Controller Integrator Clamp Pre Saturation Out" FLOAT32_IEEE EcuIntgdSwGend_CM_single 0 0 -10000.0 10000.0 ECU_ADDRESS 0x4000E3B4 /* @ECU_Address@PtoCtrl_CoeffKiClampPreSatOut@ */ /end MEASUREMENT
/begin MEASUREMENT PtoCtrl_PIDOut "PID Out" FLOAT32_IEEE EcuIntgdSwGend_CM_single_N_m 0 0 -10000.0 10000.0 ECU_ADDRESS 0x4000E660 /* @ECU_Address@PtoCtrl_PIDOut@ */ /end MEASUREMENT
/begin MEASUREMENT PtoCtrl_CoeffKiClampOut "PID Controller Integrator Clamp Out" FLOAT32_IEEE EcuIntgdSwGend_CM_single 0 0 -10000.0 10000.0 ECU_ADDRESS 0x4000DC98 /* @ECU_Address@PtoCtrl_CoeffKiClampOut@ */ /end MEASUREMENT
/begin MEASUREMENT PHC_TiElpdOnStsErrGridHeatrDeb "Timer Elapsed Time of Error Grid Heater On Status" FLOAT32_IEEE EcuIntgdSwGend_CM_single_ms 0 0 0.0 100000.0 ECU_ADDRESS 0x4000E488 /* @ECU_Address@PHC_TiElpdOnStsErrGridHeatrDeb@ */ /end MEASUREMENT
/begin MEASUREMENT PHC_TiElpdOffStsErrGridHeatrDeb "Timer Elapsed Time of Error Grid Heater Off Status" FLOAT32_IEEE EcuIntgdSwGend_CM_single_ms 0 0 0.0 100000.0 ECU_ADDRESS 0x4000DDF8 /* @ECU_Address@PHC_TiElpdOffStsErrGridHeatrDeb@ */ /end MEASUREMENT
/begin MEASUREMENT PHC_TiElpdPostAcvnGridDeb "Timer Elapsed Time for Grid Heater Activation After Starter" FLOAT32_IEEE EcuIntgdSwGend_CM_single_ms 0 0 0.0 500000.0 ECU_ADDRESS 0x4000E2AC /* @ECU_Address@PHC_TiElpdPostAcvnGridDeb@ */ /end MEASUREMENT
/begin MEASUREMENT PHC_TiElpdPreAcvnGridDeb "Timer Elapsed Time for Grid Heater Activation Before Starter" FLOAT32_IEEE EcuIntgdSwGend_CM_single_ms 0 0 0.0 500000.0 ECU_ADDRESS 0x4000DD4C /* @ECU_Address@PHC_TiElpdPreAcvnGridDeb@ */ /end MEASUREMENT
/begin MEASUREMENT IC_SoiPltInjCorrTCoolt "Start of Pilot Injection Correction wrt Coolant Temperature" FLOAT32_IEEE EcuIntgdSwGend_CM_single_deg 0 0 -100.0 500.0 ECU_ADDRESS 0x4000D850 /* @ECU_Address@IC_SoiPltInjCorrTCoolt@ */ /end MEASUREMENT
/begin MEASUREMENT IC_SoiPltInjCorrPAmbAir "Start of Pilot Injection Correction wrt Ambient Air Pressure" FLOAT32_IEEE EcuIntgdSwGend_CM_single_deg 0 0 -100.0 500.0 ECU_ADDRESS 0x4000D7F8 /* @ECU_Address@IC_SoiPltInjCorrPAmbAir@ */ /end MEASUREMENT
/begin MEASUREMENT IC_SoiPltInjCorrTAmbAir "Start of Pilot Injection Correction wrt Ambient Air Temperature" FLOAT32_IEEE EcuIntgdSwGend_CM_single_deg 0 0 -100.0 500.0 ECU_ADDRESS 0x4000E418 /* @ECU_Address@IC_SoiPltInjCorrTAmbAir@ */ /end MEASUREMENT
/begin MEASUREMENT IC_SoiPltInjCorrTOil "Start of Pilot Injection Correction wrt Oil Temperature" FLOAT32_IEEE EcuIntgdSwGend_CM_single_deg 0 0 -100.0 500.0 ECU_ADDRESS 0x4000E140 /* @ECU_Address@IC_SoiPltInjCorrTOil@ */ /end MEASUREMENT
/begin MEASUREMENT IC_SoiPltInjCorrTAirBoost "Start of Pilot Injection Correction wrt AirBoost Temperature" FLOAT32_IEEE EcuIntgdSwGend_CM_single_deg 0 0 -100.0 500.0 ECU_ADDRESS 0x4000E70C /* @ECU_Address@IC_SoiPltInjCorrTAirBoost@ */ /end MEASUREMENT
/begin MEASUREMENT IC_SoiPltInj "Start of Pilot Injection" FLOAT32_IEEE EcuIntgdSwGend_CM_single_deg 0 0 -100.0 100.0 ECU_ADDRESS 0x4000DA78 /* @ECU_Address@IC_SoiPltInj@ */ /end MEASUREMENT
/begin MEASUREMENT IC_SoiMainInjCorrTCoolt "Start of Main Injection Correction wrtCoolant Temperature" FLOAT32_IEEE EcuIntgdSwGend_CM_single_deg 0 0 -100.0 500.0 ECU_ADDRESS 0x4000DA68 /* @ECU_Address@IC_SoiMainInjCorrTCoolt@ */ /end MEASUREMENT
/begin MEASUREMENT IC_SoiMainInjCorrPAmbAir "Start of Main Injection Correction wrt Ambient Air Pressure" FLOAT32_IEEE EcuIntgdSwGend_CM_single_deg 0 0 -100.0 500.0 ECU_ADDRESS 0x4000E55C /* @ECU_Address@IC_SoiMainInjCorrPAmbAir@ */ /end MEASUREMENT
/begin MEASUREMENT IC_SoiMainInjCorrTAmbAir "Start of Main Injection Correction wrt Ambient Air Temperature" FLOAT32_IEEE EcuIntgdSwGend_CM_single_deg 0 0 -100.0 500.0 ECU_ADDRESS 0x4000D784 /* @ECU_Address@IC_SoiMainInjCorrTAmbAir@ */ /end MEASUREMENT
/begin MEASUREMENT IC_SoiMainInjCorrTOil "Start of Main Injection Correction wrt Oil Temperature" FLOAT32_IEEE EcuIntgdSwGend_CM_single_deg 0 0 -100.0 500.0 ECU_ADDRESS 0x4000E664 /* @ECU_Address@IC_SoiMainInjCorrTOil@ */ /end MEASUREMENT
/begin MEASUREMENT IC_SoiMainInjCorrTAirBoost "Start of Main Injection Correction wrt AirBoost Temperature" FLOAT32_IEEE EcuIntgdSwGend_CM_single_deg 0 0 -100.0 500.0 ECU_ADDRESS 0x4000E018 /* @ECU_Address@IC_SoiMainInjCorrTAirBoost@ */ /end MEASUREMENT
/begin MEASUREMENT IC_SoiMaiInj "Start of Main Injection" FLOAT32_IEEE EcuIntgdSwGend_CM_single_deg 0 0 -100.0 100.0 ECU_ADDRESS 0x4000DD04 /* @ECU_Address@IC_SoiMaiInj@ */ /end MEASUREMENT
/begin MEASUREMENT IC_FuCnsLt "" FLOAT32_IEEE EcuIntgdSwGend_CM_single_L 0 0 0.0 10000.0 ECU_ADDRESS 0x4000E3F4 /* @ECU_Address@IC_FuCnsLt@ */ /end MEASUREMENT
/begin MEASUREMENT IC_DurPltInjCyl1 "Pilot Injection Duration for Cylinder 1" FLOAT32_IEEE EcuIntgdSwGend_CM_single_us 0 0 0.0 10000.0 ECU_ADDRESS 0x4000E324 /* @ECU_Address@IC_DurPltInjCyl1@ */ /end MEASUREMENT
/begin MEASUREMENT IC_DurPltInjCyl2 "Pilot Injection Duration for Cylinder 2" FLOAT32_IEEE EcuIntgdSwGend_CM_single_us 0 0 0.0 10000.0 ECU_ADDRESS 0x4000E328 /* @ECU_Address@IC_DurPltInjCyl2@ */ /end MEASUREMENT
/begin MEASUREMENT IC_DurPltInjCyl3 "Pilot Injection Duration for Cylinder 3" FLOAT32_IEEE EcuIntgdSwGend_CM_single_us 0 0 0.0 10000.0 ECU_ADDRESS 0x4000E32C /* @ECU_Address@IC_DurPltInjCyl3@ */ /end MEASUREMENT
/begin MEASUREMENT IC_DurPltInjCyl4 "Pilot Injection Duration for Cylinder 4" FLOAT32_IEEE EcuIntgdSwGend_CM_single_us 0 0 0.0 10000.0 ECU_ADDRESS 0x4000E330 /* @ECU_Address@IC_DurPltInjCyl4@ */ /end MEASUREMENT
/begin MEASUREMENT IC_DurPltInjCyl6 "Pilot Injection Duration for Cylinder 6" FLOAT32_IEEE EcuIntgdSwGend_CM_single_us 0 0 0.0 10000.0 ECU_ADDRESS 0x4000E338 /* @ECU_Address@IC_DurPltInjCyl6@ */ /end MEASUREMENT
/begin MEASUREMENT IC_DurPltInjCyl5 "Pilot Injection Duration for Cylinder 5" FLOAT32_IEEE EcuIntgdSwGend_CM_single_us 0 0 0.0 10000.0 ECU_ADDRESS 0x4000E334 /* @ECU_Address@IC_DurPltInjCyl5@ */ /end MEASUREMENT
/begin MEASUREMENT IC_CorrnFacCyl1 "Correction Factor for Cylinder 1" FLOAT32_IEEE EcuIntgdSwGend_CM_single_mm_3_stk 0 0 0.0 5000.0 ECU_ADDRESS 0x4000DE20 /* @ECU_Address@IC_CorrnFacCyl1@ */ /end MEASUREMENT
/begin MEASUREMENT IC_CorrnFacCyl2 "Correction Factor for Cylinder 2" FLOAT32_IEEE EcuIntgdSwGend_CM_single_mm_3_stk 0 0 0.0 5000.0 ECU_ADDRESS 0x4000E090 /* @ECU_Address@IC_CorrnFacCyl2@ */ /end MEASUREMENT
/begin MEASUREMENT IC_CorrnFacCyl3 "Correction Factor for Cylinder 3" FLOAT32_IEEE EcuIntgdSwGend_CM_single_mm_3_stk 0 0 0.0 5000.0 ECU_ADDRESS 0x4000E094 /* @ECU_Address@IC_CorrnFacCyl3@ */ /end MEASUREMENT
/begin MEASUREMENT IC_CorrnFacCyl4 "Correction Factor for Cylinder 4" FLOAT32_IEEE EcuIntgdSwGend_CM_single_mm_3_stk 0 0 0.0 5000.0 ECU_ADDRESS 0x4000E098 /* @ECU_Address@IC_CorrnFacCyl4@ */ /end MEASUREMENT
/begin MEASUREMENT IC_CorrnFacCyl6 "Correction Factor for Cylinder 6" FLOAT32_IEEE EcuIntgdSwGend_CM_single_mm_3_stk 0 0 0.0 5000.0 ECU_ADDRESS 0x4000DE34 /* @ECU_Address@IC_CorrnFacCyl6@ */ /end MEASUREMENT
/begin MEASUREMENT IC_CorrnFacCyl5 "Correction Factor for Cylinder 5" FLOAT32_IEEE EcuIntgdSwGend_CM_single_mm_3_stk 0 0 0.0 5000.0 ECU_ADDRESS 0x4000DE30 /* @ECU_Address@IC_CorrnFacCyl5@ */ /end MEASUREMENT
/begin MEASUREMENT EOP_CanLvlOil "SPN 98 - Engine Oil Level" FLOAT32_IEEE EcuIntgdSwGend_CM_single__ 0 0 0.0 100.0 ECU_ADDRESS 0x4000DB60 /* @ECU_Address@EOP_CanLvlOil@ */ /end MEASUREMENT
/begin MEASUREMENT EOP_CanPFu "SPN 94 - Engine Fuel Delivery Pressure" FLOAT32_IEEE EcuIntgdSwGend_CM_single_kPa 0 0 0.0 1000.0 ECU_ADDRESS 0x4000E538 /* @ECU_Address@EOP_CanPFu@ */ /end MEASUREMENT
/begin MEASUREMENT EOP_CanPercLoadAtCurrentSpd "SPN 92 - Engine Percent Load At Current Speed" FLOAT32_IEEE EcuIntgdSwGend_CM_single__ 0 0 0.0 250.0 ECU_ADDRESS 0x4000E638 /* @ECU_Address@EOP_CanPercLoadAtCurrentSpd@ */ /end MEASUREMENT
/begin MEASUREMENT EOP_CanAccrPedlPosn1 "SPN 91 - Accelerator Pedal Position 1" FLOAT32_IEEE EcuIntgdSwGend_CM_single__ 0 0 0.0 100.0 ECU_ADDRESS 0x4000DAE0 /* @ECU_Address@EOP_CanAccrPedlPosn1@ */ /end MEASUREMENT
/begin MEASUREMENT EOP_CanActEngPercTq "SPN 513 - Actual Engine Percent Torque" FLOAT32_IEEE EcuIntgdSwGend_CM_single__ 0 0 0.0 125.0 ECU_ADDRESS 0x4000D8E8 /* @ECU_Address@EOP_CanActEngPercTq@ */ /end MEASUREMENT
/begin MEASUREMENT EOP_CanEngTqMod "SPN 899 - Engine Torque Mode" FLOAT32_IEEE EcuIntgdSwGend_CM_single 0 0 0.0 15.0 ECU_ADDRESS 0x4000E5AC /* @ECU_Address@EOP_CanEngTqMod@ */ /end MEASUREMENT
/begin MEASUREMENT EOP_CanWhlBasVehSpd "SPN 84 - Wheel-Based Vehicle Speed" FLOAT32_IEEE EcuIntgdSwGend_CM_single_km_h 0 0 0.0 250.0 ECU_ADDRESS 0x4000DB20 /* @ECU_Address@EOP_CanWhlBasVehSpd@ */ /end MEASUREMENT
/begin MEASUREMENT EOP_CanEngRefTq "SPN 544 - Engine Reference Torque" FLOAT32_IEEE EcuIntgdSwGend_CM_single_N_m 0 0 0.0 64255.0 ECU_ADDRESS 0x4000E0F8 /* @ECU_Address@EOP_CanEngRefTq@ */ /end MEASUREMENT
/begin MEASUREMENT EOP_CanEngPercTqPoint5 "SPN 539 - Engine Percent Torque Point 5" FLOAT32_IEEE EcuIntgdSwGend_CM_single__ 0 0 0.0 125.0 ECU_ADDRESS 0x4000E490 /* @ECU_Address@EOP_CanEngPercTqPoint5@ */ /end MEASUREMENT
/begin MEASUREMENT EOP_CanEngPercTqPoint4 "SPN 539 - Engine Percent Torque Point 4" FLOAT32_IEEE EcuIntgdSwGend_CM_single__ 0 0 0.0 125.0 ECU_ADDRESS 0x4000DFCC /* @ECU_Address@EOP_CanEngPercTqPoint4@ */ /end MEASUREMENT
/begin MEASUREMENT EOP_CanEngPercTqPoint3 "SPN 539 - Engine Percent Torque Point 3" FLOAT32_IEEE EcuIntgdSwGend_CM_single__ 0 0 0.0 125.0 ECU_ADDRESS 0x4000DFC8 /* @ECU_Address@EOP_CanEngPercTqPoint3@ */ /end MEASUREMENT
/begin MEASUREMENT EOP_CanEngPercTqPoint2 "SPN 539 - Engine Percent Torque Point 2" FLOAT32_IEEE EcuIntgdSwGend_CM_single__ 0 0 0.0 125.0 ECU_ADDRESS 0x4000DFC4 /* @ECU_Address@EOP_CanEngPercTqPoint2@ */ /end MEASUREMENT
/begin MEASUREMENT EOP_CanEngPercTqPoint1 "SPN 539 - Engine Percent Torque Point 1" FLOAT32_IEEE EcuIntgdSwGend_CM_single__ 0 0 0.0 125.0 ECU_ADDRESS 0x4000DFC0 /* @ECU_Address@EOP_CanEngPercTqPoint1@ */ /end MEASUREMENT
/begin MEASUREMENT EOP_CanEngSpdPoint7 "SPN 533 - Engine Speed Point 7" FLOAT32_IEEE EcuIntgdSwGend_CM_single_rpm 0 0 0.0 8031.0 ECU_ADDRESS 0x4000E16C /* @ECU_Address@EOP_CanEngSpdPoint7@ */ /end MEASUREMENT
/begin MEASUREMENT EOP_CanEngSpdPoint6 "SPN 532 - Engine Speed Point 6" FLOAT32_IEEE EcuIntgdSwGend_CM_single_rpm 0 0 0.0 8031.0 ECU_ADDRESS 0x4000E168 /* @ECU_Address@EOP_CanEngSpdPoint6@ */ /end MEASUREMENT
/begin MEASUREMENT EOP_CanEngSpdPoint5 "SPN 531 - Engine Speed Point 5" FLOAT32_IEEE EcuIntgdSwGend_CM_single_rpm 0 0 0.0 8031.0 ECU_ADDRESS 0x4000E164 /* @ECU_Address@EOP_CanEngSpdPoint5@ */ /end MEASUREMENT
/begin MEASUREMENT EOP_CanEngSpdPoint4 "SPN 530 - Engine Speed Point 4" FLOAT32_IEEE EcuIntgdSwGend_CM_single_rpm 0 0 0.0 8031.0 ECU_ADDRESS 0x4000E398 /* @ECU_Address@EOP_CanEngSpdPoint4@ */ /end MEASUREMENT
/begin MEASUREMENT EOP_CanEngSpdPoint3 "SPN 529 - Engine Speed Point 3" FLOAT32_IEEE EcuIntgdSwGend_CM_single_rpm 0 0 0.0 8031.0 ECU_ADDRESS 0x4000E394 /* @ECU_Address@EOP_CanEngSpdPoint3@ */ /end MEASUREMENT
/begin MEASUREMENT EOP_CanEngSpdPoint2 "SPN 528 - Engine Speed Point 2" FLOAT32_IEEE EcuIntgdSwGend_CM_single_rpm 0 0 0.0 8031.0 ECU_ADDRESS 0x4000E15C /* @ECU_Address@EOP_CanEngSpdPoint2@ */ /end MEASUREMENT
/begin MEASUREMENT EOP_CanNomFricPercTq "SPN 514 - Nominal Friction - Percent Torque" FLOAT32_IEEE EcuIntgdSwGend_CM_single__ 0 0 0.0 100.0 ECU_ADDRESS 0x4000E620 /* @ECU_Address@EOP_CanNomFricPercTq@ */ /end MEASUREMENT
/begin MEASUREMENT EOP_CanDrvrDmdPercTq "SPN 512 - Driver Demand Percent Torque" FLOAT32_IEEE EcuIntgdSwGend_CM_single__ 0 0 0.0 125.0 ECU_ADDRESS 0x4000E28C /* @ECU_Address@EOP_CanDrvrDmdPercTq@ */ /end MEASUREMENT
/begin MEASUREMENT EOP_CanEngParasiticLoss "SPN 2978 - Estimated Engine Parasitic Losses" FLOAT32_IEEE EcuIntgdSwGend_CM_single__ 0 0 0.0 255.0 ECU_ADDRESS 0x4000DCE8 /* @ECU_Address@EOP_CanEngParasiticLoss@ */ /end MEASUREMENT
/begin MEASUREMENT EOP_CanEngTotFuQnty "SPN 250 - Engine Total Fuel Used" FLOAT32_IEEE EcuIntgdSwGend_CM_single_L 0 0 0.0 2.105540608E+9 ECU_ADDRESS 0x4000D810 /* @ECU_Address@EOP_CanEngTotFuQnty@ */ /end MEASUREMENT
/begin MEASUREMENT EOP_CanEngHr "SPN 247 - Engine Total Hours of Operation" FLOAT32_IEEE EcuIntgdSwGend_CM_single_h 0 0 0.0 2.10554061E+8 ECU_ADDRESS 0x4000E1E4 /* @ECU_Address@EOP_CanEngHr@ */ /end MEASUREMENT
/begin MEASUREMENT EOP_CanEngSpd "SPN 190 - Engine Speed" FLOAT32_IEEE EcuIntgdSwGend_CM_single_rpm 0 0 0.0 8032.0 ECU_ADDRESS 0x4000E26C /* @ECU_Address@EOP_CanEngSpd@ */ /end MEASUREMENT
/begin MEASUREMENT EOP_CanEngRatedSpd "SPN 189 - Engine Rated Speed" FLOAT32_IEEE EcuIntgdSwGend_CM_single_rpm 0 0 0.0 8032.0 ECU_ADDRESS 0x4000DE18 /* @ECU_Address@EOP_CanEngRatedSpd@ */ /end MEASUREMENT
/begin MEASUREMENT EOP_CanEngSpdPoint1 "SPN 188 - Engine Speed Point 1" FLOAT32_IEEE EcuIntgdSwGend_CM_single_rpm 0 0 0.0 8031.0 ECU_ADDRESS 0x4000E158 /* @ECU_Address@EOP_CanEngSpdPoint1@ */ /end MEASUREMENT
/begin MEASUREMENT EOP_CanEngDftTqLim "SPN 1846 - Engine Default Torque Limit" FLOAT32_IEEE EcuIntgdSwGend_CM_single_N_m 0 0 0.0 64255.0 ECU_ADDRESS 0x4000D6E4 /* @ECU_Address@EOP_CanEngDftTqLim@ */ /end MEASUREMENT
/begin MEASUREMENT EOP_CanEngFuRate "SPN 183 - Engine Fuel Rate" FLOAT32_IEEE EcuIntgdSwGend_CM_single_L_h 0 0 0.0 3213.0 ECU_ADDRESS 0x4000D69C /* @ECU_Address@EOP_CanEngFuRate@ */ /end MEASUREMENT
/begin MEASUREMENT EOP_CanTOil "SPN 175 - Engine Oil Temperature" FLOAT32_IEEE EcuIntgdSwGend_CM_single_degC 0 0 -273.0 1735.0 ECU_ADDRESS 0x4000DE48 /* @ECU_Address@EOP_CanTOil@ */ /end MEASUREMENT
/begin MEASUREMENT EOP_CanTFu "SPN 174 - Engine Fuel Temperature" FLOAT32_IEEE EcuIntgdSwGend_CM_single_degC 0 0 -40.0 210.0 ECU_ADDRESS 0x4000E778 /* @ECU_Address@EOP_CanTFu@ */ /end MEASUREMENT
/begin MEASUREMENT EOP_CanTAmbAir "SPN 171 - Ambient Air Temperature" FLOAT32_IEEE EcuIntgdSwGend_CM_single_degC 0 0 -40.0 250.0 ECU_ADDRESS 0x4000E29C /* @ECU_Address@EOP_CanTAmbAir@ */ /end MEASUREMENT
/begin MEASUREMENT EOP_CanBattVolt1 "SPN 168 - Battery Potential - Power Input 1" FLOAT32_IEEE EcuIntgdSwGend_CM_single_V 0 0 0.0 3213.0 ECU_ADDRESS 0x4000DB40 /* @ECU_Address@EOP_CanBattVolt1@ */ /end MEASUREMENT
/begin MEASUREMENT EOP_CanEngRatedPwr "SPN 166 - Engine Rated Power" FLOAT32_IEEE EcuIntgdSwGend_CM_single_kW 0 0 0.0 32128.0 ECU_ADDRESS 0x4000DE24 /* @ECU_Address@EOP_CanEngRatedPwr@ */ /end MEASUREMENT
/begin MEASUREMENT EOP_CanTCoolt "SPN 1637 - Engine Coolant Temperature (High Resolution)" FLOAT32_IEEE EcuIntgdSwGend_CM_single_degC 0 0 -273.0 1735.0 ECU_ADDRESS 0x4000E3EC /* @ECU_Address@EOP_CanTCoolt@ */ /end MEASUREMENT
/begin MEASUREMENT EOP_CanTAirBoostHiResl "SPN 1636 - Engine Intake Manifold 1 Temperature (High Resolution)" FLOAT32_IEEE EcuIntgdSwGend_CM_single_degC 0 0 -273.0 1735.0 ECU_ADDRESS 0x4000DA18 /* @ECU_Address@EOP_CanTAirBoostHiResl@ */ /end MEASUREMENT
/begin MEASUREMENT EOP_CanPRail "SPN 157 - Engine Injector Metering Rail 1 Pressure" FLOAT32_IEEE EcuIntgdSwGend_CM_single_MPa 0 0 0.0 251.0 ECU_ADDRESS 0x4000E0DC /* @ECU_Address@EOP_CanPRail@ */ /end MEASUREMENT
/begin MEASUREMENT EOP_CanSoiMaiInj "SPN1436 - Engine Actual Ignition Timing" FLOAT32_IEEE EcuIntgdSwGend_CM_single_deg 0 0 -200.0 302.0 ECU_ADDRESS 0x4000E264 /* @ECU_Address@EOP_CanSoiMaiInj@ */ /end MEASUREMENT
/begin MEASUREMENT EOP_CanPosOfWg1 "SPN 1188 - Engine Turbocharger Wastegate Actuator 1 Position" FLOAT32_IEEE EcuIntgdSwGend_CM_single__ 0 0 0.0 100.0 ECU_ADDRESS 0x4000DA3C /* @ECU_Address@EOP_CanPosOfWg1@ */ /end MEASUREMENT
/begin MEASUREMENT EOP_CanTEcu "SPN 1136 - Engine ECU Temperature" FLOAT32_IEEE EcuIntgdSwGend_CM_single_degC 0 0 -273.0 1735.0 ECU_ADDRESS 0x4000E428 /* @ECU_Address@EOP_CanTEcu@ */ /end MEASUREMENT
/begin MEASUREMENT EOP_CanCrsCtrlSetSpd "SPN 84 - Cruise Control Set Speed" SWORD EcuIntgdSwGend_CM_int16_km_h 0 0 0.0 250.0 ECU_ADDRESS 0x4000D6A4 /* @ECU_Address@EOP_CanCrsCtrlSetSpd@ */ /end MEASUREMENT
/begin MEASUREMENT EOP_CanWtrInFu "SPN 97 - Water In Fuel Indicator" UBYTE EcuIntgdSwGend_CM_uint8 0 0 0.0 3.0 ECU_ADDRESS 0x4000E708 /* @ECU_Address@EOP_CanWtrInFu@ */ /end MEASUREMENT
/begin MEASUREMENT EOP_CanAccrPedl1LoIdleSwt "SPN 558 - Accelerator Pedal 1 Low Idle Switch" UBYTE EcuIntgdSwGend_CM_uint8 0 0 0.0 4.0 ECU_ADDRESS 0x4000DE1C /* @ECU_Address@EOP_CanAccrPedl1LoIdleSwt@ */ /end MEASUREMENT
/begin MEASUREMENT EOP_CanColdStrtLamp "SPN 1081 - Engine Wait to Start Lamp" UBYTE EcuIntgdSwGend_CM_uint8 0 0 0.0 3.0 ECU_ADDRESS 0x4000DA9C /* @ECU_Address@EOP_CanColdStrtLamp@ */ /end MEASUREMENT
/begin MEASUREMENT EOP_CanEngSt "SPN 3543 - Engine Operating State" UBYTE EcuIntgdSwGend_CM_uint8 0 0 0.0 15.0 ECU_ADDRESS 0x4000E6D8 /* @ECU_Address@EOP_CanEngSt@ */ /end MEASUREMENT
/begin MEASUREMENT EOP_CanPTOGovrSt "SPN 976 - PTO Governor State" SBYTE EcuIntgdSwGend_CM_int8 0 0 0.0 31.0 ECU_ADDRESS 0x4000DF9D /* @ECU_Address@EOP_CanPTOGovrSt@ */ /end MEASUREMENT
/begin MEASUREMENT EOP_CanCrsCtrlActv "SPN 595 - Cruise Control Active" SBYTE EcuIntgdSwGend_CM_int8 0 0 0.0 3.0 ECU_ADDRESS 0x4000DFA5 /* @ECU_Address@EOP_CanCrsCtrlActv@ */ /end MEASUREMENT
/begin MEASUREMENT EOP_CanHndBrkPrkg "SPN 70 - Parking Brake Switch" SBYTE EcuIntgdSwGend_CM_int8 0 0 0.0 3.0 ECU_ADDRESS 0x4000D84A /* @ECU_Address@EOP_CanHndBrkPrkg@ */ /end MEASUREMENT
/begin MEASUREMENT EOP_CanCrsCtrlSetSwt "SPN 599 - Cruise Control Set Switch" SBYTE EcuIntgdSwGend_CM_int8 0 0 0.0 3.0 ECU_ADDRESS 0x4000DDD1 /* @ECU_Address@EOP_CanCrsCtrlSetSwt@ */ /end MEASUREMENT
/begin MEASUREMENT EOP_CanCrsCtrlIncSwt "SPN 602 - Cruise Control Accelerate Switch" SBYTE EcuIntgdSwGend_CM_int8 0 0 0.0 3.0 ECU_ADDRESS 0x4000DC35 /* @ECU_Address@EOP_CanCrsCtrlIncSwt@ */ /end MEASUREMENT
/begin MEASUREMENT EOP_CanCrsCtrlDecSwt "SPN 600 - Cruise Control Coast (Decelerate) Switch" SBYTE EcuIntgdSwGend_CM_int8 0 0 0.0 3.0 ECU_ADDRESS 0x4000E760 /* @ECU_Address@EOP_CanCrsCtrlDecSwt@ */ /end MEASUREMENT
/begin MEASUREMENT EOP_CanCrsCtrlResSwt "SPN 601 - Cruise Control Resume Switch" SBYTE EcuIntgdSwGend_CM_int8 0 0 0.0 3.0 ECU_ADDRESS 0x4000DBFC /* @ECU_Address@EOP_CanCrsCtrlResSwt@ */ /end MEASUREMENT
/begin MEASUREMENT EOP_CanBrkSwt "SPN 597 - Brake Switch" SBYTE EcuIntgdSwGend_CM_int8 0 0 0.0 3.0 ECU_ADDRESS 0x4000D9A9 /* @ECU_Address@EOP_CanBrkSwt@ */ /end MEASUREMENT
/begin MEASUREMENT EOP_CanCrsCtrlEnaSwt "SPN 596 - Cruise Control Enable Switch" SBYTE EcuIntgdSwGend_CM_int8 0 0 0.0 3.0 ECU_ADDRESS 0x4000D9F8 /* @ECU_Address@EOP_CanCrsCtrlEnaSwt@ */ /end MEASUREMENT
/begin MEASUREMENT EOP_CanEngStrtrMod "SPN 1675 - Engine Starter Mode" SBYTE EcuIntgdSwGend_CM_int8 0 0 0.0 15.0 ECU_ADDRESS 0x4000E111 /* @ECU_Address@EOP_CanEngStrtrMod@ */ /end MEASUREMENT
/begin MEASUREMENT EOP_CanEngShtdwnOvrdSwt "SPN 1237 - Engine Shutdown Override Switch" SBYTE EcuIntgdSwGend_CM_int8 0 0 0.0 3.0 ECU_ADDRESS 0x4000DA6C /* @ECU_Address@EOP_CanEngShtdwnOvrdSwt@ */ /end MEASUREMENT
/begin MEASUREMENT WM_bErrLvlOilSnsrLimp "Oil Level Sensor Limp Error" UBYTE EcuIntgdSwGend_CM_boolean 0 0 0.0 1.0 ECU_ADDRESS 0x4000E161 /* @ECU_Address@WM_bErrLvlOilSnsrLimp@ */ /end MEASUREMENT
/begin MEASUREMENT WM_bErrTFuSnsrLimp "Fuel Temperature Sensor Limp Error" UBYTE EcuIntgdSwGend_CM_boolean 0 0 0.0 1.0 ECU_ADDRESS 0x4000DBB8 /* @ECU_Address@WM_bErrTFuSnsrLimp@ */ /end MEASUREMENT
/begin MEASUREMENT WM_bErrTAirBoostSnsrLimp "Air Boost Temperature Sensor Limp Error" UBYTE EcuIntgdSwGend_CM_boolean 0 0 0.0 1.0 ECU_ADDRESS 0x4000D868 /* @ECU_Address@WM_bErrTAirBoostSnsrLimp@ */ /end MEASUREMENT
/begin MEASUREMENT WM_bErrTAmbAirSnsrLimp "Ambient Air Temperature Sensor Limp Error" UBYTE EcuIntgdSwGend_CM_boolean 0 0 0.0 1.0 ECU_ADDRESS 0x4000E260 /* @ECU_Address@WM_bErrTAmbAirSnsrLimp@ */ /end MEASUREMENT
/begin MEASUREMENT WM_bErrPFuSnsrLimp "Fuel Pressure Sensor Limp Error" UBYTE EcuIntgdSwGend_CM_boolean 0 0 0.0 1.0 ECU_ADDRESS 0x4000D74B /* @ECU_Address@WM_bErrPFuSnsrLimp@ */ /end MEASUREMENT
/begin MEASUREMENT WM_bErrPAmbAirSnsrLimp "Ambient Air Pressure Sensor Limp Error" UBYTE EcuIntgdSwGend_CM_boolean 0 0 0.0 1.0 ECU_ADDRESS 0x4000DBD4 /* @ECU_Address@WM_bErrPAmbAirSnsrLimp@ */ /end MEASUREMENT
/begin MEASUREMENT WM_bErrPAirBoostSnsrLimp "Air Boost Pressure Sensor Limp Error" UBYTE EcuIntgdSwGend_CM_boolean 0 0 0.0 1.0 ECU_ADDRESS 0x4000DA38 /* @ECU_Address@WM_bErrPAirBoostSnsrLimp@ */ /end MEASUREMENT
/begin MEASUREMENT WM_bErrTEcuLimp "ECU Temperature Sensor Limp Error" UBYTE EcuIntgdSwGend_CM_boolean 0 0 0.0 1.0 ECU_ADDRESS 0x4000DE8C /* @ECU_Address@WM_bErrTEcuLimp@ */ /end MEASUREMENT
/begin MEASUREMENT WM_bErrUClmp30SnsrLimp "Batter Voltage Sensor Limp Error" UBYTE EcuIntgdSwGend_CM_boolean 0 0 0.0 1.0 ECU_ADDRESS 0x4000DE50 /* @ECU_Address@WM_bErrUClmp30SnsrLimp@ */ /end MEASUREMENT
/begin MEASUREMENT WM_bErrWgLimp "Wastegate Sensor Limp Error" UBYTE EcuIntgdSwGend_CM_boolean 0 0 0.0 1.0 ECU_ADDRESS 0x4000E78C /* @ECU_Address@WM_bErrWgLimp@ */ /end MEASUREMENT
/begin MEASUREMENT WM_bErrPOilSnsrLimp "Oil Pressure Sensor Limp Error" UBYTE EcuIntgdSwGend_CM_boolean 0 0 0.0 1.0 ECU_ADDRESS 0x4000DB68 /* @ECU_Address@WM_bErrPOilSnsrLimp@ */ /end MEASUREMENT
/begin MEASUREMENT WM_bErrTOilSnsrLimp "Oil Temperature Sensor Limp Error" UBYTE EcuIntgdSwGend_CM_boolean 0 0 0.0 1.0 ECU_ADDRESS 0x4000E224 /* @ECU_Address@WM_bErrTOilSnsrLimp@ */ /end MEASUREMENT
/begin MEASUREMENT WM_bErrTCooltSnsrLimp "Coolant Temperature Sensor Limp Error" UBYTE EcuIntgdSwGend_CM_boolean 0 0 0.0 1.0 ECU_ADDRESS 0x4000D8E0 /* @ECU_Address@WM_bErrTCooltSnsrLimp@ */ /end MEASUREMENT
/begin MEASUREMENT WM_bAcvLimpRctn "Limp Reaction Active" UBYTE EcuIntgdSwGend_CM_boolean 0 0 0.0 1.0 ECU_ADDRESS 0x4000D8A0 /* @ECU_Address@WM_bAcvLimpRctn@ */ /end MEASUREMENT
/begin MEASUREMENT TL_bEnaTmrNEngAcvForTCoolt "Timer Enable Condition for Coolant High Temperature Limit Activation" UBYTE EcuIntgdSwGend_CM_boolean 0 0 0.0 1.0 ECU_ADDRESS 0x4000E225 /* @ECU_Address@TL_bEnaTmrNEngAcvForTCoolt@ */ /end MEASUREMENT
/begin MEASUREMENT TL_bEnaTmrNEngAcvForTFu "Timer Enable Condition for Fuel Temperature Limit Activation" UBYTE EcuIntgdSwGend_CM_boolean 0 0 0.0 1.0 ECU_ADDRESS 0x4000E187 /* @ECU_Address@TL_bEnaTmrNEngAcvForTFu@ */ /end MEASUREMENT
/begin MEASUREMENT TL_bEnaTmrNEngAcvForNExhTrbChrg "Timer Enable Condition for Turbo Charger Limit Activation" UBYTE EcuIntgdSwGend_CM_boolean 0 0 0.0 1.0 ECU_ADDRESS 0x4000DF05 /* @ECU_Address@TL_bEnaTmrNEngAcvForNExhTrbChrg@ */ /end MEASUREMENT
/begin MEASUREMENT TL_bEnaTmrNEngAcvForPAirBoost "Timer Enable Condition for Air Boost Pressure Limit Activation" UBYTE EcuIntgdSwGend_CM_boolean 0 0 0.0 1.0 ECU_ADDRESS 0x4000E5B4 /* @ECU_Address@TL_bEnaTmrNEngAcvForPAirBoost@ */ /end MEASUREMENT
/begin MEASUREMENT TL_bErrTAirSnsr "Air Temperature Sensor Error" UBYTE EcuIntgdSwGend_CM_boolean 0 0 0.0 1.0 ECU_ADDRESS 0x4000E4CD /* @ECU_Address@TL_bErrTAirSnsr@ */ /end MEASUREMENT
/begin MEASUREMENT TL_bEnaTmrNEngAcvForTAir "Timer Enable Condition for Air Boost Temperature Limit Activation" UBYTE EcuIntgdSwGend_CM_boolean 0 0 0.0 1.0 ECU_ADDRESS 0x4000E5FD /* @ECU_Address@TL_bEnaTmrNEngAcvForTAir@ */ /end MEASUREMENT
/begin MEASUREMENT TL_bEnaTmrNEngAcvForPAirAmb "Timer Enable Condition for Ambient Pressure Limit Activation" UBYTE EcuIntgdSwGend_CM_boolean 0 0 0.0 1.0 ECU_ADDRESS 0x4000E700 /* @ECU_Address@TL_bEnaTmrNEngAcvForPAirAmb@ */ /end MEASUREMENT
/begin MEASUREMENT TL_bEnaTmrNEngAcvForTOil "Timer Enable Condition for Oil Temperature Limit Activation" UBYTE EcuIntgdSwGend_CM_boolean 0 0 0.0 1.0 ECU_ADDRESS 0x4000E2B3 /* @ECU_Address@TL_bEnaTmrNEngAcvForTOil@ */ /end MEASUREMENT
/begin MEASUREMENT SC_bAcvStrtOvrHeatProtn "Starter OverHeat Protection" UBYTE EcuIntgdSwGend_CM_boolean 0 0 0.0 1.0 ECU_ADDRESS 0x4000E551 /* @ECU_Address@SC_bAcvStrtOvrHeatProtn@ */ /end MEASUREMENT
/begin MEASUREMENT SC_bNEngRunDeacThd "Debouncer Flag for Deactivation Engine Speed Threshold" UBYTE EcuIntgdSwGend_CM_boolean 0 0 0.0 1.0 ECU_ADDRESS 0x4000E1E0 /* @ECU_Address@SC_bNEngRunDeacThd@ */ /end MEASUREMENT
/begin MEASUREMENT SC_bNEngStrtrInhThd "Debouncer Flag for Start Inhibition Engine Speed Threshold" UBYTE EcuIntgdSwGend_CM_boolean 0 0 0.0 1.0 ECU_ADDRESS 0x4000DC36 /* @ECU_Address@SC_bNEngStrtrInhThd@ */ /end MEASUREMENT
/begin MEASUREMENT SC_bAcvEngRunng "Engine is Running Flag" UBYTE EcuIntgdSwGend_CM_boolean 0 0 0.0 1.0 ECU_ADDRESS 0x4000DF9C /* @ECU_Address@SC_bAcvEngRunng@ */ /end MEASUREMENT
/begin MEASUREMENT SC_bEngNotTurnTiEna "Engine Not Turn Timer Enable" UBYTE EcuIntgdSwGend_CM_boolean 0 0 0.0 1.0 ECU_ADDRESS 0x4000D8D2 /* @ECU_Address@SC_bEngNotTurnTiEna@ */ /end MEASUREMENT
/begin MEASUREMENT SC_bEngNotTurn "Engine Not Turn Signal" UBYTE EcuIntgdSwGend_CM_boolean 0 0 0.0 1.0 ECU_ADDRESS 0x4000E370 /* @ECU_Address@SC_bEngNotTurn@ */ /end MEASUREMENT
/begin MEASUREMENT SC_bComplDebNEngStrtLock "Debouncer Flag for Starter Locking" UBYTE EcuIntgdSwGend_CM_boolean 0 0 0.0 1.0 ECU_ADDRESS 0x4000DE6D /* @ECU_Address@SC_bComplDebNEngStrtLock@ */ /end MEASUREMENT
/begin MEASUREMENT SC_EngRunngActvnforEngAlrdyRunng "Engine Runnig Activation for Engine Already Running" UBYTE EcuIntgdSwGend_CM_boolean 0 0 0.0 1.0 ECU_ADDRESS 0x4000E0E0 /* @ECU_Address@SC_EngRunngActvnforEngAlrdyRunng@ */ /end MEASUREMENT
/begin MEASUREMENT SC_bInhErrElectFailPreTest "Inhibition Engine Start Electrical Failure Pre Test" UBYTE EcuIntgdSwGend_CM_boolean 0 0 0.0 1.0 ECU_ADDRESS 0x4000E4AB /* @ECU_Address@SC_bInhErrElectFailPreTest@ */ /end MEASUREMENT
/begin MEASUREMENT SC_bTiAcvnLvlFuDeb "Fuel Level Debouncer Activation" UBYTE EcuIntgdSwGend_CM_boolean 0 0 0.0 1.0 ECU_ADDRESS 0x4000E047 /* @ECU_Address@SC_bTiAcvnLvlFuDeb@ */ /end MEASUREMENT
/begin MEASUREMENT SC_bTiAcvnLvlOilDeb "Oil Level Debouncer Activation" UBYTE EcuIntgdSwGend_CM_boolean 0 0 0.0 1.0 ECU_ADDRESS 0x4000DFB0 /* @ECU_Address@SC_bTiAcvnLvlOilDeb@ */ /end MEASUREMENT
/begin MEASUREMENT SC_bInhEngStrtPreTest "Inhibition Engine Start Pre Test" UBYTE EcuIntgdSwGend_CM_boolean 0 0 0.0 1.0 ECU_ADDRESS 0x4000D7A4 /* @ECU_Address@SC_bInhEngStrtPreTest@ */ /end MEASUREMENT
/begin MEASUREMENT SpdLimr_EngBrkLvl1Ena "Engine Brake Level 1 Enable" UBYTE EcuIntgdSwGend_CM_boolean 0 0 0.0 1.0 ECU_ADDRESS 0x4000E26B /* @ECU_Address@SpdLimr_EngBrkLvl1Ena@ */ /end MEASUREMENT
/begin MEASUREMENT SpdLimr_EngBrkLvl2Ena "Engine Brake Level 2 Enable" UBYTE EcuIntgdSwGend_CM_boolean 0 0 0.0 1.0 ECU_ADDRESS 0x4000E43C /* @ECU_Address@SpdLimr_EngBrkLvl2Ena@ */ /end MEASUREMENT
/begin MEASUREMENT SpdLimr_ErrCanTrtCaseSts "Error CAN Transfer Case Status" UBYTE EcuIntgdSwGend_CM_boolean 0 0 0.0 1.0 ECU_ADDRESS 0x4000D7F3 /* @ECU_Address@SpdLimr_ErrCanTrtCaseSts@ */ /end MEASUREMENT
/begin MEASUREMENT SpdLimr_ErrCanTrsmTqCnvrRat "Error CAN Transmission Torque Convertor Ratio" UBYTE EcuIntgdSwGend_CM_boolean 0 0 0.0 1.0 ECU_ADDRESS 0x4000E4AC /* @ECU_Address@SpdLimr_ErrCanTrsmTqCnvrRat@ */ /end MEASUREMENT
/begin MEASUREMENT RPG_bCompNEngThdAcvnPRail "Debouncer Flag for Rail Pressure Correction Activation wrt Comparision with Engine Speed" UBYTE EcuIntgdSwGend_CM_boolean 0 0 0.0 1.0 ECU_ADDRESS 0x4000E280 /* @ECU_Address@RPG_bCompNEngThdAcvnPRail@ */ /end MEASUREMENT
/begin MEASUREMENT PHC_bGridHeatrFault "Grid Heater Fault" UBYTE EcuIntgdSwGend_CM_boolean 0 0 0.0 1.0 ECU_ADDRESS 0x4000E496 /* @ECU_Address@PHC_bGridHeatrFault@ */ /end MEASUREMENT
/begin MEASUREMENT PHC_bErrAcvGridHeatrOffSts "Grid Heater Error Off Status" UBYTE EcuIntgdSwGend_CM_boolean 0 0 0.0 1.0 ECU_ADDRESS 0x4000DC14 /* @ECU_Address@PHC_bErrAcvGridHeatrOffSts@ */ /end MEASUREMENT
/begin MEASUREMENT PHC_bErrAcvGridHeatrOnSts "Grid Heater Error On Status" UBYTE EcuIntgdSwGend_CM_boolean 0 0 0.0 1.0 ECU_ADDRESS 0x4000E709 /* @ECU_Address@PHC_bErrAcvGridHeatrOnSts@ */ /end MEASUREMENT
/begin MEASUREMENT EngBrk_ErrEngBrkReq2Btn "Engine Brake Request Button 2 Error" UBYTE EcuIntgdSwGend_CM_boolean 0 0 0.0 1.0 ECU_ADDRESS 0x4000E74D /* @ECU_Address@EngBrk_ErrEngBrkReq2Btn@ */ /end MEASUREMENT
/begin MEASUREMENT EngBrk_ActvEngBrkReq2Btn "Engine Brake Request Button 2 Active" UBYTE EcuIntgdSwGend_CM_boolean 0 0 0.0 1.0 ECU_ADDRESS 0x4000E552 /* @ECU_Address@EngBrk_ActvEngBrkReq2Btn@ */ /end MEASUREMENT
/begin MEASUREMENT EngBrk_ActvEngBrkBtn2 "Engine Brake Button 2 Active" UBYTE EcuIntgdSwGend_CM_boolean 0 0 0.0 1.0 ECU_ADDRESS 0x4000E74F /* @ECU_Address@EngBrk_ActvEngBrkBtn2@ */ /end MEASUREMENT
/begin MEASUREMENT EngBrk_ActvBrkPedl "Brake Pedal Active" UBYTE EcuIntgdSwGend_CM_boolean 0 0 0.0 1.0 ECU_ADDRESS 0x4000D9A0 /* @ECU_Address@EngBrk_ActvBrkPedl@ */ /end MEASUREMENT
/begin MEASUREMENT EngBrk_ActvCanABS "ABS Active from CAN" UBYTE EcuIntgdSwGend_CM_boolean 0 0 0.0 1.0 ECU_ADDRESS 0x4000DAF8 /* @ECU_Address@EngBrk_ActvCanABS@ */ /end MEASUREMENT
/begin MEASUREMENT EngBrk_TrsmCurrentGearNotNeut "Transmission Current Gear Evaluation" UBYTE EcuIntgdSwGend_CM_boolean 0 0 0.0 1.0 ECU_ADDRESS 0x4000E09F /* @ECU_Address@EngBrk_TrsmCurrentGearNotNeut@ */ /end MEASUREMENT
/begin MEASUREMENT EngBrk_ActvTrsmLockUpEngd "Transmission Lock Up Engaged Active" UBYTE EcuIntgdSwGend_CM_boolean 0 0 0.0 1.0 ECU_ADDRESS 0x4000E614 /* @ECU_Address@EngBrk_ActvTrsmLockUpEngd@ */ /end MEASUREMENT
/begin MEASUREMENT EngBrk_PtoNotActv "Power Take Off Not Active" UBYTE EcuIntgdSwGend_CM_boolean 0 0 0.0 1.0 ECU_ADDRESS 0x4000DBE0 /* @ECU_Address@EngBrk_PtoNotActv@ */ /end MEASUREMENT
/begin MEASUREMENT EngBrk_EnaEngBrk "Engine Brake Enable" UBYTE EcuIntgdSwGend_CM_boolean 0 0 0.0 1.0 ECU_ADDRESS 0x4000DAC0 /* @ECU_Address@EngBrk_EnaEngBrk@ */ /end MEASUREMENT
/begin MEASUREMENT EngBrk_ActvEngBrkReq1Btn "Engine Brake Request Button 1 Active" UBYTE EcuIntgdSwGend_CM_boolean 0 0 0.0 1.0 ECU_ADDRESS 0x4000DCC1 /* @ECU_Address@EngBrk_ActvEngBrkReq1Btn@ */ /end MEASUREMENT
/begin MEASUREMENT EngBrk_ActvEngBrkBtn1 "Engine Brake Button 1 Active" UBYTE EcuIntgdSwGend_CM_boolean 0 0 0.0 1.0 ECU_ADDRESS 0x4000DD7D /* @ECU_Address@EngBrk_ActvEngBrkBtn1@ */ /end MEASUREMENT
/begin MEASUREMENT EngBrk_ActvEngBrkSoln2 "Engine Brake Selenoid 2 Active" UBYTE EcuIntgdSwGend_CM_boolean 0 0 0.0 1.0 ECU_ADDRESS 0x4000DE7D /* @ECU_Address@EngBrk_ActvEngBrkSoln2@ */ /end MEASUREMENT
/begin MEASUREMENT EngBrk_ErrEngBrkReq1Btn "Engine Brake Request Button 1 Error" UBYTE EcuIntgdSwGend_CM_boolean 0 0 0.0 1.0 ECU_ADDRESS 0x4000DEAC /* @ECU_Address@EngBrk_ErrEngBrkReq1Btn@ */ /end MEASUREMENT
/begin MEASUREMENT EngBrk_ActvEngBrkSoln1 "Engine Brake Selenoid 1 Active" UBYTE EcuIntgdSwGend_CM_boolean 0 0 0.0 1.0 ECU_ADDRESS 0x4000DE7C /* @ECU_Address@EngBrk_ActvEngBrkSoln1@ */ /end MEASUREMENT
/begin MEASUREMENT EngBrk_ActvEngBrkCtrl "Engine Brake Control" UBYTE EcuIntgdSwGend_CM_boolean 0 0 0.0 1.0 ECU_ADDRESS 0x4000D7AC /* @ECU_Address@EngBrk_ActvEngBrkCtrl@ */ /end MEASUREMENT
/begin MEASUREMENT EOP_CanAmberWarnLamp "SPN 624 - Amber Warning Lamp" UBYTE EcuIntgdSwGend_CM_boolean 0 0 0.0 1.0 ECU_ADDRESS 0x4000D73D /* @ECU_Address@EOP_CanAmberWarnLamp@ */ /end MEASUREMENT
/begin MEASUREMENT EOP_CanRedStopLamp "SPN 623 - Red Stop Lamp" UBYTE EcuIntgdSwGend_CM_boolean 0 0 0.0 1.0 ECU_ADDRESS 0x4000D961 /* @ECU_Address@EOP_CanRedStopLamp@ */ /end MEASUREMENT
/begin COMPU_METHOD EcuIntgdSwGend_CM_single_N_m "Q = V" RAT_FUNC "%8.6" "N*m" COEFFS 0 1 0 0 0 1 /end COMPU_METHOD
/begin COMPU_METHOD EcuIntgdSwGend_CM_single_rpm "Q = V" RAT_FUNC "%8.6" "rpm" COEFFS 0 1 0 0 0 1 /end COMPU_METHOD
/begin COMPU_METHOD EcuIntgdSwGend_CM_single_degC "Q = V" RAT_FUNC "%8.6" "degC" COEFFS 0 1 0 0 0 1 /end COMPU_METHOD
/begin COMPU_METHOD EcuIntgdSwGend_CM_single "Q = V" RAT_FUNC "%8.6" "" COEFFS 0 1 0 0 0 1 /end COMPU_METHOD
/begin COMPU_METHOD EcuIntgdSwGend_CM_single__ "Q = V" RAT_FUNC "%8.6" "%" COEFFS 0 1 0 0 0 1 /end COMPU_METHOD
/begin COMPU_METHOD EcuIntgdSwGend_CM_single_L "Q = V" RAT_FUNC "%8.6" "L" COEFFS 0 1 0 0 0 1 /end COMPU_METHOD
/begin COMPU_METHOD EcuIntgdSwGend_CM_single_deg "Q = V" RAT_FUNC "%8.6" "deg" COEFFS 0 1 0 0 0 1 /end COMPU_METHOD
/begin COMPU_METHOD EcuIntgdSwGend_CM_single_ms "Q = V" RAT_FUNC "%8.6" "ms" COEFFS 0 1 0 0 0 1 /end COMPU_METHOD
/begin COMPU_METHOD EcuIntgdSwGend_CM_single_mbar "Q = V" RAT_FUNC "%8.6" "mbar" COEFFS 0 1 0 0 0 1 /end COMPU_METHOD
/begin COMPU_METHOD EcuIntgdSwGend_CM_single_bar "Q = V" RAT_FUNC "%8.6" "bar" COEFFS 0 1 0 0 0 1 /end COMPU_METHOD
/begin COMPU_METHOD EcuIntgdSwGend_CM_single_mm_3_stk "Q = V" RAT_FUNC "%8.6" "mm^3/stk" COEFFS 0 1 0 0 0 1 /end COMPU_METHOD
/begin COMPU_METHOD EcuIntgdSwGend_CM_single_V "Q = V" RAT_FUNC "%8.6" "V" COEFFS 0 1 0 0 0 1 /end COMPU_METHOD
/begin COMPU_METHOD EcuIntgdSwGend_CM_single_km_h "Q = V" RAT_FUNC "%8.6" "km/h" COEFFS 0 1 0 0 0 1 /end COMPU_METHOD
/begin COMPU_METHOD EcuIntgdSwGend_CM_single_us "Q = V" RAT_FUNC "%8.6" "us" COEFFS 0 1 0 0 0 1 /end COMPU_METHOD
/begin COMPU_METHOD EcuIntgdSwGend_CM_single_km "Q = V" RAT_FUNC "%8.6" "km" COEFFS 0 1 0 0 0 1 /end COMPU_METHOD
/begin COMPU_METHOD EcuIntgdSwGend_CM_single_h "Q = V" RAT_FUNC "%8.6" "h" COEFFS 0 1 0 0 0 1 /end COMPU_METHOD
/begin COMPU_METHOD EcuIntgdSwGend_CM_single_L_h "Q = V" RAT_FUNC "%8.6" "L/h" COEFFS 0 1 0 0 0 1 /end COMPU_METHOD
/begin COMPU_METHOD EcuIntgdSwGend_CM_single_kW "Q = V" RAT_FUNC "%8.6" "kW" COEFFS 0 1 0 0 0 1 /end COMPU_METHOD
/begin COMPU_METHOD EcuIntgdSwGend_CM_single_kPa "Q = V" RAT_FUNC "%8.6" "kPa" COEFFS 0 1 0 0 0 1 /end COMPU_METHOD
/begin COMPU_METHOD EcuIntgdSwGend_CM_single_MPa "Q = V" RAT_FUNC "%8.6" "MPa" COEFFS 0 1 0 0 0 1 /end COMPU_METHOD
/begin COMPU_METHOD EcuIntgdSwGend_CM_uint32 "Q = V" RAT_FUNC "%10.0" "" COEFFS 0 1 0 0 0 1 /end COMPU_METHOD
/begin COMPU_METHOD EcuIntgdSwGend_CM_int16_km_h "Q = V" RAT_FUNC "%5.0" "km/h" COEFFS 0 1 0 0 0 1 /end COMPU_METHOD
/begin COMPU_METHOD EcuIntgdSwGend_CM_boolean "Q = V" RAT_FUNC "%1.0" "" COEFFS 0 1 0 0 0 1 /end COMPU_METHOD
/begin COMPU_METHOD EcuIntgdSwGend_CM_boolean_deg "Q = V" RAT_FUNC "%1.0" "deg" COEFFS 0 1 0 0 0 1 /end COMPU_METHOD
/begin COMPU_METHOD EcuIntgdSwGend_CM_int8 "Q = V" RAT_FUNC "%3.0" "" COEFFS 0 1 0 0 0 1 /end COMPU_METHOD
/begin COMPU_METHOD EcuIntgdSwGend_CM_uint8 "Q = V" RAT_FUNC "%3.0" "" COEFFS 0 1 0 0 0 1 /end COMPU_METHOD
/begin GROUP S302_SPN_1081___Engine_Wait_to_Start_Lamp "EcuIntgdSwGend/ControlSoftware/EcuOutpPrcsg/CAN Signals/SPN 1081 - Engine Wait to Start Lamp"
 /begin REF_CHARACTERISTIC EG_ColdStrtLampErr_C EG_ColdStrtLampNotAvl_C EG_ColdStrtLampOff_C EG_ColdStrtLampOn_C EOP_CanColdStrtLampOvs_P EOP_CanColdStrtLampOvv_P EOP_ColdStrtLampNotAvl_P /end REF_CHARACTERISTIC
 /begin REF_MEASUREMENT EOP_CanColdStrtLamp /end REF_MEASUREMENT
/end GROUP
/begin GROUP S302_SPN_1136___Engine_ECU_Temperature "EcuIntgdSwGend/ControlSoftware/EcuOutpPrcsg/CAN Signals/SPN 1136 - Engine ECU Temperature" /begin REF_CHARACTERISTIC EOP_CanTEcuOvs_P EOP_CanTEcuOvv_P /end REF_CHARACTERISTIC /begin REF_MEASUREMENT EOP_CanTEcu /end REF_MEASUREMENT /end GROUP
/begin GROUP S302_SPN_1188___Engine_Turbocharger_Wastegate_Actuator_1_Position "EcuIntgdSwGend/ControlSoftware/EcuOutpPrcsg/CAN Signals/SPN 1188 - Engine Turbocharger Wastegate Actuator 1 Position" /begin REF_CHARACTERISTIC EOP_CanPosOfWg1Ovs_P EOP_CanPosOfWg1Ovv_P /end REF_CHARACTERISTIC /begin REF_MEASUREMENT EOP_CanPosOfWg1 /end REF_MEASUREMENT /end GROUP
/begin GROUP S302_SPN_1237___Engine_Shutdown_Override_Switch "EcuIntgdSwGend/ControlSoftware/EcuOutpPrcsg/CAN Signals/SPN 1237 - Engine Shutdown Override Switch"
 /begin REF_CHARACTERISTIC EG_CmbtSwtErr_C EG_CmbtSwtNotAvlNotAvl_C EG_CmbtSwtOff_C EG_CmbtSwtOn_C EOP_CanEngShtdwnOvrdSwtOvs_P EOP_CanEngShtdwnOvrdSwtOvv_P EOP_CmbtSwtNotAvl_P /end REF_CHARACTERISTIC
 /begin REF_MEASUREMENT EOP_CanEngShtdwnOvrdSwt /end REF_MEASUREMENT
/end GROUP
/begin GROUP S302_SPN_1436___Engine_Actual_Ignition_Timing "EcuIntgdSwGend/ControlSoftware/EcuOutpPrcsg/CAN Signals/SPN 1436 - Engine Actual Ignition Timing" /begin REF_CHARACTERISTIC EOP_CanSoiMaiInjOvs_P EOP_CanSoiMaiInjOvv_P /end REF_CHARACTERISTIC /begin REF_MEASUREMENT EOP_CanSoiMaiInj /end REF_MEASUREMENT /end GROUP
/begin GROUP S302_SPN_157___Engine_Injector_Metering_Rail_1_Pressure "EcuIntgdSwGend/ControlSoftware/EcuOutpPrcsg/CAN Signals/SPN 157 - Engine Injector Metering Rail 1 Pressure" /begin REF_CHARACTERISTIC EG_Bar2MPa_C EOP_CanPRailOvs_P EOP_CanPRailOvv_P /end REF_CHARACTERISTIC /begin REF_MEASUREMENT EOP_CanPRail /end REF_MEASUREMENT /end GROUP
/begin GROUP S302_SPN_1636___Engine_Intake_Manifold_1_Air_Temperature__High_Resolution_ "EcuIntgdSwGend/ControlSoftware/EcuOutpPrcsg/CAN Signals/SPN 1636 - Engine Intake Manifold 1 Air Temperature (High Resolution)" /begin REF_CHARACTERISTIC EOP_CanTAirBoostHiReslOvs_P EOP_CanTAirBoostHiReslOvv_P /end REF_CHARACTERISTIC /begin REF_MEASUREMENT EOP_CanTAirBoostHiResl /end REF_MEASUREMENT /end GROUP
/begin GROUP S302_SPN_1637___Engine_Coolant_Temperature__High_Resolution_ "EcuIntgdSwGend/ControlSoftware/EcuOutpPrcsg/CAN Signals/SPN 1637 - Engine Coolant Temperature (High Resolution)" /begin REF_CHARACTERISTIC EOP_CanTCooltOvs_P EOP_CanTCooltOvv_P /end REF_CHARACTERISTIC /begin REF_MEASUREMENT EOP_CanTCoolt /end REF_MEASUREMENT /end GROUP
/begin GROUP S302_SPN_166___Engine_Rated_Power "EcuIntgdSwGend/ControlSoftware/EcuOutpPrcsg/CAN Signals/SPN 166 - Engine Rated Power"
 /begin REF_CHARACTERISTIC EOP_CanEngRatedPwrOvs_P EOP_CanEngRatedPwrOvv_P EOP_EngRatedPwr_P /end REF_CHARACTERISTIC
 /begin REF_MEASUREMENT EOP_CanEngRatedPwr /end REF_MEASUREMENT
/end GROUP
/begin GROUP S302_SPN_1675___Engine_Starter_Mode "EcuIntgdSwGend/ControlSoftware/EcuOutpPrcsg/CAN Signals/SPN 1675 - Engine Starter Mode"
 /begin REF_CHARACTERISTIC EG_EngStrtrModeNotAvl_C EOP_CanEngStrtrModOvs_P EOP_CanEngStrtrModOvv_P EOP_EngStrtrModeNotAvl_P /end REF_CHARACTERISTIC
 /begin REF_MEASUREMENT EOP_CanEngStrtrMod /end REF_MEASUREMENT
/end GROUP
/begin GROUP S302_SPN_168___Battery_Potential____Power_Input_1 "EcuIntgdSwGend/ControlSoftware/EcuOutpPrcsg/CAN Signals/SPN 168 - Battery Potential // Power Input 1" /begin REF_CHARACTERISTIC EOP_CanBattVolt1Ovs_P EOP_CanBattVolt1Ovv_P /end REF_CHARACTERISTIC /begin REF_MEASUREMENT EOP_CanBattVolt1 /end REF_MEASUREMENT /end GROUP
/begin GROUP S302_SPN_171___Ambient_Air_Temperature "EcuIntgdSwGend/ControlSoftware/EcuOutpPrcsg/CAN Signals/SPN 171 - Ambient Air Temperature" /begin REF_CHARACTERISTIC EOP_CanTAmbAirOvs_P EOP_CanTAmbAirOvv_P /end REF_CHARACTERISTIC /begin REF_MEASUREMENT EOP_CanTAmbAir /end REF_MEASUREMENT /end GROUP
/begin GROUP S302_SPN_174___Engine_Fuel_Temperature_1 "EcuIntgdSwGend/ControlSoftware/EcuOutpPrcsg/CAN Signals/SPN 174 - Engine Fuel Temperature 1" /begin REF_CHARACTERISTIC EOP_CanTFuOvs_P EOP_CanTFuOvv_P /end REF_CHARACTERISTIC /begin REF_MEASUREMENT EOP_CanTFu /end REF_MEASUREMENT /end GROUP
/begin GROUP S302_SPN_175___Engine_Oil_Temperature_1 "EcuIntgdSwGend/ControlSoftware/EcuOutpPrcsg/CAN Signals/SPN 175 - Engine Oil Temperature 1" /begin REF_CHARACTERISTIC EOP_CanTOilOvs_P EOP_CanTOilOvv_P /end REF_CHARACTERISTIC /begin REF_MEASUREMENT EOP_CanTOil /end REF_MEASUREMENT /end GROUP
/begin GROUP S302_SPN_183___Engine_Fuel_Rate "EcuIntgdSwGend/ControlSoftware/EcuOutpPrcsg/CAN Signals/SPN 183 - Engine Fuel Rate" /begin REF_CHARACTERISTIC EOP_CanEngFuRateOvs_P EOP_CanEngFuRateOvv_P /end REF_CHARACTERISTIC /begin REF_MEASUREMENT EOP_CanEngFuRate /end REF_MEASUREMENT /end GROUP
/begin GROUP S302_SPN_1846___Engine_Default_Torque_Limit "EcuIntgdSwGend/ControlSoftware/EcuOutpPrcsg/CAN Signals/SPN 1846 - Engine Default Torque Limit" /begin REF_CHARACTERISTIC EOP_CanEngDftTqLimOvs_P EOP_CanEngDftTqLimOvv_P /end REF_CHARACTERISTIC /begin REF_MEASUREMENT EOP_CanEngDftTqLim /end REF_MEASUREMENT /end GROUP
/begin GROUP S302_SPN_188___Engine_Speed_At_Idle__Point_1 "EcuIntgdSwGend/ControlSoftware/EcuOutpPrcsg/CAN Signals/SPN 188 - Engine Speed At Idle, Point 1" /begin REF_CHARACTERISTIC EOP_CanEngSpdPoint1Ovs_P EOP_CanEngSpdPoint1Ovv_P /end REF_CHARACTERISTIC /begin REF_MEASUREMENT EOP_CanEngSpdPoint1 /end REF_MEASUREMENT /end GROUP
/begin GROUP S302_SPN_189___Engine_Rated_Speed "EcuIntgdSwGend/ControlSoftware/EcuOutpPrcsg/CAN Signals/SPN 189 - Engine Rated Speed"
 /begin REF_CHARACTERISTIC EOP_CanEngRatedSpdOvs_P EOP_CanEngRatedSpdOvv_P EOP_EngRatedSpd_P /end REF_CHARACTERISTIC
 /begin REF_MEASUREMENT EOP_CanEngRatedSpd /end REF_MEASUREMENT
/end GROUP
/begin GROUP S302_SPN_190___Engine_Speed "EcuIntgdSwGend/ControlSoftware/EcuOutpPrcsg/CAN Signals/SPN 190 - Engine Speed" /begin REF_CHARACTERISTIC EOP_CanEngSpdOvs_P EOP_CanEngSpdOvv_P /end REF_CHARACTERISTIC /begin REF_MEASUREMENT EOP_CanEngSpd /end REF_MEASUREMENT /end GROUP
/begin GROUP S302_SPN_247___Engine_Total_Hours_of_Operation "EcuIntgdSwGend/ControlSoftware/EcuOutpPrcsg/CAN Signals/SPN 247 - Engine Total Hours of Operation" /begin REF_CHARACTERISTIC EOP_CanEngHrOvs_P EOP_CanEngHrOvv_P /end REF_CHARACTERISTIC /begin REF_MEASUREMENT EOP_CanEngHr /end REF_MEASUREMENT /end GROUP
/begin GROUP S302_SPN_250___Engine_Total_Fuel_Used "EcuIntgdSwGend/ControlSoftware/EcuOutpPrcsg/CAN Signals/SPN 250 - Engine Total Fuel Used" /begin REF_CHARACTERISTIC EOP_CanEngTotFuQntyOvs_P EOP_CanEngTotFuQntyOvv_P /end REF_CHARACTERISTIC /begin REF_MEASUREMENT EOP_CanEngTotFuQnty /end REF_MEASUREMENT /end GROUP
/begin GROUP S302_SPN_2978___Estimated_Engine_Parasitic_Losses___Percent_Torque "EcuIntgdSwGend/ControlSoftware/EcuOutpPrcsg/CAN Signals/SPN 2978 - Estimated Engine Parasitic Losses - Percent Torque"
 /begin REF_CHARACTERISTIC EG_0xFB_C EOP_CanEngParasiticLossOvs_P EOP_CanEngParasiticLossOvv_P /end REF_CHARACTERISTIC
 /begin REF_MEASUREMENT EOP_CanEngParasiticLoss /end REF_MEASUREMENT
/end GROUP
/begin GROUP S302_SPN_3543___Engine_Operating_State "EcuIntgdSwGend/ControlSoftware/EcuOutpPrcsg/CAN Signals/SPN 3543 - Engine Operating State"
 /begin SUB_GROUP S334_Cool_Down S334_Engine_Running_Mode S334_Engine_Stopped___Ready S334_Not_Available S334_Post_Run S334_Pre_Start S334_Running S334_Starting S334_Stopping S334_Warm_Up /end SUB_GROUP
 /begin REF_CHARACTERISTIC EG_ModEngCtlPwrOn_C EG_ModEngCtlStp_C EG_ModEngCtlStrt_C EOP_CanEngStOvs_P EOP_CanEngStOvv_P /end REF_CHARACTERISTIC
 /begin REF_MEASUREMENT EOP_CanEngSt /end REF_MEASUREMENT
/end GROUP
/begin GROUP 0 "EcuIntgdSwGend/ControlSoftware/EcuOutpPrcsg/CAN Signals/SPN 512 - Driver's Demand Engine - Percent Torque" /begin REF_CHARACTERISTIC EOP_CanDrvrDmdPercTqOvs_P EOP_CanDrvrDmdPercTqOvv_P /end REF_CHARACTERISTIC /begin REF_MEASUREMENT EOP_CanDrvrDmdPercTq /end REF_MEASUREMENT /end GROUP
/begin GROUP S302_SPN_513___Actual_Engine___Percent_Torque "EcuIntgdSwGend/ControlSoftware/EcuOutpPrcsg/CAN Signals/SPN 513 - Actual Engine - Percent Torque" /begin REF_CHARACTERISTIC EOP_CanActEngPercTqOvs_P EOP_CanActEngPercTqOvv_P /end REF_CHARACTERISTIC /begin REF_MEASUREMENT EOP_CanActEngPercTq /end REF_MEASUREMENT /end GROUP
/begin GROUP S302_SPN_514___Nominal_Friction___Percent_Torque "EcuIntgdSwGend/ControlSoftware/EcuOutpPrcsg/CAN Signals/SPN 514 - Nominal Friction - Percent Torque" /begin REF_CHARACTERISTIC EOP_CanNomFricPercTqOvs_P EOP_CanNomFricPercTqOvv_P /end REF_CHARACTERISTIC /begin REF_MEASUREMENT EOP_CanNomFricPercTq /end REF_MEASUREMENT /end GROUP
/begin GROUP S302_SPN_528___Engine_Speed_At_Point_2 "EcuIntgdSwGend/ControlSoftware/EcuOutpPrcsg/CAN Signals/SPN 528 - Engine Speed At Point 2" /begin REF_CHARACTERISTIC EOP_CanEngSpdPoint2Ovs_P EOP_CanEngSpdPoint2Ovv_P /end REF_CHARACTERISTIC /begin REF_MEASUREMENT EOP_CanEngSpdPoint2 /end REF_MEASUREMENT /end GROUP
/begin GROUP S302_SPN_529___Engine_Speed_At_Point_3 "EcuIntgdSwGend/ControlSoftware/EcuOutpPrcsg/CAN Signals/SPN 529 - Engine Speed At Point 3" /begin REF_CHARACTERISTIC EOP_CanEngSpdPoint3Ovs_P EOP_CanEngSpdPoint3Ovv_P /end REF_CHARACTERISTIC /begin REF_MEASUREMENT EOP_CanEngSpdPoint3 /end REF_MEASUREMENT /end GROUP
/begin GROUP S302_SPN_530___Engine_Speed_At_Point_4 "EcuIntgdSwGend/ControlSoftware/EcuOutpPrcsg/CAN Signals/SPN 530 - Engine Speed At Point 4" /begin REF_CHARACTERISTIC EOP_CanEngSpdPoint4Ovs_P EOP_CanEngSpdPoint4Ovv_P /end REF_CHARACTERISTIC /begin REF_MEASUREMENT EOP_CanEngSpdPoint4 /end REF_MEASUREMENT /end GROUP
/begin GROUP S302_SPN_531___Engine_Speed_At_Point_5 "EcuIntgdSwGend/ControlSoftware/EcuOutpPrcsg/CAN Signals/SPN 531 - Engine Speed At Point 5" /begin REF_CHARACTERISTIC EOP_CanEngSpdPoint5Ovs_P EOP_CanEngSpdPoint5Ovv_P /end REF_CHARACTERISTIC /begin REF_MEASUREMENT EOP_CanEngSpdPoint5 /end REF_MEASUREMENT /end GROUP
/begin GROUP S302_SPN_532___Engine_Speed_At_High_Idle__Point_6 "EcuIntgdSwGend/ControlSoftware/EcuOutpPrcsg/CAN Signals/SPN 532 - Engine Speed At High Idle, Point 6" /begin REF_CHARACTERISTIC EOP_CanEngSpdPoint6Ovs_P EOP_CanEngSpdPoint6Ovv_P /end REF_CHARACTERISTIC /begin REF_MEASUREMENT EOP_CanEngSpdPoint6 /end REF_MEASUREMENT /end GROUP
/begin GROUP S302_SPN_533___Engine_Maximum_Momentary_Override_Speed__Point_7 "EcuIntgdSwGend/ControlSoftware/EcuOutpPrcsg/CAN Signals/SPN 533 - Engine Maximum Momentary Override Speed, Point 7" /begin REF_CHARACTERISTIC EOP_CanEngSpdPoint7Ovs_P EOP_CanEngSpdPoint7Ovv_P /end REF_CHARACTERISTIC /begin REF_MEASUREMENT EOP_CanEngSpdPoint7 /end REF_MEASUREMENT /end GROUP
/begin GROUP S302_SPN_539___Engine_Percent_Torque_At_Idle__Point_1 "EcuIntgdSwGend/ControlSoftware/EcuOutpPrcsg/CAN Signals/SPN 539 - Engine Percent Torque At Idle, Point 1" /begin REF_CHARACTERISTIC EOP_CanEngPercTqPoint1Ovs_P EOP_CanEngPercTqPoint1Ovv_P /end REF_CHARACTERISTIC /begin REF_MEASUREMENT EOP_CanEngPercTqPoint1 /end REF_MEASUREMENT /end GROUP
/begin GROUP S302_SPN_540___Engine_Percent_Torque_At_Point_2 "EcuIntgdSwGend/ControlSoftware/EcuOutpPrcsg/CAN Signals/SPN 540 - Engine Percent Torque At Point 2" /begin REF_CHARACTERISTIC EOP_CanEngPercTqPoint2Ovs_P EOP_CanEngPercTqPoint2Ovv_P /end REF_CHARACTERISTIC /begin REF_MEASUREMENT EOP_CanEngPercTqPoint2 /end REF_MEASUREMENT /end GROUP
/begin GROUP S302_SPN_541___Engine_Percent_Torque_At_Point_3 "EcuIntgdSwGend/ControlSoftware/EcuOutpPrcsg/CAN Signals/SPN 541 - Engine Percent Torque At Point 3" /begin REF_CHARACTERISTIC EOP_CanEngPercTqPoint3Ovs_P EOP_CanEngPercTqPoint3Ovv_P /end REF_CHARACTERISTIC /begin REF_MEASUREMENT EOP_CanEngPercTqPoint3 /end REF_MEASUREMENT /end GROUP
/begin GROUP S302_SPN_542___Engine_Percent_Torque_At_Point_4 "EcuIntgdSwGend/ControlSoftware/EcuOutpPrcsg/CAN Signals/SPN 542 - Engine Percent Torque At Point 4" /begin REF_CHARACTERISTIC EOP_CanEngPercTqPoint4Ovs_P EOP_CanEngPercTqPoint4Ovv_P /end REF_CHARACTERISTIC /begin REF_MEASUREMENT EOP_CanEngPercTqPoint4 /end REF_MEASUREMENT /end GROUP
/begin GROUP S302_SPN_543___Engine_Percent_Torque_At_Point_5 "EcuIntgdSwGend/ControlSoftware/EcuOutpPrcsg/CAN Signals/SPN 543 - Engine Percent Torque At Point 5" /begin REF_CHARACTERISTIC EOP_CanEngPercTqPoint5Ovs_P EOP_CanEngPercTqPoint5Ovv_P /end REF_CHARACTERISTIC /begin REF_MEASUREMENT EOP_CanEngPercTqPoint5 /end REF_MEASUREMENT /end GROUP
/begin GROUP S302_SPN_544___Engine_Reference_Torque "EcuIntgdSwGend/ControlSoftware/EcuOutpPrcsg/CAN Signals/SPN 544 - Engine Reference Torque" /begin REF_CHARACTERISTIC EOP_CanEngRefTqOvs_P EOP_CanEngRefTqOvv_P /end REF_CHARACTERISTIC /begin REF_MEASUREMENT EOP_CanEngRefTq /end REF_MEASUREMENT /end GROUP
/begin GROUP S302_SPN_558___Accelerator_Pedal_1_Low_Idle_Switch "EcuIntgdSwGend/ControlSoftware/EcuOutpPrcsg/CAN Signals/SPN 558 - Accelerator Pedal 1 Low Idle Switch"
 /begin REF_CHARACTERISTIC EG_AccrPedl1IdleAvl_C EG_AccrPedl1IdleErr_C EG_AccrPedl1Idle_C EG_AccrPedl1NotIdle_C EOP_AccrPedl1IdleCndThd_P EOP_CanAccrPedl1LoIdleSwtOvs_P EOP_CanAccrPedl1LoIdleSwtOvv_P EOP_HndBrkPrkgNotAvl_P /end REF_CHARACTERISTIC
 /begin REF_MEASUREMENT EOP_CanAccrPedl1LoIdleSwt /end REF_MEASUREMENT
/end GROUP
/begin GROUP S302_SPN_595___Cruise_Control_Active "EcuIntgdSwGend/ControlSoftware/EcuOutpPrcsg/CAN Signals/SPN 595 - Cruise Control Active" /begin REF_CHARACTERISTIC EOP_CanCrsCtrlActvOvs_P EOP_CanCrsCtrlActvOvv_P /end REF_CHARACTERISTIC /begin REF_MEASUREMENT EOP_CanCrsCtrlActv /end REF_MEASUREMENT /end GROUP
/begin GROUP S302_SPN_596___Cruise_Control_Enable_Switch "EcuIntgdSwGend/ControlSoftware/EcuOutpPrcsg/CAN Signals/SPN 596 - Cruise Control Enable Switch"
 /begin REF_CHARACTERISTIC EG_CrsCtrlDi_C EG_CrsCtrlEnaSwtErr_C EG_CrsCtrlEnaSwtNotAvl_C EG_CrsCtrlEna_C EOP_CanCrsCtrlEnaSwtOvs_P EOP_CanCrsCtrlEnaSwtOvv_P EOP_CrsCtrlEnaSwtNotAvl_P /end REF_CHARACTERISTIC
 /begin REF_MEASUREMENT EOP_CanCrsCtrlEnaSwt /end REF_MEASUREMENT
/end GROUP
/begin GROUP S302_SPN_597___Brake_Switch "EcuIntgdSwGend/ControlSoftware/EcuOutpPrcsg/CAN Signals/SPN 597 - Brake Switch"
 /begin REF_CHARACTERISTIC EG_BrkPdlDepressed_C EG_BrkPdlReld_C EG_BrkPedlErr_C EG_BrkPedlNotAvl_C EOP_BrkPedlNotAvl_P EOP_CanBrkSwtOvs_P EOP_CanBrkSwtOvv_P /end REF_CHARACTERISTIC
 /begin REF_MEASUREMENT EOP_CanBrkSwt /end REF_MEASUREMENT
/end GROUP
/begin GROUP S302_SPN_599___Cruise_Control_Set_Switch "EcuIntgdSwGend/ControlSoftware/EcuOutpPrcsg/CAN Signals/SPN 599 - Cruise Control Set Switch"
 /begin REF_CHARACTERISTIC EG_CrsCtrlSetSwtDi_C EG_CrsCtrlSetSwtEna_C EG_CrsCtrlSetSwtErr_C EG_CrsCtrlSetSwtNotAvl_C EOP_CanCrsCtrlSetSwtOvs_P EOP_CanCrsCtrlSetSwtOvv_P EOP_CrsCtrlSetSwtNotAvl_P /end REF_CHARACTERISTIC
 /begin REF_MEASUREMENT EOP_CanCrsCtrlSetSwt /end REF_MEASUREMENT
/end GROUP
/begin GROUP S302_SPN_600___Cruise_Control_Coast__Decelerate__Switch "EcuIntgdSwGend/ControlSoftware/EcuOutpPrcsg/CAN Signals/SPN 600 - Cruise Control Coast (Decelerate) Switch"
 /begin REF_CHARACTERISTIC EG_CrsCtrlDecSwtDi_C EG_CrsCtrlDecSwtEna_C EG_CrsCtrlDecSwtErr_C EG_CrsCtrlDecSwtNotAvl_C EOP_CanCrsCtrlDecSwtOvs_P EOP_CanCrsCtrlDecSwtOvv_P EOP_CrsCtrlDecSwtNotAvl_P /end REF_CHARACTERISTIC
 /begin REF_MEASUREMENT EOP_CanCrsCtrlDecSwt /end REF_MEASUREMENT
/end GROUP
/begin GROUP S302_SPN_601___Cruise_Control_Resume_Switch "EcuIntgdSwGend/ControlSoftware/EcuOutpPrcsg/CAN Signals/SPN 601 - Cruise Control Resume Switch"
 /begin REF_CHARACTERISTIC EG_CrsCtrlResSwtDi_C EG_CrsCtrlResSwtEna_C EG_CrsCtrlResSwtErr_C EG_CrsCtrlResSwtNotAvl_C EOP_CanCrsCtrlResSwtOvs_P EOP_CanCrsCtrlResSwtOvv_P EOP_CrsCtrlResSwtNotAvl_P /end REF_CHARACTERISTIC
 /begin REF_MEASUREMENT EOP_CanCrsCtrlResSwt /end REF_MEASUREMENT
/end GROUP
/begin GROUP S302_SPN_602___Cruise_Control_Accelerate_Switch "EcuIntgdSwGend/ControlSoftware/EcuOutpPrcsg/CAN Signals/SPN 602 - Cruise Control Accelerate Switch"
 /begin REF_CHARACTERISTIC EG_CrsCtrlIncSwtDi_C EG_CrsCtrlIncSwtEna_C EG_CrsCtrlIncSwtErr_C EG_CrsCtrlIncSwtNotAvl_C EOP_CanCrsCtrlIncSwtOvs_P EOP_CanCrsCtrlIncSwtOvv_P EOP_CrsCtrlIncSwtNotAvl_P /end REF_CHARACTERISTIC
 /begin REF_MEASUREMENT EOP_CanCrsCtrlIncSwt /end REF_MEASUREMENT
/end GROUP
/begin GROUP S302_SPN_623___Red_Stop_Lamp "EcuIntgdSwGend/ControlSoftware/EcuOutpPrcsg/CAN Signals/SPN 623 - Red Stop Lamp" /begin REF_CHARACTERISTIC EOP_CanRedStopLampOvs_P EOP_CanRedStopLampOvv_P /end REF_CHARACTERISTIC /begin REF_MEASUREMENT EOP_CanRedStopLamp /end REF_MEASUREMENT /end GROUP
/begin GROUP S302_SPN_624___Amber_Warning_Lamp "EcuIntgdSwGend/ControlSoftware/EcuOutpPrcsg/CAN Signals/SPN 624 - Amber Warning Lamp" /begin REF_CHARACTERISTIC EOP_CanAmberWarnLampOvs_P EOP_CanAmberWarnLampOvv_P /end REF_CHARACTERISTIC /begin REF_MEASUREMENT EOP_CanAmberWarnLamp /end REF_MEASUREMENT /end GROUP
/begin GROUP S302_SPN_70___Parking_Brake_Switch "EcuIntgdSwGend/ControlSoftware/EcuOutpPrcsg/CAN Signals/SPN 70 - Parking Brake Switch"
 /begin REF_CHARACTERISTIC EG_PrkgBrkErr_C EG_PrkgBrkNotAvl_C EG_PrkgBrkNotSet_C EG_PrkgBrkSet_C EOP_CanHndBrkPrkgOvs_P EOP_CanHndBrkPrkgOvv_P EOP_HndBrkPrkgNotAvl_P /end REF_CHARACTERISTIC
 /begin REF_MEASUREMENT EOP_CanHndBrkPrkg /end REF_MEASUREMENT
/end GROUP
/begin GROUP S302_SPN_84___Wheel_Based_Vehicle_Speed "EcuIntgdSwGend/ControlSoftware/EcuOutpPrcsg/CAN Signals/SPN 84 - Wheel-Based Vehicle Speed" /begin REF_CHARACTERISTIC EOP_CanWhlBasVehSpdOvs_P EOP_CanWhlBasVehSpdOvv_P /end REF_CHARACTERISTIC /begin REF_MEASUREMENT EOP_CanWhlBasVehSpd /end REF_MEASUREMENT /end GROUP
/begin GROUP S302_SPN_86___Cruise_Control_Set_Speed "EcuIntgdSwGend/ControlSoftware/EcuOutpPrcsg/CAN Signals/SPN 86 - Cruise Control Set Speed" /begin REF_CHARACTERISTIC EOP_CanCrsCtrlSetSpdOvs_P EOP_CanCrsCtrlSetSpdOvv_P /end REF_CHARACTERISTIC /begin REF_MEASUREMENT EOP_CanCrsCtrlSetSpd /end REF_MEASUREMENT /end GROUP
/begin GROUP S302_SPN_899___Engine_Torque_Mode "EcuIntgdSwGend/ControlSoftware/EcuOutpPrcsg/CAN Signals/SPN 899 - Engine Torque Mode"
 /begin SUB_GROUP S363_ABS_Control___Activated S363_ABS_control S363_ASR_Control___Activated S363_ASR_control S363_Accelerator_pedal__operator_selection S363_Cruise_Control S363_High_speed_governor S363_Low_idle_governor__no_request__default_mode_ S363_Not_Defined S363_Road_speed_governor S363_Torque_limiting S363_Transmission_control /end SUB_GROUP
 /begin REF_CHARACTERISTIC EG_CrsCtrlActvd_C EG_ModEngCtlIdleSpd_C EG_ModEngCtlTq_C EOP_CanEngTqModOvs_P EOP_CanEngTqModOvv_P /end REF_CHARACTERISTIC
 /begin REF_MEASUREMENT EOP_CanEngTqMod /end REF_MEASUREMENT
/end GROUP
/begin GROUP S302_SPN_91___Accelerator_Pedal_Position_1 "EcuIntgdSwGend/ControlSoftware/EcuOutpPrcsg/CAN Signals/SPN 91 - Accelerator Pedal Position 1" /begin REF_CHARACTERISTIC EOP_CanAccrPedlPosn1Ovs_P EOP_CanAccrPedlPosn1Ovv_P /end REF_CHARACTERISTIC /begin REF_MEASUREMENT EOP_CanAccrPedlPosn1 /end REF_MEASUREMENT /end GROUP
/begin GROUP S302_SPN_92___Engine_Percent_Load_At_Current_Speed "EcuIntgdSwGend/ControlSoftware/EcuOutpPrcsg/CAN Signals/SPN 92 - Engine Percent Load At Current Speed" /begin SUB_GROUP S365_avoidzerodivision_single /end SUB_GROUP
 /begin REF_CHARACTERISTIC EG_NmrSng100_C EOP_CanPercLoadAtCurrentSpdOvs_P EOP_CanPercLoadAtCurrentSpdOvv_P /end REF_CHARACTERISTIC
 /begin REF_MEASUREMENT EOP_CanPercLoadAtCurrentSpd /end REF_MEASUREMENT
/end GROUP
/begin GROUP S302_SPN_94___Engine_Fuel_Delivery_Pressure "EcuIntgdSwGend/ControlSoftware/EcuOutpPrcsg/CAN Signals/SPN 94 - Engine Fuel Delivery Pressure" /begin REF_CHARACTERISTIC EG_mBar2kPa_C EOP_CanPFuOvs_P EOP_CanPFuOvv_P /end REF_CHARACTERISTIC /begin REF_MEASUREMENT EOP_CanPFu /end REF_MEASUREMENT /end GROUP
/begin GROUP S302_SPN_97___Water_In_Fuel_Indicator "EcuIntgdSwGend/ControlSoftware/EcuOutpPrcsg/CAN Signals/SPN 97 - Water In Fuel Indicator" /begin REF_CHARACTERISTIC EOP_CanWtrInFuOvs_P EOP_CanWtrInFuOvv_P /end REF_CHARACTERISTIC /begin REF_MEASUREMENT EOP_CanWtrInFu /end REF_MEASUREMENT /end GROUP
/begin GROUP S302_SPN_976___PTO_Governor_State "EcuIntgdSwGend/ControlSoftware/EcuOutpPrcsg/CAN Signals/SPN 976 - PTO Governor State" /begin REF_CHARACTERISTIC EOP_CanPTOGovrStOvs_P EOP_CanPTOGovrStOvv_P /end REF_CHARACTERISTIC /begin REF_MEASUREMENT EOP_CanPTOGovrSt /end REF_MEASUREMENT /end GROUP
/begin GROUP S302_SPN_98___Engine_Oil_Level "EcuIntgdSwGend/ControlSoftware/EcuOutpPrcsg/CAN Signals/SPN 98 - Engine Oil Level" /begin REF_CHARACTERISTIC EOP_CanLvlOilOvs_P EOP_CanLvlOilOvv_P /end REF_CHARACTERISTIC /begin REF_MEASUREMENT EOP_CanLvlOil /end REF_MEASUREMENT /end GROUP
/begin GROUP S396_Can_Message_and_Hardware_Check "EcuIntgdSwGend/ControlSoftware/EngBrk/Engine Brake Control/Can Message and Hardware Check"
 /begin REF_CHARACTERISTIC EG_VldInpSt_C EG_bFlgTrue_C EngBrk_ActvCanOrDigInOvs_P EngBrk_EngBrkLvl1_C EngBrk_EngBrkLvl2_C /end REF_CHARACTERISTIC
 /begin REF_MEASUREMENT EngBrk_ActvEngBrkBtn1 EngBrk_ActvEngBrkBtn2 EngBrk_ActvEngBrkReq1Btn EngBrk_ActvEngBrkReq2Btn EngBrk_ErrEngBrkReq1Btn EngBrk_ErrEngBrkReq2Btn /end REF_MEASUREMENT
/end GROUP
/begin GROUP S396_Enable_Conditionals "EcuIntgdSwGend/ControlSoftware/EngBrk/Engine Brake Control/Enable Conditionals" /begin SUB_GROUP S398_Hysteresis_Switch /end SUB_GROUP
 /begin REF_CHARACTERISTIC EngBrk_NEngActvThd_P EngBrk_NEngDeacThd_P EngBrk_NEngEnaSwt_C EngBrk_PAirBoostMaxThd_P EngBrk_PercgAccrThd_P EngBrk_VehVMinThd_P /end REF_CHARACTERISTIC
 /begin REF_MEASUREMENT EngBrk_EnaEngBrk /end REF_MEASUREMENT
/end GROUP
/begin GROUP S396_Engine_Brake_Active "EcuIntgdSwGend/ControlSoftware/EngBrk/Engine Brake Control/Engine Brake Active"
 /begin REF_CHARACTERISTIC EngBrk_ActvEngBrkSoln1Ovs_P EngBrk_ActvEngBrkSoln1Ovv_P EngBrk_ActvEngBrkSoln2Ovs_P EngBrk_ActvEngBrkSoln2Ovv_P EngBrk_EngBrkBtn1NotActv_C EngBrk_EngBrkBtn2NotActv_C /end REF_CHARACTERISTIC
 /begin REF_MEASUREMENT EngBrk_ActvEngBrkCtrl EngBrk_ActvEngBrkSoln1 EngBrk_ActvEngBrkSoln2 /end REF_MEASUREMENT
/end GROUP
/begin GROUP S396_For_Calibration "EcuIntgdSwGend/ControlSoftware/EngBrk/Engine Brake Control/For Calibration"
 /begin REF_CHARACTERISTIC EG_VldInpSt_C EngBrk_ActvTrsmLockUpEngd_C EngBrk_BrkPedlActv_C EngBrk_BrkPedlEvln_P EngBrk_BrkPedlNotActv_C EngBrk_CanABSActv_C EngBrk_CanABSAcvEvln_P EngBrk_CanABSNotActv_C EngBrk_IdxGearNeut_C EngBrk_IdxGearNotNeut_C EngBrk_PtoNotActv_C EngBrk_TrsmCurrentGearEvln_P EngBrk_TrsmLockUpEngdEvln_P EngBrk_TrsmLockUpEngd_C /end REF_CHARACTERISTIC
 /begin REF_MEASUREMENT EngBrk_ActvBrkPedl EngBrk_ActvCanABS EngBrk_ActvTrsmLockUpEngd EngBrk_PtoNotActv EngBrk_TrsmCurrentGearNotNeut /end REF_MEASUREMENT
/end GROUP
/begin GROUP S409_Cylinder_Balancing_For_Cylinder_1 "EcuIntgdSwGend/ControlSoftware/InjCtl/Cylinder Balancing/Cylinder Balancing For Cylinder 1" /begin REF_MEASUREMENT IC_CorrnFacCyl1 /end REF_MEASUREMENT /end GROUP
/begin GROUP S409_Cylinder_Balancing_For_Cylinder_2 "EcuIntgdSwGend/ControlSoftware/InjCtl/Cylinder Balancing/Cylinder Balancing For Cylinder 2" /begin REF_MEASUREMENT IC_CorrnFacCyl2 /end REF_MEASUREMENT /end GROUP
/begin GROUP S409_Cylinder_Balancing_For_Cylinder_3 "EcuIntgdSwGend/ControlSoftware/InjCtl/Cylinder Balancing/Cylinder Balancing For Cylinder 3" /begin REF_MEASUREMENT IC_CorrnFacCyl3 /end REF_MEASUREMENT /end GROUP
/begin GROUP S409_Cylinder_Balancing_For_Cylinder_4 "EcuIntgdSwGend/ControlSoftware/InjCtl/Cylinder Balancing/Cylinder Balancing For Cylinder 4" /begin REF_MEASUREMENT IC_CorrnFacCyl4 /end REF_MEASUREMENT /end GROUP
/begin GROUP S409_Cylinder_Balancing_For_Cylinder_5 "EcuIntgdSwGend/ControlSoftware/InjCtl/Cylinder Balancing/Cylinder Balancing For Cylinder 5" /begin REF_MEASUREMENT IC_CorrnFacCyl5 /end REF_MEASUREMENT /end GROUP
/begin GROUP S409_Cylinder_Balancing_For_Cylinder_6 "EcuIntgdSwGend/ControlSoftware/InjCtl/Cylinder Balancing/Cylinder Balancing For Cylinder 6" /begin REF_MEASUREMENT IC_CorrnFacCyl6 /end REF_MEASUREMENT /end GROUP
/begin GROUP S409_Cylinder_Balancing_PID_Controllers_ "EcuIntgdSwGend/ControlSoftware/InjCtl/Cylinder Balancing/Cylinder Balancing PID Controllers "
 /begin SUB_GROUP S422_PID_Controller_for_Cylinder_1 S422_PID_Controller_for_Cylinder_2 S422_PID_Controller_for_Cylinder_3 S422_PID_Controller_for_Cylinder_4 S422_PID_Controller_for_Cylinder_5 S422_PID_Controller_for_Cylinder_6 /end SUB_GROUP
 /begin REF_CHARACTERISTIC IC_FacCyl1SatMax_P IC_FacCyl1SatMin_P IC_FacCyl2SatMax_P IC_FacCyl2SatMin_P IC_FacCyl3SatMax_P IC_FacCyl3SatMin_P IC_FacCyl4SatMax_P IC_FacCyl4SatMin_P IC_FacCyl5SatMax_P IC_FacCyl5SatMin_P IC_FacCyl6SatMax_P IC_FacCyl6SatMin_P IC_KdCoeffCyl1_P IC_KdCoeffCyl2_P IC_KdCoeffCyl3_P IC_KdCoeffCyl4_P IC_KdCoeffCyl5_P IC_KdCoeffCyl6_P IC_KdCyl1_P IC_KdCyl2_P IC_KdCyl3_P IC_KdCyl4_P IC_KdCyl5_P IC_KdCyl6_P IC_KiCyl1_P IC_KiCyl2_P IC_KiCyl3_P IC_KiCyl4_P IC_KiCyl5_P IC_KiCyl6_P IC_KpCyl1_P IC_KpCyl2_P IC_KpCyl3_P IC_KpCyl4_P IC_KpCyl5_P IC_KpCyl6_P /end REF_CHARACTERISTIC
/end GROUP
/begin GROUP S410_LowPassFilter "EcuIntgdSwGend/ControlSoftware/InjCtl/Fuel Consumption Calculation/LowPassFilter" /begin REF_CHARACTERISTIC EG_NmrSng0_C EG_bFlgTrue_C /end REF_CHARACTERISTIC /end GROUP
/begin GROUP S410_LowPassFilter1 "EcuIntgdSwGend/ControlSoftware/InjCtl/Fuel Consumption Calculation/LowPassFilter1" /begin REF_CHARACTERISTIC EG_NmrSng0_C EG_bFlgTrue_C /end REF_CHARACTERISTIC /end GROUP
/begin GROUP S410_LowPassFilter2 "EcuIntgdSwGend/ControlSoftware/InjCtl/Fuel Consumption Calculation/LowPassFilter2" /begin REF_CHARACTERISTIC EG_NmrSng0_C EG_bFlgTrue_C /end REF_CHARACTERISTIC /end GROUP
/begin GROUP S410_avoidzerodivision_single3 "EcuIntgdSwGend/ControlSoftware/InjCtl/Fuel Consumption Calculation/avoidzerodivision_single3" /begin REF_CHARACTERISTIC EG_NmrSng0_C EG_NmrSng1_C /end REF_CHARACTERISTIC /end GROUP
/begin GROUP S410_avoidzerodivision_single4 "EcuIntgdSwGend/ControlSoftware/InjCtl/Fuel Consumption Calculation/avoidzerodivision_single4" /begin REF_CHARACTERISTIC EG_NmrSng0_C EG_NmrSng1_C /end REF_CHARACTERISTIC /begin REF_MEASUREMENT IC_FuCnsLt /end REF_MEASUREMENT /end GROUP
/begin GROUP S410_avoidzerodivision_single5 "EcuIntgdSwGend/ControlSoftware/InjCtl/Fuel Consumption Calculation/avoidzerodivision_single5" /begin REF_CHARACTERISTIC EG_NmrSng0_C EG_NmrSng1_C /end REF_CHARACTERISTIC /end GROUP
/begin GROUP S412_Injector_1_Characteristic "EcuIntgdSwGend/ControlSoftware/InjCtl/Main Injector Characteristic Maps/Injector 1 Characteristic"
 /begin SUB_GROUP S447_Injector_1_Characteristic_Map_1 S447_Injector_1_Characteristic_Map_2 S447_Injector_1_Characteristic_Map_3 S447_Injector_1_Characteristic_Map_4 S447_Injector_1_Characteristic_Map_5 /end SUB_GROUP
/end GROUP
/begin GROUP S412_Injector_1_Characteristic_Calibration_ "EcuIntgdSwGend/ControlSoftware/InjCtl/Main Injector Characteristic Maps/Injector 1 Characteristic Calibration " /begin REF_CHARACTERISTIC IC_DurMaiLimd_M /end REF_CHARACTERISTIC /end GROUP
/begin GROUP S412_Injector_2_Characteristic "EcuIntgdSwGend/ControlSoftware/InjCtl/Main Injector Characteristic Maps/Injector 2 Characteristic"
 /begin SUB_GROUP S449_Injector_2_Characteristic_Map_1 S449_Injector_2_Characteristic_Map_2 S449_Injector_2_Characteristic_Map_3 S449_Injector_2_Characteristic_Map_4 S449_Injector_2_Characteristic_Map_5 /end SUB_GROUP
/end GROUP
/begin GROUP S412_Injector_2_Characteristic_Calibration_ "EcuIntgdSwGend/ControlSoftware/InjCtl/Main Injector Characteristic Maps/Injector 2 Characteristic Calibration " /begin REF_CHARACTERISTIC IC_DurMaiLimd_M /end REF_CHARACTERISTIC /end GROUP
/begin GROUP S412_Injector_3_Characteristic "EcuIntgdSwGend/ControlSoftware/InjCtl/Main Injector Characteristic Maps/Injector 3 Characteristic"
 /begin SUB_GROUP S451_Injector_3_Characteristic_Map_1 S451_Injector_3_Characteristic_Map_2 S451_Injector_3_Characteristic_Map_3 S451_Injector_3_Characteristic_Map_4 S451_Injector_3_Characteristic_Map_5 /end SUB_GROUP
/end GROUP
/begin GROUP S412_Injector_3_Characteristic_Calibration_ "EcuIntgdSwGend/ControlSoftware/InjCtl/Main Injector Characteristic Maps/Injector 3 Characteristic Calibration " /begin REF_CHARACTERISTIC IC_DurMaiLimd_M /end REF_CHARACTERISTIC /end GROUP
/begin GROUP S412_Injector_4_Characteristic "EcuIntgdSwGend/ControlSoftware/InjCtl/Main Injector Characteristic Maps/Injector 4 Characteristic"
 /begin SUB_GROUP S453_Injector_4_Characteristic_Map_1 S453_Injector_4_Characteristic_Map_2 S453_Injector_4_Characteristic_Map_3 S453_Injector_4_Characteristic_Map_4 S453_Injector_4_Characteristic_Map_5 /end SUB_GROUP
/end GROUP
/begin GROUP S412_Injector_4_Characteristic_Calibration_ "EcuIntgdSwGend/ControlSoftware/InjCtl/Main Injector Characteristic Maps/Injector 4 Characteristic Calibration " /begin REF_CHARACTERISTIC IC_DurMaiLimd_M /end REF_CHARACTERISTIC /end GROUP
/begin GROUP S412_Injector_5_Characteristic "EcuIntgdSwGend/ControlSoftware/InjCtl/Main Injector Characteristic Maps/Injector 5 Characteristic"
 /begin SUB_GROUP S455_Injector_5_Characteristic_Map_1 S455_Injector_5_Characteristic_Map_2 S455_Injector_5_Characteristic_Map_3 S455_Injector_5_Characteristic_Map_4 S455_Injector_5_Characteristic_Map_5 /end SUB_GROUP
/end GROUP
/begin GROUP S412_Injector_5_Characteristic_Calibration_ "EcuIntgdSwGend/ControlSoftware/InjCtl/Main Injector Characteristic Maps/Injector 5 Characteristic Calibration " /begin REF_CHARACTERISTIC IC_DurMaiLimd_M /end REF_CHARACTERISTIC /end GROUP
/begin GROUP S412_Injector_6_Characteristic "EcuIntgdSwGend/ControlSoftware/InjCtl/Main Injector Characteristic Maps/Injector 6 Characteristic"
 /begin SUB_GROUP S457_Injector_6_Characteristic_Map_1 S457_Injector_6_Characteristic_Map_2 S457_Injector_6_Characteristic_Map_3 S457_Injector_6_Characteristic_Map_4 S457_Injector_6_Characteristic_Map_5 /end SUB_GROUP
/end GROUP
/begin GROUP S412_Injector_6_Characteristic_Calibration "EcuIntgdSwGend/ControlSoftware/InjCtl/Main Injector Characteristic Maps/Injector 6 Characteristic Calibration" /begin REF_CHARACTERISTIC IC_DurMaiLimd_M /end REF_CHARACTERISTIC /end GROUP
/begin GROUP S413__Injector_1_Characteristic "EcuIntgdSwGend/ControlSoftware/InjCtl/Pilot Injector Characteristic Maps/ Injector 1 Characteristic"
 /begin SUB_GROUP S489_Injector_1_Characteristic_Map_1 S489_Injector_1_Characteristic_Map_2 S489_Injector_1_Characteristic_Map_3 S489_Injector_1_Characteristic_Map_4 S489_Injector_1_Characteristic_Map_5 /end SUB_GROUP
/end GROUP
/begin GROUP S413__Injector_1_Characteristic_Calibration "EcuIntgdSwGend/ControlSoftware/InjCtl/Pilot Injector Characteristic Maps/ Injector 1 Characteristic Calibration" /begin REF_CHARACTERISTIC IC_DurPltLimd_M /end REF_CHARACTERISTIC /end GROUP
/begin GROUP S413__Injector_2_Characteristic "EcuIntgdSwGend/ControlSoftware/InjCtl/Pilot Injector Characteristic Maps/ Injector 2 Characteristic"
 /begin SUB_GROUP S491_Injector_2_Characteristic_Map_1 S491_Injector_2_Characteristic_Map_2 S491_Injector_2_Characteristic_Map_3 S491_Injector_2_Characteristic_Map_4 S491_Injector_2_Characteristic_Map_5 /end SUB_GROUP
/end GROUP
/begin GROUP S413__Injector_2_Characteristic_Calibration "EcuIntgdSwGend/ControlSoftware/InjCtl/Pilot Injector Characteristic Maps/ Injector 2 Characteristic Calibration" /begin REF_CHARACTERISTIC IC_DurPltLimd_M /end REF_CHARACTERISTIC /end GROUP
/begin GROUP S413__Injector_3_Characteristic "EcuIntgdSwGend/ControlSoftware/InjCtl/Pilot Injector Characteristic Maps/ Injector 3 Characteristic"
 /begin SUB_GROUP S493_Injector_3_Characteristic_Map_1 S493_Injector_3_Characteristic_Map_2 S493_Injector_3_Characteristic_Map_3 S493_Injector_3_Characteristic_Map_4 S493_Injector_3_Characteristic_Map_5 /end SUB_GROUP
/end GROUP
/begin GROUP S413__Injector_3_Characteristic_Calibration "EcuIntgdSwGend/ControlSoftware/InjCtl/Pilot Injector Characteristic Maps/ Injector 3 Characteristic Calibration" /begin REF_CHARACTERISTIC IC_DurPltLimd_M /end REF_CHARACTERISTIC /end GROUP
/begin GROUP S413__Injector_4_Characteristic "EcuIntgdSwGend/ControlSoftware/InjCtl/Pilot Injector Characteristic Maps/ Injector 4 Characteristic"
 /begin SUB_GROUP S495_Injector_4_Characteristic_Map_1 S495_Injector_4_Characteristic_Map_2 S495_Injector_4_Characteristic_Map_3 S495_Injector_4_Characteristic_Map_4 S495_Injector_4_Characteristic_Map_5 /end SUB_GROUP
/end GROUP
/begin GROUP S413__Injector_4_Characteristic_Calibration "EcuIntgdSwGend/ControlSoftware/InjCtl/Pilot Injector Characteristic Maps/ Injector 4 Characteristic Calibration" /begin REF_CHARACTERISTIC IC_DurPltLimd_M /end REF_CHARACTERISTIC /end GROUP
/begin GROUP S413__Injector_5_Characteristic "EcuIntgdSwGend/ControlSoftware/InjCtl/Pilot Injector Characteristic Maps/ Injector 5 Characteristic"
 /begin SUB_GROUP S497_Injector_5_Characteristic_Map_1 S497_Injector_5_Characteristic_Map_2 S497_Injector_5_Characteristic_Map_3 S497_Injector_5_Characteristic_Map_4 S497_Injector_5_Characteristic_Map_5 /end SUB_GROUP
/end GROUP
/begin GROUP S413__Injector_5_Characteristic_Calibration "EcuIntgdSwGend/ControlSoftware/InjCtl/Pilot Injector Characteristic Maps/ Injector 5 Characteristic Calibration" /begin REF_CHARACTERISTIC IC_DurPltLimd_M /end REF_CHARACTERISTIC /end GROUP
/begin GROUP S413__Injector_6_Characteristic "EcuIntgdSwGend/ControlSoftware/InjCtl/Pilot Injector Characteristic Maps/ Injector 6 Characteristic"
 /begin SUB_GROUP S499_Injector_6_Characteristic_Map_1 S499_Injector_6_Characteristic_Map_2 S499_Injector_6_Characteristic_Map_3 S499_Injector_6_Characteristic_Map_4 S499_Injector_6_Characteristic_Map_5 /end SUB_GROUP
/end GROUP
/begin GROUP S413__Injector_6_Characteristic_Calibration "EcuIntgdSwGend/ControlSoftware/InjCtl/Pilot Injector Characteristic Maps/ Injector 6 Characteristic Calibration" /begin REF_CHARACTERISTIC IC_DurPltLimd_M /end REF_CHARACTERISTIC /end GROUP
/begin GROUP S413_Duration_Injection_1_Pre "EcuIntgdSwGend/ControlSoftware/InjCtl/Pilot Injector Characteristic Maps/Duration Injection 1 Pre" /begin REF_MEASUREMENT IC_DurPltInjCyl1 /end REF_MEASUREMENT /end GROUP
/begin GROUP S413_Duration_Injection_2_Pre "EcuIntgdSwGend/ControlSoftware/InjCtl/Pilot Injector Characteristic Maps/Duration Injection 2 Pre" /begin REF_MEASUREMENT IC_DurPltInjCyl2 /end REF_MEASUREMENT /end GROUP
/begin GROUP S413_Duration_Injection_3_Pre "EcuIntgdSwGend/ControlSoftware/InjCtl/Pilot Injector Characteristic Maps/Duration Injection 3 Pre" /begin REF_MEASUREMENT IC_DurPltInjCyl3 /end REF_MEASUREMENT /end GROUP
/begin GROUP S413_Duration_Injection_4_Pre "EcuIntgdSwGend/ControlSoftware/InjCtl/Pilot Injector Characteristic Maps/Duration Injection 4 Pre" /begin REF_MEASUREMENT IC_DurPltInjCyl4 /end REF_MEASUREMENT /end GROUP
/begin GROUP S413_Duration_Injection_5_Pre "EcuIntgdSwGend/ControlSoftware/InjCtl/Pilot Injector Characteristic Maps/Duration Injection 5 Pre" /begin REF_MEASUREMENT IC_DurPltInjCyl5 /end REF_MEASUREMENT /end GROUP
/begin GROUP S413_Duration_Injection_6_Pre "EcuIntgdSwGend/ControlSoftware/InjCtl/Pilot Injector Characteristic Maps/Duration Injection 6 Pre" /begin REF_MEASUREMENT IC_DurPltInjCyl6 /end REF_MEASUREMENT /end GROUP
/begin GROUP S415_Main_SOI_Reference_Calculation "EcuIntgdSwGend/ControlSoftware/InjCtl/Start of Injection Angle for Pilot and Main Injection/Main SOI Reference Calculation" /begin SUB_GROUP S537_N_Map_Interpolation_for_Main_Start_of_Injection /end SUB_GROUP
 /begin REF_CHARACTERISTIC IC_PAmbAirCorrForMainSOI_M IC_SoiMaiInjNotCorrdOvs_P IC_SoiMaiInjOvs_P IC_SoiMaiInjOvv_P IC_SoiMaiLimdHi_P IC_SoiMaiLimdLo_P IC_SoiMaiLimd_M IC_TAirBoostCorrForMainSOI_M IC_TAmbAirCorrForMainSOI_M IC_TCooltCorrForMainSOI_M IC_TOilCorrForMainSOI_M /end REF_CHARACTERISTIC
 /begin REF_MEASUREMENT IC_SoiMaiInj IC_SoiMainInjCorrPAmbAir IC_SoiMainInjCorrTAirBoost IC_SoiMainInjCorrTAmbAir IC_SoiMainInjCorrTCoolt IC_SoiMainInjCorrTOil /end REF_MEASUREMENT
/end GROUP
/begin GROUP S415_Pilot_SOI_Reference_Calculation "EcuIntgdSwGend/ControlSoftware/InjCtl/Start of Injection Angle for Pilot and Main Injection/Pilot SOI Reference Calculation" /begin SUB_GROUP S538_N_Map_Interpolation_for_Pre_Start_of_Injection_ /end SUB_GROUP
 /begin REF_CHARACTERISTIC IC_PAmbAirCorrForPilotSOI_M IC_SoiPltInjNotCorrdOvs_P IC_SoiPltInjOvs_P IC_SoiPltInjOvv_P IC_SoiPltLimdHi_P IC_SoiPltLimdLo_P IC_SoiPltLimd_M IC_TAirBoostCorrForPilotSOI_M IC_TAmbAirCorrForPilotSOI_M IC_TCooltCorrForPilotSOI_M IC_TOilCorrForPilotSOI_M /end REF_CHARACTERISTIC
 /begin REF_MEASUREMENT IC_SoiPltInj IC_SoiPltInjCorrPAmbAir IC_SoiPltInjCorrTAirBoost IC_SoiPltInjCorrTAmbAir IC_SoiPltInjCorrTCoolt IC_SoiPltInjCorrTOil /end REF_MEASUREMENT
/end GROUP
/begin GROUP S545_SetRstLtch "EcuIntgdSwGend/ControlSoftware/PrhtgCtl/Grid Heater Activation/SetRstLtch" /begin REF_CHARACTERISTIC EG_bFlgFalse_C EG_bFlgTrue_C /end REF_CHARACTERISTIC /begin REF_MEASUREMENT PHC_bGridHeatrFault /end REF_MEASUREMENT /end GROUP
/begin GROUP S546_CompRstTmr "EcuIntgdSwGend/ControlSoftware/PrhtgCtl/Grid Heater Activation After Starter/CompRstTmr" /begin REF_CHARACTERISTIC EG_NmrInt0_C /end REF_CHARACTERISTIC /begin REF_MEASUREMENT PHC_TiElpdPostAcvnGridDeb /end REF_MEASUREMENT /end GROUP
/begin GROUP S546_Neg_Edge "EcuIntgdSwGend/ControlSoftware/PrhtgCtl/Grid Heater Activation After Starter/Neg_Edge" /begin REF_CHARACTERISTIC EG_NmrSng0_C /end REF_CHARACTERISTIC /end GROUP
/begin GROUP S546_Pos_Edge "EcuIntgdSwGend/ControlSoftware/PrhtgCtl/Grid Heater Activation After Starter/Pos_Edge" /begin REF_CHARACTERISTIC EG_NmrSng0_C /end REF_CHARACTERISTIC /end GROUP
/begin GROUP S546_SetRstLtch "EcuIntgdSwGend/ControlSoftware/PrhtgCtl/Grid Heater Activation After Starter/SetRstLtch" /begin REF_CHARACTERISTIC EG_bFlgFalse_C EG_bFlgTrue_C /end REF_CHARACTERISTIC /end GROUP
/begin GROUP S547_CompRstTmr "EcuIntgdSwGend/ControlSoftware/PrhtgCtl/Grid Heater Activation Before Starter/CompRstTmr" /begin REF_CHARACTERISTIC EG_NmrInt0_C /end REF_CHARACTERISTIC /begin REF_MEASUREMENT PHC_TiElpdPreAcvnGridDeb /end REF_MEASUREMENT /end GROUP
/begin GROUP S547_Neg_Edge1 "EcuIntgdSwGend/ControlSoftware/PrhtgCtl/Grid Heater Activation Before Starter/Neg_Edge1" /begin REF_CHARACTERISTIC EG_NmrSng0_C /end REF_CHARACTERISTIC /end GROUP
/begin GROUP S547_Neg_Edge2 "EcuIntgdSwGend/ControlSoftware/PrhtgCtl/Grid Heater Activation Before Starter/Neg_Edge2" /begin REF_CHARACTERISTIC EG_NmrSng0_C /end REF_CHARACTERISTIC /end GROUP
/begin GROUP S547_Pos_Edge "EcuIntgdSwGend/ControlSoftware/PrhtgCtl/Grid Heater Activation Before Starter/Pos_Edge" /begin REF_CHARACTERISTIC EG_NmrSng0_C /end REF_CHARACTERISTIC /end GROUP
/begin GROUP S547_SetRstLtch "EcuIntgdSwGend/ControlSoftware/PrhtgCtl/Grid Heater Activation Before Starter/SetRstLtch" /begin REF_CHARACTERISTIC EG_bFlgFalse_C EG_bFlgTrue_C /end REF_CHARACTERISTIC /end GROUP
/begin GROUP S548_Debouncer "EcuIntgdSwGend/ControlSoftware/PrhtgCtl/Grid Heater Fault/Debouncer" /begin REF_MEASUREMENT PHC_TiElpdOnStsErrGridHeatrDeb /end REF_MEASUREMENT /end GROUP
/begin GROUP S548_Debouncer1 "EcuIntgdSwGend/ControlSoftware/PrhtgCtl/Grid Heater Fault/Debouncer1" /begin REF_MEASUREMENT PHC_TiElpdOffStsErrGridHeatrDeb /end REF_MEASUREMENT /end GROUP
/begin GROUP S548_SetRstLtch1 "EcuIntgdSwGend/ControlSoftware/PrhtgCtl/Grid Heater Fault/SetRstLtch1" /begin REF_CHARACTERISTIC EG_bFlgFalse_C EG_bFlgTrue_C /end REF_CHARACTERISTIC /begin REF_MEASUREMENT PHC_bErrAcvGridHeatrOnSts /end REF_MEASUREMENT /end GROUP
/begin GROUP S548_SetRstLtch2 "EcuIntgdSwGend/ControlSoftware/PrhtgCtl/Grid Heater Fault/SetRstLtch2" /begin REF_CHARACTERISTIC EG_bFlgFalse_C EG_bFlgTrue_C /end REF_CHARACTERISTIC /begin REF_MEASUREMENT PHC_bErrAcvGridHeatrOffSts /end REF_MEASUREMENT /end GROUP
/begin GROUP S563_Pos_Edge "EcuIntgdSwGend/ControlSoftware/PtoCtrl/Cabin PTO/Pos_Edge" /begin REF_CHARACTERISTIC EG_NmrSng0_C /end REF_CHARACTERISTIC /end GROUP
/begin GROUP S566_PID_Controller "EcuIntgdSwGend/ControlSoftware/PtoCtrl/PTO PID/PID_Controller" /begin SUB_GROUP S573_clamping_unit /end SUB_GROUP /begin REF_CHARACTERISTIC EG_NmrSng0_C /end REF_CHARACTERISTIC
 /begin REF_MEASUREMENT PtoCtrl_CoeffKdFbOut PtoCtrl_CoeffKdOut PtoCtrl_CoeffKiClampOut PtoCtrl_CoeffKiClampPreSatOut PtoCtrl_CoeffKpOut PtoCtrl_PIDOut /end REF_MEASUREMENT
/end GROUP
/begin GROUP S568_Pos_Edge1 "EcuIntgdSwGend/ControlSoftware/PtoCtrl/Remote PTO/Pos_Edge1" /begin REF_CHARACTERISTIC EG_NmrSng0_C /end REF_CHARACTERISTIC /end GROUP
/begin GROUP S568_Pos_Edge3 "EcuIntgdSwGend/ControlSoftware/PtoCtrl/Remote PTO/Pos_Edge3" /begin REF_CHARACTERISTIC EG_NmrSng0_C /end REF_CHARACTERISTIC /end GROUP
/begin GROUP S582_avoidzerodivision_single "EcuIntgdSwGend/ControlSoftware/RailPGovr/Rail Pressure Control FeedForward Map /avoidzerodivision_single" /begin REF_CHARACTERISTIC EG_NmrSng0_C EG_NmrSng1_C /end REF_CHARACTERISTIC /end GROUP
/begin GROUP S582_avoidzerodivision_single1 "EcuIntgdSwGend/ControlSoftware/RailPGovr/Rail Pressure Control FeedForward Map /avoidzerodivision_single1" /begin REF_CHARACTERISTIC EG_NmrSng0_C EG_NmrSng1_C /end REF_CHARACTERISTIC /end GROUP
/begin GROUP S583_VCV_Opening_Percentage_PID_Controller "EcuIntgdSwGend/ControlSoftware/RailPGovr/Rail Pressure PID Controller/VCV Opening Percentage PID Controller" /begin SUB_GROUP S588_Integrator_Reset S588_clamping_unit /end SUB_GROUP /begin REF_CHARACTERISTIC EG_NmrSng0_C /end REF_CHARACTERISTIC
 /begin REF_MEASUREMENT RPG_CoeffKdFbOut RPG_CoeffKdOut RPG_CoeffKiClampOut RPG_CoeffKiClampPreSatOut RPG_CoeffKiClampSwtchOut RPG_CoeffKiOut RPG_CoeffKpOut RPG_PercgVolCtrlVlv /end REF_MEASUREMENT
/end GROUP
/begin GROUP S584_Debouncer "EcuIntgdSwGend/ControlSoftware/RailPGovr/Rail Pressure Reference Calculation/Debouncer" /begin REF_MEASUREMENT RPG_TiElpdCompNEngThdAcvnPRail RPG_bCompNEngThdAcvnPRail /end REF_MEASUREMENT /end GROUP
/begin GROUP S584_N_Map_Interpolation_for_Rail_Pressure_Reference "EcuIntgdSwGend/ControlSoftware/RailPGovr/Rail Pressure Reference Calculation/N-Map Interpolation for Rail Pressure Reference"
 /begin SUB_GROUP S594_avoidzerodivision_single S594_avoidzerodivision_single1 /end SUB_GROUP
 /begin REF_CHARACTERISTIC RPG_PRailSetPoint1_M RPG_PRailSetPoint2_M RPG_PRailSetPoint3_M RPG_PRailSetPointOvs_P RPG_PRailSetPointOvv_P RPG_TCooltMap1Thd_P RPG_TCooltMap2Thd_P RPG_TCooltMap3Thd_P /end REF_CHARACTERISTIC
 /begin REF_MEASUREMENT RPG_PRailSetPoint RPG_PRailSetPoint1to2Intp RPG_PRailSetPoint2to3Intp RPG_PRailSetPointFromMap1 RPG_PRailSetPointFromMap2 RPG_PRailSetPointFromMap3 /end REF_MEASUREMENT
/end GROUP
/begin GROUP S599_Debouncer "EcuIntgdSwGend/ControlSoftware/SpdLimr/Engine Brake Activation Via Speed Limiter/Debouncer" /begin REF_MEASUREMENT SpdLimr_TiElpdEngBrkLvl1Actvn /end REF_MEASUREMENT /end GROUP
/begin GROUP S599_Debouncer1 "EcuIntgdSwGend/ControlSoftware/SpdLimr/Engine Brake Activation Via Speed Limiter/Debouncer1" /begin REF_MEASUREMENT SpdLimr_TiElpdEngBrkLvl2Actvn /end REF_MEASUREMENT /end GROUP
/begin GROUP S599_SetRstLtch1 "EcuIntgdSwGend/ControlSoftware/SpdLimr/Engine Brake Activation Via Speed Limiter/SetRstLtch1" /begin REF_CHARACTERISTIC EG_bFlgFalse_C EG_bFlgTrue_C /end REF_CHARACTERISTIC /begin REF_MEASUREMENT SpdLimr_EngBrkLvl1Ena /end REF_MEASUREMENT /end GROUP
/begin GROUP S599_SetRstLtch2 "EcuIntgdSwGend/ControlSoftware/SpdLimr/Engine Brake Activation Via Speed Limiter/SetRstLtch2" /begin REF_CHARACTERISTIC EG_bFlgFalse_C EG_bFlgTrue_C /end REF_CHARACTERISTIC /begin REF_MEASUREMENT SpdLimr_EngBrkLvl2Ena /end REF_MEASUREMENT /end GROUP
/begin GROUP S600_Pos_Edge "EcuIntgdSwGend/ControlSoftware/SpdLimr/Speed Limiter/Pos_Edge" /begin REF_CHARACTERISTIC EG_NmrSng0_C /end REF_CHARACTERISTIC /end GROUP
/begin GROUP S601_SpeedLimiterPIDController "EcuIntgdSwGend/ControlSoftware/SpdLimr/Speed Limiter PID/SpeedLimiterPIDController" /begin SUB_GROUP S609_PID_Controller /end SUB_GROUP
 /begin REF_CHARACTERISTIC EG_NmrSng1_C EG_VldInpSt_C SpdLimr_CoeffDForVehVCtrl_M SpdLimr_CoeffFiltForVehVCtrl_M SpdLimr_CoeffIForVehVCtrl_M SpdLimr_CoeffPForVehVCtrl_M SpdLimr_IntglRstErrVehThd_P SpdLimr_PIDCoeffDOvs_P SpdLimr_PIDCoeffDOvv_P SpdLimr_PIDCoeffFiltOvs_P SpdLimr_PIDCoeffFiltOvv_P SpdLimr_PIDCoeffIOvs_P SpdLimr_PIDCoeffIOvv_P SpdLimr_PIDCoeffPOvs_P SpdLimr_PIDCoeffPOvv_P SpdLimr_PIDMax_M SpdLimr_PIDMin_P SpdLimr_TrfCaseStsFac_M SpdLimr_TrsmTqCnvrRatFac_M /end REF_CHARACTERISTIC
 /begin REF_MEASUREMENT SpdLimr_CoeffDForVehVCtrl SpdLimr_CoeffFiltForVehVCtrl SpdLimr_CoeffIForVehVCtrl SpdLimr_CoeffPForVehVCtrl SpdLimr_ErrCanTrsmTqCnvrRat SpdLimr_ErrCanTrtCaseSts SpdLimr_PIDMax SpdLimr_TrfCaseStsFac SpdLimr_TrsmTqCnvrRatFac /end REF_MEASUREMENT
/end GROUP
/begin GROUP S613_Debouncer "EcuIntgdSwGend/ControlSoftware/StrtrCtl/Enabling & Disabling Starter/Debouncer" /begin REF_MEASUREMENT SC_TiElpdNEngStrtrInhThd SC_bNEngStrtrInhThd /end REF_MEASUREMENT /end GROUP
/begin GROUP S613_Debouncer1 "EcuIntgdSwGend/ControlSoftware/StrtrCtl/Enabling & Disabling Starter/Debouncer1" /begin REF_MEASUREMENT SC_TiElpdNEngRunDeacThd SC_bNEngRunDeacThd /end REF_MEASUREMENT /end GROUP
/begin GROUP S613_Debouncer2 "EcuIntgdSwGend/ControlSoftware/StrtrCtl/Enabling & Disabling Starter/Debouncer2" /begin REF_MEASUREMENT SC_EngRunngActvnforEngAlrdyRunng SC_TiElpdEngAlrdyRunngThd /end REF_MEASUREMENT /end GROUP
/begin GROUP S613_SetRstLtch "EcuIntgdSwGend/ControlSoftware/StrtrCtl/Enabling & Disabling Starter/SetRstLtch" /begin REF_CHARACTERISTIC EG_bFlgFalse_C EG_bFlgTrue_C /end REF_CHARACTERISTIC /begin REF_MEASUREMENT SC_bAcvEngRunng /end REF_MEASUREMENT /end GROUP
/begin GROUP S614_CompRstTmr "EcuIntgdSwGend/ControlSoftware/StrtrCtl/Maximum Allowable Cranking Time Calculation/CompRstTmr" /begin REF_CHARACTERISTIC EG_NmrInt0_C /end REF_CHARACTERISTIC /begin REF_MEASUREMENT SC_TiElpdEnaAcvnStrtr /end REF_MEASUREMENT /end GROUP
/begin GROUP S614_Neg_Edge "EcuIntgdSwGend/ControlSoftware/StrtrCtl/Maximum Allowable Cranking Time Calculation/Neg_Edge" /begin REF_CHARACTERISTIC EG_NmrSng0_C /end REF_CHARACTERISTIC /end GROUP
/begin GROUP S615_Engine_Not_Turn "EcuIntgdSwGend/ControlSoftware/StrtrCtl/Start Error Detect Algorithms /Engine Not Turn" /begin SUB_GROUP S624_CompRstTmr S624_Pos_Edge2 S624_SetRstLtch1 /end SUB_GROUP
 /begin REF_CHARACTERISTIC EG_NmrSng0_C EG_TsSw_C SC_NEngThdForStrtTurn_P SC_TiEngNotTurnTiEna_P SC_bEngNotTurnOvs_P SC_bEngNotTurnOvv_P /end REF_CHARACTERISTIC
 /begin REF_MEASUREMENT SC_bEngNotTurn SC_bEngNotTurnTiEna /end REF_MEASUREMENT
/end GROUP
/begin GROUP S615_Engine_Over_Heating_Protection "EcuIntgdSwGend/ControlSoftware/StrtrCtl/Start Error Detect Algorithms /Engine Over Heating Protection" /begin SUB_GROUP S625_CompRstTmr1 S625_Neg_Edge S625_SetRstLtch /end SUB_GROUP
 /begin REF_CHARACTERISTIC EG_NmrSng0_C EG_TsSw_C SC_NEngThdForOvrHeatProtn_P SC_TiForEngProtn_P SC_bAcvStrtrOvrHeatProtnOvs_P SC_bAcvStrtrOvrHeatProtnOvv_P /end REF_CHARACTERISTIC
 /begin REF_MEASUREMENT SC_bAcvStrtOvrHeatProtn /end REF_MEASUREMENT
/end GROUP
/begin GROUP S616_Electrical_Failure_Dependent_Sensor_Inhibitor "EcuIntgdSwGend/ControlSoftware/StrtrCtl/StartInhibitor/Electrical Failure Dependent Sensor Inhibitor" /begin SUB_GROUP S632_Debouncer S632_Debouncer1 /end SUB_GROUP
 /begin REF_CHARACTERISTIC EG_NmrSng0_C EG_TsSw_C SC_TiAcvnErrPCVDeb_P SC_TiAcvnErrVCVDeb_P /end REF_CHARACTERISTIC
 /begin REF_MEASUREMENT SC_bInhErrElectFailPreTest /end REF_MEASUREMENT
/end GROUP
/begin GROUP S616_Sensor_Inhibitor "EcuIntgdSwGend/ControlSoftware/StrtrCtl/StartInhibitor/Sensor Inhibitor" /begin SUB_GROUP S633_Debouncer1 S633_Debouncer2 /end SUB_GROUP
 /begin REF_CHARACTERISTIC EG_NmrSng0_C EG_TsSw_C SC_LvlFuInhEnaSwt_P SC_LvlFuPreTestMin_P SC_LvlOilInhEnaSwt_P SC_LvlOilPreTestMin_P SC_TiAcvnLvlFuDeb_P SC_TiAcvnLvlOilDeb_P /end REF_CHARACTERISTIC
 /begin REF_MEASUREMENT SC_bInhEngStrtPreTest SC_bTiAcvnLvlFuDeb SC_bTiAcvnLvlOilDeb /end REF_MEASUREMENT
/end GROUP
/begin GROUP S617_Debouncer "EcuIntgdSwGend/ControlSoftware/StrtrCtl/Starter Locking/Debouncer" /begin REF_MEASUREMENT SC_TiElpdComplDebStrtLock SC_bComplDebNEngStrtLock /end REF_MEASUREMENT /end GROUP
/begin GROUP S617_Neg_Edge "EcuIntgdSwGend/ControlSoftware/StrtrCtl/Starter Locking/Neg_Edge" /begin REF_CHARACTERISTIC EG_NmrSng0_C /end REF_CHARACTERISTIC /end GROUP
/begin GROUP S617_SetRstLtch "EcuIntgdSwGend/ControlSoftware/StrtrCtl/Starter Locking/SetRstLtch" /begin REF_CHARACTERISTIC EG_bFlgFalse_C EG_bFlgTrue_C /end REF_CHARACTERISTIC /end GROUP
/begin GROUP S643_avoidzerodivision_single "EcuIntgdSwGend/ControlSoftware/TqCnvn/N-Map Interpolation for Main Quantity/avoidzerodivision_single" /begin REF_CHARACTERISTIC EG_NmrSng0_C EG_NmrSng1_C /end REF_CHARACTERISTIC /end GROUP
/begin GROUP S643_avoidzerodivision_single1 "EcuIntgdSwGend/ControlSoftware/TqCnvn/N-Map Interpolation for Main Quantity/avoidzerodivision_single1" /begin REF_CHARACTERISTIC EG_NmrSng0_C EG_NmrSng1_C /end REF_CHARACTERISTIC /end GROUP
/begin GROUP S644_avoidzerodivision_single "EcuIntgdSwGend/ControlSoftware/TqCnvn/N-Map Interpolation for Pre Quantity/avoidzerodivision_single" /begin REF_CHARACTERISTIC EG_NmrSng0_C EG_NmrSng1_C /end REF_CHARACTERISTIC /end GROUP
/begin GROUP S644_avoidzerodivision_single1 "EcuIntgdSwGend/ControlSoftware/TqCnvn/N-Map Interpolation for Pre Quantity/avoidzerodivision_single1" /begin REF_CHARACTERISTIC EG_NmrSng0_C EG_NmrSng1_C /end REF_CHARACTERISTIC /end GROUP
/begin GROUP S646_avoidzerodivision_single "EcuIntgdSwGend/ControlSoftware/TqCnvn/Smoke Limitation/avoidzerodivision_single" /begin REF_CHARACTERISTIC EG_NmrSng0_C EG_NmrSng1_C /end REF_CHARACTERISTIC /end GROUP
/begin GROUP S646_avoidzerodivision_single1 "EcuIntgdSwGend/ControlSoftware/TqCnvn/Smoke Limitation/avoidzerodivision_single1" /begin REF_CHARACTERISTIC EG_NmrSng0_C EG_NmrSng1_C /end REF_CHARACTERISTIC /end GROUP
/begin GROUP S646_avoidzerodivision_single2 "EcuIntgdSwGend/ControlSoftware/TqCnvn/Smoke Limitation/avoidzerodivision_single2" /begin REF_CHARACTERISTIC EG_NmrSng0_C EG_NmrSng1_C /end REF_CHARACTERISTIC /end GROUP
/begin GROUP S646_saturation "EcuIntgdSwGend/ControlSoftware/TqCnvn/Smoke Limitation/saturation" /begin REF_MEASUREMENT TrC_RatAirFuCalc /end REF_MEASUREMENT /end GROUP
/begin GROUP S655_Torque_Limitation_For_Fuel_Temperature "EcuIntgdSwGend/ControlSoftware/TqLim/Engine Protection/Torque Limitation For Fuel Temperature" /begin SUB_GROUP S662_Debouncer /end SUB_GROUP
 /begin REF_CHARACTERISTIC EG_NmrSng0_C EG_NmrSng100_C EG_TsSw_C TL_NEngAcvTqLimnForTFu_P TL_PercgTqLimnForTFu_M TL_TiTqLimnForTFuDeb_P /end REF_CHARACTERISTIC
 /begin REF_MEASUREMENT TL_PercgTqLimnForTFu TL_bEnaTmrNEngAcvForTFu /end REF_MEASUREMENT
/end GROUP
/begin GROUP S655_Torque_Limitation_for_Air_Temperature "EcuIntgdSwGend/ControlSoftware/TqLim/Engine Protection/Torque Limitation for Air Temperature" /begin SUB_GROUP S663_Debouncer /end SUB_GROUP
 /begin REF_CHARACTERISTIC EG_NmrSng0_C EG_NmrSng100_C EG_TsSw_C TL_NEngAcvTqLimnForTAir_P TL_PercgTqLimnForTAir_M TL_SnsrSwtForTAirLimn_P TL_TiTqLimnForTAirDeb_P /end REF_CHARACTERISTIC
 /begin REF_MEASUREMENT TL_PercgTqLimnForTAir TL_TAir TL_bEnaTmrNEngAcvForTAir TL_bErrTAirSnsr /end REF_MEASUREMENT
/end GROUP
/begin GROUP S655_Torque_Limitation_for_Ambient_Air_Pressure "EcuIntgdSwGend/ControlSoftware/TqLim/Engine Protection/Torque Limitation for Ambient Air Pressure" /begin SUB_GROUP S664_Debouncer /end SUB_GROUP
 /begin REF_CHARACTERISTIC EG_NmrSng0_C EG_NmrSng100_C EG_TsSw_C TL_NEngAcvTqLimnForPAirAmb_P TL_PercgTqLimnForPAmbAir_M TL_TiTqLimnForPAirAmbDeb_P /end REF_CHARACTERISTIC
 /begin REF_MEASUREMENT TL_PercgTqLimnForPAmbAir TL_bEnaTmrNEngAcvForPAirAmb /end REF_MEASUREMENT
/end GROUP
/begin GROUP S655_Torque_Limitation_for_Coolant_Temperature "EcuIntgdSwGend/ControlSoftware/TqLim/Engine Protection/Torque Limitation for Coolant Temperature" /begin SUB_GROUP S665_Debouncer /end SUB_GROUP
 /begin REF_CHARACTERISTIC EG_NmrSng0_C EG_NmrSng100_C EG_TsSw_C TL_NEngAcvTqLimnForTCoolt_P TL_PercgTqLimnForErrTCooltSnsr_P TL_PercgTqLimnForTCoolt_M TL_TiTqLimnForTCooltDeb_P /end REF_CHARACTERISTIC
 /begin REF_MEASUREMENT TL_PercgTqLimnForTCoolt TL_bEnaTmrNEngAcvForTCoolt /end REF_MEASUREMENT
/end GROUP
/begin GROUP S655_Torque_Limitation_for_Intake_Air_Pressure "EcuIntgdSwGend/ControlSoftware/TqLim/Engine Protection/Torque Limitation for Intake Air Pressure" /begin SUB_GROUP S666_Debouncer /end SUB_GROUP
 /begin REF_CHARACTERISTIC EG_NmrSng0_C EG_NmrSng100_C EG_TsSw_C TL_NEngAcvTqLimnForPAirBoost_P TL_PercgTqLimnForPBoostAir_M TL_TiTqLimnForPAirBoostDeb_P /end REF_CHARACTERISTIC
 /begin REF_MEASUREMENT TL_PercgTqLimnForPAirBoost TL_bEnaTmrNEngAcvForPAirBoost /end REF_MEASUREMENT
/end GROUP
/begin GROUP S655_Torque_Limitation_for_Oil_Temperature "EcuIntgdSwGend/ControlSoftware/TqLim/Engine Protection/Torque Limitation for Oil Temperature" /begin SUB_GROUP S667_Debouncer1 /end SUB_GROUP
 /begin REF_CHARACTERISTIC EG_NmrSng0_C EG_NmrSng100_C EG_TsSw_C TL_NEngAcvTqLimnForTOil_P TL_PercgTqLimnForErrTOilSnsr_P TL_PercgTqLimnForTOil_M TL_TiTqLimnForTOilDeb_P /end REF_CHARACTERISTIC
 /begin REF_MEASUREMENT TL_PercgTqLimnForTOil TL_bEnaTmrNEngAcvForTOil /end REF_MEASUREMENT
/end GROUP
/begin GROUP S655_Torque_Limitation_for_Surge_Protection "EcuIntgdSwGend/ControlSoftware/TqLim/Engine Protection/Torque Limitation for Surge Protection" /begin REF_CHARACTERISTIC EG_NmrSng100_C TL_SurgeLineTqLimd_M /end REF_CHARACTERISTIC /begin REF_MEASUREMENT TL_PercgTqLimnForSurge TL_TqLimnForSurge /end REF_MEASUREMENT /end GROUP
/begin GROUP S655_Torque_Limitation_for_Turbo_Charge_Speed "EcuIntgdSwGend/ControlSoftware/TqLim/Engine Protection/Torque Limitation for Turbo Charge Speed" /begin SUB_GROUP S669_Debouncer /end SUB_GROUP
 /begin REF_CHARACTERISTIC EG_NmrSng0_C EG_NmrSng100_C EG_TsSw_C TL_NEngAcvTqLimnForNExhTrbChrg_P TL_PercgTqLimnForNExhTrbChrg_M TL_TiTqLimnForNExhTrbChrgDeb_P /end REF_CHARACTERISTIC
 /begin REF_MEASUREMENT TL_PercgTqLimnForNExhTrbChrg TL_bEnaTmrNEngAcvForNExhTrbChrg /end REF_MEASUREMENT
/end GROUP
/begin GROUP S680_Global_Enable "EcuIntgdSwGend/ControlSoftware/WarnMong/Warning-Reduction-Shutdown Functions/Global Enable" /begin SUB_GROUP S681_Engine_Speed_Level_Check /end SUB_GROUP
 /begin REF_CHARACTERISTIC EG_Mask32Bit0_C EG_Mask32Bit128_C EG_Mask32Bit16_C EG_Mask32Bit1_C EG_Mask32Bit2_C EG_Mask32Bit32_C EG_Mask32Bit4_C EG_Mask32Bit64_C EG_Mask32Bit8_C WM_MaskGEOvs_P WM_MaskGEOvv_P /end REF_CHARACTERISTIC
 /begin REF_MEASUREMENT WM_MaskGE /end REF_MEASUREMENT
/end GROUP
/begin GROUP S680_Internal "EcuIntgdSwGend/ControlSoftware/WarnMong/Warning-Reduction-Shutdown Functions/Internal"
 /begin SUB_GROUP S682_Battery_Over_Voltage S682_Battery_Under_Voltage S682_Cylinder_Misfire /end SUB_GROUP
/end GROUP
/begin GROUP S680_Limp "EcuIntgdSwGend/ControlSoftware/WarnMong/Warning-Reduction-Shutdown Functions/Limp"
 /begin REF_CHARACTERISTIC WM_bErrLvlOilSnsrLimp_P WM_bErrPAirBoostSnsrLimp_P WM_bErrPAmbAirSnsrLimp_P WM_bErrPFuSnsrLimp_P WM_bErrPOilSnsrLimp_P WM_bErrTAirBoostSnsrLimp_P WM_bErrTAmbAirSnsrLimp_P WM_bErrTCooltSnsrLimp_P WM_bErrTEcuSnsrLimp_P WM_bErrTFuSnsrLimp_P WM_bErrTOilSnsrLimp_P WM_bErrUClmp30SnsrLimp_P WM_bErrWgLimp_P /end REF_CHARACTERISTIC
 /begin REF_MEASUREMENT WM_bAcvLimpRctn WM_bErrLvlOilSnsrLimp WM_bErrPAirBoostSnsrLimp WM_bErrPAmbAirSnsrLimp WM_bErrPFuSnsrLimp WM_bErrPOilSnsrLimp WM_bErrTAirBoostSnsrLimp WM_bErrTAmbAirSnsrLimp WM_bErrTCooltSnsrLimp WM_bErrTEcuLimp WM_bErrTFuSnsrLimp WM_bErrTOilSnsrLimp WM_bErrUClmp30SnsrLimp WM_bErrWgLimp /end REF_MEASUREMENT
/end GROUP
/begin GROUP S680_Pressure "EcuIntgdSwGend/ControlSoftware/WarnMong/Warning-Reduction-Shutdown Functions/Pressure"
 /begin SUB_GROUP S684_Air_Boost_Over_Pressure S684_Air_Boost_Under_Pressure S684_Ambient_Air_Over_Pressure S684_Ambient_Air_Under_Pressure S684_Fuel_Over_Pressure S684_Fuel_Under_Pressure S684_Oil_Over_Pressure S684_Oil_Under_Pressure S684_Rail_Over_Pressure S684_Rail_Under_Pressure /end SUB_GROUP
/end GROUP
/begin GROUP S680_Reaction "EcuIntgdSwGend/ControlSoftware/WarnMong/Warning-Reduction-Shutdown Functions/Reaction"
 /begin SUB_GROUP S685_Bit_Extract S685_Error_List S685_SetResetFaultReaction S685_SetResetFaultReaction24 S685_SetResetFaultReaction25 S685_SetResetFaultReaction26 S685_SetResetFaultReaction27 S685_Warning_Monitoring_Diagnostic_Info /end SUB_GROUP
 /begin REF_CHARACTERISTIC WM_MaskRTNForAcvLimp_P WM_MaskRTNForEmgcyShtdwnForOvspd_P WM_MaskRTNForErrCamCrankTotLoss_P WM_MaskRTNForErrInjrShtdwn_P WM_MaskRTNForPRailNotCtldMsg_P WM_MaskRctnForAcvLimp_P WM_MaskRctnForEmgcyShtdwnForOvspd_P WM_MaskRctnForErrCamCrankTotLoss_P WM_MaskRctnForErrInjrShtdwn_P WM_MaskRctnForPRailNotCtldMsg_P WM_MaskRctnOvs_P WM_MaskRctnOvv_P /end REF_CHARACTERISTIC
 /begin REF_MEASUREMENT WM_MaskRctn /end REF_MEASUREMENT
/end GROUP
/end MODULE
/end PROJECT
