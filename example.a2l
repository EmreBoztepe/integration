/* ASAP2 file: ECU_SW_NG_CYL428_TUNA.a2l */
/* Author : Sebnem Saliha Cakiroglu */
ASAP2_VERSION 1 6
/begin PROJECT ECEMTAG_CR8 ""
/begin MODULE DIM ""
/begin IF_DATA VISION /*
* Size cal par_start to checksum(not included)
* Application area : 0x800000-0xE00000
* CAL_SEG area : 0x40028000-0x40068000
*/
 /begin MEMORY_REGION CAL_SEG_RAM 0x40040000 0x13100 0x6 0 /end MEMORY_REGION
 /begin MEMORY_REGION APPL_FLASH 0x00800000 0x00200000 0x1 0 /end MEMORY_REGION
 /* PROTOCOL_HEADER_START */ /*XCP_Header_Start*/ DEVICE_SETTING "XcpEcuOverrideFlags=0x10" DEVICE_SETTING "XcpNumSegments=3" DEVICE_SETTING "SkipPingAfterSync=TRUE" DEVICE_SETTING "XcpDaqPollingMode=0" DEVICE_SETTING "XcpCanIfDaqPollingMode=0" DEVICE_SETTING "EcuByteOrder=1" DEVICE_SETTING "XcpSegment1Page1=0,3,3,3,0" DEVICE_SETTING "XcpCanIfProtocolVersion=0x0100" DEVICE_SETTING "XcpSegment1Config=Code01,0,1,0,0" DEVICE_SETTING "XcpSegment2NumPages=1" DEVICE_SETTING "XcpSegment2Config=Code02,0,1,0,0" DEVICE_SETTING "XcpCanIfProtocolOptionalCmds=12,0xf8,0xf7,0xf6,0xf5,0xf3,0xda,0xd9,0xd8,0xd7,0xd0,0xd1,0xd2" DEVICE_SETTING "XcpCanIfConfig=1000000,75,1,5,2,1" DEVICE_SETTING "XcpSegment3Page1=0,3,3,3,0" DEVICE_SETTING "GroupSeparator=#" DEVICE_SETTING "XcpCanIfDaqConfig=0,12,12,0,0,0,0,1,12,2" DEVICE_SETTING "XcpDaqConfig=0,12,12,0,0,0,0,1,12,2" DEVICE_SETTING "XcpDaqConfigOptionsNumEvents=12" DEVICE_SETTING "XcpCanIfDaqConfigOptionsTimestamp=1,2,7,0" DEVICE_SETTING "XcpCanIfProtocolTiming=2000,3000,800,800,3000,800,3000" DEVICE_SETTING "XcpSegment3NumPages=1" DEVICE_SETTING "XcpCanIfDaqConfigOptionsNumEvents=12" DEVICE_SETTING "XcpProtocolConfig=8,8,0,1" DEVICE_SETTING "XcpStoreSuppport=1" DEVICE_SETTING "XcpProtocolVersion=0x0100" DEVICE_SETTING "XcpProtocolTiming=2000,3000,800,800,3000,800,3000" DEVICE_SETTING "XcpProtocolSeedAndKey=SeedDLL.dll" DEVICE_SETTING "SyncDownloadRegionsOnly=TRUE" DEVICE_SETTING "XcpSegment2Page1=0,3,3,3,0" DEVICE_SETTING "XcpPagConfig=1,0" DEVICE_SETTING "XcpCanIfProtocolConfig=8,8,0,1" DEVICE_SETTING "XcpCanIfDaqConfigOptions=1,1,0" DEVICE_SETTING "XcpCanIfDaqConfigOptionsDaqList1=0,1,12,0,0,0,0" DEVICE_SETTING "XcpCanIfDaqConfigOptionsDaqList2=1,1,12,0,10,0,0" DEVICE_SETTING "XcpCanIfDaqConfigOptionsDaqList3=2,1,12,0,20,0,0" DEVICE_SETTING "XcpCanIfDaqConfigOptionsDaqList4=3,1,12,0,30,0,0" DEVICE_SETTING "XcpCanIfDaqConfigOptionsDaqList5=4,1,12,0,40,0,0" DEVICE_SETTING "XcpCanIfDaqConfigOptionsDaqList6=5,1,12,0,50,0,0" DEVICE_SETTING "XcpCanIfDaqConfigOptionsDaqList7=6,1,12,0,60,0,0" DEVICE_SETTING "XcpCanIfDaqConfigOptionsDaqList8=7,1,12,0,70,0,0" DEVICE_SETTING "XcpCanIfDaqConfigOptionsDaqList9=8,1,12,0,80,0,0" DEVICE_SETTING "XcpCanIfDaqConfigOptionsDaqList10=9,1,12,0,90,0,0" DEVICE_SETTING "XcpCanIfDaqConfigOptionsDaqList11=10,1,12,0,100,0,0" DEVICE_SETTING "XcpCanIfDaqConfigOptionsDaqList12=11,1,12,0,110,0,0" DEVICE_SETTING "XcpDaqConfigOptionsDaqList1=0,1,12,0,0,0,0" DEVICE_SETTING "XcpDaqConfigOptionsDaqList2=1,1,12,0,10,0,0" DEVICE_SETTING "XcpDaqConfigOptionsDaqList3=2,1,12,0,20,0,0" DEVICE_SETTING "XcpDaqConfigOptionsDaqList4=3,1,12,0,30,0,0" DEVICE_SETTING "XcpDaqConfigOptionsDaqList5=4,1,12,0,40,0,0" DEVICE_SETTING "XcpDaqConfigOptionsDaqList6=5,1,12,0,50,0,0" DEVICE_SETTING "XcpDaqConfigOptionsDaqList7=6,1,12,0,60,0,0" DEVICE_SETTING "XcpDaqConfigOptionsDaqList8=7,1,12,0,70,0,0" DEVICE_SETTING "XcpDaqConfigOptionsDaqList9=8,1,12,0,80,0,0" DEVICE_SETTING "XcpDaqConfigOptionsDaqList10=9,1,12,0,90,0,0" DEVICE_SETTING "XcpDaqConfigOptionsDaqList11=10,1,12,0,100,0,0" DEVICE_SETTING "XcpDaqConfigOptionsDaqList12=11,1,12,0,110,0,0" DEVICE_SETTING "XcpCanIfDaqConfigOptionsNumDaqLists=12" DEVICE_SETTING "XcpDaqConfigOptions=1,0,0" DEVICE_SETTING "XcpDaqConfigOptionsNumDaqLists=12" DEVICE_SETTING "XcpCanIfCanIds=0x0100,1,0x551,0x557,8" DEVICE_SETTING "XcpCanIfDaqConfigOptionsEvent1=10_ms_task,10 ms,0,1,1,1,7,0xFF" DEVICE_SETTING "XcpCanIfDaqConfigOptionsEvent2=10_ms_task,10 ms,1,1,1,1,7,0xFF" DEVICE_SETTING "XcpCanIfDaqConfigOptionsEvent3=10_ms_task,10 ms,2,1,1,1,7,0xFF" DEVICE_SETTING "XcpCanIfDaqConfigOptionsEvent4=10_ms_task,10 ms,3,1,1,1,7,0xFF" DEVICE_SETTING "XcpCanIfDaqConfigOptionsEvent5=10_ms_task,10 ms,4,1,1,1,7,0xFF" DEVICE_SETTING "XcpCanIfDaqConfigOptionsEvent6=10_ms_task,10 ms,5,1,1,1,7,0xFF" DEVICE_SETTING "XcpCanIfDaqConfigOptionsEvent7=10_ms_task,10 ms,6,1,1,1,7,0xFF" DEVICE_SETTING "XcpCanIfDaqConfigOptionsEvent8=10_ms_task,10 ms,7,1,1,1,7,0xFF" DEVICE_SETTING "XcpCanIfDaqConfigOptionsEvent9=10_ms_task,10 ms,8,1,1,1,7,0xFF" DEVICE_SETTING "XcpCanIfDaqConfigOptionsEvent10=10_ms_task,10 ms,9,1,1,1,7,0xFF" DEVICE_SETTING "XcpCanIfDaqConfigOptionsEvent11=10_ms_task,10 ms,10,1,1,1,7,0xFF" DEVICE_SETTING "XcpCanIfDaqConfigOptionsEvent12=10_ms_task,10 ms,11,1,1,1,7,0xFF" DEVICE_SETTING "XcpCanIfDaqEventDefaultEventList1=0" DEVICE_SETTING "XcpCanIfDaqEventDefaultEventList2=1" DEVICE_SETTING "XcpCanIfDaqEventDefaultEventList3=2" DEVICE_SETTING "XcpCanIfDaqEventDefaultEventList4=3" DEVICE_SETTING "XcpCanIfDaqEventDefaultEventList5=4" DEVICE_SETTING "XcpCanIfDaqEventDefaultEventList6=5" DEVICE_SETTING "XcpCanIfDaqEventDefaultEventList7=6" DEVICE_SETTING "XcpCanIfDaqEventDefaultEventList8=7" DEVICE_SETTING "XcpCanIfDaqEventDefaultEventList9=8" DEVICE_SETTING "XcpCanIfDaqEventDefaultEventList10=9" DEVICE_SETTING "XcpCanIfDaqEventDefaultEventList11=10" DEVICE_SETTING "XcpCanIfDaqEventDefaultEventList12=11" DEVICE_SETTING "XcpProtocolOptionalCmds=12,0xf8,0xf7,0xf6,0xf5,0xf3,0xda,0xd9,0xd8,0xd7,0xd0,0xd1,0xd2" DEVICE_SETTING "XcpDaqConfigOptionsTimestamp=1,2,7,0" DEVICE_SETTING "XcpCanIfProtocolSeedAndKey=SeedDLL.dll" DEVICE_SETTING "XcpPgmConfig=1,3,8" DEVICE_SETTING "XcpPgm=1,1,8,10,0,0" DEVICE_SETTING "StructureNameOption=1" DEVICE_SETTING "XcpPgmNumSector=3" DEVICE_SETTING "XcpPgmConfigSector1=APPL_FLASH,0,0x00080000,0xA0000,0,0,0" DEVICE_SETTING "XcpPgmConfigSector2=CAL_FLASH,1,0x00120000,0x20000,1,1,0" DEVICE_SETTING "XcpPgmConfigSector3=CAL_SEG,2,0x00120000,0x17D9C,2,2,0" /*XCP_Header_End*/ /* PROTOCOL_HEADER_END */ /end IF_DATA
/*
* MOD_COMMON keyword is used to specify general description data for the module
* which are then used as standard in this module
*/
/begin MOD_COMMON "Mod Common Comment Here" DEPOSIT ABSOLUTE BYTE_ORDER MSB_FIRST /end MOD_COMMON
/* MOD_PAR : management data to be specified for an device */
/begin MOD_PAR "MOD PAR Comment Goes Here" /end MOD_PAR
/* If not in main a2l, add compu method*/
/begin COMPU_METHOD Debug_CM "Scale 1" RAT_FUNC "%20.0" "us" COEFFS 0 1 0 0 0 1 /end COMPU_METHOD
/begin COMPU_METHOD LevelSensor_Scale100_CM "Scale 100" RAT_FUNC "%20.0" "%" COEFFS 0 1 0 0 0 100 /end COMPU_METHOD
/begin COMPU_METHOD mbar_CM "Scale 1" RAT_FUNC "%20.0" "mbar" COEFFS 0 1 0 0 0 1 /end COMPU_METHOD
/begin COMPU_METHOD Torque_CM "Scale 1" RAT_FUNC "%20.0" "Nm" COEFFS 0 1 0 0 0 1 /end COMPU_METHOD
/begin RECORD_LAYOUT FLOAT32_IEEE FNC_VALUES 1 FLOAT32_IEEE ROW_DIR DIRECT /end RECORD_LAYOUT
/begin RECORD_LAYOUT SWORD FNC_VALUES 1 SWORD ROW_DIR DIRECT /end RECORD_LAYOUT
/begin RECORD_LAYOUT UBYTE FNC_VALUES 1 UBYTE ROW_DIR DIRECT /end RECORD_LAYOUT
/begin RECORD_LAYOUT SBYTE FNC_VALUES 1 SBYTE ROW_DIR DIRECT /end RECORD_LAYOUT
/******************************* From MATLAB ***************************************/ /* MATLAB_SECTION_START_1 */
/begin RECORD_LAYOUT Scalar_BOOLEAN FNC_VALUES 1 UBYTE ROW_DIR DIRECT /end RECORD_LAYOUT
/begin RECORD_LAYOUT Scalar_FLOAT32_IEEE FNC_VALUES 1 FLOAT32_IEEE ROW_DIR DIRECT /end RECORD_LAYOUT
/begin RECORD_LAYOUT Lookup1D_FLOAT32_IEEE FNC_VALUES 1 FLOAT32_IEEE ROW_DIR DIRECT /end RECORD_LAYOUT
/begin RECORD_LAYOUT Lookup1D_X_FLOAT32_IEEE AXIS_PTS_X 1 FLOAT32_IEEE INDEX_INCR DIRECT /end RECORD_LAYOUT
/begin RECORD_LAYOUT Lookup2D_FLOAT32_IEEE FNC_VALUES 1 FLOAT32_IEEE ROW_DIR DIRECT /end RECORD_LAYOUT
/begin RECORD_LAYOUT Lookup2D_X_FLOAT32_IEEE AXIS_PTS_X 1 FLOAT32_IEEE INDEX_INCR DIRECT /end RECORD_LAYOUT
/begin CHARACTERISTIC DTqC_MaxTqAtCurrentEngSpd_M "Max Torque at Current Engine Speed Map" CURVE 0x40041C48 /* @ECU_Address@DTqC_MaxTqAtCurrentEngSpd_M@ */ Lookup1D_FLOAT32_IEEE 0 EcuIntgdSwGend_CM_single_N_m 0.0 10000.0
 /begin AXIS_DESCR COM_AXIS EIP_NEng EcuIntgdSwGend_CM_single_rpm 12 0.0 50000.0 AXIS_PTS_REF DTqC_MaxTqNEng_A /end AXIS_DESCR
/end CHARACTERISTIC
/begin AXIS_PTS DTqC_MaxTqNEng_A "Axis Values of Engine Speed for Max Torque Map" 0x40041C78 /* @ECU_Address@DTqC_MaxTqNEng_A@ */ EIP_NEng Lookup1D_X_FLOAT32_IEEE 0 EcuIntgdSwGend_CM_single_rpm 12 0.0 50000.0 /end AXIS_PTS
/begin CHARACTERISTIC DTqC_TqFric_M "Friction Torque Map" MAP 0x40043344 /* @ECU_Address@DTqC_TqFric_M@ */ Lookup2D_FLOAT32_IEEE 0 EcuIntgdSwGend_CM_single_N_m 0.0 10000.0
 /begin AXIS_DESCR COM_AXIS EIP_TOil EcuIntgdSwGend_CM_single_degC 20 -40.0 200.0 AXIS_PTS_REF DTqC_TOil_A /end AXIS_DESCR
 /begin AXIS_DESCR COM_AXIS EIP_NEng EcuIntgdSwGend_CM_single_rpm 20 0.0 6000.0 AXIS_PTS_REF DTqC_NEng_A /end AXIS_DESCR
/end CHARACTERISTIC
/begin AXIS_PTS DTqC_TOil_A "Axis Values of Oil Temperature for Start Control Torque Map" 0x40041FC4 /* @ECU_Address@DTqC_TOil_A@ */ EIP_TOil Lookup2D_X_FLOAT32_IEEE 0 EcuIntgdSwGend_CM_single_degC 20 -40.0 200.0 /end AXIS_PTS
/begin AXIS_PTS DTqC_NEng_A "Axis Values of Engine Speed for Break Torque Maps" 0x40041D78 /* @ECU_Address@DTqC_NEng_A@ */ EIP_NEng Lookup2D_X_FLOAT32_IEEE 0 EcuIntgdSwGend_CM_single_rpm 20 0.0 6000.0 /end AXIS_PTS
/begin CHARACTERISTIC DTqC_TqStrt_M "Start Control Torque Map" MAP 0x400439A8 /* @ECU_Address@DTqC_TqStrt_M@ */ Lookup2D_FLOAT32_IEEE 0 EcuIntgdSwGend_CM_single_N_m 0.0 10000.0
 /begin AXIS_DESCR COM_AXIS EIP_TOil EcuIntgdSwGend_CM_single_degC 20 -40.0 200.0 AXIS_PTS_REF DTqC_TOil_A /end AXIS_DESCR
 /begin AXIS_DESCR COM_AXIS EIP_NEng EcuIntgdSwGend_CM_single_rpm 20 0.0 6000.0 AXIS_PTS_REF DTqC_NEngForStrtCtl_A /end AXIS_DESCR
/end CHARACTERISTIC
/begin AXIS_PTS DTqC_NEngForStrtCtl_A "Axis Values of Temperature Oil for Start Control Torque Map" 0x40041CD0 /* @ECU_Address@DTqC_NEngForStrtCtl_A@ */ EIP_NEng Lookup2D_X_FLOAT32_IEEE 0 EcuIntgdSwGend_CM_single_rpm 20 0.0 6000.0 /end AXIS_PTS
/begin CHARACTERISTIC EIP_TCooltFromTOil_M "Coolant Temperature from Oil Temperature Map" CURVE 0x40044488 /* @ECU_Address@EIP_TCooltFromTOil_M@ */ Lookup1D_FLOAT32_IEEE 0 EcuIntgdSwGend_CM_single_degC -50.0 250.0
 /begin AXIS_DESCR COM_AXIS NO_INPUT_QUANTITY EcuIntgdSwGend_CM_single_degC 12 -50.0 250.0 AXIS_PTS_REF EIP_TOil_A /end AXIS_DESCR
/end CHARACTERISTIC
/begin AXIS_PTS EIP_TOil_A "Oil Temperature Map Axis" 0x40044568 /* @ECU_Address@EIP_TOil_A@ */ NO_INPUT_QUANTITY Lookup1D_X_FLOAT32_IEEE 0 EcuIntgdSwGend_CM_single_degC 12 -50.0 250.0 /end AXIS_PTS
/begin CHARACTERISTIC EIP_TOilFromTCoolt_M "Oil Temperature from Coolant Temperature Map" CURVE 0x40044528 /* @ECU_Address@EIP_TOilFromTCoolt_M@ */ Lookup1D_FLOAT32_IEEE 0 EcuIntgdSwGend_CM_single_degC -50.0 250.0
 /begin AXIS_DESCR COM_AXIS NO_INPUT_QUANTITY EcuIntgdSwGend_CM_single_degC 12 -50.0 250.0 AXIS_PTS_REF EIP_TCoolt_A /end AXIS_DESCR
/end CHARACTERISTIC
/begin AXIS_PTS EIP_TCoolt_A "Coolant Temperature Map Axis" 0x400444CC /* @ECU_Address@EIP_TCoolt_A@ */ NO_INPUT_QUANTITY Lookup1D_X_FLOAT32_IEEE 0 EcuIntgdSwGend_CM_single_degC 12 -50.0 250.0 /end AXIS_PTS
/begin CHARACTERISTIC EMS_NEngStrtToIdleThd_M "Start To Idle Mode Engine Speed Threshold Map" CURVE 0x400448E8 /* @ECU_Address@EMS_NEngStrtToIdleThd_M@ */ Lookup1D_FLOAT32_IEEE 0 EcuIntgdSwGend_CM_single_rpm 0.0 5000.0
 /begin AXIS_DESCR COM_AXIS EIP_TCoolt EcuIntgdSwGend_CM_single_degC 11 -40.0 200.0 AXIS_PTS_REF EMS_TCooltStrtToIdle_A /end AXIS_DESCR
/end CHARACTERISTIC
/begin AXIS_PTS EMS_TCooltStrtToIdle_A "Start To Idle Mode Coolant Temperature Axis for Engine Speed Threshold Map" 0x4004491C /* @ECU_Address@EMS_TCooltStrtToIdle_A@ */ EIP_TCoolt Lookup1D_X_FLOAT32_IEEE 0 EcuIntgdSwGend_CM_single_degC 11 -40.0 200.0 /end AXIS_PTS
/begin CHARACTERISTIC CrsCtrl_LongPsdTiThd_P "Long Pressed Timer Threshold Parameter" VALUE 0x40040594 /* @ECU_Address@CrsCtrl_LongPsdTiThd_P@ */ Scalar_FLOAT32_IEEE 0 EcuIntgdSwGend_CM_single_ms 0.0 10000.0 /end CHARACTERISTIC
/begin CHARACTERISTIC CrsCtrl_MaxTarSpd_P "Maximum Target Speed Parameter" VALUE 0x40040598 /* @ECU_Address@CrsCtrl_MaxTarSpd_P@ */ Scalar_FLOAT32_IEEE 0 EcuIntgdSwGend_CM_single_km_h 0.0 300.0 /end CHARACTERISTIC
/begin CHARACTERISTIC CrsCtrl_MinTarSpd_P "Minimum Target Speed Parameter" VALUE 0x4004059C /* @ECU_Address@CrsCtrl_MinTarSpd_P@ */ Scalar_FLOAT32_IEEE 0 EcuIntgdSwGend_CM_single_km_h 0.0 200.0 /end CHARACTERISTIC
/begin CHARACTERISTIC CrsCtrl_ShoPsdTiThd_P "Short Pressed Time Threshold Parameter" VALUE 0x4004066C /* @ECU_Address@CrsCtrl_ShoPsdTiThd_P@ */ Scalar_FLOAT32_IEEE 0 EcuIntgdSwGend_CM_single_ms 0.0 10000.0 /end CHARACTERISTIC
/begin CHARACTERISTIC CrsCtrl_TiCrsBtnThd_P "" VALUE 0x40040670 /* @ECU_Address@CrsCtrl_TiCrsBtnThd_P@ */ Scalar_FLOAT32_IEEE 0 EcuIntgdSwGend_CM_single_ms 0.0 10000.0 /end CHARACTERISTIC
/begin CHARACTERISTIC CrsCtrl_TqDmd_P "Cruise Control Torque Demand Parameter" VALUE 0x4004067C /* @ECU_Address@CrsCtrl_TqDmd_P@ */ Scalar_FLOAT32_IEEE 0 EcuIntgdSwGend_CM_single_N_m -10000.0 10000.0 /end CHARACTERISTIC
/begin CHARACTERISTIC CrsCtrl_VehVLongPsd_P "Vehicle Velocity Long Pressed Parameter" VALUE 0x40040700 /* @ECU_Address@CrsCtrl_VehVLongPsd_P@ */ Scalar_FLOAT32_IEEE 0 EcuIntgdSwGend_CM_single_km_h 0.0 200.0 /end CHARACTERISTIC
/begin CHARACTERISTIC CrsCtrl_VehVShoPsd_P "Vehicle Velocity Short Pressed Parameter" VALUE 0x40040704 /* @ECU_Address@CrsCtrl_VehVShoPsd_P@ */ Scalar_FLOAT32_IEEE 0 EcuIntgdSwGend_CM_single_km_h 0.0 200.0 /end CHARACTERISTIC
/begin CHARACTERISTIC DTqC_MaxNomEngSpd_P "Max Nominal Engine Speed" VALUE 0x40041C40 /* @ECU_Address@DTqC_MaxNomEngSpd_P@ */ Scalar_FLOAT32_IEEE 0 EcuIntgdSwGend_CM_single_rpm 0.0 50000.0 /end CHARACTERISTIC
/begin CHARACTERISTIC DTqC_MaxNomTq_P "Max Nominal Torque" VALUE 0x40041C44 /* @ECU_Address@DTqC_MaxNomTq_P@ */ Scalar_FLOAT32_IEEE 0 EcuIntgdSwGend_CM_single_N_m 0.0 10000.0 /end CHARACTERISTIC
/begin CHARACTERISTIC DTqC_NEngIdleRefMax_P "Reference Idle Engine Speed Min Parameter" VALUE 0x40041D58 /* @ECU_Address@DTqC_NEngIdleRefMax_P@ */ Scalar_FLOAT32_IEEE 0 EcuIntgdSwGend_CM_single 500.0 1600.0 /end CHARACTERISTIC
/begin CHARACTERISTIC DTqC_NEngIdleRefMin_P "Reference Idle Engine Speed Max Parameter" VALUE 0x40041D5C /* @ECU_Address@DTqC_NEngIdleRefMin_P@ */ Scalar_FLOAT32_IEEE 0 EcuIntgdSwGend_CM_single 500.0 1600.0 /end CHARACTERISTIC
/begin CHARACTERISTIC DTqC_NEngIdleRefOvv_P "Engine Idle Reference Signal - Override Value" VALUE 0x40041D64 /* @ECU_Address@DTqC_NEngIdleRefOvv_P@ */ Scalar_FLOAT32_IEEE 0 EcuIntgdSwGend_CM_single_rpm 0.0 6000.0 /end CHARACTERISTIC
/begin CHARACTERISTIC DTqC_NEngTrbChrgOilLeakgIdleRef_P "Idle Reference Value for Turbo Oil Leakage" VALUE 0x40041D74 /* @ECU_Address@DTqC_NEngTrbChrgOilLeakgIdleRef_P@ */ Scalar_FLOAT32_IEEE 0 EcuIntgdSwGend_CM_single_rpm 0.0 6000.0 /end CHARACTERISTIC
/begin CHARACTERISTIC DTqC_TqBrkStrtCtlOvv_P "Break Torque of Start Control - Override Value" VALUE 0x40043308 /* @ECU_Address@DTqC_TqBrkStrtCtlOvv_P@ */ Scalar_FLOAT32_IEEE 0 EcuIntgdSwGend_CM_single_N_m 0.0 10000.0 /end CHARACTERISTIC
/begin CHARACTERISTIC DTqC_TqFricOvv_P "Friction Torque Value - Override Value" VALUE 0x40043340 /* @ECU_Address@DTqC_TqFricOvv_P@ */ Scalar_FLOAT32_IEEE 0 EcuIntgdSwGend_CM_single_N_m 0.0 10000.0 /end CHARACTERISTIC
/begin CHARACTERISTIC DTqC_TqIndcdOvs_P "Indicated Torque Value - Override Switch" VALUE 0x40043984 /* @ECU_Address@DTqC_TqIndcdOvs_P@ */ Scalar_FLOAT32_IEEE 0 EcuIntgdSwGend_CM_single 0.0 1.0 /end CHARACTERISTIC
/begin CHARACTERISTIC DTqC_TqIndcdOvv_P "Indicated Torque Value - Override Value" VALUE 0x40043988 /* @ECU_Address@DTqC_TqIndcdOvv_P@ */ Scalar_FLOAT32_IEEE 0 EcuIntgdSwGend_CM_single_N_m 0.0 10000.0 /end CHARACTERISTIC
/begin CHARACTERISTIC DTqC_TqIndcdSatMin_P "Indicated Torque Saturation Min Parameter" VALUE 0x4004398C /* @ECU_Address@DTqC_TqIndcdSatMin_P@ */ Scalar_FLOAT32_IEEE 0 EcuIntgdSwGend_CM_single_N_m 0.0 10000.0 /end CHARACTERISTIC
/begin CHARACTERISTIC EIP_CamsftSpdOvv_P "Input Processing Camshaft Speed Override Value Parameter" VALUE 0x40043FF4 /* @ECU_Address@EIP_CamsftSpdOvv_P@ */ Scalar_FLOAT32_IEEE 0 EcuIntgdSwGend_CM_single_rpm 0.0 5000.0 /end CHARACTERISTIC
/begin CHARACTERISTIC EIP_CoeffFilRat_P "Derivative Filter Coefficient Ratio Parameter" VALUE 0x40044124 /* @ECU_Address@EIP_CoeffFilRat_P@ */ Scalar_FLOAT32_IEEE 0 EcuIntgdSwGend_CM_single 0.0 100.0 /end CHARACTERISTIC
/begin CHARACTERISTIC EIP_CrnksftSpdOvv_P "Input Processing Crankshaft Speed Override Value Parameter" VALUE 0x4004412C /* @ECU_Address@EIP_CrnksftSpdOvv_P@ */ Scalar_FLOAT32_IEEE 0 EcuIntgdSwGend_CM_single_rpm 0.0 5000.0 /end CHARACTERISTIC
/begin CHARACTERISTIC EIP_CrsAndPTOVehvActvdThd_P "Cruise Control and PTO Vehicle Speed Activated Threshold" VALUE 0x40044130 /* @ECU_Address@EIP_CrsAndPTOVehvActvdThd_P@ */ Scalar_FLOAT32_IEEE 0 EcuIntgdSwGend_CM_single_km_h 0.0 200.0 /end CHARACTERISTIC
/begin CHARACTERISTIC EIP_DstTrvldInKmOvv_P "Distance to Travelled in Kilometer Ovveride Value Parameter" VALUE 0x40044138 /* @ECU_Address@EIP_DstTrvldInKmOvv_P@ */ Scalar_FLOAT32_IEEE 0 EcuIntgdSwGend_CM_single_km 0.0 1.0E+6 /end CHARACTERISTIC
/begin CHARACTERISTIC EIP_DstTrvldMemOvv_P "Distance to Travelled Memory Override Value Parameter" VALUE 0x40044140 /* @ECU_Address@EIP_DstTrvldMemOvv_P@ */ Scalar_FLOAT32_IEEE 0 EcuIntgdSwGend_CM_single_km 0.0 1.0E+6 /end CHARACTERISTIC
/begin CHARACTERISTIC EIP_EngHrMemOvv_P "Engine Hour From Memory Override Value Parameter" VALUE 0x40044150 /* @ECU_Address@EIP_EngHrMemOvv_P@ */ Scalar_FLOAT32_IEEE 0 EcuIntgdSwGend_CM_single_h 0.0 1.0E+6 /end CHARACTERISTIC
/begin CHARACTERISTIC EIP_EngHrOvv_P "Engine Hour Override Value Parameter" VALUE 0x40044158 /* @ECU_Address@EIP_EngHrOvv_P@ */ Scalar_FLOAT32_IEEE 0 EcuIntgdSwGend_CM_single_h 0.0 1.0E+6 /end CHARACTERISTIC
/begin CHARACTERISTIC EIP_FuelCnsMemOvv_P "Fuel Consumption from Memory - Override Value" VALUE 0x40044190 /* @ECU_Address@EIP_FuelCnsMemOvv_P@ */ Scalar_FLOAT32_IEEE 0 EcuIntgdSwGend_CM_single_l_100km 0.0 10000.0 /end CHARACTERISTIC
/begin CHARACTERISTIC EIP_GrdtUClmp30_P "Battery Voltage Gradient Parameter" VALUE 0x400441C8 /* @ECU_Address@EIP_GrdtUClmp30_P@ */ Scalar_FLOAT32_IEEE 0 EcuIntgdSwGend_CM_single_V_sec -10000.0 20000.0 /end CHARACTERISTIC
/begin CHARACTERISTIC EIP_GridHeatrRlyFbOvv_P "Grid Heater Relay Feedback - Override Value Parameter" VALUE 0x400441D0 /* @ECU_Address@EIP_GridHeatrRlyFbOvv_P@ */ Scalar_FLOAT32_IEEE 0 EcuIntgdSwGend_CM_single_V 0.0 50.0 /end CHARACTERISTIC
/begin CHARACTERISTIC EIP_IgnSwtUThd_P "Ignition Switch Voltage Threshold Parameter" VALUE 0x400441DC /* @ECU_Address@EIP_IgnSwtUThd_P@ */ Scalar_FLOAT32_IEEE 0 EcuIntgdSwGend_CM_single_V 0.0 50.0 /end CHARACTERISTIC
/begin CHARACTERISTIC EIP_LvlOilDft_P "Default Oil Level" VALUE 0x400441E0 /* @ECU_Address@EIP_LvlOilDft_P@ */ Scalar_FLOAT32_IEEE 0 EcuIntgdSwGend_CM_single__ 0.0 100.0 /end CHARACTERISTIC
/begin CHARACTERISTIC EIP_LvlOilOvv_P "Oil Level - Override Value Parameter" VALUE 0x400441F0 /* @ECU_Address@EIP_LvlOilOvv_P@ */ Scalar_FLOAT32_IEEE 0 EcuIntgdSwGend_CM_single__ 0.0 200.0 /end CHARACTERISTIC
/begin CHARACTERISTIC EIP_NEngOvv_P "Engine Speed - Override Value Parameter" VALUE 0x4004424C /* @ECU_Address@EIP_NEngOvv_P@ */ Scalar_FLOAT32_IEEE 0 EcuIntgdSwGend_CM_single_rpm 0.0 4000.0 /end CHARACTERISTIC
/begin CHARACTERISTIC EIP_PAirBoostDft_P "Air Boost Pressure Default Parameter" VALUE 0x40044260 /* @ECU_Address@EIP_PAirBoostDft_P@ */ Scalar_FLOAT32_IEEE 0 EcuIntgdSwGend_CM_single_mbar 0.0 15000.0 /end CHARACTERISTIC
/begin CHARACTERISTIC EIP_PAirBoostOvv_P "Air Boost Pressure - Override Value Parameter" VALUE 0x40044270 /* @ECU_Address@EIP_PAirBoostOvv_P@ */ Scalar_FLOAT32_IEEE 0 EcuIntgdSwGend_CM_single_mbar 0.0 15000.0 /end CHARACTERISTIC
/begin CHARACTERISTIC EIP_PAmbAirDft_P "Ambient Air Pressure Default Parameter" VALUE 0x40044274 /* @ECU_Address@EIP_PAmbAirDft_P@ */ Scalar_FLOAT32_IEEE 0 EcuIntgdSwGend_CM_single_mbar 0.0 15000.0 /end CHARACTERISTIC
/begin CHARACTERISTIC EIP_PAmbAirOvv_P "Ambient Air Pressure - Override Value Parameter" VALUE 0x40044284 /* @ECU_Address@EIP_PAmbAirOvv_P@ */ Scalar_FLOAT32_IEEE 0 EcuIntgdSwGend_CM_single_mbar -1000.0 1600.0 /end CHARACTERISTIC
/begin CHARACTERISTIC EIP_PFuDft_P "Fuel Pressure Default Parameter" VALUE 0x40044288 /* @ECU_Address@EIP_PFuDft_P@ */ Scalar_FLOAT32_IEEE 0 EcuIntgdSwGend_CM_single_mbar 0.0 15000.0 /end CHARACTERISTIC
/begin CHARACTERISTIC EIP_PFuOvv_P "Fuel Pressure - Override Value Parameter" VALUE 0x40044298 /* @ECU_Address@EIP_PFuOvv_P@ */ Scalar_FLOAT32_IEEE 0 EcuIntgdSwGend_CM_single_mbar 0.0 15000.0 /end CHARACTERISTIC
/begin CHARACTERISTIC EIP_POilDft_P "Oil Pressure Default Parameter" VALUE 0x4004429C /* @ECU_Address@EIP_POilDft_P@ */ Scalar_FLOAT32_IEEE 0 EcuIntgdSwGend_CM_single_mbar 0.0 15000.0 /end CHARACTERISTIC
/begin CHARACTERISTIC EIP_POilOvv_P "Oil Pressure - Override Value Parameter" VALUE 0x400442AC /* @ECU_Address@EIP_POilOvv_P@ */ Scalar_FLOAT32_IEEE 0 EcuIntgdSwGend_CM_single_mbar 0.0 15000.0 /end CHARACTERISTIC
/begin CHARACTERISTIC EIP_PRailDft_P "Rail Pressure Default Parameter" VALUE 0x400442B0 /* @ECU_Address@EIP_PRailDft_P@ */ Scalar_FLOAT32_IEEE 0 EcuIntgdSwGend_CM_single_bar 0.0 15000.0 /end CHARACTERISTIC
/begin CHARACTERISTIC EIP_PRailOvv_P "Rail Pressure - Override Value Parameter" VALUE 0x400442C0 /* @ECU_Address@EIP_PRailOvv_P@ */ Scalar_FLOAT32_IEEE 0 EcuIntgdSwGend_CM_single_bar 0.0 15000.0 /end CHARACTERISTIC
/begin CHARACTERISTIC EIP_PercgAccr1Ovv_P "First Acelerator Pedal Percentage - Override Value Parameter" VALUE 0x400442D0 /* @ECU_Address@EIP_PercgAccr1Ovv_P@ */ Scalar_FLOAT32_IEEE 0 EcuIntgdSwGend_CM_single__ 0.0 100.0 /end CHARACTERISTIC
/begin CHARACTERISTIC EIP_PercgAccr2Ovv_P "Second Acelerator Pedal Percentage - Override Value Parameter" VALUE 0x400442E0 /* @ECU_Address@EIP_PercgAccr2Ovv_P@ */ Scalar_FLOAT32_IEEE 0 EcuIntgdSwGend_CM_single__ 0.0 100.0 /end CHARACTERISTIC
/begin CHARACTERISTIC EIP_PercgAccrLvl0Max_P "Acelerator Pedal Percentage Level 0 Max Parameter" VALUE 0x400442E8 /* @ECU_Address@EIP_PercgAccrLvl0Max_P@ */ Scalar_FLOAT32_IEEE 0 EcuIntgdSwGend_CM_single__ 0.0 100.0 /end CHARACTERISTIC
/begin CHARACTERISTIC EIP_PercgAccrLvl1Max_P "Acelerator Pedal Percentage Level 1 Max Parameter" VALUE 0x400442EC /* @ECU_Address@EIP_PercgAccrLvl1Max_P@ */ Scalar_FLOAT32_IEEE 0 EcuIntgdSwGend_CM_single__ 0.0 100.0 /end CHARACTERISTIC
/begin CHARACTERISTIC EIP_PercgAccrLvl2Max_P "Acelerator Pedal Percentage Level 2 Max Parameter" VALUE 0x400442F0 /* @ECU_Address@EIP_PercgAccrLvl2Max_P@ */ Scalar_FLOAT32_IEEE 0 EcuIntgdSwGend_CM_single__ 0.0 100.0 /end CHARACTERISTIC
/begin CHARACTERISTIC EIP_PercgAccrOvv_P "Acelerator Pedal Percentage - Override Value Parameter" VALUE 0x40044310 /* @ECU_Address@EIP_PercgAccrOvv_P@ */ Scalar_FLOAT32_IEEE 0 EcuIntgdSwGend_CM_single__ 0.0 100.0 /end CHARACTERISTIC
/begin CHARACTERISTIC EIP_StAccrOvv_P "Acalerator State - Override Value Parameter" VALUE 0x40044318 /* @ECU_Address@EIP_StAccrOvv_P@ */ Scalar_FLOAT32_IEEE 0 EcuIntgdSwGend_CM_single 0.0 3.0 /end CHARACTERISTIC
/begin CHARACTERISTIC EIP_TAirBoostDft_P "Air Boost Temperature Default Parameter" VALUE 0x4004445C /* @ECU_Address@EIP_TAirBoostDft_P@ */ Scalar_FLOAT32_IEEE 0 EcuIntgdSwGend_CM_single_degC -50.0 250.0 /end CHARACTERISTIC
/begin CHARACTERISTIC EIP_TAirBoostOvv_P "Air Boost Temperature - Override Value Parameter" VALUE 0x4004446C /* @ECU_Address@EIP_TAirBoostOvv_P@ */ Scalar_FLOAT32_IEEE 0 EcuIntgdSwGend_CM_single_degC -50.0 250.0 /end CHARACTERISTIC
/begin CHARACTERISTIC EIP_TAmbAirDft_P "Ambient Air Temperature Default Parameter" VALUE 0x40044470 /* @ECU_Address@EIP_TAmbAirDft_P@ */ Scalar_FLOAT32_IEEE 0 EcuIntgdSwGend_CM_single_degC -50.0 250.0 /end CHARACTERISTIC
/begin CHARACTERISTIC EIP_TAmbAirOvv_P "Ambient Air Temperature - Override Value Parameter" VALUE 0x40044480 /* @ECU_Address@EIP_TAmbAirOvv_P@ */ Scalar_FLOAT32_IEEE 0 EcuIntgdSwGend_CM_single_degC -50.0 250.0 /end CHARACTERISTIC
/begin CHARACTERISTIC EIP_TCooltDft_P "Coolant Temperature Default Parameter" VALUE 0x40044484 /* @ECU_Address@EIP_TCooltDft_P@ */ Scalar_FLOAT32_IEEE 0 EcuIntgdSwGend_CM_single_degC -50.0 250.0 /end CHARACTERISTIC
/begin CHARACTERISTIC EIP_TCooltOvv_P "Coolant Temperature - Override Value Parameter" VALUE 0x400444C4 /* @ECU_Address@EIP_TCooltOvv_P@ */ Scalar_FLOAT32_IEEE 0 EcuIntgdSwGend_CM_single_degC -50.0 250.0 /end CHARACTERISTIC
/begin CHARACTERISTIC EIP_TEcuDft_P "Ecu Temperature Default Parameter" VALUE 0x400444FC /* @ECU_Address@EIP_TEcuDft_P@ */ Scalar_FLOAT32_IEEE 0 EcuIntgdSwGend_CM_single_degC -50.0 250.0 /end CHARACTERISTIC
/begin CHARACTERISTIC EIP_TEcuOvv_P "Ecu Temperature - Override Value Parameter" VALUE 0x4004450C /* @ECU_Address@EIP_TEcuOvv_P@ */ Scalar_FLOAT32_IEEE 0 EcuIntgdSwGend_CM_single_degC -50.0 250.0 /end CHARACTERISTIC
/begin CHARACTERISTIC EIP_TFuDft_P "Fuel Temperature Default Parameter" VALUE 0x40044510 /* @ECU_Address@EIP_TFuDft_P@ */ Scalar_FLOAT32_IEEE 0 EcuIntgdSwGend_CM_single_degC -50.0 250.0 /end CHARACTERISTIC
/begin CHARACTERISTIC EIP_TFuOvv_P "Fuel Temperature - Override Value Parameter" VALUE 0x40044520 /* @ECU_Address@EIP_TFuOvv_P@ */ Scalar_FLOAT32_IEEE 0 EcuIntgdSwGend_CM_single_degC -50.0 250.0 /end CHARACTERISTIC
/begin CHARACTERISTIC EIP_TOilDft_P "Oil Temperature Default Parameter" VALUE 0x40044524 /* @ECU_Address@EIP_TOilDft_P@ */ Scalar_FLOAT32_IEEE 0 EcuIntgdSwGend_CM_single_degC -50.0 250.0 /end CHARACTERISTIC
/begin CHARACTERISTIC EIP_TOilOvv_P "Oil Temperature- Override Value Parameter" VALUE 0x40044564 /* @ECU_Address@EIP_TOilOvv_P@ */ Scalar_FLOAT32_IEEE 0 EcuIntgdSwGend_CM_single_degC -50.0 250.0 /end CHARACTERISTIC
/begin CHARACTERISTIC EIP_TcAccr1PosnFil_P "Low Pass Filter Time Constant for First Accelerator Position Parameter" VALUE 0x40044598 /* @ECU_Address@EIP_TcAccr1PosnFil_P@ */ Scalar_FLOAT32_IEEE 0 EcuIntgdSwGend_CM_single_ms 0.0 5.0 /end CHARACTERISTIC
/begin CHARACTERISTIC EIP_TcAccr2PosnFil_P "Low Pass Filter Time Constant for Second Accelerator Position Parameter" VALUE 0x4004459C /* @ECU_Address@EIP_TcAccr2PosnFil_P@ */ Scalar_FLOAT32_IEEE 0 EcuIntgdSwGend_CM_single_ms 0.0 5.0 /end CHARACTERISTIC
/begin CHARACTERISTIC EIP_TcCamsftSpdFil_P "Low Pass Filter Time Constant for Camshaft Speed" VALUE 0x400445A0 /* @ECU_Address@EIP_TcCamsftSpdFil_P@ */ Scalar_FLOAT32_IEEE 0 EcuIntgdSwGend_CM_single_ms 0.0 5000.0 /end CHARACTERISTIC
/begin CHARACTERISTIC EIP_TcCrnksftSpdFil_P "Low Pass Filter Time Constant for Crankshaft Speed" VALUE 0x400445A4 /* @ECU_Address@EIP_TcCrnksftSpdFil_P@ */ Scalar_FLOAT32_IEEE 0 EcuIntgdSwGend_CM_single_ms 0.0 5000.0 /end CHARACTERISTIC
/begin CHARACTERISTIC EIP_TcNEngFil_P "Low Pass Filter Time Constant for Engine Speed" VALUE 0x400445C4 /* @ECU_Address@EIP_TcNEngFil_P@ */ Scalar_FLOAT32_IEEE 0 EcuIntgdSwGend_CM_single_ms 0.0 5000.0 /end CHARACTERISTIC
/begin CHARACTERISTIC EIP_TcUClmp30Fil_P "Low Pass Filter Time Constant for Battery Voltage" VALUE 0x400445F8 /* @ECU_Address@EIP_TcUClmp30Fil_P@ */ Scalar_FLOAT32_IEEE 0 EcuIntgdSwGend_CM_single_ms 0.0 5.0 /end CHARACTERISTIC
/begin CHARACTERISTIC EIP_TiBrkPedlDeb_P "Debouncer Time for Brake Pedal Parameter" VALUE 0x40044610 /* @ECU_Address@EIP_TiBrkPedlDeb_P@ */ Scalar_FLOAT32_IEEE 0 EcuIntgdSwGend_CM_single_ms 0.0 50000.0 /end CHARACTERISTIC
/begin CHARACTERISTIC EIP_TiCmbtSwtDeb_P "Debouncer Time for Combat Switch Parameter" VALUE 0x40044614 /* @ECU_Address@EIP_TiCmbtSwtDeb_P@ */ Scalar_FLOAT32_IEEE 0 EcuIntgdSwGend_CM_single_ms 0.0 250000.0 /end CHARACTERISTIC
/begin CHARACTERISTIC EIP_TiCrsCtrlOnOffBtnDeb_P "Debouncer Time for Cruise Control On Off Button Debouncer Parameter" VALUE 0x40044618 /* @ECU_Address@EIP_TiCrsCtrlOnOffBtnDeb_P@ */ Scalar_FLOAT32_IEEE 0 EcuIntgdSwGend_CM_single_ms 0.0 50000.0 /end CHARACTERISTIC
/begin CHARACTERISTIC EIP_TiDecCrsCtrlBtnDeb_P "Debouncer Time for Cruise Control Button Parameter" VALUE 0x40044620 /* @ECU_Address@EIP_TiDecCrsCtrlBtnDeb_P@ */ Scalar_FLOAT32_IEEE 0 EcuIntgdSwGend_CM_single_ms 0.0 50000.0 /end CHARACTERISTIC
/begin CHARACTERISTIC EIP_TiEngBrkReq1BtnDeb_P "Debouncer Time for Brake Request 1 Button Parameter" VALUE 0x40044624 /* @ECU_Address@EIP_TiEngBrkReq1BtnDeb_P@ */ Scalar_FLOAT32_IEEE 0 EcuIntgdSwGend_CM_single_ms 0.0 50000.0 /end CHARACTERISTIC
/begin CHARACTERISTIC EIP_TiEngBrkReq2BtnDeb_P "Debouncer Time for Brake Request 2 Button Parameter" VALUE 0x40044628 /* @ECU_Address@EIP_TiEngBrkReq2BtnDeb_P@ */ Scalar_FLOAT32_IEEE 0 EcuIntgdSwGend_CM_single_ms 0.0 50000.0 /end CHARACTERISTIC
/begin CHARACTERISTIC EIP_TiHndBrkPrkgDeb_P "Debouncer Time for Hand Brake Parking Parameter" VALUE 0x4004462C /* @ECU_Address@EIP_TiHndBrkPrkgDeb_P@ */ Scalar_FLOAT32_IEEE 0 EcuIntgdSwGend_CM_single_ms 0.0 50000.0 /end CHARACTERISTIC
/begin CHARACTERISTIC EIP_TiIgnSwtDeb_P "Debouncer Time for Ignition Switch Parameter" VALUE 0x40044634 /* @ECU_Address@EIP_TiIgnSwtDeb_P@ */ Scalar_FLOAT32_IEEE 0 EcuIntgdSwGend_CM_single_ms 0.0 50000.0 /end CHARACTERISTIC
/begin CHARACTERISTIC EIP_TiIncCrsCtrlBtnDeb_P "Debouncer Time for Increment Cruise Control Button Parameter" VALUE 0x40044638 /* @ECU_Address@EIP_TiIncCrsCtrlBtnDeb_P@ */ Scalar_FLOAT32_IEEE 0 EcuIntgdSwGend_CM_single_ms 0.0 50000.0 /end CHARACTERISTIC
/begin CHARACTERISTIC EIP_TiSpdLimrOnOffBtnDeb_P "Elapsed Time Speed Limiter Enable Button Parameter" VALUE 0x40044654 /* @ECU_Address@EIP_TiSpdLimrOnOffBtnDeb_P@ */ Scalar_FLOAT32_IEEE 0 EcuIntgdSwGend_CM_single_ms 0.0 10000.0 /end CHARACTERISTIC
/begin CHARACTERISTIC EIP_TiStrtReqSwtDeb_P "Debouncer Time for Start Request Switch Parameter" VALUE 0x40044658 /* @ECU_Address@EIP_TiStrtReqSwtDeb_P@ */ Scalar_FLOAT32_IEEE 0 EcuIntgdSwGend_CM_single_ms 0.0 50000.0 /end CHARACTERISTIC
/begin CHARACTERISTIC EIP_TiTroubleshootingBtnDeb_P "Debouncer Time for Troubleshooting Button Parameter" VALUE 0x40044674 /* @ECU_Address@EIP_TiTroubleshootingBtnDeb_P@ */ Scalar_FLOAT32_IEEE 0 EcuIntgdSwGend_CM_single_ms 0.0 50000.0 /end CHARACTERISTIC
/begin CHARACTERISTIC EIP_TiUClmp30SnsrDeb_P "Debouncer Time for Battery Voltage Parameter" VALUE 0x40044678 /* @ECU_Address@EIP_TiUClmp30SnsrDeb_P@ */ Scalar_FLOAT32_IEEE 0 EcuIntgdSwGend_CM_single_ms 0.0 50000.0 /end CHARACTERISTIC
/begin CHARACTERISTIC EIP_TripMemOvv_P "Trip from Memory - Override Value" VALUE 0x40044684 /* @ECU_Address@EIP_TripMemOvv_P@ */ Scalar_FLOAT32_IEEE 0 EcuIntgdSwGend_CM_single_km 0.0 1.0E+6 /end CHARACTERISTIC
/begin CHARACTERISTIC EIP_UClmp30Dft_P "Battery Voltage Default Value" VALUE 0x40044688 /* @ECU_Address@EIP_UClmp30Dft_P@ */ Scalar_FLOAT32_IEEE 0 EcuIntgdSwGend_CM_single_V 0.0 50.0 /end CHARACTERISTIC
/begin CHARACTERISTIC EIP_UClmp30Max_P "Max Battery Voltage Parameter" VALUE 0x4004468C /* @ECU_Address@EIP_UClmp30Max_P@ */ Scalar_FLOAT32_IEEE 0 EcuIntgdSwGend_CM_single_V 0.0 50.0 /end CHARACTERISTIC
/begin CHARACTERISTIC EIP_UClmp30Min_P "Min Battery Voltage Parameter" VALUE 0x40044690 /* @ECU_Address@EIP_UClmp30Min_P@ */ Scalar_FLOAT32_IEEE 0 EcuIntgdSwGend_CM_single_V 0.0 50.0 /end CHARACTERISTIC
/begin CHARACTERISTIC EIP_UClmp30Ovv_P "Battery Voltage - Override Value Parameter" VALUE 0x40044698 /* @ECU_Address@EIP_UClmp30Ovv_P@ */ Scalar_FLOAT32_IEEE 0 EcuIntgdSwGend_CM_single_V 0.0 50.0 /end CHARACTERISTIC
/begin CHARACTERISTIC EIP_VehVFilCon_P "Vehicle Speed Low Pass Filter Coefficient" VALUE 0x400446A4 /* @ECU_Address@EIP_VehVFilCon_P@ */ Scalar_FLOAT32_IEEE 0 EcuIntgdSwGend_CM_single 0.0 10000.0 /end CHARACTERISTIC
/begin CHARACTERISTIC EIP_VehVThdForDstTrvld_P "Vehicle Velocity Threshold for Distance to Travelled" VALUE 0x400446A8 /* @ECU_Address@EIP_VehVThdForDstTrvld_P@ */ Scalar_FLOAT32_IEEE 0 EcuIntgdSwGend_CM_single_km_h 0.0 1000.0 /end CHARACTERISTIC
/begin CHARACTERISTIC EMS_NEngIdletoTqThd_P "Idle to Torque Transition Engine Speed Threshold" VALUE 0x400448E0 /* @ECU_Address@EMS_NEngIdletoTqThd_P@ */ Scalar_FLOAT32_IEEE 0 EcuIntgdSwGend_CM_single_rpm 0.0 3000.0 /end CHARACTERISTIC
/begin CHARACTERISTIC EMS_NEngStopThd_P "Engine Stop Mode Engine Speed Threshold Parameter" VALUE 0x400448E4 /* @ECU_Address@EMS_NEngStopThd_P@ */ Scalar_FLOAT32_IEEE 0 EcuIntgdSwGend_CM_single_rpm 0.0 5000.0 /end CHARACTERISTIC
/begin CHARACTERISTIC EMS_NEngStrtrAcvThd_P "Start Active Engine Speed Threshold Parameter" VALUE 0x40044914 /* @ECU_Address@EMS_NEngStrtrAcvThd_P@ */ Scalar_FLOAT32_IEEE 0 EcuIntgdSwGend_CM_single_rpm 0.0 5000.0 /end CHARACTERISTIC
/begin CHARACTERISTIC EMS_NEngTqtoIdleThd_P "Torque To Idle Mode Engine Speed Threshold Parameter" VALUE 0x40044918 /* @ECU_Address@EMS_NEngTqtoIdleThd_P@ */ Scalar_FLOAT32_IEEE 0 EcuIntgdSwGend_CM_single_rpm 0.0 5000.0 /end CHARACTERISTIC
/begin CHARACTERISTIC IC_MTotFuQntyCorrdOvv_P "Corrected Total Fuel Quantity Mass - Override Value Parameter" VALUE 0x40045BF8 /* @ECU_Address@IC_MTotFuQntyCorrdOvv_P@ */ Scalar_FLOAT32_IEEE 0 EcuIntgdSwGend_CM_single_mm_3_stk 0.0 5000.0 /end CHARACTERISTIC
/begin CHARACTERISTIC PtoCtrl_TargetSpdRateLoLim_P "Target Speed Rate Limiter Lower Limit" VALUE 0x40048F6C /* @ECU_Address@PtoCtrl_TargetSpdRateLoLim_P@ */ Scalar_FLOAT32_IEEE 0 EcuIntgdSwGend_CM_single_rpm -10000.0 0.0 /end CHARACTERISTIC
/begin CHARACTERISTIC PtoCtrl_TargetSpdRateUpLim_P "Target Speed Rate Limiter Upper Limit" VALUE 0x40048F70 /* @ECU_Address@PtoCtrl_TargetSpdRateUpLim_P@ */ Scalar_FLOAT32_IEEE 0 EcuIntgdSwGend_CM_single_rpm 0.0 10000.0 /end CHARACTERISTIC
/begin CHARACTERISTIC PtoCtrl_TqDmd_P "Torque Demand for PTO Not Active" VALUE 0x40048F74 /* @ECU_Address@PtoCtrl_TqDmd_P@ */ Scalar_FLOAT32_IEEE 0 EcuIntgdSwGend_CM_single_N_m -10000.0 0.0 /end CHARACTERISTIC
/begin CHARACTERISTIC RPG_PRailRefOvv_P "Reference Rail Pressure - Override Value Parameter" VALUE 0x40049980 /* @ECU_Address@RPG_PRailRefOvv_P@ */ Scalar_FLOAT32_IEEE 0 EcuIntgdSwGend_CM_single_bar 0.0 2500.0 /end CHARACTERISTIC
/begin CHARACTERISTIC CrsCtrl_ActvCanOrDigInEva_P "Can Message or Digital Input Evaluation Parameter" VALUE 0x400403E4 /* @ECU_Address@CrsCtrl_ActvCanOrDigInEva_P@ */ Scalar_BOOLEAN 0 EcuIntgdSwGend_CM_boolean 0.0 1.0 /end CHARACTERISTIC
/begin CHARACTERISTIC DTqC_NEngIdleRefOvs_P "Engine Idle Reference Signal - Override Switch" VALUE 0x40041D60 /* @ECU_Address@DTqC_NEngIdleRefOvs_P@ */ Scalar_BOOLEAN 0 EcuIntgdSwGend_CM_boolean 0.0 1.0 /end CHARACTERISTIC
/begin CHARACTERISTIC DTqC_TqBrkStrtCtlOvs_P "Break Torque of Start Control - Override Switch" VALUE 0x40043304 /* @ECU_Address@DTqC_TqBrkStrtCtlOvs_P@ */ Scalar_BOOLEAN 0 EcuIntgdSwGend_CM_boolean 0.0 1.0 /end CHARACTERISTIC
/begin CHARACTERISTIC DTqC_TqFricOvs_P "Friction Torque Value - Override Switch" VALUE 0x4004333C /* @ECU_Address@DTqC_TqFricOvs_P@ */ Scalar_BOOLEAN 0 EcuIntgdSwGend_CM_boolean 0.0 1.0 /end CHARACTERISTIC
/begin CHARACTERISTIC EIP_CamsftSpdOvs_P "Input Processing Camshaft Speed Override Switch Parameter" VALUE 0x40043FF0 /* @ECU_Address@EIP_CamsftSpdOvs_P@ */ Scalar_BOOLEAN 0 EcuIntgdSwGend_CM_boolean 0.0 1.0 /end CHARACTERISTIC
/begin CHARACTERISTIC EIP_CrnksftSpdOvs_P "Input Processing Crankshaft Speed Override Switch Parameter" VALUE 0x40044128 /* @ECU_Address@EIP_CrnksftSpdOvs_P@ */ Scalar_BOOLEAN 0 EcuIntgdSwGend_CM_boolean 0.0 1.0 /end CHARACTERISTIC
/begin CHARACTERISTIC EIP_DstTrvldInKmOvs_P "Distance to Travelled in Kilometer Ovveride Switch Parameter" VALUE 0x40044134 /* @ECU_Address@EIP_DstTrvldInKmOvs_P@ */ Scalar_BOOLEAN 0 EcuIntgdSwGend_CM_boolean 0.0 1.0 /end CHARACTERISTIC
/begin CHARACTERISTIC EIP_DstTrvldMemOvs_P "Distance to Travelled Memory Override Switch Parameter" VALUE 0x4004413C /* @ECU_Address@EIP_DstTrvldMemOvs_P@ */ Scalar_BOOLEAN 0 EcuIntgdSwGend_CM_boolean 0.0 1.0 /end CHARACTERISTIC
/begin CHARACTERISTIC EIP_EngHrMemOvs_P "Engine Hour From Memory Override Switch Parameter" VALUE 0x4004414C /* @ECU_Address@EIP_EngHrMemOvs_P@ */ Scalar_BOOLEAN 0 EcuIntgdSwGend_CM_boolean 0.0 1.0 /end CHARACTERISTIC
/begin CHARACTERISTIC EIP_EngHrOvs_P "Engine Hour Override Switch Parameter" VALUE 0x40044154 /* @ECU_Address@EIP_EngHrOvs_P@ */ Scalar_BOOLEAN 0 EcuIntgdSwGend_CM_boolean 0.0 1.0 /end CHARACTERISTIC
/begin CHARACTERISTIC EIP_ErrAmberWarnLampOvs_P "Error Amber Warning Lamp (AWL) Override Switch Parameter" VALUE 0x4004415C /* @ECU_Address@EIP_ErrAmberWarnLampOvs_P@ */ Scalar_BOOLEAN 0 EcuIntgdSwGend_CM_boolean 0.0 1.0 /end CHARACTERISTIC
/begin CHARACTERISTIC EIP_ErrAmberWarnLampOvv_P "Error Amber Warning Lamp (AWL) Override Value Parameter" VALUE 0x40044160 /* @ECU_Address@EIP_ErrAmberWarnLampOvv_P@ */ Scalar_BOOLEAN 0 EcuIntgdSwGend_CM_boolean 0.0 1.0 /end CHARACTERISTIC
/begin CHARACTERISTIC EIP_ErrColdStrtLampOvs_P "Error Cold Start Lamp (CSL) Override Switch Parameter" VALUE 0x40044164 /* @ECU_Address@EIP_ErrColdStrtLampOvs_P@ */ Scalar_BOOLEAN 0 EcuIntgdSwGend_CM_boolean 0.0 1.0 /end CHARACTERISTIC
/begin CHARACTERISTIC EIP_ErrColdStrtLampOvv_P "Error Cold Start Lamp (CSL) Override Value Parameter" VALUE 0x40044168 /* @ECU_Address@EIP_ErrColdStrtLampOvv_P@ */ Scalar_BOOLEAN 0 EcuIntgdSwGend_CM_boolean 0.0 1.0 /end CHARACTERISTIC
/begin CHARACTERISTIC EIP_ErrEngBrkSoln1Ovs_P "Error Engine Brake Selenoid 1 Override Switch Parameter" VALUE 0x4004416C /* @ECU_Address@EIP_ErrEngBrkSoln1Ovs_P@ */ Scalar_BOOLEAN 0 EcuIntgdSwGend_CM_boolean 0.0 1.0 /end CHARACTERISTIC
/begin CHARACTERISTIC EIP_ErrEngBrkSoln1Ovv_P "Error Engine Brake Selenoid 1 Override Value Parameter" VALUE 0x40044170 /* @ECU_Address@EIP_ErrEngBrkSoln1Ovv_P@ */ Scalar_BOOLEAN 0 EcuIntgdSwGend_CM_boolean 0.0 1.0 /end CHARACTERISTIC
/begin CHARACTERISTIC EIP_ErrEngBrkSoln2Ovs_P "Error Engine Brake Selenoid 2 Override Switch Parameter" VALUE 0x40044174 /* @ECU_Address@EIP_ErrEngBrkSoln2Ovs_P@ */ Scalar_BOOLEAN 0 EcuIntgdSwGend_CM_boolean 0.0 1.0 /end CHARACTERISTIC
/begin CHARACTERISTIC EIP_ErrEngBrkSoln2Ovv_P "Error Engine Brake Selenoid 2 Override Value Parameter" VALUE 0x40044178 /* @ECU_Address@EIP_ErrEngBrkSoln2Ovv_P@ */ Scalar_BOOLEAN 0 EcuIntgdSwGend_CM_boolean 0.0 1.0 /end CHARACTERISTIC
/begin CHARACTERISTIC EIP_ErrRedStopLampOvs_P "Error Red Stop Lamp (RSL) Override Switch Parameter" VALUE 0x4004417C /* @ECU_Address@EIP_ErrRedStopLampOvs_P@ */ Scalar_BOOLEAN 0 EcuIntgdSwGend_CM_boolean 0.0 1.0 /end CHARACTERISTIC
/begin CHARACTERISTIC EIP_ErrRedStopLampOvv_P "Error Red Stop Lamp (RSL) Override Value Parameter" VALUE 0x40044180 /* @ECU_Address@EIP_ErrRedStopLampOvv_P@ */ Scalar_BOOLEAN 0 EcuIntgdSwGend_CM_boolean 0.0 1.0 /end CHARACTERISTIC
/begin CHARACTERISTIC EIP_ErrStrtrOvs_P "Starter Error - Override Switch" VALUE 0x40044184 /* @ECU_Address@EIP_ErrStrtrOvs_P@ */ Scalar_BOOLEAN 0 EcuIntgdSwGend_CM_boolean 0.0 1.0 /end CHARACTERISTIC
/begin CHARACTERISTIC EIP_ErrStrtrOvv_P "Starter Error - Override Value" VALUE 0x40044188 /* @ECU_Address@EIP_ErrStrtrOvv_P@ */ Scalar_BOOLEAN 0 EcuIntgdSwGend_CM_boolean 0.0 1.0 /end CHARACTERISTIC
/begin CHARACTERISTIC EIP_FuelCnsMemOvs_P "Fuel Consumption from Memory - Override Switch" VALUE 0x4004418C /* @ECU_Address@EIP_FuelCnsMemOvs_P@ */ Scalar_BOOLEAN 0 EcuIntgdSwGend_CM_boolean 0.0 1.0 /end CHARACTERISTIC
/begin CHARACTERISTIC EIP_GridHeatrRlyFbOvs_P "Grid Heater Relay Feedback - Override Switch Parameter" VALUE 0x400441CC /* @ECU_Address@EIP_GridHeatrRlyFbOvs_P@ */ Scalar_BOOLEAN 0 EcuIntgdSwGend_CM_boolean 0.0 1.0 /end CHARACTERISTIC
/begin CHARACTERISTIC EIP_HndBrkPrkgOvs_P "Hand Brake Parking - Override Switch Parameter" VALUE 0x400441D4 /* @ECU_Address@EIP_HndBrkPrkgOvs_P@ */ Scalar_BOOLEAN 0 EcuIntgdSwGend_CM_boolean 0.0 1.0 /end CHARACTERISTIC
/begin CHARACTERISTIC EIP_HndBrkPrkgOvv_P "Hand Brake Parking - Override Value Parameter" VALUE 0x400441D8 /* @ECU_Address@EIP_HndBrkPrkgOvv_P@ */ Scalar_BOOLEAN 0 EcuIntgdSwGend_CM_boolean 0.0 1.0 /end CHARACTERISTIC
/begin CHARACTERISTIC EIP_LvlOilOvs_P "Oil Level - Override Switch Parameter" VALUE 0x400441EC /* @ECU_Address@EIP_LvlOilOvs_P@ */ Scalar_BOOLEAN 0 EcuIntgdSwGend_CM_boolean 0.0 1.0 /end CHARACTERISTIC
/begin CHARACTERISTIC EIP_NEngOvs_P "Engine Speed - Override Switch Parameter" VALUE 0x40044248 /* @ECU_Address@EIP_NEngOvs_P@ */ Scalar_BOOLEAN 0 EcuIntgdSwGend_CM_boolean 0.0 1.0 /end CHARACTERISTIC
/begin CHARACTERISTIC EIP_PAirBoostOvs_P "Air Boost Pressure - Override Switch Parameter" VALUE 0x4004426C /* @ECU_Address@EIP_PAirBoostOvs_P@ */ Scalar_BOOLEAN 0 EcuIntgdSwGend_CM_boolean 0.0 1.0 /end CHARACTERISTIC
/begin CHARACTERISTIC EIP_PAmbAirOvs_P "Ambient Air Pressure - Override Switch Parameter" VALUE 0x40044280 /* @ECU_Address@EIP_PAmbAirOvs_P@ */ Scalar_BOOLEAN 0 EcuIntgdSwGend_CM_boolean 0.0 1.0 /end CHARACTERISTIC
/begin CHARACTERISTIC EIP_PFuOvs_P "Fuel Pressure - Override Switch Parameter" VALUE 0x40044294 /* @ECU_Address@EIP_PFuOvs_P@ */ Scalar_BOOLEAN 0 EcuIntgdSwGend_CM_boolean 0.0 1.0 /end CHARACTERISTIC
/begin CHARACTERISTIC EIP_POilOvs_P "Oil Pressure - Override Switch Parameter" VALUE 0x400442A8 /* @ECU_Address@EIP_POilOvs_P@ */ Scalar_BOOLEAN 0 EcuIntgdSwGend_CM_boolean 0.0 1.0 /end CHARACTERISTIC
/begin CHARACTERISTIC EIP_PRailOvs_P "Rail Pressure - Override Switch Parameter" VALUE 0x400442BC /* @ECU_Address@EIP_PRailOvs_P@ */ Scalar_BOOLEAN 0 EcuIntgdSwGend_CM_boolean 0.0 1.0 /end CHARACTERISTIC
/begin CHARACTERISTIC EIP_PercgAccr1Ovs_P "First Acelerator Pedal Percentage - Override Switch Parameter" VALUE 0x400442CC /* @ECU_Address@EIP_PercgAccr1Ovs_P@ */ Scalar_BOOLEAN 0 EcuIntgdSwGend_CM_boolean 0.0 1.0 /end CHARACTERISTIC
/begin CHARACTERISTIC EIP_PercgAccr2Ovs_P "Second Acelerator Pedal Percentage - Override Switch Parameter" VALUE 0x400442DC /* @ECU_Address@EIP_PercgAccr2Ovs_P@ */ Scalar_BOOLEAN 0 EcuIntgdSwGend_CM_boolean 0.0 1.0 /end CHARACTERISTIC
/begin CHARACTERISTIC EIP_PercgAccrOvs_P "Acelerator Pedal Percentage - Override Switch Parameter" VALUE 0x4004430C /* @ECU_Address@EIP_PercgAccrOvs_P@ */ Scalar_BOOLEAN 0 EcuIntgdSwGend_CM_boolean 0.0 1.0 /end CHARACTERISTIC
/begin CHARACTERISTIC EIP_StAccrOvs_P "Acalerator State - Override Switch Parameter" VALUE 0x40044314 /* @ECU_Address@EIP_StAccrOvs_P@ */ Scalar_BOOLEAN 0 EcuIntgdSwGend_CM_boolean 0.0 1.0 /end CHARACTERISTIC
/begin CHARACTERISTIC EIP_TAirBoostOvs_P "Air Boost Temperature - Override Switch Parameter" VALUE 0x40044468 /* @ECU_Address@EIP_TAirBoostOvs_P@ */ Scalar_BOOLEAN 0 EcuIntgdSwGend_CM_boolean 0.0 1.0 /end CHARACTERISTIC
/begin CHARACTERISTIC EIP_TAmbAirOvs_P "Ambient Air Temperature - Override Switch Parameter" VALUE 0x4004447C /* @ECU_Address@EIP_TAmbAirOvs_P@ */ Scalar_BOOLEAN 0 EcuIntgdSwGend_CM_boolean 0.0 1.0 /end CHARACTERISTIC
/begin CHARACTERISTIC EIP_TCooltOvs_P "Coolant Temperature - Override Switch Parameter" VALUE 0x400444C0 /* @ECU_Address@EIP_TCooltOvs_P@ */ Scalar_BOOLEAN 0 EcuIntgdSwGend_CM_boolean 0.0 1.0 /end CHARACTERISTIC
/begin CHARACTERISTIC EIP_TEcuOvs_P "Ecu Temperature - Override Switch Parameter" VALUE 0x40044508 /* @ECU_Address@EIP_TEcuOvs_P@ */ Scalar_BOOLEAN 0 EcuIntgdSwGend_CM_boolean 0.0 1.0 /end CHARACTERISTIC
/begin CHARACTERISTIC EIP_TFuOvs_P "Fuel Temperature - Override Switch Parameter" VALUE 0x4004451C /* @ECU_Address@EIP_TFuOvs_P@ */ Scalar_BOOLEAN 0 EcuIntgdSwGend_CM_boolean 0.0 1.0 /end CHARACTERISTIC
/begin CHARACTERISTIC EIP_TOilOvs_P "Oil Temperature - Override Switch Parameter" VALUE 0x40044560 /* @ECU_Address@EIP_TOilOvs_P@ */ Scalar_BOOLEAN 0 EcuIntgdSwGend_CM_boolean 0.0 1.0 /end CHARACTERISTIC
/begin CHARACTERISTIC EIP_TripMemOvs_P "Trip from Memory - Override Switch" VALUE 0x40044680 /* @ECU_Address@EIP_TripMemOvs_P@ */ Scalar_BOOLEAN 0 EcuIntgdSwGend_CM_boolean 0.0 1.0 /end CHARACTERISTIC
/begin CHARACTERISTIC EIP_UClmp30Ovs_P "Battery Voltage - Override Switch Parameter" VALUE 0x40044694 /* @ECU_Address@EIP_UClmp30Ovs_P@ */ Scalar_BOOLEAN 0 EcuIntgdSwGend_CM_boolean 0.0 1.0 /end CHARACTERISTIC
/begin CHARACTERISTIC EIP_bAcvCmbtSwtOvs_P "Combat Switch Active - Override Switch Parameter" VALUE 0x400446B0 /* @ECU_Address@EIP_bAcvCmbtSwtOvs_P@ */ Scalar_BOOLEAN 0 EcuIntgdSwGend_CM_boolean 0.0 1.0 /end CHARACTERISTIC
/begin CHARACTERISTIC EIP_bAcvCmbtSwtOvv_P "Combat Switch Active - Override Value Parameter" VALUE 0x400446B4 /* @ECU_Address@EIP_bAcvCmbtSwtOvv_P@ */ Scalar_BOOLEAN 0 EcuIntgdSwGend_CM_boolean 0.0 1.0 /end CHARACTERISTIC
/begin CHARACTERISTIC EIP_bAcvPtoOnOffBtnOvs_P "Pto On Off Button Active - Override Switch Parameter" VALUE 0x400446E8 /* @ECU_Address@EIP_bAcvPtoOnOffBtnOvs_P@ */ Scalar_BOOLEAN 0 EcuIntgdSwGend_CM_boolean 0.0 1.0 /end CHARACTERISTIC
/begin CHARACTERISTIC EIP_bAcvPtoOnOffBtnOvv_P "Pto On Off Button Active - Override Value Parameter" VALUE 0x400446EC /* @ECU_Address@EIP_bAcvPtoOnOffBtnOvv_P@ */ Scalar_BOOLEAN 0 EcuIntgdSwGend_CM_boolean 0.0 1.0 /end CHARACTERISTIC
/begin CHARACTERISTIC EIP_bAcvPtoResuBtnOvs_P "Pto Resume Button Active - Override Switch Parameter" VALUE 0x400446F0 /* @ECU_Address@EIP_bAcvPtoResuBtnOvs_P@ */ Scalar_BOOLEAN 0 EcuIntgdSwGend_CM_boolean 0.0 1.0 /end CHARACTERISTIC
/begin CHARACTERISTIC EIP_bAcvPtoResuBtnOvv_P "Pto Resume Button Active - Override Value Parameter" VALUE 0x400446F4 /* @ECU_Address@EIP_bAcvPtoResuBtnOvv_P@ */ Scalar_BOOLEAN 0 EcuIntgdSwGend_CM_boolean 0.0 1.0 /end CHARACTERISTIC
/begin CHARACTERISTIC EIP_bAcvPtoSetBtnOvs_P "Pto Set Button Active - Override Switch Parameter" VALUE 0x400446F8 /* @ECU_Address@EIP_bAcvPtoSetBtnOvs_P@ */ Scalar_BOOLEAN 0 EcuIntgdSwGend_CM_boolean 0.0 1.0 /end CHARACTERISTIC
/begin CHARACTERISTIC EIP_bAcvPtoSetBtnOvv_P "Pto Set Button Active - Override Value Parameter" VALUE 0x400446FC /* @ECU_Address@EIP_bAcvPtoSetBtnOvv_P@ */ Scalar_BOOLEAN 0 EcuIntgdSwGend_CM_boolean 0.0 1.0 /end CHARACTERISTIC
/begin CHARACTERISTIC EIP_bBrkPedlOvs_P "Brake Pedal - Override Switch Parameter" VALUE 0x40044700 /* @ECU_Address@EIP_bBrkPedlOvs_P@ */ Scalar_BOOLEAN 0 EcuIntgdSwGend_CM_boolean 0.0 1.0 /end CHARACTERISTIC
/begin CHARACTERISTIC EIP_bBrkPedlOvv_P "Brake Pedal - Override Value Parameter" VALUE 0x40044704 /* @ECU_Address@EIP_bBrkPedlOvv_P@ */ Scalar_BOOLEAN 0 EcuIntgdSwGend_CM_boolean 0.0 1.0 /end CHARACTERISTIC
/begin CHARACTERISTIC EIP_bCrsCtrlOnOffBtnOvs_P "Cruise Control On Off Button - Override Switch Parameter" VALUE 0x40044708 /* @ECU_Address@EIP_bCrsCtrlOnOffBtnOvs_P@ */ Scalar_BOOLEAN 0 EcuIntgdSwGend_CM_boolean 0.0 1.0 /end CHARACTERISTIC
/begin CHARACTERISTIC EIP_bCrsCtrlOnOffBtnOvv_P "Cruise Control On Off Button - Override Value Parameter" VALUE 0x4004470C /* @ECU_Address@EIP_bCrsCtrlOnOffBtnOvv_P@ */ Scalar_BOOLEAN 0 EcuIntgdSwGend_CM_boolean 0.0 1.0 /end CHARACTERISTIC
/begin CHARACTERISTIC EIP_bDecCrsCtrlBtnOvs_P "Cruise Control Decrement Button - Override Switch Parameter" VALUE 0x40044710 /* @ECU_Address@EIP_bDecCrsCtrlBtnOvs_P@ */ Scalar_BOOLEAN 0 EcuIntgdSwGend_CM_boolean 0.0 1.0 /end CHARACTERISTIC
/begin CHARACTERISTIC EIP_bDecCrsCtrlBtnOvv_P "Cruise Control Decrement Button - Override Value Parameter" VALUE 0x40044714 /* @ECU_Address@EIP_bDecCrsCtrlBtnOvv_P@ */ Scalar_BOOLEAN 0 EcuIntgdSwGend_CM_boolean 0.0 1.0 /end CHARACTERISTIC
/begin CHARACTERISTIC EIP_bDecSpdLimrBtnOvs_P "" VALUE 0x40044718 /* @ECU_Address@EIP_bDecSpdLimrBtnOvs_P@ */ Scalar_BOOLEAN 0 EcuIntgdSwGend_CM_boolean 0.0 1.0 /end CHARACTERISTIC
/begin CHARACTERISTIC EIP_bDecSpdLimrBtnOvv_P "" VALUE 0x4004471C /* @ECU_Address@EIP_bDecSpdLimrBtnOvv_P@ */ Scalar_BOOLEAN 0 EcuIntgdSwGend_CM_boolean 0.0 1.0 /end CHARACTERISTIC
/begin CHARACTERISTIC EIP_bEngBrkReq1BtnOvs_P "Engine Break Request 1 Button - Override Switch Parameter" VALUE 0x40044720 /* @ECU_Address@EIP_bEngBrkReq1BtnOvs_P@ */ Scalar_BOOLEAN 0 EcuIntgdSwGend_CM_boolean 0.0 1.0 /end CHARACTERISTIC
/begin CHARACTERISTIC EIP_bEngBrkReq1BtnOvv_P "Engine Break Request 1 Button - Override Value Parameter" VALUE 0x40044724 /* @ECU_Address@EIP_bEngBrkReq1BtnOvv_P@ */ Scalar_BOOLEAN 0 EcuIntgdSwGend_CM_boolean 0.0 1.0 /end CHARACTERISTIC
/begin CHARACTERISTIC EIP_bEngBrkReq2BtnOvs_P "Engine Break Request 2 Button - Override Switch Parameter" VALUE 0x40044728 /* @ECU_Address@EIP_bEngBrkReq2BtnOvs_P@ */ Scalar_BOOLEAN 0 EcuIntgdSwGend_CM_boolean 0.0 1.0 /end CHARACTERISTIC
/begin CHARACTERISTIC EIP_bEngBrkReq2BtnOvv_P "Engine Break Request 2 Button - Override Value Parameter" VALUE 0x4004472C /* @ECU_Address@EIP_bEngBrkReq2BtnOvv_P@ */ Scalar_BOOLEAN 0 EcuIntgdSwGend_CM_boolean 0.0 1.0 /end CHARACTERISTIC
/begin CHARACTERISTIC EIP_bErrAccrSnsr1Ovs_P "Error Accelerator 1 Sensor - Override Switch Parameter" VALUE 0x40044740 /* @ECU_Address@EIP_bErrAccrSnsr1Ovs_P@ */ Scalar_BOOLEAN 0 EcuIntgdSwGend_CM_boolean 0.0 1.0 /end CHARACTERISTIC
/begin CHARACTERISTIC EIP_bErrAccrSnsr1Ovv_P "Error Accelerator 1 Sensor - Override Value Parameter" VALUE 0x40044744 /* @ECU_Address@EIP_bErrAccrSnsr1Ovv_P@ */ Scalar_BOOLEAN 0 EcuIntgdSwGend_CM_boolean 0.0 1.0 /end CHARACTERISTIC
/begin CHARACTERISTIC EIP_bErrAccrSnsr2Ovs_P "Error Accelerator 2 Sensor - Override Switch Parameter" VALUE 0x40044748 /* @ECU_Address@EIP_bErrAccrSnsr2Ovs_P@ */ Scalar_BOOLEAN 0 EcuIntgdSwGend_CM_boolean 0.0 1.0 /end CHARACTERISTIC
/begin CHARACTERISTIC EIP_bErrAccrSnsr2Ovv_P "Error Accelerator 2 Sensor - Override Value Parameter" VALUE 0x4004474C /* @ECU_Address@EIP_bErrAccrSnsr2Ovv_P@ */ Scalar_BOOLEAN 0 EcuIntgdSwGend_CM_boolean 0.0 1.0 /end CHARACTERISTIC
/begin CHARACTERISTIC EIP_bErrBrkPedlOvs_P "Engine Input Processing - Brake Pedal Switch Error - Override Switch Parameter" VALUE 0x40044750 /* @ECU_Address@EIP_bErrBrkPedlOvs_P@ */ Scalar_BOOLEAN 0 EcuIntgdSwGend_CM_boolean 0.0 1.0 /end CHARACTERISTIC
/begin CHARACTERISTIC EIP_bErrBrkPedlOvv_P "Engine Input Processing - Brake Pedal Switch Error - Override Value Parameter" VALUE 0x40044754 /* @ECU_Address@EIP_bErrBrkPedlOvv_P@ */ Scalar_BOOLEAN 0 EcuIntgdSwGend_CM_boolean 0.0 1.0 /end CHARACTERISTIC
/begin CHARACTERISTIC EIP_bErrCamCrankTotLossOvs_P "Error Cam Crank Total Loss - Override Switch Parameter" VALUE 0x40044758 /* @ECU_Address@EIP_bErrCamCrankTotLossOvs_P@ */ Scalar_BOOLEAN 0 EcuIntgdSwGend_CM_boolean 0.0 1.0 /end CHARACTERISTIC
/begin CHARACTERISTIC EIP_bErrCamCrankTotLossOvv_P "Error Cam Crank Total Loss - Override Value Parameter" VALUE 0x4004475C /* @ECU_Address@EIP_bErrCamCrankTotLossOvv_P@ */ Scalar_BOOLEAN 0 EcuIntgdSwGend_CM_boolean 0.0 1.0 /end CHARACTERISTIC
/begin CHARACTERISTIC EIP_bErrCamsftSnsrOvs_P "Error Camshaft Sensor - Override Switch Parameter" VALUE 0x40044760 /* @ECU_Address@EIP_bErrCamsftSnsrOvs_P@ */ Scalar_BOOLEAN 0 EcuIntgdSwGend_CM_boolean 0.0 1.0 /end CHARACTERISTIC
/begin CHARACTERISTIC EIP_bErrCamsftSnsrOvv_P "Error Camshaft Sensor - Override Value Parameter" VALUE 0x40044764 /* @ECU_Address@EIP_bErrCamsftSnsrOvv_P@ */ Scalar_BOOLEAN 0 EcuIntgdSwGend_CM_boolean 0.0 1.0 /end CHARACTERISTIC
/begin CHARACTERISTIC EIP_bErrCmbtSwtOvs_P "Error Combat Switch - Override Switch Parameter" VALUE 0x40044768 /* @ECU_Address@EIP_bErrCmbtSwtOvs_P@ */ Scalar_BOOLEAN 0 EcuIntgdSwGend_CM_boolean 0.0 1.0 /end CHARACTERISTIC
/begin CHARACTERISTIC EIP_bErrCmbtSwtOvv_P "Error Combat Switch - Override Value Parameter" VALUE 0x4004476C /* @ECU_Address@EIP_bErrCmbtSwtOvv_P@ */ Scalar_BOOLEAN 0 EcuIntgdSwGend_CM_boolean 0.0 1.0 /end CHARACTERISTIC
/begin CHARACTERISTIC EIP_bErrCrnksftSnsrOvs_P "Error Crankshaft Sensor - Override Switch Parameter" VALUE 0x40044770 /* @ECU_Address@EIP_bErrCrnksftSnsrOvs_P@ */ Scalar_BOOLEAN 0 EcuIntgdSwGend_CM_boolean 0.0 1.0 /end CHARACTERISTIC
/begin CHARACTERISTIC EIP_bErrCrnksftSnsrOvv_P "Error Crankshaft Sensor - Override Value Parameter" VALUE 0x40044774 /* @ECU_Address@EIP_bErrCrnksftSnsrOvv_P@ */ Scalar_BOOLEAN 0 EcuIntgdSwGend_CM_boolean 0.0 1.0 /end CHARACTERISTIC
/begin CHARACTERISTIC EIP_bErrCrsCtrlOnOffBtnOvs_P "Error Cruise Control On Off Button - Override Switch Parameter" VALUE 0x40044778 /* @ECU_Address@EIP_bErrCrsCtrlOnOffBtnOvs_P@ */ Scalar_BOOLEAN 0 EcuIntgdSwGend_CM_boolean 0.0 1.0 /end CHARACTERISTIC
/begin CHARACTERISTIC EIP_bErrCrsCtrlOnOffBtnOvv_P "Error Cruise Control On Off Button - Override Value Parameter" VALUE 0x4004477C /* @ECU_Address@EIP_bErrCrsCtrlOnOffBtnOvv_P@ */ Scalar_BOOLEAN 0 EcuIntgdSwGend_CM_boolean 0.0 1.0 /end CHARACTERISTIC
/begin CHARACTERISTIC EIP_bErrDecCrsCtrlBtnOvs_P "Error Cruise Control Decrement Button - Override Switch Parameter" VALUE 0x40044780 /* @ECU_Address@EIP_bErrDecCrsCtrlBtnOvs_P@ */ Scalar_BOOLEAN 0 EcuIntgdSwGend_CM_boolean 0.0 1.0 /end CHARACTERISTIC
/begin CHARACTERISTIC EIP_bErrDecCrsCtrlBtnOvv_P "Error Cruise Control Decrement Button - Override Value Parameter" VALUE 0x40044784 /* @ECU_Address@EIP_bErrDecCrsCtrlBtnOvv_P@ */ Scalar_BOOLEAN 0 EcuIntgdSwGend_CM_boolean 0.0 1.0 /end CHARACTERISTIC
/begin CHARACTERISTIC EIP_bErrDecSpdLimrBtnOvs_P "" VALUE 0x40044788 /* @ECU_Address@EIP_bErrDecSpdLimrBtnOvs_P@ */ Scalar_BOOLEAN 0 EcuIntgdSwGend_CM_boolean 0.0 1.0 /end CHARACTERISTIC
/begin CHARACTERISTIC EIP_bErrDecSpdLimrBtnOvv_P "" VALUE 0x4004478C /* @ECU_Address@EIP_bErrDecSpdLimrBtnOvv_P@ */ Scalar_BOOLEAN 0 EcuIntgdSwGend_CM_boolean 0.0 1.0 /end CHARACTERISTIC
/begin CHARACTERISTIC EIP_bErrEngBrkReq1BtnOvs_P "Error Engine Brake Request 1 Switch  - Override Switch Parameter" VALUE 0x40044790 /* @ECU_Address@EIP_bErrEngBrkReq1BtnOvs_P@ */ Scalar_BOOLEAN 0 EcuIntgdSwGend_CM_boolean 0.0 1.0 /end CHARACTERISTIC
/begin CHARACTERISTIC EIP_bErrEngBrkReq1BtnOvv_P "Error Engine Brake Request 1 Switch - Override Value Parameter" VALUE 0x40044794 /* @ECU_Address@EIP_bErrEngBrkReq1BtnOvv_P@ */ Scalar_BOOLEAN 0 EcuIntgdSwGend_CM_boolean 0.0 1.0 /end CHARACTERISTIC
/begin CHARACTERISTIC EIP_bErrEngBrkReq2BtnOvs_P "Error Engine Brake Request 2 Switch - Override Switch Parameter" VALUE 0x40044798 /* @ECU_Address@EIP_bErrEngBrkReq2BtnOvs_P@ */ Scalar_BOOLEAN 0 EcuIntgdSwGend_CM_boolean 0.0 1.0 /end CHARACTERISTIC
/begin CHARACTERISTIC EIP_bErrEngBrkReq2BtnOvv_P "Engine Brake Request 2 - Override Value" VALUE 0x4004479C /* @ECU_Address@EIP_bErrEngBrkReq2BtnOvv_P@ */ Scalar_BOOLEAN 0 EcuIntgdSwGend_CM_boolean 0.0 1.0 /end CHARACTERISTIC
/begin CHARACTERISTIC EIP_bErrGridHeatrOvs_P "Error Grid Heater - Override Switch Parameter" VALUE 0x400447A0 /* @ECU_Address@EIP_bErrGridHeatrOvs_P@ */ Scalar_BOOLEAN 0 EcuIntgdSwGend_CM_boolean 0.0 1.0 /end CHARACTERISTIC
/begin CHARACTERISTIC EIP_bErrGridHeatrOvv_P "Error Grid Heater - Override Value Parameter" VALUE 0x400447A4 /* @ECU_Address@EIP_bErrGridHeatrOvv_P@ */ Scalar_BOOLEAN 0 EcuIntgdSwGend_CM_boolean 0.0 1.0 /end CHARACTERISTIC
/begin CHARACTERISTIC EIP_bErrHndBrkPrkgOvs_P "Engine Input Processing - Hand Brake Parking Switch Error - Override Switch Parameter" VALUE 0x400447A8 /* @ECU_Address@EIP_bErrHndBrkPrkgOvs_P@ */ Scalar_BOOLEAN 0 EcuIntgdSwGend_CM_boolean 0.0 1.0 /end CHARACTERISTIC
/begin CHARACTERISTIC EIP_bErrHndBrkPrkgOvv_P "Engine Input Processing - Hand Brake Parking Switch Error - Override Value Parameter" VALUE 0x400447AC /* @ECU_Address@EIP_bErrHndBrkPrkgOvv_P@ */ Scalar_BOOLEAN 0 EcuIntgdSwGend_CM_boolean 0.0 1.0 /end CHARACTERISTIC
/begin CHARACTERISTIC EIP_bErrIgnSwtOvv_P "Error Ignition Switch - Override Switch Parameter" VALUE 0x400447B0 /* @ECU_Address@EIP_bErrIgnSwtOvv_P@ */ Scalar_BOOLEAN 0 EcuIntgdSwGend_CM_boolean 0.0 1.0 /end CHARACTERISTIC
/begin CHARACTERISTIC EIP_bErrIgnSwtSwtOvs_P "Error Ignition Switch - Override Value Parameter" VALUE 0x400447B4 /* @ECU_Address@EIP_bErrIgnSwtSwtOvs_P@ */ Scalar_BOOLEAN 0 EcuIntgdSwGend_CM_boolean 0.0 1.0 /end CHARACTERISTIC
/begin CHARACTERISTIC EIP_bErrIncCrsCtrlBtnOvs_P "Error Cruise Control Increment Button - Override Switch Parameter" VALUE 0x400447B8 /* @ECU_Address@EIP_bErrIncCrsCtrlBtnOvs_P@ */ Scalar_BOOLEAN 0 EcuIntgdSwGend_CM_boolean 0.0 1.0 /end CHARACTERISTIC
/begin CHARACTERISTIC EIP_bErrIncCrsCtrlBtnOvv_P "Error Cruise Control Increment Button - Override Value Parameter" VALUE 0x400447BC /* @ECU_Address@EIP_bErrIncCrsCtrlBtnOvv_P@ */ Scalar_BOOLEAN 0 EcuIntgdSwGend_CM_boolean 0.0 1.0 /end CHARACTERISTIC
/begin CHARACTERISTIC EIP_bErrInctSpdLimrBtnOvs_P "" VALUE 0x400447C0 /* @ECU_Address@EIP_bErrInctSpdLimrBtnOvs_P@ */ Scalar_BOOLEAN 0 EcuIntgdSwGend_CM_boolean 0.0 1.0 /end CHARACTERISTIC
/begin CHARACTERISTIC EIP_bErrInctSpdLimrBtnOvv_P "" VALUE 0x400447C4 /* @ECU_Address@EIP_bErrInctSpdLimrBtnOvv_P@ */ Scalar_BOOLEAN 0 EcuIntgdSwGend_CM_boolean 0.0 1.0 /end CHARACTERISTIC
/begin CHARACTERISTIC EIP_bErrInjr1Ovs_P "Error Injector 1 - Override Switch Parameter" VALUE 0x400447C8 /* @ECU_Address@EIP_bErrInjr1Ovs_P@ */ Scalar_BOOLEAN 0 EcuIntgdSwGend_CM_boolean 0.0 1.0 /end CHARACTERISTIC
/begin CHARACTERISTIC EIP_bErrInjr1Ovv_P "Error Injector 1 - Override Value Parameter" VALUE 0x400447CC /* @ECU_Address@EIP_bErrInjr1Ovv_P@ */ Scalar_BOOLEAN 0 EcuIntgdSwGend_CM_boolean 0.0 1.0 /end CHARACTERISTIC
/begin CHARACTERISTIC EIP_bErrInjr2Ovs_P "Error Injector 2 - Override Switch Parameter" VALUE 0x400447D0 /* @ECU_Address@EIP_bErrInjr2Ovs_P@ */ Scalar_BOOLEAN 0 EcuIntgdSwGend_CM_boolean 0.0 1.0 /end CHARACTERISTIC
/begin CHARACTERISTIC EIP_bErrInjr2Ovv_P "Error Injector 2 - Override Value Parameter" VALUE 0x400447D4 /* @ECU_Address@EIP_bErrInjr2Ovv_P@ */ Scalar_BOOLEAN 0 EcuIntgdSwGend_CM_boolean 0.0 1.0 /end CHARACTERISTIC
/begin CHARACTERISTIC EIP_bErrInjr3Ovs_P "Error Injector 3 - Override Switch Parameter" VALUE 0x400447D8 /* @ECU_Address@EIP_bErrInjr3Ovs_P@ */ Scalar_BOOLEAN 0 EcuIntgdSwGend_CM_boolean 0.0 1.0 /end CHARACTERISTIC
/begin CHARACTERISTIC EIP_bErrInjr3Ovv_P "Error Injector 3 - Override Value Parameter" VALUE 0x400447DC /* @ECU_Address@EIP_bErrInjr3Ovv_P@ */ Scalar_BOOLEAN 0 EcuIntgdSwGend_CM_boolean 0.0 1.0 /end CHARACTERISTIC
/begin CHARACTERISTIC EIP_bErrInjr4Ovs_P "Error Injector 4 - Override Switch Parameter" VALUE 0x400447E0 /* @ECU_Address@EIP_bErrInjr4Ovs_P@ */ Scalar_BOOLEAN 0 EcuIntgdSwGend_CM_boolean 0.0 1.0 /end CHARACTERISTIC
/begin CHARACTERISTIC EIP_bErrInjr4Ovv_P "Error Injector 4 - Override Value Parameter" VALUE 0x400447E4 /* @ECU_Address@EIP_bErrInjr4Ovv_P@ */ Scalar_BOOLEAN 0 EcuIntgdSwGend_CM_boolean 0.0 1.0 /end CHARACTERISTIC
/begin CHARACTERISTIC EIP_bErrInjr5Ovs_P "Error Injector 5 - Override Switch Parameter" VALUE 0x400447E8 /* @ECU_Address@EIP_bErrInjr5Ovs_P@ */ Scalar_BOOLEAN 0 EcuIntgdSwGend_CM_boolean 0.0 1.0 /end CHARACTERISTIC
/begin CHARACTERISTIC EIP_bErrInjr5Ovv_P "Error Injector 5 - Override Value Parameter" VALUE 0x400447EC /* @ECU_Address@EIP_bErrInjr5Ovv_P@ */ Scalar_BOOLEAN 0 EcuIntgdSwGend_CM_boolean 0.0 1.0 /end CHARACTERISTIC
/begin CHARACTERISTIC EIP_bErrInjr6Ovs_P "Error Injector 6 - Override Switch Parameter" VALUE 0x400447F0 /* @ECU_Address@EIP_bErrInjr6Ovs_P@ */ Scalar_BOOLEAN 0 EcuIntgdSwGend_CM_boolean 0.0 1.0 /end CHARACTERISTIC
/begin CHARACTERISTIC EIP_bErrInjr6Ovv_P "Error Injector 6 - Override Value Parameter" VALUE 0x400447F4 /* @ECU_Address@EIP_bErrInjr6Ovv_P@ */ Scalar_BOOLEAN 0 EcuIntgdSwGend_CM_boolean 0.0 1.0 /end CHARACTERISTIC
/begin CHARACTERISTIC EIP_bErrPCVOvs_P "Error PCV - Override Switch Parameter" VALUE 0x40044810 /* @ECU_Address@EIP_bErrPCVOvs_P@ */ Scalar_BOOLEAN 0 EcuIntgdSwGend_CM_boolean 0.0 1.0 /end CHARACTERISTIC
/begin CHARACTERISTIC EIP_bErrPCVOvv_P "Error PCV - Override Value Parameter" VALUE 0x40044814 /* @ECU_Address@EIP_bErrPCVOvv_P@ */ Scalar_BOOLEAN 0 EcuIntgdSwGend_CM_boolean 0.0 1.0 /end CHARACTERISTIC
/begin CHARACTERISTIC EIP_bErrPtoOnOffBtnOvs_P "Power Take Off On Off Error Button - Override Switch Parameter" VALUE 0x40044830 /* @ECU_Address@EIP_bErrPtoOnOffBtnOvs_P@ */ Scalar_BOOLEAN 0 EcuIntgdSwGend_CM_boolean 0.0 1.0 /end CHARACTERISTIC
/begin CHARACTERISTIC EIP_bErrPtoOnOffBtnOvv_P "Power Take Off On Off Error Button - Override Value Parameter" VALUE 0x40044834 /* @ECU_Address@EIP_bErrPtoOnOffBtnOvv_P@ */ Scalar_BOOLEAN 0 EcuIntgdSwGend_CM_boolean 0.0 1.0 /end CHARACTERISTIC
/begin CHARACTERISTIC EIP_bErrPtoResuBtnOvs_P "Error Pto Resume Button - Override Switch Parameter" VALUE 0x40044838 /* @ECU_Address@EIP_bErrPtoResuBtnOvs_P@ */ Scalar_BOOLEAN 0 EcuIntgdSwGend_CM_boolean 0.0 1.0 /end CHARACTERISTIC
/begin CHARACTERISTIC EIP_bErrPtoResuBtnOvv_P "Error Pto Resume Button - Override Value Parameter" VALUE 0x4004483C /* @ECU_Address@EIP_bErrPtoResuBtnOvv_P@ */ Scalar_BOOLEAN 0 EcuIntgdSwGend_CM_boolean 0.0 1.0 /end CHARACTERISTIC
/begin CHARACTERISTIC EIP_bErrPtoSetBtnOvs_P "Error Pto Set Button - Override Value Parameter" VALUE 0x40044840 /* @ECU_Address@EIP_bErrPtoSetBtnOvs_P@ */ Scalar_BOOLEAN 0 EcuIntgdSwGend_CM_boolean 0.0 1.0 /end CHARACTERISTIC
/begin CHARACTERISTIC EIP_bErrPtoSetBtnOvv_P "Error Pto Set Button - Override Value Parameter" VALUE 0x40044844 /* @ECU_Address@EIP_bErrPtoSetBtnOvv_P@ */ Scalar_BOOLEAN 0 EcuIntgdSwGend_CM_boolean 0.0 1.0 /end CHARACTERISTIC
/begin CHARACTERISTIC EIP_bErrSpdLimrOnOffBtnOvs_P "" VALUE 0x40044848 /* @ECU_Address@EIP_bErrSpdLimrOnOffBtnOvs_P@ */ Scalar_BOOLEAN 0 EcuIntgdSwGend_CM_boolean 0.0 1.0 /end CHARACTERISTIC
/begin CHARACTERISTIC EIP_bErrSpdLimrOnOffBtnOvv_P "" VALUE 0x4004484C /* @ECU_Address@EIP_bErrSpdLimrOnOffBtnOvv_P@ */ Scalar_BOOLEAN 0 EcuIntgdSwGend_CM_boolean 0.0 1.0 /end CHARACTERISTIC
/begin CHARACTERISTIC EIP_bErrStrtReqSwtOvs_P "Error Start Request Switch - Override Value Parameter" VALUE 0x40044850 /* @ECU_Address@EIP_bErrStrtReqSwtOvs_P@ */ Scalar_BOOLEAN 0 EcuIntgdSwGend_CM_boolean 0.0 1.0 /end CHARACTERISTIC
/begin CHARACTERISTIC EIP_bErrStrtReqSwtOvv_P "Error Start Request Switch - Override Value Parameter" VALUE 0x40044854 /* @ECU_Address@EIP_bErrStrtReqSwtOvv_P@ */ Scalar_BOOLEAN 0 EcuIntgdSwGend_CM_boolean 0.0 1.0 /end CHARACTERISTIC
/begin CHARACTERISTIC EIP_bErrTroublesootingBtnOvs_P "Error Troublesooting Button - Override Switch Parameter" VALUE 0x40044888 /* @ECU_Address@EIP_bErrTroublesootingBtnOvs_P@ */ Scalar_BOOLEAN 0 EcuIntgdSwGend_CM_boolean 0.0 1.0 /end CHARACTERISTIC
/begin CHARACTERISTIC EIP_bErrTroublesootingBtnOvv_P "Error Troublesooting Button - Override Value Parameter" VALUE 0x4004488C /* @ECU_Address@EIP_bErrTroublesootingBtnOvv_P@ */ Scalar_BOOLEAN 0 EcuIntgdSwGend_CM_boolean 0.0 1.0 /end CHARACTERISTIC
/begin CHARACTERISTIC EIP_bErrUClmp30SnsrOvs_P "Error Battery Voltage Sensor - Override Switch Parameter" VALUE 0x40044890 /* @ECU_Address@EIP_bErrUClmp30SnsrOvs_P@ */ Scalar_BOOLEAN 0 EcuIntgdSwGend_CM_boolean 0.0 1.0 /end CHARACTERISTIC
/begin CHARACTERISTIC EIP_bErrUClmp30SnsrOvv_P "Error Battery Voltage Sensor - Override Value Parameter" VALUE 0x40044894 /* @ECU_Address@EIP_bErrUClmp30SnsrOvv_P@ */ Scalar_BOOLEAN 0 EcuIntgdSwGend_CM_boolean 0.0 1.0 /end CHARACTERISTIC
/begin CHARACTERISTIC EIP_bErrVCVOvs_P "Error VCV - Override Switch Parameter" VALUE 0x40044898 /* @ECU_Address@EIP_bErrVCVOvs_P@ */ Scalar_BOOLEAN 0 EcuIntgdSwGend_CM_boolean 0.0 1.0 /end CHARACTERISTIC
/begin CHARACTERISTIC EIP_bErrVCVOvv_P "Error VCV - Override Value Parameter" VALUE 0x4004489C /* @ECU_Address@EIP_bErrVCVOvv_P@ */ Scalar_BOOLEAN 0 EcuIntgdSwGend_CM_boolean 0.0 1.0 /end CHARACTERISTIC
/begin CHARACTERISTIC EIP_bErrWgOvs_P "Error Wastegate - Override Switch Parameter" VALUE 0x400448A0 /* @ECU_Address@EIP_bErrWgOvs_P@ */ Scalar_BOOLEAN 0 EcuIntgdSwGend_CM_boolean 0.0 1.0 /end CHARACTERISTIC
/begin CHARACTERISTIC EIP_bErrWgOvv_P "Error Wastegate - Override Value Parameter" VALUE 0x400448A4 /* @ECU_Address@EIP_bErrWgOvv_P@ */ Scalar_BOOLEAN 0 EcuIntgdSwGend_CM_boolean 0.0 1.0 /end CHARACTERISTIC
/begin CHARACTERISTIC EIP_bIgnSwtOvs_P "Ignition Switch - Override Switch Parameter" VALUE 0x400448A8 /* @ECU_Address@EIP_bIgnSwtOvs_P@ */ Scalar_BOOLEAN 0 EcuIntgdSwGend_CM_boolean 0.0 1.0 /end CHARACTERISTIC
/begin CHARACTERISTIC EIP_bIgnSwtOvv_P "Ignition Switch - Override Value Parameter" VALUE 0x400448AC /* @ECU_Address@EIP_bIgnSwtOvv_P@ */ Scalar_BOOLEAN 0 EcuIntgdSwGend_CM_boolean 0.0 1.0 /end CHARACTERISTIC
/begin CHARACTERISTIC EIP_bIncCrsCtrlBtnOvs_P "Cruise Control Increment Button - Override Switch Parameter" VALUE 0x400448B0 /* @ECU_Address@EIP_bIncCrsCtrlBtnOvs_P@ */ Scalar_BOOLEAN 0 EcuIntgdSwGend_CM_boolean 0.0 1.0 /end CHARACTERISTIC
/begin CHARACTERISTIC EIP_bIncCrsCtrlBtnOvv_P "Cruise Control Increment Button - Override Value Parameter" VALUE 0x400448B4 /* @ECU_Address@EIP_bIncCrsCtrlBtnOvv_P@ */ Scalar_BOOLEAN 0 EcuIntgdSwGend_CM_boolean 0.0 1.0 /end CHARACTERISTIC
/begin CHARACTERISTIC EIP_bInctSpdLimrBtnOvs_P "" VALUE 0x400448B8 /* @ECU_Address@EIP_bInctSpdLimrBtnOvs_P@ */ Scalar_BOOLEAN 0 EcuIntgdSwGend_CM_boolean 0.0 1.0 /end CHARACTERISTIC
/begin CHARACTERISTIC EIP_bInctSpdLimrBtnOvv_P "" VALUE 0x400448BC /* @ECU_Address@EIP_bInctSpdLimrBtnOvv_P@ */ Scalar_BOOLEAN 0 EcuIntgdSwGend_CM_boolean 0.0 1.0 /end CHARACTERISTIC
/begin CHARACTERISTIC EIP_bSpdLimrOnOffBtnOvs_P "" VALUE 0x400448C0 /* @ECU_Address@EIP_bSpdLimrOnOffBtnOvs_P@ */ Scalar_BOOLEAN 0 EcuIntgdSwGend_CM_boolean 0.0 1.0 /end CHARACTERISTIC
/begin CHARACTERISTIC EIP_bSpdLimrOnOffBtnOvv_P "" VALUE 0x400448C4 /* @ECU_Address@EIP_bSpdLimrOnOffBtnOvv_P@ */ Scalar_BOOLEAN 0 EcuIntgdSwGend_CM_boolean 0.0 1.0 /end CHARACTERISTIC
/begin CHARACTERISTIC EIP_bStrtReqSwtOvs_P "Start Request Switch - Override Switch Parameter" VALUE 0x400448C8 /* @ECU_Address@EIP_bStrtReqSwtOvs_P@ */ Scalar_BOOLEAN 0 EcuIntgdSwGend_CM_boolean 0.0 1.0 /end CHARACTERISTIC
/begin CHARACTERISTIC EIP_bStrtReqSwtOvv_P "Start Request Switch - Override Value Parameter" VALUE 0x400448CC /* @ECU_Address@EIP_bStrtReqSwtOvv_P@ */ Scalar_BOOLEAN 0 EcuIntgdSwGend_CM_boolean 0.0 1.0 /end CHARACTERISTIC
/begin CHARACTERISTIC EIP_bTroubleshootingBtnOvs_P "Troubleshooting Button - Override Switch Parameter" VALUE 0x400448D0 /* @ECU_Address@EIP_bTroubleshootingBtnOvs_P@ */ Scalar_BOOLEAN 0 EcuIntgdSwGend_CM_boolean 0.0 1.0 /end CHARACTERISTIC
/begin CHARACTERISTIC EIP_bTroubleshootingBtnOvv_P "Troubleshooting Button - Override Value Parameter" VALUE 0x400448D4 /* @ECU_Address@EIP_bTroubleshootingBtnOvv_P@ */ Scalar_BOOLEAN 0 EcuIntgdSwGend_CM_boolean 0.0 1.0 /end CHARACTERISTIC
/begin CHARACTERISTIC EMS_DynoModOvs_P "Starter Dyno Mode Override Switch" VALUE 0x400448D8 /* @ECU_Address@EMS_DynoModOvs_P@ */ Scalar_BOOLEAN 0 EcuIntgdSwGend_CM_boolean 0.0 1.0 /end CHARACTERISTIC
/begin CHARACTERISTIC EMS_DynoModOvv_P "Starter Dyno Mode Override Value" VALUE 0x400448DC /* @ECU_Address@EMS_DynoModOvv_P@ */ Scalar_BOOLEAN 0 EcuIntgdSwGend_CM_boolean 0.0 1.0 /end CHARACTERISTIC
/begin CHARACTERISTIC EOP_ActvEngBrkSoln1Ovs_P "" VALUE 0x4004494C /* @ECU_Address@EOP_ActvEngBrkSoln1Ovs_P@ */ Scalar_BOOLEAN 0 EcuIntgdSwGend_CM_boolean 0.0 1.0 /end CHARACTERISTIC
/begin CHARACTERISTIC EOP_ActvEngBrkSoln1Ovv_P "" VALUE 0x40044950 /* @ECU_Address@EOP_ActvEngBrkSoln1Ovv_P@ */ Scalar_BOOLEAN 0 EcuIntgdSwGend_CM_boolean 0.0 1.0 /end CHARACTERISTIC
/begin CHARACTERISTIC EOP_ActvEngBrkSoln2Ovs_P "" VALUE 0x40044954 /* @ECU_Address@EOP_ActvEngBrkSoln2Ovs_P@ */ Scalar_BOOLEAN 0 EcuIntgdSwGend_CM_boolean 0.0 1.0 /end CHARACTERISTIC
/begin CHARACTERISTIC EOP_ActvEngBrkSoln2Ovv_P "" VALUE 0x40044958 /* @ECU_Address@EOP_ActvEngBrkSoln2Ovv_P@ */ Scalar_BOOLEAN 0 EcuIntgdSwGend_CM_boolean 0.0 1.0 /end CHARACTERISTIC
/begin CHARACTERISTIC EOP_AmberWarnLampOvs_P "Amber Warning Lamp (AWL) Override Switch Parameter" VALUE 0x4004495C /* @ECU_Address@EOP_AmberWarnLampOvs_P@ */ Scalar_BOOLEAN 0 EcuIntgdSwGend_CM_boolean 0.0 1.0 /end CHARACTERISTIC
/begin CHARACTERISTIC EOP_AmberWarnLampOvv_P "Amber Warning Lamp (AWL) Override Value Parameter" VALUE 0x40044960 /* @ECU_Address@EOP_AmberWarnLampOvv_P@ */ Scalar_BOOLEAN 0 EcuIntgdSwGend_CM_boolean 0.0 1.0 /end CHARACTERISTIC
/begin CHARACTERISTIC EOP_ColdStrtLampOvs_P "Check System Lamp (CSL) Override Switch Parameter" VALUE 0x40044B5C /* @ECU_Address@EOP_ColdStrtLampOvs_P@ */ Scalar_BOOLEAN 0 EcuIntgdSwGend_CM_boolean 0.0 1.0 /end CHARACTERISTIC
/begin CHARACTERISTIC EOP_ColdStrtLampOvv_P "Check System Lamp (CSL) Override Value Parameter" VALUE 0x40044B60 /* @ECU_Address@EOP_ColdStrtLampOvv_P@ */ Scalar_BOOLEAN 0 EcuIntgdSwGend_CM_boolean 0.0 1.0 /end CHARACTERISTIC
/begin CHARACTERISTIC EOP_RedStopLampOvs_P "Red Stop Lamp (RSL) Override Switch Parameter" VALUE 0x40044CC4 /* @ECU_Address@EOP_RedStopLampOvs_P@ */ Scalar_BOOLEAN 0 EcuIntgdSwGend_CM_boolean 0.0 1.0 /end CHARACTERISTIC
/begin CHARACTERISTIC EOP_RedStopLampOvv_P "Red Stop Lamp (RSL) Override Value Parameter" VALUE 0x40044CC8 /* @ECU_Address@EOP_RedStopLampOvv_P@ */ Scalar_BOOLEAN 0 EcuIntgdSwGend_CM_boolean 0.0 1.0 /end CHARACTERISTIC
/begin CHARACTERISTIC EOP_bAcvGridHeatrOvs_P "Output Processing Grid Heater Activation Override Switch Parameter" VALUE 0x40044D34 /* @ECU_Address@EOP_bAcvGridHeatrOvs_P@ */ Scalar_BOOLEAN 0 EcuIntgdSwGend_CM_boolean 0.0 1.0 /end CHARACTERISTIC
/begin CHARACTERISTIC EOP_bAcvGridHeatrOvv_P "Output Processing Grid Heater Activation Override Value Parameter" VALUE 0x40044D38 /* @ECU_Address@EOP_bAcvGridHeatrOvv_P@ */ Scalar_BOOLEAN 0 EcuIntgdSwGend_CM_boolean 0.0 1.0 /end CHARACTERISTIC
/begin CHARACTERISTIC IC_DurMaiCyl1DeacBalOvs_P "Main Injection Duration Deactivate Balance for Cylinder 1 - Override Switch Parameter" VALUE 0x40044D98 /* @ECU_Address@IC_DurMaiCyl1DeacBalOvs_P@ */ Scalar_BOOLEAN 0 EcuIntgdSwGend_CM_boolean 0.0 1.0 /end CHARACTERISTIC
/begin CHARACTERISTIC IC_DurMaiCyl2DeacBalOvs_P "Main Injection Duration Deactivate Balance for Cylinder 2 - Override Switch Parameter" VALUE 0x40044DA4 /* @ECU_Address@IC_DurMaiCyl2DeacBalOvs_P@ */ Scalar_BOOLEAN 0 EcuIntgdSwGend_CM_boolean 0.0 1.0 /end CHARACTERISTIC
/begin CHARACTERISTIC IC_DurMaiCyl3DeacBalOvs_P "Main Injection Duration Deactivate Balance for Cylinder 3 - Override Switch Parameter" VALUE 0x40044DB0 /* @ECU_Address@IC_DurMaiCyl3DeacBalOvs_P@ */ Scalar_BOOLEAN 0 EcuIntgdSwGend_CM_boolean 0.0 1.0 /end CHARACTERISTIC
/begin CHARACTERISTIC IC_DurMaiCyl4DeacBalOvs_P "Main Injection Duration Deactivate Balance for Cylinder 4 - Override Switch Parameter" VALUE 0x40044DBC /* @ECU_Address@IC_DurMaiCyl4DeacBalOvs_P@ */ Scalar_BOOLEAN 0 EcuIntgdSwGend_CM_boolean 0.0 1.0 /end CHARACTERISTIC
/begin CHARACTERISTIC IC_DurMaiCyl5DeacBalOvs_P "Main Injection Duration Deactivate Balance for Cylinder 5 - Override Switch Parameter" VALUE 0x40044DC8 /* @ECU_Address@IC_DurMaiCyl5DeacBalOvs_P@ */ Scalar_BOOLEAN 0 EcuIntgdSwGend_CM_boolean 0.0 1.0 /end CHARACTERISTIC
/begin CHARACTERISTIC IC_DurMaiCyl6DeacBalOvs_P "Main Injection Duration Deactivate Balance for Cylinder 6 - Override Switch Parameter" VALUE 0x40044DD4 /* @ECU_Address@IC_DurMaiCyl6DeacBalOvs_P@ */ Scalar_BOOLEAN 0 EcuIntgdSwGend_CM_boolean 0.0 1.0 /end CHARACTERISTIC
/begin CHARACTERISTIC IC_MTotFuQntyCorrdOvs_P "Corrected Total Fuel Quantity Mass - Override Switch Parameter" VALUE 0x40045BF4 /* @ECU_Address@IC_MTotFuQntyCorrdOvs_P@ */ Scalar_BOOLEAN 0 EcuIntgdSwGend_CM_boolean 0.0 1.0 /end CHARACTERISTIC
/begin CHARACTERISTIC PtoCtrl_bAcvLimpOvs_P "Limp Mode Active Override Value Switch" VALUE 0x40048F9C /* @ECU_Address@PtoCtrl_bAcvLimpOvs_P@ */ Scalar_BOOLEAN 0 EcuIntgdSwGend_CM_boolean 0.0 1.0 /end CHARACTERISTIC
/begin CHARACTERISTIC PtoCtrl_bAcvRednLvl1Ovs_P "Reduction Level 1 - Override Switch" VALUE 0x40048FA0 /* @ECU_Address@PtoCtrl_bAcvRednLvl1Ovs_P@ */ Scalar_BOOLEAN 0 EcuIntgdSwGend_CM_boolean 0.0 1.0 /end CHARACTERISTIC
/begin CHARACTERISTIC PtoCtrl_bAcvRednLvl2Ovs_P "Reduction Level 2 Active Override Value Switch" VALUE 0x40048FA4 /* @ECU_Address@PtoCtrl_bAcvRednLvl2Ovs_P@ */ Scalar_BOOLEAN 0 EcuIntgdSwGend_CM_boolean 0.0 1.0 /end CHARACTERISTIC
/begin CHARACTERISTIC RPG_PRailRefOvs_P "Reference Rail Pressure - Override Switch Parameter" VALUE 0x4004997C /* @ECU_Address@RPG_PRailRefOvs_P@ */ Scalar_BOOLEAN 0 EcuIntgdSwGend_CM_boolean 0.0 1.0 /end CHARACTERISTIC
/begin MEASUREMENT INP_bAcvCmbtSwt "Combat Switch" UBYTE EcuIntgdSwGend_CM_boolean 0 0 0.0 1.0 ECU_ADDRESS 0x4000D73C /* @ECU_Address@INP_bAcvCmbtSwt@ */ /end MEASUREMENT
/begin MEASUREMENT INP_bStrtReqSwt "Starter Request Switch" UBYTE EcuIntgdSwGend_CM_boolean 0 0 0.0 1.0 ECU_ADDRESS 0x4000DC6C /* @ECU_Address@INP_bStrtReqSwt@ */ /end MEASUREMENT
/begin MEASUREMENT INP_IgnSwtU "Ignition Switch Voltage Input" FLOAT32_IEEE EcuIntgdSwGend_CM_single_V 0 0 0.0 50.0 ECU_ADDRESS 0x4000E320 /* @ECU_Address@INP_IgnSwtU@ */ /end MEASUREMENT
/begin MEASUREMENT INP_bBrkPedl "Brake Pedal" UBYTE EcuIntgdSwGend_CM_boolean 0 0 0.0 1.0 ECU_ADDRESS 0x4000D720 /* @ECU_Address@INP_bBrkPedl@ */ /end MEASUREMENT
/begin MEASUREMENT INP_NEng "Engine Speed" FLOAT32_IEEE EcuIntgdSwGend_CM_single_rpm 0 0 0.0 4000.0 ECU_ADDRESS 0x4000DEB8 /* @ECU_Address@INP_NEng@ */ /end MEASUREMENT
/begin MEASUREMENT INP_bErrCamsftSnsr "Camshaft Sensor Error Signal" UBYTE EcuIntgdSwGend_CM_boolean 0 0 0.0 1.0 ECU_ADDRESS 0x4000DF51 /* @ECU_Address@INP_bErrCamsftSnsr@ */ /end MEASUREMENT
/begin MEASUREMENT INP_bErrCrnksftSnsr "Crankshaft Sensor Error Signal" UBYTE EcuIntgdSwGend_CM_boolean 0 0 0.0 1.0 ECU_ADDRESS 0x4000DEEF /* @ECU_Address@INP_bErrCrnksftSnsr@ */ /end MEASUREMENT
/begin MEASUREMENT INP_PercgAccr1 "Percentage Accelerator Pedal 1" FLOAT32_IEEE EcuIntgdSwGend_CM_single__ 0 0 0.0 100.0 ECU_ADDRESS 0x4000E0FC /* @ECU_Address@INP_PercgAccr1@ */ /end MEASUREMENT
/begin MEASUREMENT INP_PercgAccr2 "Percentage Accelerator Pedal 2" FLOAT32_IEEE EcuIntgdSwGend_CM_single__ 0 0 0.0 100.0 ECU_ADDRESS 0x4000DD10 /* @ECU_Address@INP_PercgAccr2@ */ /end MEASUREMENT
/begin MEASUREMENT INP_bErrAccrSnsr1 "Accelerator Pedal 1 Error Signal" UBYTE EcuIntgdSwGend_CM_boolean 0 0 0.0 1.0 ECU_ADDRESS 0x4000DE6C /* @ECU_Address@INP_bErrAccrSnsr1@ */ /end MEASUREMENT
/begin MEASUREMENT INP_bErrAccrSnsr2 "Accelerator Pedal 2 Error Signal" UBYTE EcuIntgdSwGend_CM_boolean 0 0 0.0 1.0 ECU_ADDRESS 0x4000E33C /* @ECU_Address@INP_bErrAccrSnsr2@ */ /end MEASUREMENT
/begin MEASUREMENT INP_LvlOil "Oil Level Sensor" FLOAT32_IEEE EcuIntgdSwGend_CM_single__ 0 0 0.0 100.0 ECU_ADDRESS 0x4000E18C /* @ECU_Address@INP_LvlOil@ */ /end MEASUREMENT
/begin MEASUREMENT INP_bErrLvlOilSnsr "Oil Level Sensor Error Signal" UBYTE EcuIntgdSwGend_CM_boolean 0 0 0.0 1.0 ECU_ADDRESS 0x4000DA96 /* @ECU_Address@INP_bErrLvlOilSnsr@ */ /end MEASUREMENT
/begin MEASUREMENT INP_PAmbAir "Ambient Air Pressure" FLOAT32_IEEE EcuIntgdSwGend_CM_single_bar 0 0 0.0 10.0 ECU_ADDRESS 0x4000D86C /* @ECU_Address@INP_PAmbAir@ */ /end MEASUREMENT
/begin MEASUREMENT INP_PFu "Fuel Pressure" FLOAT32_IEEE EcuIntgdSwGend_CM_single_bar 0 0 0.0 10.0 ECU_ADDRESS 0x4000DFF8 /* @ECU_Address@INP_PFu@ */ /end MEASUREMENT
/begin MEASUREMENT INP_POil "Oil Pressure" FLOAT32_IEEE EcuIntgdSwGend_CM_single_bar 0 0 0.0 10.0 ECU_ADDRESS 0x4000E610 /* @ECU_Address@INP_POil@ */ /end MEASUREMENT
/begin MEASUREMENT INP_PAirBoost "Air Boost Pressure" FLOAT32_IEEE EcuIntgdSwGend_CM_single_bar 0 0 0.0 10.0 ECU_ADDRESS 0x4000DD94 /* @ECU_Address@INP_PAirBoost@ */ /end MEASUREMENT
/begin MEASUREMENT INP_PRail "Rail Pressure" FLOAT32_IEEE EcuIntgdSwGend_CM_single_bar 0 0 0.0 15.0 ECU_ADDRESS 0x4000E458 /* @ECU_Address@INP_PRail@ */ /end MEASUREMENT
/begin MEASUREMENT INP_bErrPRailSnsr "Rail Pressure Sensor Error Signal" UBYTE EcuIntgdSwGend_CM_boolean 0 0 0.0 1.0 ECU_ADDRESS 0x4000DFA7 /* @ECU_Address@INP_bErrPRailSnsr@ */ /end MEASUREMENT
/begin MEASUREMENT INP_bErrPAirBoostSnsr "Airboost Pressure Sensor Error Signal" UBYTE EcuIntgdSwGend_CM_boolean 0 0 0.0 1.0 ECU_ADDRESS 0x4000D934 /* @ECU_Address@INP_bErrPAirBoostSnsr@ */ /end MEASUREMENT
/begin MEASUREMENT INP_TOil "Oil Temperature" FLOAT32_IEEE EcuIntgdSwGend_CM_single_degC 0 0 -50.0 250.0 ECU_ADDRESS 0x4000E66C /* @ECU_Address@INP_TOil@ */ /end MEASUREMENT
/begin MEASUREMENT INP_TCoolt "Coolant Temperature" FLOAT32_IEEE EcuIntgdSwGend_CM_single_degC 0 0 -50.0 250.0 ECU_ADDRESS 0x4000E440 /* @ECU_Address@INP_TCoolt@ */ /end MEASUREMENT
/begin MEASUREMENT INP_TAmbAir "Ambient Air Temperature" FLOAT32_IEEE EcuIntgdSwGend_CM_single_degC 0 0 -50.0 250.0 ECU_ADDRESS 0x4000DF38 /* @ECU_Address@INP_TAmbAir@ */ /end MEASUREMENT
/begin MEASUREMENT INP_TEcu "ECU Temperature" FLOAT32_IEEE EcuIntgdSwGend_CM_single_degC 0 0 -50.0 250.0 ECU_ADDRESS 0x4000E2A4 /* @ECU_Address@INP_TEcu@ */ /end MEASUREMENT
/begin MEASUREMENT INP_TFu "Fuel Temperature" FLOAT32_IEEE EcuIntgdSwGend_CM_single_degC 0 0 -50.0 250.0 ECU_ADDRESS 0x4000DC70 /* @ECU_Address@INP_TFu@ */ /end MEASUREMENT
/begin MEASUREMENT INP_TAirBoost "Air Boost Temperature" FLOAT32_IEEE EcuIntgdSwGend_CM_single_degC 0 0 -50.0 250.0 ECU_ADDRESS 0x4000E210 /* @ECU_Address@INP_TAirBoost@ */ /end MEASUREMENT
/begin MEASUREMENT INP_bErrTCooltSnsr "Coolant Temperature Sensor Error Signal" UBYTE EcuIntgdSwGend_CM_boolean 0 0 0.0 1.0 ECU_ADDRESS 0x4000E066 /* @ECU_Address@INP_bErrTCooltSnsr@ */ /end MEASUREMENT
/begin MEASUREMENT INP_bErrTAirBoostSnsr "Airboost Temperature Sensor Error Signal" UBYTE EcuIntgdSwGend_CM_boolean 0 0 0.0 1.0 ECU_ADDRESS 0x4000E6E9 /* @ECU_Address@INP_bErrTAirBoostSnsr@ */ /end MEASUREMENT
/begin MEASUREMENT INP_bErrTEcuSnsr "ECU Temperature Sensor Error Signal" UBYTE EcuIntgdSwGend_CM_boolean 0 0 0.0 1.0 ECU_ADDRESS 0x4000DA88 /* @ECU_Address@INP_bErrTEcuSnsr@ */ /end MEASUREMENT
/begin MEASUREMENT INP_bErrTFuSnsr "Fuel Temperature Sensor Error Signal" UBYTE EcuIntgdSwGend_CM_boolean 0 0 0.0 1.0 ECU_ADDRESS 0x4000DBE8 /* @ECU_Address@INP_bErrTFuSnsr@ */ /end MEASUREMENT
/begin MEASUREMENT INP_bErrTOilSnsr "Oil Temperature Sensor Error Signal" UBYTE EcuIntgdSwGend_CM_boolean 0 0 0.0 1.0 ECU_ADDRESS 0x4000DA7C /* @ECU_Address@INP_bErrTOilSnsr@ */ /end MEASUREMENT
/begin MEASUREMENT INP_bErrPOilSnsr "Oil Pressure Sensor Error Signal" UBYTE EcuIntgdSwGend_CM_boolean 0 0 0.0 1.0 ECU_ADDRESS 0x4000DC08 /* @ECU_Address@INP_bErrPOilSnsr@ */ /end MEASUREMENT
/begin MEASUREMENT INP_bErrPFuSnsr "Fuel Pressure Sensor Error Signal" UBYTE EcuIntgdSwGend_CM_boolean 0 0 0.0 1.0 ECU_ADDRESS 0x4000D849 /* @ECU_Address@INP_bErrPFuSnsr@ */ /end MEASUREMENT
/begin MEASUREMENT INP_bErrPAmbAirSnsr "Ambient Pressure Sensor Error Signal" UBYTE EcuIntgdSwGend_CM_boolean 0 0 0.0 1.0 ECU_ADDRESS 0x4000E2CB /* @ECU_Address@INP_bErrPAmbAirSnsr@ */ /end MEASUREMENT
/begin MEASUREMENT INP_bCrsCtrlOnOffBtn "Cruise Control On-Off Button" UBYTE EcuIntgdSwGend_CM_boolean 0 0 0.0 1.0 ECU_ADDRESS 0x4000DB3C /* @ECU_Address@INP_bCrsCtrlOnOffBtn@ */ /end MEASUREMENT
/begin MEASUREMENT INP_bDecCrsCtrlBtn "Cruise Control Resume Button" UBYTE EcuIntgdSwGend_CM_boolean 0 0 0.0 1.0 ECU_ADDRESS 0x4000DBA0 /* @ECU_Address@INP_bDecCrsCtrlBtn@ */ /end MEASUREMENT
/begin MEASUREMENT INP_bErrGridHeatr "Grid Heater Relay Error Signal" UBYTE EcuIntgdSwGend_CM_boolean 0 0 0.0 1.0 ECU_ADDRESS 0x4000DDB5 /* @ECU_Address@INP_bErrGridHeatr@ */ /end MEASUREMENT
/begin MEASUREMENT INP_bErrVCV "Volume Control Valve Actuator Error Signal" UBYTE EcuIntgdSwGend_CM_boolean 0 0 0.0 1.0 ECU_ADDRESS 0x4000D7B8 /* @ECU_Address@INP_bErrVCV@ */ /end MEASUREMENT
/begin MEASUREMENT INP_bErrInjr1 "Injector 1  Error Signal" UBYTE EcuIntgdSwGend_CM_boolean 0 0 0.0 1.0 ECU_ADDRESS 0x4000DD14 /* @ECU_Address@INP_bErrInjr1@ */ /end MEASUREMENT
/begin MEASUREMENT INP_bErrInjr2 "Injector 2  Error Signal" UBYTE EcuIntgdSwGend_CM_boolean 0 0 0.0 1.0 ECU_ADDRESS 0x4000DBCD /* @ECU_Address@INP_bErrInjr2@ */ /end MEASUREMENT
/begin MEASUREMENT INP_bErrInjr3 "Injector 3  Error Signal" UBYTE EcuIntgdSwGend_CM_boolean 0 0 0.0 1.0 ECU_ADDRESS 0x4000D8D1 /* @ECU_Address@INP_bErrInjr3@ */ /end MEASUREMENT
/begin MEASUREMENT INP_bErrInjr4 "Injector 4  Error Signal" UBYTE EcuIntgdSwGend_CM_boolean 0 0 0.0 1.0 ECU_ADDRESS 0x4000D8D3 /* @ECU_Address@INP_bErrInjr4@ */ /end MEASUREMENT
/begin MEASUREMENT INP_bErrInjr5 "Injector 5  Error Signal" UBYTE EcuIntgdSwGend_CM_boolean 0 0 0.0 1.0 ECU_ADDRESS 0x4000DA4C /* @ECU_Address@INP_bErrInjr5@ */ /end MEASUREMENT
/begin MEASUREMENT INP_bErrInjr6 "Injector 6  Error Signal" UBYTE EcuIntgdSwGend_CM_boolean 0 0 0.0 1.0 ECU_ADDRESS 0x4000DA58 /* @ECU_Address@INP_bErrInjr6@ */ /end MEASUREMENT
/begin MEASUREMENT INP_MeanDifNEngAndCyl1 "Difference of Cylinder 1 Speed to Mean Engine Speed" FLOAT32_IEEE EcuIntgdSwGend_CM_single_rpm 0 0 0.0 3200.0 ECU_ADDRESS 0x4000E704 /* @ECU_Address@INP_MeanDifNEngAndCyl1@ */ /end MEASUREMENT
/begin MEASUREMENT INP_MeanDifNEngAndCyl2 "Difference of Cylinder 2 Speed to Mean Engine Speed" FLOAT32_IEEE EcuIntgdSwGend_CM_single_rpm 0 0 0.0 3200.0 ECU_ADDRESS 0x4000DE3C /* @ECU_Address@INP_MeanDifNEngAndCyl2@ */ /end MEASUREMENT
/begin MEASUREMENT INP_MeanDifNEngAndCyl3 "Difference of Cylinder 3 Speed to Mean Engine Speed" FLOAT32_IEEE EcuIntgdSwGend_CM_single_rpm 0 0 0.0 3200.0 ECU_ADDRESS 0x4000DBA8 /* @ECU_Address@INP_MeanDifNEngAndCyl3@ */ /end MEASUREMENT
/begin MEASUREMENT INP_MeanDifNEngAndCyl4 "Difference of Cylinder 4 Speed to Mean Engine Speed" FLOAT32_IEEE EcuIntgdSwGend_CM_single_rpm 0 0 0.0 3200.0 ECU_ADDRESS 0x4000DE44 /* @ECU_Address@INP_MeanDifNEngAndCyl4@ */ /end MEASUREMENT
/begin MEASUREMENT INP_MeanDifNEngAndCyl5 "Difference of Cylinder 5 Speed to Mean Engine Speed" FLOAT32_IEEE EcuIntgdSwGend_CM_single_rpm 0 0 0.0 3200.0 ECU_ADDRESS 0x4000D8C4 /* @ECU_Address@INP_MeanDifNEngAndCyl5@ */ /end MEASUREMENT
/begin MEASUREMENT INP_MeanDifNEngAndCyl6 "Difference of Cylinder 6 Speed to Mean Engine Speed" FLOAT32_IEEE EcuIntgdSwGend_CM_single_rpm 0 0 0.0 3200.0 ECU_ADDRESS 0x4000DBB4 /* @ECU_Address@INP_MeanDifNEngAndCyl6@ */ /end MEASUREMENT
/begin MEASUREMENT INP_GridHeatrRlyFb "Grid Heater Relay Voltage Feedback" FLOAT32_IEEE EcuIntgdSwGend_CM_single_V 0 0 0.0 50.0 ECU_ADDRESS 0x4000E554 /* @ECU_Address@INP_GridHeatrRlyFb@ */ /end MEASUREMENT
/begin MEASUREMENT INP_bIncCrsCtrlBtn "Cruise Control Set Button" UBYTE EcuIntgdSwGend_CM_boolean 0 0 0.0 1.0 ECU_ADDRESS 0x4000DB24 /* @ECU_Address@INP_bIncCrsCtrlBtn@ */ /end MEASUREMENT
/begin MEASUREMENT INP_bErrWg "Wastage Actuator Error Signal" UBYTE EcuIntgdSwGend_CM_boolean 0 0 0.0 1.0 ECU_ADDRESS 0x4000D7E8 /* @ECU_Address@INP_bErrWg@ */ /end MEASUREMENT
/begin MEASUREMENT INP_bErrPCV "Pressure Control Valve Actuator Error Signal" UBYTE EcuIntgdSwGend_CM_boolean 0 0 0.0 1.0 ECU_ADDRESS 0x4000DF2C /* @ECU_Address@INP_bErrPCV@ */ /end MEASUREMENT
/begin MEASUREMENT INP_bTroubleshootingBtn "Troubleshooting Button" UBYTE EcuIntgdSwGend_CM_boolean 0 0 0.0 1.0 ECU_ADDRESS 0x4000DE51 /* @ECU_Address@INP_bTroubleshootingBtn@ */ /end MEASUREMENT
/begin MEASUREMENT INP_HndBrkPrkg "Hand Parking Brake" UBYTE EcuIntgdSwGend_CM_boolean 0 0 0.0 1.0 ECU_ADDRESS 0x4000DBF6 /* @ECU_Address@INP_HndBrkPrkg@ */ /end MEASUREMENT
/begin MEASUREMENT INP_bEngBrkReq1Btn "Engine Brake Level 1 Request Button" UBYTE EcuIntgdSwGend_CM_boolean 0 0 0.0 1.0 ECU_ADDRESS 0x4000E3B8 /* @ECU_Address@INP_bEngBrkReq1Btn@ */ /end MEASUREMENT
/begin MEASUREMENT INP_bEngBrkReq2Btn "Engine Brake Level 2 Request Button" UBYTE EcuIntgdSwGend_CM_boolean 0 0 0.0 1.0 ECU_ADDRESS 0x4000E74E /* @ECU_Address@INP_bEngBrkReq2Btn@ */ /end MEASUREMENT
/begin MEASUREMENT INP_bErrStrtReqSwt "Starter Request Switch Error Signal" UBYTE EcuIntgdSwGend_CM_boolean 0 0 0.0 1.0 ECU_ADDRESS 0x4000DB10 /* @ECU_Address@INP_bErrStrtReqSwt@ */ /end MEASUREMENT
/begin MEASUREMENT INP_bErrIgnSwt "Ignition Switch Error Signal" UBYTE EcuIntgdSwGend_CM_boolean 0 0 0.0 1.0 ECU_ADDRESS 0x4000E734 /* @ECU_Address@INP_bErrIgnSwt@ */ /end MEASUREMENT
/begin MEASUREMENT INP_bErrCrsCtrlOnOffBtn "Cruise Control On-Off Button Error Signal" UBYTE EcuIntgdSwGend_CM_boolean 0 0 0.0 1.0 ECU_ADDRESS 0x4000DA49 /* @ECU_Address@INP_bErrCrsCtrlOnOffBtn@ */ /end MEASUREMENT
/begin MEASUREMENT INP_bErrCmbtSwt "Combat Swtich Error Signal" UBYTE EcuIntgdSwGend_CM_boolean 0 0 0.0 1.0 ECU_ADDRESS 0x4000E1E1 /* @ECU_Address@INP_bErrCmbtSwt@ */ /end MEASUREMENT
/begin MEASUREMENT INP_bErrDecCrsCtrlBtn "Cruise Control Resume Button Error Signal" UBYTE EcuIntgdSwGend_CM_boolean 0 0 0.0 1.0 ECU_ADDRESS 0x4000E5B5 /* @ECU_Address@INP_bErrDecCrsCtrlBtn@ */ /end MEASUREMENT
/begin MEASUREMENT INP_bErrIncCrsCtrlBtn "Cruise Control Set Button  Error Signal" UBYTE EcuIntgdSwGend_CM_boolean 0 0 0.0 1.0 ECU_ADDRESS 0x4000E414 /* @ECU_Address@INP_bErrIncCrsCtrlBtn@ */ /end MEASUREMENT
/begin MEASUREMENT INP_bErrTroublesootingBtn "Troubleshooting Button Error Signal" UBYTE EcuIntgdSwGend_CM_boolean 0 0 0.0 1.0 ECU_ADDRESS 0x4000D944 /* @ECU_Address@INP_bErrTroublesootingBtn@ */ /end MEASUREMENT
/begin MEASUREMENT INP_bErrEngBrkReq1Btn "Engine Brake Level 1 Request Button Error Signal" UBYTE EcuIntgdSwGend_CM_boolean 0 0 0.0 1.0 ECU_ADDRESS 0x4000DA4A /* @ECU_Address@INP_bErrEngBrkReq1Btn@ */ /end MEASUREMENT
/begin MEASUREMENT INP_bErrEngBrkReq2Btn "Engine Brake Level 2 Request Button Error Signal" UBYTE EcuIntgdSwGend_CM_boolean 0 0 0.0 1.0 ECU_ADDRESS 0x4000E758 /* @ECU_Address@INP_bErrEngBrkReq2Btn@ */ /end MEASUREMENT
/begin MEASUREMENT INP_NCyl1Min "Cylinder 1 Minimum Speed" FLOAT32_IEEE EcuIntgdSwGend_CM_single_rpm 0 0 0.0 3500.0 ECU_ADDRESS 0x4000DAA0 /* @ECU_Address@INP_NCyl1Min@ */ /end MEASUREMENT
/begin MEASUREMENT INP_NCyl2Min "Cylinder 2 Minimum Speed" FLOAT32_IEEE EcuIntgdSwGend_CM_single_rpm 0 0 0.0 3500.0 ECU_ADDRESS 0x4000DBBC /* @ECU_Address@INP_NCyl2Min@ */ /end MEASUREMENT
/begin MEASUREMENT INP_NCyl3Min "Cylinder 3 Minimum Speed" FLOAT32_IEEE EcuIntgdSwGend_CM_single_rpm 0 0 0.0 3500.0 ECU_ADDRESS 0x4000E180 /* @ECU_Address@INP_NCyl3Min@ */ /end MEASUREMENT
/begin MEASUREMENT INP_NCyl4Min "Cylinder 4 Minimum Speed" FLOAT32_IEEE EcuIntgdSwGend_CM_single_rpm 0 0 0.0 3500.0 ECU_ADDRESS 0x4000DD18 /* @ECU_Address@INP_NCyl4Min@ */ /end MEASUREMENT
/begin MEASUREMENT INP_NCyl5Min "Cylinder 5 Minimum Speed" FLOAT32_IEEE EcuIntgdSwGend_CM_single_rpm 0 0 0.0 3500.0 ECU_ADDRESS 0x4000DAC4 /* @ECU_Address@INP_NCyl5Min@ */ /end MEASUREMENT
/begin MEASUREMENT INP_NCyl6Min "Cylinder 6 Minimum Speed" FLOAT32_IEEE EcuIntgdSwGend_CM_single_rpm 0 0 0.0 3500.0 ECU_ADDRESS 0x4000D788 /* @ECU_Address@INP_NCyl6Min@ */ /end MEASUREMENT
/begin MEASUREMENT INP_NMeaCylMin "Mean Minimum Cylinder Speed" FLOAT32_IEEE EcuIntgdSwGend_CM_single_rpm 0 0 0.0 3200.0 ECU_ADDRESS 0x4000E2D8 /* @ECU_Address@INP_NMeaCylMin@ */ /end MEASUREMENT
/begin MEASUREMENT INP_bErrTAmbAirSnsr "Ambient Air Temperature Sensor Error Signal" UBYTE EcuIntgdSwGend_CM_boolean 0 0 0.0 1.0 ECU_ADDRESS 0x4000DDDC /* @ECU_Address@INP_bErrTAmbAirSnsr@ */ /end MEASUREMENT
/begin MEASUREMENT INP_UClmp30 "Clamp 30 Voltage" FLOAT32_IEEE EcuIntgdSwGend_CM_single_V 0 0 0.0 50.0 ECU_ADDRESS 0x4000DF00 /* @ECU_Address@INP_UClmp30@ */ /end MEASUREMENT
/begin MEASUREMENT INP_CanReqdPercFanSpd "Requested Percent Fan Speed" FLOAT32_IEEE EcuIntgdSwGend_CM_single__ 0 0 0.0 100.0 ECU_ADDRESS 0x4000DAF0 /* @ECU_Address@INP_CanReqdPercFanSpd@ */ /end MEASUREMENT
/begin MEASUREMENT INP_CanTrsmOilLvlReq "Transmission Oil Level Request" UBYTE EcuIntgdSwGend_CM_uint8__ 0 0 0.0 3.0 ECU_ADDRESS 0x4000D858 /* @ECU_Address@INP_CanTrsmOilLvlReq@ */ /end MEASUREMENT
/begin MEASUREMENT INP_CanEngTqLimReqMaxCntns "Engine Torque Limit Request - Maximum Continuous" SBYTE EcuIntgdSwGend_CM_int8__ 0 0 -125.0 125.0 ECU_ADDRESS 0x4000E249 /* @ECU_Address@INP_CanEngTqLimReqMaxCntns@ */ /end MEASUREMENT
/begin MEASUREMENT INP_CanASREngCtrlActv "ASR Engine Control Active" UBYTE EcuIntgdSwGend_CM_uint8 0 0 0.0 3.0 ECU_ADDRESS 0x4000E310 /* @ECU_Address@INP_CanASREngCtrlActv@ */ /end MEASUREMENT
/begin MEASUREMENT INP_CanASRBrkCtrlActv "ASR Brake Control Active" UBYTE EcuIntgdSwGend_CM_uint8 0 0 0.0 3.0 ECU_ADDRESS 0x4000E545 /* @ECU_Address@INP_CanASRBrkCtrlActv@ */ /end MEASUREMENT
/begin MEASUREMENT INP_CanABSActv "Anti-Lock Braking (ABS) Active" UBYTE EcuIntgdSwGend_CM_uint8 0 0 0.0 3.0 ECU_ADDRESS 0x4000E74C /* @ECU_Address@INP_CanABSActv@ */ /end MEASUREMENT
/begin MEASUREMENT INP_CanEngAuxShtdwnSwt "Engine Auxiliary Shutdown Switch" SBYTE EcuIntgdSwGend_CM_int8 0 0 0.0 3.0 ECU_ADDRESS 0x4000E06C /* @ECU_Address@INP_CanEngAuxShtdwnSwt@ */ /end MEASUREMENT
/begin MEASUREMENT INP_CanTrsmEngCrkEna "Transmission Engine Crank Enable" UBYTE EcuIntgdSwGend_CM_uint8 0 0 0.0 3.0 ECU_ADDRESS 0x4000DEEC /* @ECU_Address@INP_CanTrsmEngCrkEna@ */ /end MEASUREMENT
/begin MEASUREMENT INP_CanEstimdEngParasiticTq "Estimated Engine Parasitic Losses" SBYTE EcuIntgdSwGend_CM_int8__ 0 0 -125.0 125.0 ECU_ADDRESS 0x4000E568 /* @ECU_Address@INP_CanEstimdEngParasiticTq@ */ /end MEASUREMENT
/begin MEASUREMENT INP_CanActMaxAvlRtdr "Actual Maximum Available Retarder" SBYTE EcuIntgdSwGend_CM_int8__ 0 0 -125.0 125.0 ECU_ADDRESS 0x4000D8F2 /* @ECU_Address@INP_CanActMaxAvlRtdr@ */ /end MEASUREMENT
/begin MEASUREMENT INP_CanTrsmTqCnvLockUpEngd "Transmission Torque Converter Lockup Engaged" UBYTE EcuIntgdSwGend_CM_uint8 0 0 0.0 3.0 ECU_ADDRESS 0x4000D93C /* @ECU_Address@INP_CanTrsmTqCnvLockUpEngd@ */ /end MEASUREMENT
/begin MEASUREMENT INP_CanTrsmOutpShaftSpd "Transmission Output Shaft Speed" FLOAT32_IEEE EcuIntgdSwGend_CM_single_rpm 0 0 0.0 8100.0 ECU_ADDRESS 0x4000DEA8 /* @ECU_Address@INP_CanTrsmOutpShaftSpd@ */ /end MEASUREMENT
/begin MEASUREMENT INP_CanPercCluSlip "Percent Clutch Slip" FLOAT32_IEEE EcuIntgdSwGend_CM_single__ 0 0 0.0 100.0 ECU_ADDRESS 0x4000D9AC /* @ECU_Address@INP_CanPercCluSlip@ */ /end MEASUREMENT
/begin MEASUREMENT INP_CanTrsmCurrentGear "Transmission Current Gear" SWORD EcuIntgdSwGend_CM_int16 0 0 -125.0 251.0 ECU_ADDRESS 0x4000E102 /* @ECU_Address@INP_CanTrsmCurrentGear@ */ /end MEASUREMENT
/begin MEASUREMENT INP_CanTrsmSeldGear "Transmission Selected Gear" SWORD EcuIntgdSwGend_CM_int16 0 0 -125.0 251.0 ECU_ADDRESS 0x4000DE58 /* @ECU_Address@INP_CanTrsmSeldGear@ */ /end MEASUREMENT
/begin MEASUREMENT INP_CanTrsmActGearRat "Transmission Actual Gear Ratio" FLOAT32_IEEE EcuIntgdSwGend_CM_single 0 0 0.0 64255.0 ECU_ADDRESS 0x4000DA70 /* @ECU_Address@INP_CanTrsmActGearRat@ */ /end MEASUREMENT
/begin MEASUREMENT INP_CanTrsmTqCnvrRat "Transmission Torque Converter Ratio" FLOAT32_IEEE EcuIntgdSwGend_CM_single 0 0 0.0 64255.0 ECU_ADDRESS 0x4000E6EC /* @ECU_Address@INP_CanTrsmTqCnvrRat@ */ /end MEASUREMENT
/begin MEASUREMENT INP_CanEstimdPercFanSpd "Estimated Percent Fan Speed" FLOAT32_IEEE EcuIntgdSwGend_CM_single__ 0 0 0.0 100.0 ECU_ADDRESS 0x4000E130 /* @ECU_Address@INP_CanEstimdPercFanSpd@ */ /end MEASUREMENT
/begin MEASUREMENT INP_CanTrfCaseSts "Transfer case status" UBYTE EcuIntgdSwGend_CM_uint8 0 0 0.0 7.0 ECU_ADDRESS 0x4000D962 /* @ECU_Address@INP_CanTrfCaseSts@ */ /end MEASUREMENT
/begin MEASUREMENT INP_CanEngReqTqHiResl "Engine Requested Torque - High Resolution" FLOAT32_IEEE EcuIntgdSwGend_CM_single__ 0 0 0.0 0.875 ECU_ADDRESS 0x4000DC2C /* @ECU_Address@INP_CanEngReqTqHiResl@ */ /end MEASUREMENT
/begin MEASUREMENT INP_CanTSC1MessageCntr "TSC1 Message Counter" UBYTE EcuIntgdSwGend_CM_uint8 0 0 0.0 15.0 ECU_ADDRESS 0x4000DF34 /* @ECU_Address@INP_CanTSC1MessageCntr@ */ /end MEASUREMENT
/begin MEASUREMENT INP_CanEngTqReq "Engine Requested Torque/Torque Limit" SWORD EcuIntgdSwGend_CM_int16__ 0 0 -125.0 125.0 ECU_ADDRESS 0x4000E33E /* @ECU_Address@INP_CanEngTqReq@ */ /end MEASUREMENT
/begin MEASUREMENT INP_CanEngOvrdCtrlMod "Engine Override Control Mode" UBYTE EcuIntgdSwGend_CM_uint8 0 0 0.0 3.0 ECU_ADDRESS 0x4000DF9A /* @ECU_Address@INP_CanEngOvrdCtrlMod@ */ /end MEASUREMENT
/begin MEASUREMENT INP_CanOvrdCtrlModPrio "Override Control Mode Priority" UBYTE EcuIntgdSwGend_CM_uint8 0 0 0.0 3.0 ECU_ADDRESS 0x4000DFA8 /* @ECU_Address@INP_CanOvrdCtrlModPrio@ */ /end MEASUREMENT
/begin MEASUREMENT INP_CanEngSpdReq "Engine Requested Speed/Speed Limit" FLOAT32_IEEE EcuIntgdSwGend_CM_single_rpm 0 0 0.0 8100.0 ECU_ADDRESS 0x4000E548 /* @ECU_Address@INP_CanEngSpdReq@ */ /end MEASUREMENT
/begin MEASUREMENT INP_FuelCnsMem "Fuel Consumption from Memory" FLOAT32_IEEE EcuIntgdSwGend_CM_single_l_100km 0 0 0.0 10000.0 ECU_ADDRESS 0x4000E3C4 /* @ECU_Address@INP_FuelCnsMem@ */ /end MEASUREMENT
/begin MEASUREMENT INP_TripMem "Trip from Memory" FLOAT32_IEEE EcuIntgdSwGend_CM_single_km 0 0 0.0 1.0E+6 ECU_ADDRESS 0x4000E4E8 /* @ECU_Address@INP_TripMem@ */ /end MEASUREMENT
/begin MEASUREMENT INP_CanWhlBasVehSpd "Wheel Based Vehicle Speed" SWORD EcuIntgdSwGend_CM_int16_km_h 0 0 0.0 250.0 ECU_ADDRESS 0x4000DE8E /* @ECU_Address@INP_CanWhlBasVehSpd@ */ /end MEASUREMENT
/begin MEASUREMENT INP_CanTachographVehSpd "Tachograph Vehicle Speed" SWORD EcuIntgdSwGend_CM_int16_km_h 0 0 0.0 250.0 ECU_ADDRESS 0x4000E09C /* @ECU_Address@INP_CanTachographVehSpd@ */ /end MEASUREMENT
/begin MEASUREMENT INP_StOfCanTrsmOutpShaftSpd "State of Transmission Outputshaft Speed" UBYTE EcuIntgdSwGend_CM_boolean 0 0 0.0 1.0 ECU_ADDRESS 0x4000D834 /* @ECU_Address@INP_StOfCanTrsmOutpShaftSpd@ */ /end MEASUREMENT
/begin MEASUREMENT INP_StOfCanWhlBasVehSpd "State of Wheel Based Vehicle Speed" UBYTE EcuIntgdSwGend_CM_boolean 0 0 0.0 1.0 ECU_ADDRESS 0x4000E258 /* @ECU_Address@INP_StOfCanWhlBasVehSpd@ */ /end MEASUREMENT
/begin MEASUREMENT INP_StOfCanTachographVehSpd "State of Tachograph Vehicle Speed" UBYTE EcuIntgdSwGend_CM_boolean 0 0 0.0 1.0 ECU_ADDRESS 0x4000DBAE /* @ECU_Address@INP_StOfCanTachographVehSpd@ */ /end MEASUREMENT
/begin MEASUREMENT INP_bErrHndBrkPrkg "Hand Brake Parking Switch Error" UBYTE EcuIntgdSwGend_CM_boolean 0 0 0.0 1.0 ECU_ADDRESS 0x4000DA95 /* @ECU_Address@INP_bErrHndBrkPrkg@ */ /end MEASUREMENT
/begin MEASUREMENT INP_bErrBrkPedl "Brake Pedal Switch Error" UBYTE EcuIntgdSwGend_CM_boolean 0 0 0.0 1.0 ECU_ADDRESS 0x4000DDD0 /* @ECU_Address@INP_bErrBrkPedl@ */ /end MEASUREMENT
/begin MEASUREMENT INP_CanEngPtoGovrEnaSwt "Can Engine Pto Governor Enable Switch" UBYTE EcuIntgdSwGend_CM_uint8 0 0 0.0 3.0 ECU_ADDRESS 0x4000DEF5 /* @ECU_Address@INP_CanEngPtoGovrEnaSwt@ */ /end MEASUREMENT
/begin MEASUREMENT INP_CanEngRemPtoGovrProgdSpdCtrlSwt "Can Engine Remote Pto Governor Programed Speed Control Switch" UBYTE EcuIntgdSwGend_CM_uint8 0 0 0.0 3.0 ECU_ADDRESS 0x4000E79C /* @ECU_Address@INP_CanEngRemPtoGovrProgdSpdCtrlSwt@ */ /end MEASUREMENT
/begin MEASUREMENT INP_CanEngPtoGovrSetSwt "Can Engine Pto Governor Set Switch" UBYTE EcuIntgdSwGend_CM_uint8 0 0 0.0 3.0 ECU_ADDRESS 0x4000D771 /* @ECU_Address@INP_CanEngPtoGovrSetSwt@ */ /end MEASUREMENT
/begin MEASUREMENT INP_CanEngPtoGovrCoastSwt "Can Engine Pto Governor Coast Switch" UBYTE EcuIntgdSwGend_CM_uint8 0 0 0.0 3.0 ECU_ADDRESS 0x4000E3E1 /* @ECU_Address@INP_CanEngPtoGovrCoastSwt@ */ /end MEASUREMENT
/begin MEASUREMENT INP_CanEngPtoGovrResuSwt "Can Engine Pto Governor Resume Switch" UBYTE EcuIntgdSwGend_CM_uint8 0 0 0.0 3.0 ECU_ADDRESS 0x4000E408 /* @ECU_Address@INP_CanEngPtoGovrResuSwt@ */ /end MEASUREMENT
/begin MEASUREMENT INP_CanEngPtoGovrAccrSwt "Can Engine Pto Governor Accelerator Switch" UBYTE EcuIntgdSwGend_CM_uint8 0 0 0.0 3.0 ECU_ADDRESS 0x4000D904 /* @ECU_Address@INP_CanEngPtoGovrAccrSwt@ */ /end MEASUREMENT
/begin MEASUREMENT INP_StOfCanEngPtoGovrEnaSwt "State Of Can Engine Pto Governor Enable Switch" UBYTE EcuIntgdSwGend_CM_boolean 0 0 0.0 1.0 ECU_ADDRESS 0x4000DFBC /* @ECU_Address@INP_StOfCanEngPtoGovrEnaSwt@ */ /end MEASUREMENT
/begin MEASUREMENT INP_StOfCanEngRemPtoGovrSpdCtrlSwt "State Can Engine Remote Pto Governor Programed Speed Control Switch" UBYTE EcuIntgdSwGend_CM_boolean 0 0 0.0 1.0 ECU_ADDRESS 0x4000E170 /* @ECU_Address@INP_StOfCanEngRemPtoGovrSpdCtrlSwt@ */ /end MEASUREMENT
/begin MEASUREMENT INP_StOfCanEngPtoGovrSetSwt "State Of Can Engine Pto Governor SetSwitch" UBYTE EcuIntgdSwGend_CM_boolean 0 0 0.0 1.0 ECU_ADDRESS 0x4000E118 /* @ECU_Address@INP_StOfCanEngPtoGovrSetSwt@ */ /end MEASUREMENT
/begin MEASUREMENT INP_StOfCanEngPtoGovrCoastSwt "State Of Can Engine Pto Governor Coast Switch" UBYTE EcuIntgdSwGend_CM_boolean 0 0 0.0 1.0 ECU_ADDRESS 0x4000DD5A /* @ECU_Address@INP_StOfCanEngPtoGovrCoastSwt@ */ /end MEASUREMENT
/begin MEASUREMENT INP_StOfCanEngPtoGovrResuSwt "State Of Can Engine Pto Governor Resume Switch" UBYTE EcuIntgdSwGend_CM_boolean 0 0 0.0 1.0 ECU_ADDRESS 0x4000D9C9 /* @ECU_Address@INP_StOfCanEngPtoGovrResuSwt@ */ /end MEASUREMENT
/begin MEASUREMENT INP_StOfCanEngPtoGovrAccrSwt "State Of Can Engine Pto v Accelerate Switch" UBYTE EcuIntgdSwGend_CM_boolean 0 0 0.0 1.0 ECU_ADDRESS 0x4000DCF3 /* @ECU_Address@INP_StOfCanEngPtoGovrAccrSwt@ */ /end MEASUREMENT
/begin MEASUREMENT INP_CanFuLvl1 "Fuel Level 1" FLOAT32_IEEE EcuIntgdSwGend_CM_single__ 0 0 0.0 100.0 ECU_ADDRESS 0x4000DD2C /* @ECU_Address@INP_CanFuLvl1@ */ /end MEASUREMENT
/begin MEASUREMENT INP_StOfCanFuLvl1 "State Of Fuel Level 1" UBYTE EcuIntgdSwGend_CM_boolean 0 0 0.0 1.0 ECU_ADDRESS 0x4000E199 /* @ECU_Address@INP_StOfCanFuLvl1@ */ /end MEASUREMENT
/begin MEASUREMENT INP_StOfCanEngOvrdCtrlMod "State Of Engine Override Control Mode" UBYTE EcuIntgdSwGend_CM_boolean 0 0 0.0 1.0 ECU_ADDRESS 0x4000E5BC /* @ECU_Address@INP_StOfCanEngOvrdCtrlMod@ */ /end MEASUREMENT
/begin MEASUREMENT INP_StOfCanABSActv "Input Processing State Of CanABS Active" UBYTE EcuIntgdSwGend_CM_boolean 0 0 0.0 1.0 ECU_ADDRESS 0x4000D9C8 /* @ECU_Address@INP_StOfCanABSActv@ */ /end MEASUREMENT
/begin MEASUREMENT INP_StOfCanTrsmTqCnvLockUpEngd "State Of Can Transmission Torque Convertor Lock Up Enagaged" UBYTE EcuIntgdSwGend_CM_boolean 0 0 0.0 1.0 ECU_ADDRESS 0x4000DE84 /* @ECU_Address@INP_StOfCanTrsmTqCnvLockUpEngd@ */ /end MEASUREMENT
/begin MEASUREMENT INP_StOfCanTrsmCurrentGear "State Of Can Transmission Current Gear" UBYTE EcuIntgdSwGend_CM_boolean 0 0 0.0 1.0 ECU_ADDRESS 0x4000DCFA /* @ECU_Address@INP_StOfCanTrsmCurrentGear@ */ /end MEASUREMENT
/begin MEASUREMENT INP_CrnksftSpd "Crankshaft Speed" FLOAT32_IEEE EcuIntgdSwGend_CM_single_rpm 0 0 0.0 5000.0 ECU_ADDRESS 0x4000DB44 /* @ECU_Address@INP_CrnksftSpd@ */ /end MEASUREMENT
/begin MEASUREMENT INP_CamsftSpd "Camshaft Speed" FLOAT32_IEEE EcuIntgdSwGend_CM_single_rpm 0 0 0.0 5000.0 ECU_ADDRESS 0x4000DA1C /* @ECU_Address@INP_CamsftSpd@ */ /end MEASUREMENT
/begin MEASUREMENT INP_DstTrvldMem "Input Processing Distance to Travelled Memory" FLOAT32_IEEE EcuIntgdSwGend_CM_single_km 0 0 0.0 1.0E+6 ECU_ADDRESS 0x4000DBB0 /* @ECU_Address@INP_DstTrvldMem@ */ /end MEASUREMENT
/begin MEASUREMENT INP_EngHrMem "Distance Traveled Memory" FLOAT32_IEEE EcuIntgdSwGend_CM_single_h 0 0 0.0 1.0E+6 ECU_ADDRESS 0x4000E524 /* @ECU_Address@INP_EngHrMem@ */ /end MEASUREMENT
/begin MEASUREMENT INP_ErrRedStopLamp "Input Processing Error Red Stop Lamp (RSL)" UBYTE EcuIntgdSwGend_CM_boolean 0 0 0.0 1.0 ECU_ADDRESS 0x4000DD51 /* @ECU_Address@INP_ErrRedStopLamp@ */ /end MEASUREMENT
/begin MEASUREMENT INP_ErrAmberWarnLamp "Input Processing Error Amber Warning Lamp (AWL)" UBYTE EcuIntgdSwGend_CM_boolean 0 0 0.0 1.0 ECU_ADDRESS 0x4000DF04 /* @ECU_Address@INP_ErrAmberWarnLamp@ */ /end MEASUREMENT
/begin MEASUREMENT INP_ErrColdStrtLamp "Input Processing Error Cold Start Lamp (CSL)" UBYTE EcuIntgdSwGend_CM_boolean 0 0 0.0 1.0 ECU_ADDRESS 0x4000E12C /* @ECU_Address@INP_ErrColdStrtLamp@ */ /end MEASUREMENT
/begin MEASUREMENT INP_ErrEngBrkSoln1 "Input Processing Error Engine Brake Selenoid 1" UBYTE EcuIntgdSwGend_CM_boolean 0 0 0.0 1.0 ECU_ADDRESS 0x4000DF68 /* @ECU_Address@INP_ErrEngBrkSoln1@ */ /end MEASUREMENT
/begin MEASUREMENT INP_ErrEngBrkSoln2 "Input Processing Error Engine Brake Selenoid 2" UBYTE EcuIntgdSwGend_CM_boolean 0 0 0.0 1.0 ECU_ADDRESS 0x4000DC25 /* @ECU_Address@INP_ErrEngBrkSoln2@ */ /end MEASUREMENT
/begin MEASUREMENT INP_StOfCanTrsmEngCrkEna "Input Processing State Of Transmission Engine Crank Enable" UBYTE EcuIntgdSwGend_CM_boolean 0 0 0.0 1.0 ECU_ADDRESS 0x4000E230 /* @ECU_Address@INP_StOfCanTrsmEngCrkEna@ */ /end MEASUREMENT
/begin MEASUREMENT INP_StOfCanTrsmTqCnvrRat "Input Processing State Of Transmission Torque Converter Ratio" UBYTE EcuIntgdSwGend_CM_boolean 0 0 0.0 1.0 ECU_ADDRESS 0x4000DB08 /* @ECU_Address@INP_StOfCanTrsmTqCnvrRat@ */ /end MEASUREMENT
/begin MEASUREMENT INP_StOfCanTrfCaseSts "Input Processing State Of Transfer Case Status" UBYTE EcuIntgdSwGend_CM_boolean 0 0 0.0 1.0 ECU_ADDRESS 0x4000DC94 /* @ECU_Address@INP_StOfCanTrfCaseSts@ */ /end MEASUREMENT
/begin MEASUREMENT INP_StOfCanReqdPercFanSpd "Input Processing State Of Can Requested Percent Fan Speed" UBYTE EcuIntgdSwGend_CM_boolean 0 0 0.0 1.0 ECU_ADDRESS 0x4000D9BE /* @ECU_Address@INP_StOfCanReqdPercFanSpd@ */ /end MEASUREMENT
/begin MEASUREMENT INP_StOfCanTrsmOilLvlReq "Input Processing State Of Can Transmission Oil Level Request" UBYTE EcuIntgdSwGend_CM_boolean 0 0 0.0 1.0 ECU_ADDRESS 0x4000DD89 /* @ECU_Address@INP_StOfCanTrsmOilLvlReq@ */ /end MEASUREMENT
/begin MEASUREMENT INP_StOfCanEngTqLimReqMaxCntns "Input Processing State Of Can Engine Torque Limit Request - Maximum Continuous" UBYTE EcuIntgdSwGend_CM_boolean 0 0 0.0 1.0 ECU_ADDRESS 0x4000DEED /* @ECU_Address@INP_StOfCanEngTqLimReqMaxCntns@ */ /end MEASUREMENT
/begin MEASUREMENT INP_StOfCanASREngCtrlActv "Input Procesing State Of Can Acceleration Slip Requation (ASR) Engine Control Active" UBYTE EcuIntgdSwGend_CM_boolean 0 0 0.0 1.0 ECU_ADDRESS 0x4000D74C /* @ECU_Address@INP_StOfCanASREngCtrlActv@ */ /end MEASUREMENT
/begin MEASUREMENT INP_StOfCanASRBrkCtrlActv "Input Procesing State Of Can Acceleration Slip Requation (ASR) Brake Control Active" UBYTE EcuIntgdSwGend_CM_boolean 0 0 0.0 1.0 ECU_ADDRESS 0x4000E77C /* @ECU_Address@INP_StOfCanASRBrkCtrlActv@ */ /end MEASUREMENT
/begin MEASUREMENT INP_StOfCanEngAuxShtdwnSwt "Input Processing State Of Can Engine Auxiliary Shutdown Switch" UBYTE EcuIntgdSwGend_CM_boolean 0 0 0.0 1.0 ECU_ADDRESS 0x4000E2A0 /* @ECU_Address@INP_StOfCanEngAuxShtdwnSwt@ */ /end MEASUREMENT
/begin MEASUREMENT INP_StOfCanEstimdEngParasiticTq "Input Processing State Of Can Estimated Percent Engine Parasitic Torque" UBYTE EcuIntgdSwGend_CM_boolean 0 0 0.0 1.0 ECU_ADDRESS 0x4000DEC4 /* @ECU_Address@INP_StOfCanEstimdEngParasiticTq@ */ /end MEASUREMENT
/begin MEASUREMENT INP_StOfCanActMaxAvlRtdr "Input Processing State Of Can Actual Maximum Available Retarder" UBYTE EcuIntgdSwGend_CM_boolean 0 0 0.0 1.0 ECU_ADDRESS 0x4000E080 /* @ECU_Address@INP_StOfCanActMaxAvlRtdr@ */ /end MEASUREMENT
/begin MEASUREMENT INP_StOfCanPercCluSlip "Input Processing State Of Can Percent Clutch Slip" UBYTE EcuIntgdSwGend_CM_boolean 0 0 0.0 1.0 ECU_ADDRESS 0x4000DD50 /* @ECU_Address@INP_StOfCanPercCluSlip@ */ /end MEASUREMENT
/begin MEASUREMENT INP_StOfCanTrsmSeldGear "Input Processing State Of Can Transmission Selected Gear" UBYTE EcuIntgdSwGend_CM_boolean 0 0 0.0 1.0 ECU_ADDRESS 0x4000E1FC /* @ECU_Address@INP_StOfCanTrsmSeldGear@ */ /end MEASUREMENT
/begin MEASUREMENT INP_StOfCanTrsmActGearRat "Input Processing State Of Can Transmission Actual Gear Ratio" UBYTE EcuIntgdSwGend_CM_boolean 0 0 0.0 1.0 ECU_ADDRESS 0x4000DB5D /* @ECU_Address@INP_StOfCanTrsmActGearRat@ */ /end MEASUREMENT
/begin MEASUREMENT INP_StOfCanEstimdPercFanSpd "Input Processing State Of Can Estimated Percent Fan Speed" UBYTE EcuIntgdSwGend_CM_boolean 0 0 0.0 1.0 ECU_ADDRESS 0x4000E761 /* @ECU_Address@INP_StOfCanEstimdPercFanSpd@ */ /end MEASUREMENT
/begin MEASUREMENT INP_StOfCanEngReqTqHiResl "State Of Can Engine Request Torque - High Resolution" UBYTE EcuIntgdSwGend_CM_boolean 0 0 0.0 1.0 ECU_ADDRESS 0x4000DF06 /* @ECU_Address@INP_StOfCanEngReqTqHiResl@ */ /end MEASUREMENT
/begin MEASUREMENT INP_StOfCanTSC1MessageCntr "Input Processing State Of Can TSC1 Message Counter" UBYTE EcuIntgdSwGend_CM_boolean 0 0 0.0 1.0 ECU_ADDRESS 0x4000D7FC /* @ECU_Address@INP_StOfCanTSC1MessageCntr@ */ /end MEASUREMENT
/begin MEASUREMENT INP_StOfCanEngTqReq "Input Processing State Of Can Engine Torque Request" UBYTE EcuIntgdSwGend_CM_boolean 0 0 0.0 1.0 ECU_ADDRESS 0x4000E400 /* @ECU_Address@INP_StOfCanEngTqReq@ */ /end MEASUREMENT
/begin MEASUREMENT INP_StOfCanOvrdCtrlModPrio "Input Processing State Of Can Override Control Mode Priority" UBYTE EcuIntgdSwGend_CM_boolean 0 0 0.0 1.0 ECU_ADDRESS 0x4000DF18 /* @ECU_Address@INP_StOfCanOvrdCtrlModPrio@ */ /end MEASUREMENT
/begin MEASUREMENT INP_StOfCanEngSpdReq "Input Processing State Of Can Engine Speed Request" UBYTE EcuIntgdSwGend_CM_boolean 0 0 0.0 1.0 ECU_ADDRESS 0x4000E030 /* @ECU_Address@INP_StOfCanEngSpdReq@ */ /end MEASUREMENT
/begin MEASUREMENT INP_CanCrsCtrlSetSwt "Input Processing Cruise Control Set Switch From CAN" UBYTE EcuIntgdSwGend_CM_uint8 0 0 0.0 3.0 ECU_ADDRESS 0x4000D814 /* @ECU_Address@INP_CanCrsCtrlSetSwt@ */ /end MEASUREMENT
/begin MEASUREMENT INP_StOfCanCrsCtrlSetSwt "Input Processing State Of Can Cruise Control Set Switch" UBYTE EcuIntgdSwGend_CM_boolean 0 0 0.0 1.0 ECU_ADDRESS 0x4000DF50 /* @ECU_Address@INP_StOfCanCrsCtrlSetSwt@ */ /end MEASUREMENT
/begin MEASUREMENT INP_CanCrsCtrlResuSwt "Input Processing Cruise Control Resume Switch From CAN" UBYTE EcuIntgdSwGend_CM_uint8 0 0 0.0 3.0 ECU_ADDRESS 0x4000E694 /* @ECU_Address@INP_CanCrsCtrlResuSwt@ */ /end MEASUREMENT
/begin MEASUREMENT INP_StOfCanCrsCtrlResuSwt "Input Processing State Of Can Cruise Control Resume Switch" UBYTE EcuIntgdSwGend_CM_boolean 0 0 0.0 1.0 ECU_ADDRESS 0x4000D6B8 /* @ECU_Address@INP_StOfCanCrsCtrlResuSwt@ */ /end MEASUREMENT
/begin MEASUREMENT INP_CanCrsCtrlEnaSwt "Input Processing Can Cruise Control Enable Switch" UBYTE EcuIntgdSwGend_CM_uint8 0 0 0.0 3.0 ECU_ADDRESS 0x4000E2B2 /* @ECU_Address@INP_CanCrsCtrlEnaSwt@ */ /end MEASUREMENT
/begin MEASUREMENT INP_StOfCanCrsCtrlEnaSwt "Inpt Processing State Of Can Cruise Control Enable Switch" UBYTE EcuIntgdSwGend_CM_boolean 0 0 0.0 1.0 ECU_ADDRESS 0x4000DA34 /* @ECU_Address@INP_StOfCanCrsCtrlEnaSwt@ */ /end MEASUREMENT
/begin MEASUREMENT INP_CanVehLimSpdGovrEnaSwt "" UBYTE EcuIntgdSwGend_CM_uint8 0 0 0.0 3.0 ECU_ADDRESS 0x4000D8BC /* @ECU_Address@INP_CanVehLimSpdGovrEnaSwt@ */ /end MEASUREMENT
/begin MEASUREMENT INP_StOfCanVehLimSpdGovrEnaSwt "" UBYTE EcuIntgdSwGend_CM_boolean 0 0 0.0 1.0 ECU_ADDRESS 0x4000D8D0 /* @ECU_Address@INP_StOfCanVehLimSpdGovrEnaSwt@ */ /end MEASUREMENT
/begin MEASUREMENT INP_CanVehLimSpdGovrInctSwt "" UBYTE EcuIntgdSwGend_CM_uint8 0 0 0.0 3.0 ECU_ADDRESS 0x4000E49C /* @ECU_Address@INP_CanVehLimSpdGovrInctSwt@ */ /end MEASUREMENT
/begin MEASUREMENT INP_StOfCanVehLimSpdGovrInctSwt "" UBYTE EcuIntgdSwGend_CM_boolean 0 0 0.0 1.0 ECU_ADDRESS 0x4000D8B1 /* @ECU_Address@INP_StOfCanVehLimSpdGovrInctSwt@ */ /end MEASUREMENT
/begin MEASUREMENT INP_CanVehLimSpdGovrDecSwt "" UBYTE EcuIntgdSwGend_CM_uint8 0 0 0.0 3.0 ECU_ADDRESS 0x4000D9E0 /* @ECU_Address@INP_CanVehLimSpdGovrDecSwt@ */ /end MEASUREMENT
/begin MEASUREMENT INP_StOfCanVehLimSpdGovrDecSwt "" UBYTE EcuIntgdSwGend_CM_boolean 0 0 0.0 1.0 ECU_ADDRESS 0x4000DF71 /* @ECU_Address@INP_StOfCanVehLimSpdGovrDecSwt@ */ /end MEASUREMENT
/begin MEASUREMENT INP_ErrStrtr "Starter Error" UBYTE EcuIntgdSwGend_CM_boolean 0 0 0.0 1.0 ECU_ADDRESS 0x4000DC48 /* @ECU_Address@INP_ErrStrtr@ */ /end MEASUREMENT
/begin MEASUREMENT TrC_MTotFuQntyCorr "Total Fuel Quantity Correction" FLOAT32_IEEE EcuIntgdSwGend_CM_single_mm_3_stk 0 0 0.0 10000.0 ECU_ADDRESS 0x4000DD30 /* @ECU_Address@TrC_MTotFuQntyCorr@ */ /end MEASUREMENT
/begin MEASUREMENT TrC_MPltFuQntyAllwd "Pilot Fuel Quantity Allowed Signal" FLOAT32_IEEE EcuIntgdSwGend_CM_single_mm_3_stk 0 0 0.0 1000.0 ECU_ADDRESS 0x4000E190 /* @ECU_Address@TrC_MPltFuQntyAllwd@ */ /end MEASUREMENT
/begin MEASUREMENT TrC_MMaiFuQntyCorr "Main Quantity Map 3" FLOAT32_IEEE EcuIntgdSwGend_CM_single_mm_3_stk 0 0 0.0 1000.0 ECU_ADDRESS 0x4000E10C /* @ECU_Address@TrC_MMaiFuQntyCorr@ */ /end MEASUREMENT
/begin MEASUREMENT RPG_PRailRef "Reference Rail Pressure" FLOAT32_IEEE EcuIntgdSwGend_CM_single_bar 0 0 0.0 2500.0 ECU_ADDRESS 0x4000E4C4 /* @ECU_Address@RPG_PRailRef@ */ /end MEASUREMENT
/begin MEASUREMENT PtoCtrl_NEngTargetSpdPID "Engine Target Speed PID" FLOAT32_IEEE EcuIntgdSwGend_CM_single_rpm 0 0 -10000.0 10000.0 ECU_ADDRESS 0x4000E6BC /* @ECU_Address@PtoCtrl_NEngTargetSpdPID@ */ /end MEASUREMENT
/begin MEASUREMENT PtoCtrl_PtoCtrlTq "Torque Value for PTO Control" FLOAT32_IEEE EcuIntgdSwGend_CM_single_N_m 0 0 -10000.0 10000.0 ECU_ADDRESS 0x4000E4B4 /* @ECU_Address@PtoCtrl_PtoCtrlTq@ */ /end MEASUREMENT
/begin MEASUREMENT IC_MTotFuQntyCorrd "Corrected Total Fuel Quantity Mass" FLOAT32_IEEE EcuIntgdSwGend_CM_single_mm_3_stk 0 0 0.0 5000.0 ECU_ADDRESS 0x4000E1B8 /* @ECU_Address@IC_MTotFuQntyCorrd@ */ /end MEASUREMENT
/begin MEASUREMENT EMS_ModEngCtl "Engine Control Mode Output" FLOAT32_IEEE EcuIntgdSwGend_CM_single 0 0 0.0 10.0 ECU_ADDRESS 0x4000D68C /* @ECU_Address@EMS_ModEngCtl@ */ /end MEASUREMENT
/begin MEASUREMENT EIP_DstTrvldInMtr "Distance to Travelled in Meter" FLOAT32_IEEE EcuIntgdSwGend_CM_single_m 0 0 0.0 1.0E+6 ECU_ADDRESS 0x4000E6B4 /* @ECU_Address@EIP_DstTrvldInMtr@ */ /end MEASUREMENT
/begin MEASUREMENT EIP_DstTrvldInKm "Distance to Travelled in Kilometer" FLOAT32_IEEE EcuIntgdSwGend_CM_single_km 0 0 0.0 1.0E+6 ECU_ADDRESS 0x4000E3F8 /* @ECU_Address@EIP_DstTrvldInKm@ */ /end MEASUREMENT
/begin MEASUREMENT EIP_EngTiCalcn "Engine Time Calculation" FLOAT32_IEEE EcuIntgdSwGend_CM_single_ms 0 0 0.0 1.0E+6 ECU_ADDRESS 0x4000E2D4 /* @ECU_Address@EIP_EngTiCalcn@ */ /end MEASUREMENT
/begin MEASUREMENT EIP_EngHr "Engine Hour" FLOAT32_IEEE EcuIntgdSwGend_CM_single_h 0 0 0.0 1.0E+6 ECU_ADDRESS 0x4000E050 /* @ECU_Address@EIP_EngHr@ */ /end MEASUREMENT
/begin MEASUREMENT EIP_UClmp30GrdtAbsOut "Battery Voltage Gradient Absolute Out" FLOAT32_IEEE EcuIntgdSwGend_CM_single 0 0 0.0 20000.0 ECU_ADDRESS 0x4000DFB4 /* @ECU_Address@EIP_UClmp30GrdtAbsOut@ */ /end MEASUREMENT
/begin MEASUREMENT EIP_UClmp30 "Battery Voltage" FLOAT32_IEEE EcuIntgdSwGend_CM_single_V 0 0 0.0 50.0 ECU_ADDRESS 0x4000D948 /* @ECU_Address@EIP_UClmp30@ */ /end MEASUREMENT
/begin MEASUREMENT EIP_GridHeatrRlyFb "Grid Heater Relay Feedback" FLOAT32_IEEE EcuIntgdSwGend_CM_single_V 0 0 0.0 50.0 ECU_ADDRESS 0x4000D99C /* @ECU_Address@EIP_GridHeatrRlyFb@ */ /end MEASUREMENT
/begin MEASUREMENT EIP_PAirBoost "Air Boost Pressure" FLOAT32_IEEE EcuIntgdSwGend_CM_single_mbar 0 0 0.0 15000.0 ECU_ADDRESS 0x4000DAFC /* @ECU_Address@EIP_PAirBoost@ */ /end MEASUREMENT
/begin MEASUREMENT EIP_PAmbAir "Ambient Air Pressure" FLOAT32_IEEE EcuIntgdSwGend_CM_single_mbar 0 0 -1000.0 1600.0 ECU_ADDRESS 0x4000E364 /* @ECU_Address@EIP_PAmbAir@ */ /end MEASUREMENT
/begin MEASUREMENT EIP_POil "Oil Pressure" FLOAT32_IEEE EcuIntgdSwGend_CM_single_mbar 0 0 0.0 15000.0 ECU_ADDRESS 0x4000E3E8 /* @ECU_Address@EIP_POil@ */ /end MEASUREMENT
/begin MEASUREMENT EIP_PFu "Fuel Pressure" FLOAT32_IEEE EcuIntgdSwGend_CM_single_mbar 0 0 0.0 15000.0 ECU_ADDRESS 0x4000E37C /* @ECU_Address@EIP_PFu@ */ /end MEASUREMENT
/begin MEASUREMENT EIP_PRail "Rail Pressure" FLOAT32_IEEE EcuIntgdSwGend_CM_single_bar 0 0 0.0 10000.0 ECU_ADDRESS 0x4000E0B8 /* @ECU_Address@EIP_PRail@ */ /end MEASUREMENT
/begin MEASUREMENT EIP_PercgAccr1 "First Acelerator Pedal Percentage" FLOAT32_IEEE EcuIntgdSwGend_CM_single__ 0 0 0.0 100.0 ECU_ADDRESS 0x4000E0F0 /* @ECU_Address@EIP_PercgAccr1@ */ /end MEASUREMENT
/begin MEASUREMENT EIP_PercgAccr2 "Second Acelerator Pedal Percentage" FLOAT32_IEEE EcuIntgdSwGend_CM_single__ 0 0 0.0 100.0 ECU_ADDRESS 0x4000D870 /* @ECU_Address@EIP_PercgAccr2@ */ /end MEASUREMENT
/begin MEASUREMENT EIP_PercgAccr "Acelerator Pedal Percentage" FLOAT32_IEEE EcuIntgdSwGend_CM_single__ 0 0 0.0 100.0 ECU_ADDRESS 0x4000E3D8 /* @ECU_Address@EIP_PercgAccr@ */ /end MEASUREMENT
/begin MEASUREMENT EIP_StAccr "Acalerator State" FLOAT32_IEEE EcuIntgdSwGend_CM_single 0 0 0.0 3.0 ECU_ADDRESS 0x4000E52C /* @ECU_Address@EIP_StAccr@ */ /end MEASUREMENT
/begin MEASUREMENT EIP_NEng "Engine Speed" FLOAT32_IEEE EcuIntgdSwGend_CM_single_rpm 0 0 0.0 5000.0 ECU_ADDRESS 0x4000E658 /* @ECU_Address@EIP_NEng@ */ /end MEASUREMENT
/begin MEASUREMENT EIP_CrnksftSpd "Input Processing Crankshaft Speed" FLOAT32_IEEE EcuIntgdSwGend_CM_single_rpm 0 0 0.0 5000.0 ECU_ADDRESS 0x4000E3DC /* @ECU_Address@EIP_CrnksftSpd@ */ /end MEASUREMENT
/begin MEASUREMENT EIP_CamsftSpd "Input Processing Camshaft Speed" FLOAT32_IEEE EcuIntgdSwGend_CM_single_rpm 0 0 0.0 5000.0 ECU_ADDRESS 0x4000DCFC /* @ECU_Address@EIP_CamsftSpd@ */ /end MEASUREMENT
/begin MEASUREMENT EIP_FuelCnsMem "Engine Input Processing - Fuel Consumption from Memory" FLOAT32_IEEE EcuIntgdSwGend_CM_single_l_100km 0 0 0.0 10000.0 ECU_ADDRESS 0x4000D9C0 /* @ECU_Address@EIP_FuelCnsMem@ */ /end MEASUREMENT
/begin MEASUREMENT EIP_TripMem "Engine Input Processing - Trip from Memory" FLOAT32_IEEE EcuIntgdSwGend_CM_single_km 0 0 0.0 1.0E+6 ECU_ADDRESS 0x4000DCA4 /* @ECU_Address@EIP_TripMem@ */ /end MEASUREMENT
/begin MEASUREMENT EIP_DstTrvldMem "Distance to Travelled Memory" FLOAT32_IEEE EcuIntgdSwGend_CM_single_km 0 0 0.0 1.0E+6 ECU_ADDRESS 0x4000DB54 /* @ECU_Address@EIP_DstTrvldMem@ */ /end MEASUREMENT
/begin MEASUREMENT EIP_EngHrMem "Engine Hour From Memory" FLOAT32_IEEE EcuIntgdSwGend_CM_single_h 0 0 0.0 1.0E+6 ECU_ADDRESS 0x4000D930 /* @ECU_Address@EIP_EngHrMem@ */ /end MEASUREMENT
/begin MEASUREMENT EIP_TAirBoost "Air Boost Temperature" FLOAT32_IEEE EcuIntgdSwGend_CM_single_degC 0 0 -50.0 250.0 ECU_ADDRESS 0x4000D8F8 /* @ECU_Address@EIP_TAirBoost@ */ /end MEASUREMENT
/begin MEASUREMENT EIP_TOilFromTCoolt "Oil Temperature from Coolant Temperature" FLOAT32_IEEE EcuIntgdSwGend_CM_single_degC 0 0 -50.0 250.0 ECU_ADDRESS 0x4000D6BC /* @ECU_Address@EIP_TOilFromTCoolt@ */ /end MEASUREMENT
/begin MEASUREMENT EIP_TOil "Oil Temperature" FLOAT32_IEEE EcuIntgdSwGend_CM_single_degC 0 0 -50.0 250.0 ECU_ADDRESS 0x4000E448 /* @ECU_Address@EIP_TOil@ */ /end MEASUREMENT
/begin MEASUREMENT EIP_TCooltFromTOil "Coolant Temperature from Oil Temperature" FLOAT32_IEEE EcuIntgdSwGend_CM_single_degC 0 0 -50.0 250.0 ECU_ADDRESS 0x4000DCC4 /* @ECU_Address@EIP_TCooltFromTOil@ */ /end MEASUREMENT
/begin MEASUREMENT EIP_TCoolt "Coolant Temperature" FLOAT32_IEEE EcuIntgdSwGend_CM_single_degC 0 0 -50.0 250.0 ECU_ADDRESS 0x4000E2E0 /* @ECU_Address@EIP_TCoolt@ */ /end MEASUREMENT
/begin MEASUREMENT EIP_TAmbAir "Ambient Air Temperature" FLOAT32_IEEE EcuIntgdSwGend_CM_single_degC 0 0 -50.0 250.0 ECU_ADDRESS 0x4000E3CC /* @ECU_Address@EIP_TAmbAir@ */ /end MEASUREMENT
/begin MEASUREMENT EIP_TEcu "Ecu Temperature" FLOAT32_IEEE EcuIntgdSwGend_CM_single_degC 0 0 -50.0 250.0 ECU_ADDRESS 0x4000E780 /* @ECU_Address@EIP_TEcu@ */ /end MEASUREMENT
/begin MEASUREMENT EIP_TFu "Fuel Temperature" FLOAT32_IEEE EcuIntgdSwGend_CM_single_degC 0 0 -50.0 250.0 ECU_ADDRESS 0x4000DD8C /* @ECU_Address@EIP_TFu@ */ /end MEASUREMENT
/begin MEASUREMENT EIP_LvlOil "Oil Level" FLOAT32_IEEE EcuIntgdSwGend_CM_single__ 0 0 0.0 100.0 ECU_ADDRESS 0x4000E560 /* @ECU_Address@EIP_LvlOil@ */ /end MEASUREMENT
/begin MEASUREMENT DTqC_NEngIdleRef "Engine Idle Reference Signal" FLOAT32_IEEE EcuIntgdSwGend_CM_single_rpm 0 0 0.0 6000.0 ECU_ADDRESS 0x4000D884 /* @ECU_Address@DTqC_NEngIdleRef@ */ /end MEASUREMENT
/begin MEASUREMENT DTqC_TSC1MaxIndcdTq "TSC1 Max Indicated Torque" FLOAT32_IEEE EcuIntgdSwGend_CM_single_N_m 0 0 -1000.0 10000.0 ECU_ADDRESS 0x4000E54C /* @ECU_Address@DTqC_TSC1MaxIndcdTq@ */ /end MEASUREMENT
/begin MEASUREMENT DTqC_FricPercTq "Friction Percent Torque" FLOAT32_IEEE EcuIntgdSwGend_CM_single__ 0 0 0.0 125.0 ECU_ADDRESS 0x4000E4A0 /* @ECU_Address@DTqC_FricPercTq@ */ /end MEASUREMENT
/begin MEASUREMENT DTqC_MaxTqAtCurrentEngSpd "Max Torque at Current Engine Speed" FLOAT32_IEEE EcuIntgdSwGend_CM_single_N_m 0 0 -10000.0 10000.0 ECU_ADDRESS 0x4000DE68 /* @ECU_Address@DTqC_MaxTqAtCurrentEngSpd@ */ /end MEASUREMENT
/begin MEASUREMENT DTqC_MaxIndcdTqAtCurrentEngSpd "Max Indicated Torque At Current Engine Speed" FLOAT32_IEEE EcuIntgdSwGend_CM_single_N_m 0 0 -1000.0 10000.0 ECU_ADDRESS 0x4000E44C /* @ECU_Address@DTqC_MaxIndcdTqAtCurrentEngSpd@ */ /end MEASUREMENT
/begin MEASUREMENT DTqC_TqBrk "Break Torque Signal" FLOAT32_IEEE EcuIntgdSwGend_CM_single_N_m 0 0 -1000.0 10000.0 ECU_ADDRESS 0x4000E4E4 /* @ECU_Address@DTqC_TqBrk@ */ /end MEASUREMENT
/begin MEASUREMENT DTqC_TqFric "Friction Torque Value " FLOAT32_IEEE EcuIntgdSwGend_CM_single_N_m 0 0 -1000.0 10000.0 ECU_ADDRESS 0x4000E244 /* @ECU_Address@DTqC_TqFric@ */ /end MEASUREMENT
/begin MEASUREMENT DTqC_TqIndcd "Indicated Torque Value (Break + Friction)" FLOAT32_IEEE EcuIntgdSwGend_CM_single_N_m 0 0 0.0 10000.0 ECU_ADDRESS 0x4000DFDC /* @ECU_Address@DTqC_TqIndcd@ */ /end MEASUREMENT
/begin MEASUREMENT DTqC_TqBrkPwrOn "Brake Torque of Power-on Control" FLOAT32_IEEE EcuIntgdSwGend_CM_single_N_m 0 0 -1000.0 10000.0 ECU_ADDRESS 0x4000E01C /* @ECU_Address@DTqC_TqBrkPwrOn@ */ /end MEASUREMENT
/begin MEASUREMENT DTqC_TqBrkStpCtl "Brake Torque of Stop Control" FLOAT32_IEEE EcuIntgdSwGend_CM_single_N_m 0 0 -1000.0 10000.0 ECU_ADDRESS 0x4000D76C /* @ECU_Address@DTqC_TqBrkStpCtl@ */ /end MEASUREMENT
/begin MEASUREMENT DTqC_TqBrkMax "Maximum of Speed Controller and Break Torque Map Out" FLOAT32_IEEE EcuIntgdSwGend_CM_single_N_m 0 0 -1000.0 10000.0 ECU_ADDRESS 0x4000E1DC /* @ECU_Address@DTqC_TqBrkMax@ */ /end MEASUREMENT
/begin MEASUREMENT DTqC_TqBrkAtRunngMod "Brake Torque at Running Mode" FLOAT32_IEEE EcuIntgdSwGend_CM_single_N_m 0 0 -10000.0 10000.0 ECU_ADDRESS 0x4000E504 /* @ECU_Address@DTqC_TqBrkAtRunngMod@ */ /end MEASUREMENT
/begin MEASUREMENT CrsCtrl_ErrVehVRef "Error Vehicle Velocity Reference" FLOAT32_IEEE EcuIntgdSwGend_CM_single_km_h 0 0 -300.0 300.0 ECU_ADDRESS 0x4000DEF0 /* @ECU_Address@CrsCtrl_ErrVehVRef@ */ /end MEASUREMENT
/begin MEASUREMENT CrsCtrl_CrsCtrlTq "Cruise Control Torque" FLOAT32_IEEE EcuIntgdSwGend_CM_single_N_m 0 0 -5000.0 5000.0 ECU_ADDRESS 0x4000D740 /* @ECU_Address@CrsCtrl_CrsCtrlTq@ */ /end MEASUREMENT
/begin MEASUREMENT CrsCtrl_TarSpd "Cruise Control Target Speed" FLOAT32_IEEE EcuIntgdSwGend_CM_single_km_h 0 0 0.0 300.0 ECU_ADDRESS 0x4000DF48 /* @ECU_Address@CrsCtrl_TarSpd@ */ /end MEASUREMENT
/begin MEASUREMENT CrsCtrl_ActvCrsCtrl "Cruise Control Active" FLOAT32_IEEE EcuIntgdSwGend_CM_single 0 0 0.0 2.0 ECU_ADDRESS 0x4000E6E0 /* @ECU_Address@CrsCtrl_ActvCrsCtrl@ */ /end MEASUREMENT
/begin MEASUREMENT CrsCtrl_TarSpdPre "Cruise Control Target Speed Pre" FLOAT32_IEEE EcuIntgdSwGend_CM_single_km_h 0 0 0.0 300.0 ECU_ADDRESS 0x4000E174 /* @ECU_Address@CrsCtrl_TarSpdPre@ */ /end MEASUREMENT
/begin MEASUREMENT EMS_ModEngCtlSt "" SLONG EcuIntgdSwGend_CM_EngineMode 0 0 1 9 ECU_ADDRESS 0x4000DE08 /* @ECU_Address@EMS_ModEngCtlSt@ */ /end MEASUREMENT
/begin MEASUREMENT CrsCtrl_CrsCtrlModSt "" SLONG EcuIntgdSwGend_CM_CruiseControlMode 0 0 0 2 ECU_ADDRESS 0x4000DF60 /* @ECU_Address@CrsCtrl_CrsCtrlModSt@ */ /end MEASUREMENT
/begin MEASUREMENT EMS_bTranCrsCtrlToOvspd "Cruise Control To Over Speed Transition Flag" UBYTE EcuIntgdSwGend_CM_boolean 0 0 0.0 1.0 ECU_ADDRESS 0x4000DE38 /* @ECU_Address@EMS_bTranCrsCtrlToOvspd@ */ /end MEASUREMENT
/begin MEASUREMENT SC_ActvCanTrsmEngCrkEna "" UBYTE EcuIntgdSwGend_CM_boolean 0 0 0.0 1.0 ECU_ADDRESS 0x4000DF24 /* @ECU_Address@SC_ActvCanTrsmEngCrkEna@ */ /end MEASUREMENT
/begin MEASUREMENT RPG_bAcvPwrOnMod "PowerOn Mode Active" UBYTE EcuIntgdSwGend_CM_boolean 0 0 0.0 1.0 ECU_ADDRESS 0x4000E064 /* @ECU_Address@RPG_bAcvPwrOnMod@ */ /end MEASUREMENT
/begin MEASUREMENT RPG_bAcvStpMod "Stop Mode Active" UBYTE EcuIntgdSwGend_CM_boolean 0 0 0.0 1.0 ECU_ADDRESS 0x4000E6F8 /* @ECU_Address@RPG_bAcvStpMod@ */ /end MEASUREMENT
/begin MEASUREMENT PtoCtrl_bAcvLimp "Limp Mode Active" UBYTE EcuIntgdSwGend_CM_boolean 0 0 0.0 1.0 ECU_ADDRESS 0x4000D6A7 /* @ECU_Address@PtoCtrl_bAcvLimp@ */ /end MEASUREMENT
/begin MEASUREMENT PtoCtrl_bAcvRednLvl2 "Reduction Level 2 Active" UBYTE EcuIntgdSwGend_CM_boolean 0 0 0.0 1.0 ECU_ADDRESS 0x4000DB2E /* @ECU_Address@PtoCtrl_bAcvRednLvl2@ */ /end MEASUREMENT
/begin MEASUREMENT PtoCtrl_bAcvRednLvl1 "Reduction Level 1 Active" UBYTE EcuIntgdSwGend_CM_boolean 0 0 0.0 1.0 ECU_ADDRESS 0x4000DB2D /* @ECU_Address@PtoCtrl_bAcvRednLvl1@ */ /end MEASUREMENT
/begin MEASUREMENT PtoCtrl_ActvtEngIdleSpd "Engine Idle Speed Mode Activated" UBYTE EcuIntgdSwGend_CM_boolean 0 0 0.0 1.0 ECU_ADDRESS 0x4000DB5C /* @ECU_Address@PtoCtrl_ActvtEngIdleSpd@ */ /end MEASUREMENT
/begin MEASUREMENT EOP_bAcvGridHeatr "Output Processing Grid Heater Activation" UBYTE EcuIntgdSwGend_CM_boolean 0 0 0.0 1.0 ECU_ADDRESS 0x4000E636 /* @ECU_Address@EOP_bAcvGridHeatr@ */ /end MEASUREMENT
/begin MEASUREMENT EOP_RedStopLamp "Red Stop Lamp (RSL)" UBYTE EcuIntgdSwGend_CM_boolean 0 0 0.0 1.0 ECU_ADDRESS 0x4000E6F0 /* @ECU_Address@EOP_RedStopLamp@ */ /end MEASUREMENT
/begin MEASUREMENT EOP_AmberWarnLamp "Amber Warning Lamp (AWL)" UBYTE EcuIntgdSwGend_CM_boolean 0 0 0.0 1.0 ECU_ADDRESS 0x4000D8F1 /* @ECU_Address@EOP_AmberWarnLamp@ */ /end MEASUREMENT
/begin MEASUREMENT EOP_ColdStrtLamp "Check System Lamp (CSL)" UBYTE EcuIntgdSwGend_CM_boolean 0 0 0.0 1.0 ECU_ADDRESS 0x4000E11B /* @ECU_Address@EOP_ColdStrtLamp@ */ /end MEASUREMENT
/begin MEASUREMENT EOP_ActvEngBrkSoln1 "" UBYTE EcuIntgdSwGend_CM_boolean 0 0 0.0 1.0 ECU_ADDRESS 0x4000D950 /* @ECU_Address@EOP_ActvEngBrkSoln1@ */ /end MEASUREMENT
/begin MEASUREMENT EOP_ActvEngBrkSoln2 "" UBYTE EcuIntgdSwGend_CM_boolean 0 0 0.0 1.0 ECU_ADDRESS 0x4000E09E /* @ECU_Address@EOP_ActvEngBrkSoln2@ */ /end MEASUREMENT
/begin MEASUREMENT EMS_bTranPwronToStrt "Power On To Start Mode Transition Flag Signal" UBYTE EcuIntgdSwGend_CM_boolean 0 0 0.0 1.0 ECU_ADDRESS 0x4000E4F9 /* @ECU_Address@EMS_bTranPwronToStrt@ */ /end MEASUREMENT
/begin MEASUREMENT EMS_bTranStrtToIdlespd "Start To Idle Speed Mode Transition Flag Signal" UBYTE EcuIntgdSwGend_CM_boolean 0 0 0.0 1.0 ECU_ADDRESS 0x4000E1B6 /* @ECU_Address@EMS_bTranStrtToIdlespd@ */ /end MEASUREMENT
/begin MEASUREMENT EMS_bTranOvspdToStop "Overspeed To Stop Mode Transition Flag Signal" UBYTE EcuIntgdSwGend_CM_boolean 0 0 0.0 1.0 ECU_ADDRESS 0x4000DCB1 /* @ECU_Address@EMS_bTranOvspdToStop@ */ /end MEASUREMENT
/begin MEASUREMENT EMS_bTranStrtToStop "Start To Stop Mode Transition Flag Signal" UBYTE EcuIntgdSwGend_CM_boolean 0 0 0.0 1.0 ECU_ADDRESS 0x4000DEEE /* @ECU_Address@EMS_bTranStrtToStop@ */ /end MEASUREMENT
/begin MEASUREMENT EMS_bTranStopToPwrOn "Stop To Power On Mode Transition Flag Signal" UBYTE EcuIntgdSwGend_CM_boolean 0 0 0.0 1.0 ECU_ADDRESS 0x4000DFFE /* @ECU_Address@EMS_bTranStopToPwrOn@ */ /end MEASUREMENT
/begin MEASUREMENT EMS_bTranIdlespdToOvspd "Idle Speed To Overspeed Mode Transition Flag Signal" UBYTE EcuIntgdSwGend_CM_boolean 0 0 0.0 1.0 ECU_ADDRESS 0x4000D74A /* @ECU_Address@EMS_bTranIdlespdToOvspd@ */ /end MEASUREMENT
/begin MEASUREMENT EMS_bTranIdlespdToStop "Idle Speed To Stop Mode Transition Flag Signal" UBYTE EcuIntgdSwGend_CM_boolean 0 0 0.0 1.0 ECU_ADDRESS 0x4000DA7D /* @ECU_Address@EMS_bTranIdlespdToStop@ */ /end MEASUREMENT
/begin MEASUREMENT EMS_bTranIdlespdToTq "Idle Speed To Torque Mode Transition Flag Signal" UBYTE EcuIntgdSwGend_CM_boolean 0 0 0.0 1.0 ECU_ADDRESS 0x4000E0BF /* @ECU_Address@EMS_bTranIdlespdToTq@ */ /end MEASUREMENT
/begin MEASUREMENT EMS_bTranTqToIdlespd "Torque To Idle Speed Mode Transition Flag Signal" UBYTE EcuIntgdSwGend_CM_boolean 0 0 0.0 1.0 ECU_ADDRESS 0x4000E67C /* @ECU_Address@EMS_bTranTqToIdlespd@ */ /end MEASUREMENT
/begin MEASUREMENT EMS_bTranTqToOvspd "Torque To Overspeed Mode Transition Flag Signal" UBYTE EcuIntgdSwGend_CM_boolean 0 0 0.0 1.0 ECU_ADDRESS 0x4000E564 /* @ECU_Address@EMS_bTranTqToOvspd@ */ /end MEASUREMENT
/begin MEASUREMENT EMS_bTranOvspdToTq "Overspeed To Torque Mode Transition Flag Signal" UBYTE EcuIntgdSwGend_CM_boolean 0 0 0.0 1.0 ECU_ADDRESS 0x4000E668 /* @ECU_Address@EMS_bTranOvspdToTq@ */ /end MEASUREMENT
/begin MEASUREMENT EMS_bTranTqToStop "Torque To Stop Mode Transition Flag Signal" UBYTE EcuIntgdSwGend_CM_boolean 0 0 0.0 1.0 ECU_ADDRESS 0x4000E795 /* @ECU_Address@EMS_bTranTqToStop@ */ /end MEASUREMENT
/begin MEASUREMENT EMS_bTranIdlespdToPTO "Idle Speed to PTO Transition Flag" UBYTE EcuIntgdSwGend_CM_boolean 0 0 0.0 1.0 ECU_ADDRESS 0x4000E04C /* @ECU_Address@EMS_bTranIdlespdToPTO@ */ /end MEASUREMENT
/begin MEASUREMENT EMS_bTranPTOToIdlespd "PTO to Idle Speed Transition Flag" UBYTE EcuIntgdSwGend_CM_boolean 0 0 0.0 1.0 ECU_ADDRESS 0x4000D876 /* @ECU_Address@EMS_bTranPTOToIdlespd@ */ /end MEASUREMENT
/begin MEASUREMENT EMS_bTranPTOToStop "PTO to Stop Transition Flag" UBYTE EcuIntgdSwGend_CM_boolean 0 0 0.0 1.0 ECU_ADDRESS 0x4000DBF5 /* @ECU_Address@EMS_bTranPTOToStop@ */ /end MEASUREMENT
/begin MEASUREMENT EMS_bTranIdlespdToTSC1 "Idle Speed to TSC1 Mode Transition" UBYTE EcuIntgdSwGend_CM_boolean 0 0 0.0 1.0 ECU_ADDRESS 0x4000D7F2 /* @ECU_Address@EMS_bTranIdlespdToTSC1@ */ /end MEASUREMENT
/begin MEASUREMENT EMS_bTranTqToTSC1 "Torque To TSC1 Mode Transition" UBYTE EcuIntgdSwGend_CM_boolean 0 0 0.0 1.0 ECU_ADDRESS 0x4000DD15 /* @ECU_Address@EMS_bTranTqToTSC1@ */ /end MEASUREMENT
/begin MEASUREMENT EMS_bTranTSC1ToStop "TSC1 To Stop Mode Transition" UBYTE EcuIntgdSwGend_CM_boolean 0 0 0.0 1.0 ECU_ADDRESS 0x4000DF73 /* @ECU_Address@EMS_bTranTSC1ToStop@ */ /end MEASUREMENT
/begin MEASUREMENT EMS_bTranTSC1ToTq "TSC1 To Torque Mode Transition" UBYTE EcuIntgdSwGend_CM_boolean 0 0 0.0 1.0 ECU_ADDRESS 0x4000E774 /* @ECU_Address@EMS_bTranTSC1ToTq@ */ /end MEASUREMENT
/begin MEASUREMENT EMS_bTranTSC1ToOvspd "TSC1 To Overspeed Mode Transition" UBYTE EcuIntgdSwGend_CM_boolean 0 0 0.0 1.0 ECU_ADDRESS 0x4000E046 /* @ECU_Address@EMS_bTranTSC1ToOvspd@ */ /end MEASUREMENT
/begin MEASUREMENT EMS_bTranCrsCtrlToIdleSpd "Cruise Control To Idle Speed Transition Flag" UBYTE EcuIntgdSwGend_CM_boolean 0 0 0.0 1.0 ECU_ADDRESS 0x4000E278 /* @ECU_Address@EMS_bTranCrsCtrlToIdleSpd@ */ /end MEASUREMENT
/begin MEASUREMENT EMS_bTranCrsCtrlToStop "Cruise Control To Stop Transition Flag" UBYTE EcuIntgdSwGend_CM_boolean 0 0 0.0 1.0 ECU_ADDRESS 0x4000DE52 /* @ECU_Address@EMS_bTranCrsCtrlToStop@ */ /end MEASUREMENT
/begin MEASUREMENT EMS_bTranCrsCtrlToTSC1 "Cruise Control To TSC1 Transition Flag" UBYTE EcuIntgdSwGend_CM_boolean 0 0 0.0 1.0 ECU_ADDRESS 0x4000E785 /* @ECU_Address@EMS_bTranCrsCtrlToTSC1@ */ /end MEASUREMENT
/begin MEASUREMENT EMS_bTranCrsCtrlToTq "Cruise Control To Tq Transition Flag" UBYTE EcuIntgdSwGend_CM_boolean 0 0 0.0 1.0 ECU_ADDRESS 0x4000DA48 /* @ECU_Address@EMS_bTranCrsCtrlToTq@ */ /end MEASUREMENT
/begin MEASUREMENT EMS_bTranIdlespdToCrsCtrl "Idle Speed To Cruise Control Transition Flag" UBYTE EcuIntgdSwGend_CM_boolean 0 0 0.0 1.0 ECU_ADDRESS 0x4000D7F0 /* @ECU_Address@EMS_bTranIdlespdToCrsCtrl@ */ /end MEASUREMENT
/begin MEASUREMENT EMS_bTranTSC1ToCrsCtrl "TSC1 To Cruise Control Transition Flag" UBYTE EcuIntgdSwGend_CM_boolean 0 0 0.0 1.0 ECU_ADDRESS 0x4000E4EC /* @ECU_Address@EMS_bTranTSC1ToCrsCtrl@ */ /end MEASUREMENT
/begin MEASUREMENT EMS_bTranTqToCrsCtrl "Torque To Cruise Control Transition Flag" UBYTE EcuIntgdSwGend_CM_boolean 0 0 0.0 1.0 ECU_ADDRESS 0x4000DD16 /* @ECU_Address@EMS_bTranTqToCrsCtrl@ */ /end MEASUREMENT
/begin MEASUREMENT EIP_bErrUClmp30Rng "Error Battery Voltage Range" UBYTE EcuIntgdSwGend_CM_boolean 0 0 0.0 1.0 ECU_ADDRESS 0x4000DF35 /* @ECU_Address@EIP_bErrUClmp30Rng@ */ /end MEASUREMENT
/begin MEASUREMENT EIP_bErrUClmp30Grdt "Error Battery Voltage Gradient" UBYTE EcuIntgdSwGend_CM_boolean 0 0 0.0 1.0 ECU_ADDRESS 0x4000E248 /* @ECU_Address@EIP_bErrUClmp30Grdt@ */ /end MEASUREMENT
/begin MEASUREMENT EIP_bErrUClmp30Snsr "Error Battery Voltage Sensor" UBYTE EcuIntgdSwGend_CM_boolean 0 0 0.0 1.0 ECU_ADDRESS 0x4000E6E8 /* @ECU_Address@EIP_bErrUClmp30Snsr@ */ /end MEASUREMENT
/begin MEASUREMENT EIP_bErrStrtReqSwt "Error Start Request Switch" UBYTE EcuIntgdSwGend_CM_boolean 0 0 0.0 1.0 ECU_ADDRESS 0x4000DD7E /* @ECU_Address@EIP_bErrStrtReqSwt@ */ /end MEASUREMENT
/begin MEASUREMENT EIP_bErrIgnSwt "Error Ignition Switch" UBYTE EcuIntgdSwGend_CM_boolean 0 0 0.0 1.0 ECU_ADDRESS 0x4000DE98 /* @ECU_Address@EIP_bErrIgnSwt@ */ /end MEASUREMENT
/begin MEASUREMENT EIP_bErrCrsCtrlOnOffBtn "Error Cruise Control On Off Button" UBYTE EcuIntgdSwGend_CM_boolean 0 0 0.0 1.0 ECU_ADDRESS 0x4000E42C /* @ECU_Address@EIP_bErrCrsCtrlOnOffBtn@ */ /end MEASUREMENT
/begin MEASUREMENT EIP_bErrPtoOnOffBtn "Power Take Off On Off Error Button" UBYTE EcuIntgdSwGend_CM_boolean 0 0 0.0 1.0 ECU_ADDRESS 0x4000DEF4 /* @ECU_Address@EIP_bErrPtoOnOffBtn@ */ /end MEASUREMENT
/begin MEASUREMENT EIP_bErrSpdLimrOnOffBtn "" UBYTE EcuIntgdSwGend_CM_boolean 0 0 0.0 1.0 ECU_ADDRESS 0x4000E53D /* @ECU_Address@EIP_bErrSpdLimrOnOffBtn@ */ /end MEASUREMENT
/begin MEASUREMENT EIP_bErrDecCrsCtrlBtn "Error Cruise Control Decrement Button" UBYTE EcuIntgdSwGend_CM_boolean 0 0 0.0 1.0 ECU_ADDRESS 0x4000E569 /* @ECU_Address@EIP_bErrDecCrsCtrlBtn@ */ /end MEASUREMENT
/begin MEASUREMENT EIP_bErrInctSpdLimrBtn "" UBYTE EcuIntgdSwGend_CM_boolean 0 0 0.0 1.0 ECU_ADDRESS 0x4000E4D8 /* @ECU_Address@EIP_bErrInctSpdLimrBtn@ */ /end MEASUREMENT
/begin MEASUREMENT EIP_bErrPtoSetBtn "Error Pto Set Button" UBYTE EcuIntgdSwGend_CM_boolean 0 0 0.0 1.0 ECU_ADDRESS 0x4000D969 /* @ECU_Address@EIP_bErrPtoSetBtn@ */ /end MEASUREMENT
/begin MEASUREMENT EIP_bErrIncCrsCtrlBtn "Error Cruise Control Increment Button" UBYTE EcuIntgdSwGend_CM_boolean 0 0 0.0 1.0 ECU_ADDRESS 0x4000DFB2 /* @ECU_Address@EIP_bErrIncCrsCtrlBtn@ */ /end MEASUREMENT
/begin MEASUREMENT EIP_bErrDecSpdLimrBtn "" UBYTE EcuIntgdSwGend_CM_boolean 0 0 0.0 1.0 ECU_ADDRESS 0x4000E634 /* @ECU_Address@EIP_bErrDecSpdLimrBtn@ */ /end MEASUREMENT
/begin MEASUREMENT EIP_bErrPtoResuBtn "Error Pto Resume Button" UBYTE EcuIntgdSwGend_CM_boolean 0 0 0.0 1.0 ECU_ADDRESS 0x4000E1A6 /* @ECU_Address@EIP_bErrPtoResuBtn@ */ /end MEASUREMENT
/begin MEASUREMENT EIP_bErrTroublesootingBtn "Error Troublesooting Button" UBYTE EcuIntgdSwGend_CM_boolean 0 0 0.0 1.0 ECU_ADDRESS 0x4000E1B4 /* @ECU_Address@EIP_bErrTroublesootingBtn@ */ /end MEASUREMENT
/begin MEASUREMENT EIP_bErrCmbtSwt "Error Combat Switch" UBYTE EcuIntgdSwGend_CM_boolean 0 0 0.0 1.0 ECU_ADDRESS 0x4000E298 /* @ECU_Address@EIP_bErrCmbtSwt@ */ /end MEASUREMENT
/begin MEASUREMENT EIP_bErrEngBrkReq1Btn "Error Engine Brake Request 1 Switch" UBYTE EcuIntgdSwGend_CM_boolean 0 0 0.0 1.0 ECU_ADDRESS 0x4000E054 /* @ECU_Address@EIP_bErrEngBrkReq1Btn@ */ /end MEASUREMENT
/begin MEASUREMENT EIP_bErrEngBrkReq2Btn "Error Engine Brake Request 2 Switch" UBYTE EcuIntgdSwGend_CM_boolean 0 0 0.0 1.0 ECU_ADDRESS 0x4000E68C /* @ECU_Address@EIP_bErrEngBrkReq2Btn@ */ /end MEASUREMENT
/begin MEASUREMENT EIP_bErrHndBrkPrkg "Engine Input Processing - Hand Brake Parking Switch Error" UBYTE EcuIntgdSwGend_CM_boolean 0 0 0.0 1.0 ECU_ADDRESS 0x4000D765 /* @ECU_Address@EIP_bErrHndBrkPrkg@ */ /end MEASUREMENT
/begin MEASUREMENT EIP_bErrBrkPedl "Engine Input Processing - Brake Pedal Switch Error" UBYTE EcuIntgdSwGend_CM_boolean 0 0 0.0 1.0 ECU_ADDRESS 0x4000E110 /* @ECU_Address@EIP_bErrBrkPedl@ */ /end MEASUREMENT
/begin MEASUREMENT EIP_bErrAccrSnsr1 "Error Accelerator 1 Sensor" UBYTE EcuIntgdSwGend_CM_boolean 0 0 0.0 1.0 ECU_ADDRESS 0x4000DC3D /* @ECU_Address@EIP_bErrAccrSnsr1@ */ /end MEASUREMENT
/begin MEASUREMENT EIP_bErrAccrSnsr2 "Error Accelerator 2 Sensor" UBYTE EcuIntgdSwGend_CM_boolean 0 0 0.0 1.0 ECU_ADDRESS 0x4000DC3E /* @ECU_Address@EIP_bErrAccrSnsr2@ */ /end MEASUREMENT
/begin MEASUREMENT EIP_bTranAccrLvl0To1 "Accelerator State Transition Level 0 to 1" UBYTE EcuIntgdSwGend_CM_boolean 0 0 0.0 1.0 ECU_ADDRESS 0x4000E1F4 /* @ECU_Address@EIP_bTranAccrLvl0To1@ */ /end MEASUREMENT
/begin MEASUREMENT EIP_bTranAccrLvl1To0 "Accelerator State Transition Level 1 to 0" UBYTE EcuIntgdSwGend_CM_boolean 0 0 0.0 1.0 ECU_ADDRESS 0x4000E69D /* @ECU_Address@EIP_bTranAccrLvl1To0@ */ /end MEASUREMENT
/begin MEASUREMENT EIP_bTranAccrLvl1To2 "Accelerator State Transition Level 1 to 2" UBYTE EcuIntgdSwGend_CM_boolean 0 0 0.0 1.0 ECU_ADDRESS 0x4000D9B5 /* @ECU_Address@EIP_bTranAccrLvl1To2@ */ /end MEASUREMENT
/begin MEASUREMENT EIP_bTranAccrLvl2To1 "Accelerator State Transition Level 2 to 1" UBYTE EcuIntgdSwGend_CM_boolean 0 0 0.0 1.0 ECU_ADDRESS 0x4000E226 /* @ECU_Address@EIP_bTranAccrLvl2To1@ */ /end MEASUREMENT
/begin MEASUREMENT EIP_bTranAccrLvl2To3 "Accelerator State Transition Level 2 to 3" UBYTE EcuIntgdSwGend_CM_boolean 0 0 0.0 1.0 ECU_ADDRESS 0x4000E228 /* @ECU_Address@EIP_bTranAccrLvl2To3@ */ /end MEASUREMENT
/begin MEASUREMENT EIP_bTranAccrLvl3To2 "Accelerator State Transition Level 3 to 2" UBYTE EcuIntgdSwGend_CM_boolean 0 0 0.0 1.0 ECU_ADDRESS 0x4000DAEC /* @ECU_Address@EIP_bTranAccrLvl3To2@ */ /end MEASUREMENT
/begin MEASUREMENT EIP_bErrCamsftSnsr "Error Camshaft Sensor" UBYTE EcuIntgdSwGend_CM_boolean 0 0 0.0 1.0 ECU_ADDRESS 0x4000DB2C /* @ECU_Address@EIP_bErrCamsftSnsr@ */ /end MEASUREMENT
/begin MEASUREMENT EIP_bErrCrnksftSnsr "Error Crankshaft Sensor" UBYTE EcuIntgdSwGend_CM_boolean 0 0 0.0 1.0 ECU_ADDRESS 0x4000DE74 /* @ECU_Address@EIP_bErrCrnksftSnsr@ */ /end MEASUREMENT
/begin MEASUREMENT EIP_bErrCamCrankTotLoss "Error Cam Crank Total Loss" UBYTE EcuIntgdSwGend_CM_boolean 0 0 0.0 1.0 ECU_ADDRESS 0x4000DF72 /* @ECU_Address@EIP_bErrCamCrankTotLoss@ */ /end MEASUREMENT
/begin MEASUREMENT EIP_bDecSpdLimrBtn "" UBYTE EcuIntgdSwGend_CM_boolean 0 0 0.0 1.0 ECU_ADDRESS 0x4000D860 /* @ECU_Address@EIP_bDecSpdLimrBtn@ */ /end MEASUREMENT
/begin MEASUREMENT EIP_bAcvPtoResuBtn "Pto Resume Button Active" UBYTE EcuIntgdSwGend_CM_boolean 0 0 0.0 1.0 ECU_ADDRESS 0x4000E550 /* @ECU_Address@EIP_bAcvPtoResuBtn@ */ /end MEASUREMENT
/begin MEASUREMENT EIP_bDecCrsCtrlBtn "Cruise Control Decrement Button" UBYTE EcuIntgdSwGend_CM_boolean 0 0 0.0 1.0 ECU_ADDRESS 0x4000DE14 /* @ECU_Address@EIP_bDecCrsCtrlBtn@ */ /end MEASUREMENT
/begin MEASUREMENT EIP_bInctSpdLimrBtn "" UBYTE EcuIntgdSwGend_CM_boolean 0 0 0.0 1.0 ECU_ADDRESS 0x4000DB8C /* @ECU_Address@EIP_bInctSpdLimrBtn@ */ /end MEASUREMENT
/begin MEASUREMENT EIP_bAcvPtoSetBtn "Pto Set Button Active" UBYTE EcuIntgdSwGend_CM_boolean 0 0 0.0 1.0 ECU_ADDRESS 0x4000E2C0 /* @ECU_Address@EIP_bAcvPtoSetBtn@ */ /end MEASUREMENT
/begin MEASUREMENT EIP_bIncCrsCtrlBtn "Cruise Control Increment Button" UBYTE EcuIntgdSwGend_CM_boolean 0 0 0.0 1.0 ECU_ADDRESS 0x4000DDB4 /* @ECU_Address@EIP_bIncCrsCtrlBtn@ */ /end MEASUREMENT
/begin MEASUREMENT EIP_HndBrkPrkg "Hand Brake Parking" UBYTE EcuIntgdSwGend_CM_boolean 0 0 0.0 1.0 ECU_ADDRESS 0x4000E444 /* @ECU_Address@EIP_HndBrkPrkg@ */ /end MEASUREMENT
/begin MEASUREMENT EIP_bEngBrkReq1Btn "Engine Break Request 1 Button" UBYTE EcuIntgdSwGend_CM_boolean 0 0 0.0 1.0 ECU_ADDRESS 0x4000E796 /* @ECU_Address@EIP_bEngBrkReq1Btn@ */ /end MEASUREMENT
/begin MEASUREMENT EIP_bEngBrkReq2Btn "Engine Break Request 2 Button" UBYTE EcuIntgdSwGend_CM_boolean 0 0 0.0 1.0 ECU_ADDRESS 0x4000DF1B /* @ECU_Address@EIP_bEngBrkReq2Btn@ */ /end MEASUREMENT
/begin MEASUREMENT EIP_bBrkPedl "Brake Pedal" UBYTE EcuIntgdSwGend_CM_boolean 0 0 0.0 1.0 ECU_ADDRESS 0x4000DE87 /* @ECU_Address@EIP_bBrkPedl@ */ /end MEASUREMENT
/begin MEASUREMENT EIP_bIgnSwt "Ignition Switch" UBYTE EcuIntgdSwGend_CM_boolean 0 0 0.0 1.0 ECU_ADDRESS 0x4000D988 /* @ECU_Address@EIP_bIgnSwt@ */ /end MEASUREMENT
/begin MEASUREMENT EIP_bAcvPtoOnOffBtn "Pto On Off Button Active" UBYTE EcuIntgdSwGend_CM_boolean 0 0 0.0 1.0 ECU_ADDRESS 0x4000DAB4 /* @ECU_Address@EIP_bAcvPtoOnOffBtn@ */ /end MEASUREMENT
/begin MEASUREMENT EIP_bCrsCtrlOnOffBtn "Cruise Control On Off Button" UBYTE EcuIntgdSwGend_CM_boolean 0 0 0.0 1.0 ECU_ADDRESS 0x4000DDC1 /* @ECU_Address@EIP_bCrsCtrlOnOffBtn@ */ /end MEASUREMENT
/begin MEASUREMENT EIP_bSpdLimrOnOffBtn "" UBYTE EcuIntgdSwGend_CM_boolean 0 0 0.0 1.0 ECU_ADDRESS 0x4000D6A6 /* @ECU_Address@EIP_bSpdLimrOnOffBtn@ */ /end MEASUREMENT
/begin MEASUREMENT EIP_bAcvCmbtSwt "Combat Switch Active" UBYTE EcuIntgdSwGend_CM_boolean 0 0 0.0 1.0 ECU_ADDRESS 0x4000E1B7 /* @ECU_Address@EIP_bAcvCmbtSwt@ */ /end MEASUREMENT
/begin MEASUREMENT EIP_bTroubleshootingBtn "Troubleshooting Button" UBYTE EcuIntgdSwGend_CM_boolean 0 0 0.0 1.0 ECU_ADDRESS 0x4000DD7C /* @ECU_Address@EIP_bTroubleshootingBtn@ */ /end MEASUREMENT
/begin MEASUREMENT EIP_bStrtReqSwt "Start Request Switch" UBYTE EcuIntgdSwGend_CM_boolean 0 0 0.0 1.0 ECU_ADDRESS 0x4000DA24 /* @ECU_Address@EIP_bStrtReqSwt@ */ /end MEASUREMENT
/begin MEASUREMENT EIP_bAcvIdleSpdCtl "Idle Speed Control Active" UBYTE EcuIntgdSwGend_CM_boolean 0 0 0.0 1.0 ECU_ADDRESS 0x4000E53C /* @ECU_Address@EIP_bAcvIdleSpdCtl@ */ /end MEASUREMENT
/begin MEASUREMENT EIP_bErrGridHeatr "Error Grid Heater" UBYTE EcuIntgdSwGend_CM_boolean 0 0 0.0 1.0 ECU_ADDRESS 0x4000E534 /* @ECU_Address@EIP_bErrGridHeatr@ */ /end MEASUREMENT
/begin MEASUREMENT EIP_bErrVCV "Error VCV" UBYTE EcuIntgdSwGend_CM_boolean 0 0 0.0 1.0 ECU_ADDRESS 0x4000E055 /* @ECU_Address@EIP_bErrVCV@ */ /end MEASUREMENT
/begin MEASUREMENT EIP_bErrInjr1 "Error Injector 1" UBYTE EcuIntgdSwGend_CM_boolean 0 0 0.0 1.0 ECU_ADDRESS 0x4000E5E8 /* @ECU_Address@EIP_bErrInjr1@ */ /end MEASUREMENT
/begin MEASUREMENT EIP_bErrInjr2 "Error Injector 2" UBYTE EcuIntgdSwGend_CM_boolean 0 0 0.0 1.0 ECU_ADDRESS 0x4000E5E9 /* @ECU_Address@EIP_bErrInjr2@ */ /end MEASUREMENT
/begin MEASUREMENT EIP_bErrInjr3 "Error Injector 3" UBYTE EcuIntgdSwGend_CM_boolean 0 0 0.0 1.0 ECU_ADDRESS 0x4000E5EA /* @ECU_Address@EIP_bErrInjr3@ */ /end MEASUREMENT
/begin MEASUREMENT EIP_bErrInjr4 "Error Injector 4" UBYTE EcuIntgdSwGend_CM_boolean 0 0 0.0 1.0 ECU_ADDRESS 0x4000E12D /* @ECU_Address@EIP_bErrInjr4@ */ /end MEASUREMENT
/begin MEASUREMENT EIP_bErrInjr5 "Error Injector 5" UBYTE EcuIntgdSwGend_CM_boolean 0 0 0.0 1.0 ECU_ADDRESS 0x4000E134 /* @ECU_Address@EIP_bErrInjr5@ */ /end MEASUREMENT
/begin MEASUREMENT EIP_bErrInjr6 "Error Injector 6" UBYTE EcuIntgdSwGend_CM_boolean 0 0 0.0 1.0 ECU_ADDRESS 0x4000E5ED /* @ECU_Address@EIP_bErrInjr6@ */ /end MEASUREMENT
/begin MEASUREMENT EIP_bErrTotInjr "Error Total Injector" UBYTE EcuIntgdSwGend_CM_boolean 0 0 0.0 1.0 ECU_ADDRESS 0x4000E1FD /* @ECU_Address@EIP_bErrTotInjr@ */ /end MEASUREMENT
/begin MEASUREMENT EIP_bErrWg "Error Wastegate" UBYTE EcuIntgdSwGend_CM_boolean 0 0 0.0 1.0 ECU_ADDRESS 0x4000E678 /* @ECU_Address@EIP_bErrWg@ */ /end MEASUREMENT
/begin MEASUREMENT EIP_bErrPCV "Error PCV" UBYTE EcuIntgdSwGend_CM_boolean 0 0 0.0 1.0 ECU_ADDRESS 0x4000DCFB /* @ECU_Address@EIP_bErrPCV@ */ /end MEASUREMENT
/begin MEASUREMENT EIP_ErrRedStopLamp "Error Red Stop Lamp (RSL)" UBYTE EcuIntgdSwGend_CM_boolean 0 0 0.0 1.0 ECU_ADDRESS 0x4000D842 /* @ECU_Address@EIP_ErrRedStopLamp@ */ /end MEASUREMENT
/begin MEASUREMENT EIP_ErrAmberWarnLamp "Error Amber Warning Lamp (AWL)" UBYTE EcuIntgdSwGend_CM_boolean 0 0 0.0 1.0 ECU_ADDRESS 0x4000DEDC /* @ECU_Address@EIP_ErrAmberWarnLamp@ */ /end MEASUREMENT
/begin MEASUREMENT EIP_ErrColdStrtLamp "Error Cold Start Lamp (CSL)" UBYTE EcuIntgdSwGend_CM_boolean 0 0 0.0 1.0 ECU_ADDRESS 0x4000DEBC /* @ECU_Address@EIP_ErrColdStrtLamp@ */ /end MEASUREMENT
/begin MEASUREMENT EIP_ErrEngBrkSoln1 "Error Engine Brake Selenoid 1" UBYTE EcuIntgdSwGend_CM_boolean 0 0 0.0 1.0 ECU_ADDRESS 0x4000E4BC /* @ECU_Address@EIP_ErrEngBrkSoln1@ */ /end MEASUREMENT
/begin MEASUREMENT EIP_ErrEngBrkSoln2 "Error Engine Brake Selenoid 2" UBYTE EcuIntgdSwGend_CM_boolean 0 0 0.0 1.0 ECU_ADDRESS 0x4000E4BD /* @ECU_Address@EIP_ErrEngBrkSoln2@ */ /end MEASUREMENT
/begin MEASUREMENT EIP_ErrStrtr "Engine Input Processing - Starter Error" UBYTE EcuIntgdSwGend_CM_boolean 0 0 0.0 1.0 ECU_ADDRESS 0x4000D8F0 /* @ECU_Address@EIP_ErrStrtr@ */ /end MEASUREMENT
/begin MEASUREMENT DTqC_IdleSpdCtrlActv "Idle Speed Controller Active" UBYTE EcuIntgdSwGend_CM_boolean 0 0 0.0 1.0 ECU_ADDRESS 0x4000E268 /* @ECU_Address@DTqC_IdleSpdCtrlActv@ */ /end MEASUREMENT
/begin MEASUREMENT CrsCtrl_ActvCrsCtrlOnOffBtn "Cruise Control On-Off Button Active" UBYTE EcuIntgdSwGend_CM_boolean 0 0 0.0 1.0 ECU_ADDRESS 0x4000E6DC /* @ECU_Address@CrsCtrl_ActvCrsCtrlOnOffBtn@ */ /end MEASUREMENT
/begin MEASUREMENT CrsCtrl_ActvCrsCtrlSetBtn "Cruise Control Set Button Active" UBYTE EcuIntgdSwGend_CM_boolean 0 0 0.0 1.0 ECU_ADDRESS 0x4000E6C6 /* @ECU_Address@CrsCtrl_ActvCrsCtrlSetBtn@ */ /end MEASUREMENT
/begin MEASUREMENT CrsCtrl_ActvCrsCtrlResuBtn "Cruise Control Resume Button Active" UBYTE EcuIntgdSwGend_CM_boolean 0 0 0.0 1.0 ECU_ADDRESS 0x4000DC9C /* @ECU_Address@CrsCtrl_ActvCrsCtrlResuBtn@ */ /end MEASUREMENT
/begin MEASUREMENT CrsCtrl_ErrCrsCtrlOnOffBtn "Cruise Control On-Off Button Error Signal" UBYTE EcuIntgdSwGend_CM_boolean 0 0 0.0 1.0 ECU_ADDRESS 0x4000DF9B /* @ECU_Address@CrsCtrl_ErrCrsCtrlOnOffBtn@ */ /end MEASUREMENT
/begin MEASUREMENT CrsCtrl_ErrCrsCtrlSetBtn "Cruise Control Set Button Error Signal" UBYTE EcuIntgdSwGend_CM_boolean 0 0 0.0 1.0 ECU_ADDRESS 0x4000D6C0 /* @ECU_Address@CrsCtrl_ErrCrsCtrlSetBtn@ */ /end MEASUREMENT
/begin MEASUREMENT CrsCtrl_ErrCrsCtrlResuBtn "Cruise Control Resume Button Error Signal" UBYTE EcuIntgdSwGend_CM_boolean 0 0 0.0 1.0 ECU_ADDRESS 0x4000E654 /* @ECU_Address@CrsCtrl_ErrCrsCtrlResuBtn@ */ /end MEASUREMENT
/begin MEASUREMENT CrsCtrl_ErrCrsCtrlBtn "Error Cruise Control Digital Input" UBYTE EcuIntgdSwGend_CM_boolean 0 0 0.0 1.0 ECU_ADDRESS 0x4000E445 /* @ECU_Address@CrsCtrl_ErrCrsCtrlBtn@ */ /end MEASUREMENT
/begin COMPU_METHOD EcuIntgdSwGend_CM_single_N_m "Q = V" RAT_FUNC "%8.6" "N*m" COEFFS 0 1 0 0 0 1 /end COMPU_METHOD
/begin COMPU_METHOD EcuIntgdSwGend_CM_single_rpm "Q = V" RAT_FUNC "%8.6" "rpm" COEFFS 0 1 0 0 0 1 /end COMPU_METHOD
/begin COMPU_METHOD EcuIntgdSwGend_CM_single_degC "Q = V" RAT_FUNC "%8.6" "degC" COEFFS 0 1 0 0 0 1 /end COMPU_METHOD
/begin COMPU_METHOD EcuIntgdSwGend_CM_single "Q = V" RAT_FUNC "%8.6" "" COEFFS 0 1 0 0 0 1 /end COMPU_METHOD
/begin COMPU_METHOD EcuIntgdSwGend_CM_single__ "Q = V" RAT_FUNC "%8.6" "%" COEFFS 0 1 0 0 0 1 /end COMPU_METHOD
/begin COMPU_METHOD EcuIntgdSwGend_CM_single_ms "Q = V" RAT_FUNC "%8.6" "ms" COEFFS 0 1 0 0 0 1 /end COMPU_METHOD
/begin COMPU_METHOD EcuIntgdSwGend_CM_single_mbar "Q = V" RAT_FUNC "%8.6" "mbar" COEFFS 0 1 0 0 0 1 /end COMPU_METHOD
/begin COMPU_METHOD EcuIntgdSwGend_CM_single_bar "Q = V" RAT_FUNC "%8.6" "bar" COEFFS 0 1 0 0 0 1 /end COMPU_METHOD
/begin COMPU_METHOD EcuIntgdSwGend_CM_single_mm_3_stk "Q = V" RAT_FUNC "%8.6" "mm^3/stk" COEFFS 0 1 0 0 0 1 /end COMPU_METHOD
/begin COMPU_METHOD EcuIntgdSwGend_CM_single_V "Q = V" RAT_FUNC "%8.6" "V" COEFFS 0 1 0 0 0 1 /end COMPU_METHOD
/begin COMPU_METHOD EcuIntgdSwGend_CM_single_km_h "Q = V" RAT_FUNC "%8.6" "km/h" COEFFS 0 1 0 0 0 1 /end COMPU_METHOD
/begin COMPU_METHOD EcuIntgdSwGend_CM_int16 "Q = V" RAT_FUNC "%5.0" "" COEFFS 0 1 0 0 0 1 /end COMPU_METHOD
/begin COMPU_METHOD EcuIntgdSwGend_CM_single_km "Q = V" RAT_FUNC "%8.6" "km" COEFFS 0 1 0 0 0 1 /end COMPU_METHOD
/begin COMPU_METHOD EcuIntgdSwGend_CM_single_h "Q = V" RAT_FUNC "%8.6" "h" COEFFS 0 1 0 0 0 1 /end COMPU_METHOD
/begin COMPU_METHOD EcuIntgdSwGend_CM_single_l_100km "Q = V" RAT_FUNC "%8.6" "l/100km" COEFFS 0 1 0 0 0 1 /end COMPU_METHOD
/begin COMPU_METHOD EcuIntgdSwGend_CM_single_V_sec "Q = V" RAT_FUNC "%8.6" "V/sec" COEFFS 0 1 0 0 0 1 /end COMPU_METHOD
/begin COMPU_METHOD EcuIntgdSwGend_CM_int16__ "Q = V" RAT_FUNC "%5.0" "%" COEFFS 0 1 0 0 0 1 /end COMPU_METHOD
/begin COMPU_METHOD EcuIntgdSwGend_CM_int16_km_h "Q = V" RAT_FUNC "%5.0" "km/h" COEFFS 0 1 0 0 0 1 /end COMPU_METHOD
/begin COMPU_METHOD EcuIntgdSwGend_CM_boolean "Q = V" RAT_FUNC "%1.0" "" COEFFS 0 1 0 0 0 1 /end COMPU_METHOD
/begin COMPU_METHOD EcuIntgdSwGend_CM_int8 "Q = V" RAT_FUNC "%3.0" "" COEFFS 0 1 0 0 0 1 /end COMPU_METHOD
/begin COMPU_METHOD EcuIntgdSwGend_CM_int8__ "Q = V" RAT_FUNC "%3.0" "%" COEFFS 0 1 0 0 0 1 /end COMPU_METHOD
/begin COMPU_METHOD EcuIntgdSwGend_CM_uint8 "Q = V" RAT_FUNC "%3.0" "" COEFFS 0 1 0 0 0 1 /end COMPU_METHOD
/begin COMPU_METHOD EcuIntgdSwGend_CM_uint8__ "Q = V" RAT_FUNC "%3.0" "%" COEFFS 0 1 0 0 0 1 /end COMPU_METHOD
/begin COMPU_METHOD EcuIntgdSwGend_CM_single_m "Q = V" RAT_FUNC "%8.6" "m" COEFFS 0 1 0 0 0 1 /end COMPU_METHOD
/begin COMPU_METHOD EcuIntgdSwGend_CM_EngineMode "Enumerated data type: EngineMode" TAB_VERB "%0.6" "" COMPU_TAB_REF VTAB_FOR_EcuIntgdSwGend_CM_EngineMode /end COMPU_METHOD
/begin COMPU_VTAB VTAB_FOR_EcuIntgdSwGend_CM_EngineMode "Enumerated data type: EngineMode" TAB_VERB 9 1 "TorqueMode" 2 "StartMode" 3 "IdleMode" 4 "OverSpeedMode" 5 "StopMode" 6 "PowerOnMode" 7 "PTOMode" 8 "TSC1Mode" 9 "CruiseControlActiveMode" /end COMPU_VTAB
/begin COMPU_METHOD EcuIntgdSwGend_CM_CruiseControlMode "Enumerated data type: CruiseControlMode" TAB_VERB "%0.6" "" COMPU_TAB_REF VTAB_FOR_EcuIntgdSwGend_CM_CruiseControlMode /end COMPU_METHOD
/begin COMPU_VTAB VTAB_FOR_EcuIntgdSwGend_CM_CruiseControlMode "Enumerated data type: CruiseControlMode" TAB_VERB 3 0 "CruiseControlOff" 1 "CruiseControlIdle" 2 "CruiseControlOn" /end COMPU_VTAB
/begin GROUP EcuIntgdSwGend "EcuIntgdSwGend" /* Root */ ROOT /begin SUB_GROUP Root_ControlSoftware /end SUB_GROUP
 /begin REF_MEASUREMENT INP_CamsftSpd INP_CanABSActv INP_CanASRBrkCtrlActv INP_CanASREngCtrlActv INP_CanActMaxAvlRtdr INP_CanCrsCtrlEnaSwt INP_CanCrsCtrlResuSwt INP_CanCrsCtrlSetSwt INP_CanEngAuxShtdwnSwt INP_CanEngOvrdCtrlMod INP_CanEngPtoGovrAccrSwt INP_CanEngPtoGovrCoastSwt INP_CanEngPtoGovrEnaSwt INP_CanEngPtoGovrResuSwt INP_CanEngPtoGovrSetSwt INP_CanEngRemPtoGovrProgdSpdCtrlSwt INP_CanEngReqTqHiResl INP_CanEngSpdReq INP_CanEngTqLimReqMaxCntns INP_CanEngTqReq INP_CanEstimdEngParasiticTq INP_CanEstimdPercFanSpd INP_CanFuLvl1 INP_CanOvrdCtrlModPrio INP_CanPercCluSlip INP_CanReqdPercFanSpd INP_CanTSC1MessageCntr INP_CanTachographVehSpd INP_CanTrfCaseSts INP_CanTrsmActGearRat INP_CanTrsmCurrentGear INP_CanTrsmEngCrkEna INP_CanTrsmOilLvlReq INP_CanTrsmOutpShaftSpd INP_CanTrsmSeldGear INP_CanTrsmTqCnvLockUpEngd INP_CanTrsmTqCnvrRat INP_CanVehLimSpdGovrDecSwt INP_CanVehLimSpdGovrEnaSwt INP_CanVehLimSpdGovrInctSwt INP_CanWhlBasVehSpd INP_CrnksftSpd INP_DstTrvldMem INP_EngHrMem INP_ErrAmberWarnLamp INP_ErrColdStrtLamp INP_ErrEngBrkSoln1 INP_ErrEngBrkSoln2 INP_ErrRedStopLamp INP_ErrStrtr INP_FuelCnsMem INP_GridHeatrRlyFb INP_HndBrkPrkg INP_IgnSwtU INP_LvlOil INP_MeanDifNEngAndCyl1 INP_MeanDifNEngAndCyl2 INP_MeanDifNEngAndCyl3 INP_MeanDifNEngAndCyl4 INP_MeanDifNEngAndCyl5 INP_MeanDifNEngAndCyl6 INP_NCyl1Min INP_NCyl2Min INP_NCyl3Min INP_NCyl4Min INP_NCyl5Min INP_NCyl6Min INP_NEng INP_NMeaCylMin INP_PAirBoost INP_PAmbAir INP_PFu INP_POil INP_PRail INP_PercgAccr1 INP_PercgAccr2 INP_StOfCanABSActv INP_StOfCanASRBrkCtrlActv INP_StOfCanASREngCtrlActv INP_StOfCanActMaxAvlRtdr INP_StOfCanCrsCtrlEnaSwt INP_StOfCanCrsCtrlResuSwt INP_StOfCanCrsCtrlSetSwt INP_StOfCanEngAuxShtdwnSwt INP_StOfCanEngOvrdCtrlMod INP_StOfCanEngPtoGovrAccrSwt INP_StOfCanEngPtoGovrCoastSwt INP_StOfCanEngPtoGovrEnaSwt INP_StOfCanEngPtoGovrResuSwt INP_StOfCanEngPtoGovrSetSwt INP_StOfCanEngRemPtoGovrSpdCtrlSwt INP_StOfCanEngReqTqHiResl INP_StOfCanEngSpdReq INP_StOfCanEngTqLimReqMaxCntns INP_StOfCanEngTqReq INP_StOfCanEstimdEngParasiticTq INP_StOfCanEstimdPercFanSpd INP_StOfCanFuLvl1 INP_StOfCanOvrdCtrlModPrio INP_StOfCanPercCluSlip INP_StOfCanReqdPercFanSpd INP_StOfCanTSC1MessageCntr INP_StOfCanTachographVehSpd INP_StOfCanTrfCaseSts INP_StOfCanTrsmActGearRat INP_StOfCanTrsmCurrentGear INP_StOfCanTrsmEngCrkEna INP_StOfCanTrsmOilLvlReq INP_StOfCanTrsmOutpShaftSpd INP_StOfCanTrsmSeldGear INP_StOfCanTrsmTqCnvLockUpEngd INP_StOfCanTrsmTqCnvrRat INP_StOfCanVehLimSpdGovrDecSwt INP_StOfCanVehLimSpdGovrEnaSwt INP_StOfCanVehLimSpdGovrInctSwt INP_StOfCanWhlBasVehSpd INP_TAirBoost INP_TAmbAir INP_TCoolt INP_TEcu INP_TFu INP_TOil INP_TripMem INP_UClmp30 INP_bAcvCmbtSwt INP_bBrkPedl INP_bCrsCtrlOnOffBtn INP_bDecCrsCtrlBtn INP_bEngBrkReq1Btn INP_bEngBrkReq2Btn INP_bErrAccrSnsr1 INP_bErrAccrSnsr2 INP_bErrBrkPedl INP_bErrCamsftSnsr INP_bErrCmbtSwt INP_bErrCrnksftSnsr INP_bErrCrsCtrlOnOffBtn INP_bErrDecCrsCtrlBtn INP_bErrEngBrkReq1Btn INP_bErrEngBrkReq2Btn INP_bErrGridHeatr INP_bErrHndBrkPrkg INP_bErrIgnSwt INP_bErrIncCrsCtrlBtn INP_bErrInjr1 INP_bErrInjr2 INP_bErrInjr3 INP_bErrInjr4 INP_bErrInjr5 INP_bErrInjr6 INP_bErrLvlOilSnsr INP_bErrPAirBoostSnsr INP_bErrPAmbAirSnsr INP_bErrPCV INP_bErrPFuSnsr INP_bErrPOilSnsr INP_bErrPRailSnsr INP_bErrStrtReqSwt INP_bErrTAirBoostSnsr INP_bErrTAmbAirSnsr INP_bErrTCooltSnsr INP_bErrTEcuSnsr INP_bErrTFuSnsr INP_bErrTOilSnsr INP_bErrTroublesootingBtn INP_bErrVCV INP_bErrWg INP_bIncCrsCtrlBtn INP_bStrtReqSwt INP_bTroubleshootingBtn /end REF_MEASUREMENT
/end GROUP
/begin GROUP Root_ControlSoftware "EcuIntgdSwGend/ControlSoftware"
 /begin SUB_GROUP S1_CrsCtrl S1_DesTqClcn S1_EcuInpPrcsg S1_EcuModSeln S1_EcuOutpPrcsg S1_EngBrk S1_InjCtl S1_PrhtgCtl S1_PtoCtrl S1_RailPGovr S1_SpdLimr S1_StrtrCtl S1_TqCnvn S1_TqLim S1_WarnMong S1_WgtCtl /end SUB_GROUP
 /begin REF_MEASUREMENT EMS_bTranCrsCtrlToOvspd /end REF_MEASUREMENT
/end GROUP
/begin GROUP S1_CrsCtrl "EcuIntgdSwGend/ControlSoftware/CrsCtrl"
 /begin SUB_GROUP S2_Can_Message_and_Hardware_Check S2_CruiseControl S2_Cruise_Control_CAN_Signals S2_Engine_Brake_Activation_via_Cruise_Control /end SUB_GROUP
/end GROUP
/begin GROUP S1_DesTqClcn "EcuIntgdSwGend/ControlSoftware/DesTqClcn"
 /begin SUB_GROUP S3_Desired_Torque_Calculation_CAN_Signals S3_Friction_Torque_Calculation S3_Idle_Speed_Reference_Selector S3_Power_On_Control S3_Running_Mode S3_Start_Control S3_Stop_Control S3_saturation /end SUB_GROUP
 /begin REF_CHARACTERISTIC DTqC_MaxNomEngSpd_P DTqC_MaxNomTq_P DTqC_MaxTqAtCurrentEngSpd_M DTqC_TqIndcdOvs_P DTqC_TqIndcdOvv_P DTqC_TqIndcdSatMin_P EG_ModEngCtlCrs_C EG_ModEngCtlIdleSpd_C EG_ModEngCtlOvspd_C EG_ModEngCtlPTO_C EG_ModEngCtlPwrOn_C EG_ModEngCtlStp_C EG_ModEngCtlStrt_C EG_ModEngCtlTSC1_C EG_ModEngCtlTq_C /end REF_CHARACTERISTIC
 /begin REF_MEASUREMENT DTqC_MaxIndcdTqAtCurrentEngSpd DTqC_MaxTqAtCurrentEngSpd DTqC_TSC1MaxIndcdTq DTqC_TqBrk /end REF_MEASUREMENT
/end GROUP
/begin GROUP S1_EcuInpPrcsg "EcuIntgdSwGend/ControlSoftware/EcuInpPrcsg"
 /begin SUB_GROUP S4_Actuator_Defect_Signals S4_Additionals S4_CAN_Signals S4_Distance_to_Travel S4_Driver_Commands S4_ECU_Configuration S4_Electrical_Contact_Signals S4_Engine_Hour_Calculation S4_Level_Sensor_Signals S4_NVM_Signals_from_BSW S4_Position___Speed_Sensor_Signals S4_Pressure_Sensor_Signals S4_Status_Signal S4_Switch__Button_Defect_Signals S4_Temperature_Sensor_Signals S4_Vehicle_Velocity_Calculation /end SUB_GROUP
/end GROUP
/begin GROUP S1_EcuModSeln "EcuIntgdSwGend/ControlSoftware/EcuModSeln"
 /begin SUB_GROUP S5_Cruise_Control_Transition_to_Idle_Speed S5_Cruise_Control_Transition_to_Torque S5_Cruise_Control_to_Stop_Transition S5_Cruise_Control_to_TSC1_Transition S5_Idle_Speed_to_Cruise_Control_Transition S5_Idle_Speed_to_Overspeed_Transition S5_Idle_Speed_to_PTO_Transition S5_Idle_Speed_to_Stop_Transition S5_Idle_Speed_to_TSC1_Transition1 S5_Idle_Speed_to_Torque_Transiton S5_Overspeed_to_Stop_Transition S5_Overspeed_to_Torque_Transition S5_PTO_to_Idle_Speed_Transition S5_PTO_to_Stop_Transition S5_Power_On_to_Start_Transiton S5_Start_to_Idle_Speed_Transition S5_Start_to_Stop_Transition S5_Stop_to_Power_On_Transition S5_TSC1_To_Torque_Transition S5_TSC1_to_Cruise_Control_Transition S5_TSC1_to_Overspeed_Transition S5_TSC1_to_Stop_Transition S5_Torque_to_Cruise_Control_Transition S5_Torque_to_Idle_Speed_Transition S5_Torque_to_Overspeed_Transition S5_Torque_to_Stop_Transition S5_Torque_to_TSC1_Transition /end SUB_GROUP
 /begin REF_MEASUREMENT EMS_ModEngCtl EMS_ModEngCtlSt /end REF_MEASUREMENT
/end GROUP
/begin GROUP S1_EcuOutpPrcsg "EcuIntgdSwGend/ControlSoftware/EcuOutpPrcsg"
 /begin SUB_GROUP S6_AuxiliaryOutputs S6_CAN_Signals S6_Digital_Output S6_InjectionOutputs S6_NvM_Signals_to_BSW S6_Starter_Digital_Output S6_ValveOutputs /end SUB_GROUP
/end GROUP
/begin GROUP S1_EngBrk "EcuIntgdSwGend/ControlSoftware/EngBrk" /begin SUB_GROUP S7_Engine_Brake_Control /end SUB_GROUP /end GROUP
/begin GROUP S1_InjCtl "EcuIntgdSwGend/ControlSoftware/InjCtl"
 /begin SUB_GROUP S8_Calibration_Purpose S8_Cylinder_1 S8_Cylinder_2 S8_Cylinder_3 S8_Cylinder_4 S8_Cylinder_5 S8_Cylinder_6 S8_Cylinder_Balancing S8_Fuel_Consumption_Calculation S8_Main_Injector_Characteristic_Maps S8_Pilot_Injector_Characteristic_Maps S8_Pre_Injection_Shadowing S8_Start_of_Injection_Angle_for_Pilot_and_Main_Injection /end SUB_GROUP
 /begin REF_CHARACTERISTIC EG_NmrSng4_C EG_NmrSng6_C IC_DurMaiCyl1DeacBalOvs_P IC_DurMaiCyl2DeacBalOvs_P IC_DurMaiCyl3DeacBalOvs_P IC_DurMaiCyl4DeacBalOvs_P IC_DurMaiCyl5DeacBalOvs_P IC_DurMaiCyl6DeacBalOvs_P IC_MTotFuQntyCorrdOvs_P IC_MTotFuQntyCorrdOvv_P /end REF_CHARACTERISTIC
 /begin REF_MEASUREMENT IC_MTotFuQntyCorrd /end REF_MEASUREMENT
/end GROUP
/begin GROUP S1_PrhtgCtl "EcuIntgdSwGend/ControlSoftware/PrhtgCtl"
 /begin SUB_GROUP S9_Grid_Heater_Activation S9_Grid_Heater_Activation_After_Starter S9_Grid_Heater_Activation_Before_Starter S9_Grid_Heater_Fault /end SUB_GROUP
/end GROUP
/begin GROUP S1_PtoCtrl "EcuIntgdSwGend/ControlSoftware/PtoCtrl"
 /begin SUB_GROUP S10_Cabin_PTO S10_Can_Message_and_Hardware_Check S10_PTO_Governor_State S10_PTO_PID S10_Remote_PTO /end SUB_GROUP
 /begin REF_CHARACTERISTIC EG_ModEngCtlIdleSpd_C EG_bFlgFalse_C PtoCtrl_TargetSpdRateLoLim_P PtoCtrl_TargetSpdRateUpLim_P PtoCtrl_TqDmd_P PtoCtrl_bAcvLimpAcv_C PtoCtrl_bAcvLimpOvs_P PtoCtrl_bAcvRednLvl1Acv_C PtoCtrl_bAcvRednLvl1Ovs_P PtoCtrl_bAcvRednLvl2Acv_C PtoCtrl_bAcvRednLvl2Ovs_P /end REF_CHARACTERISTIC
 /begin REF_MEASUREMENT PtoCtrl_ActvtEngIdleSpd PtoCtrl_NEngTargetSpdPID PtoCtrl_PtoCtrlTq PtoCtrl_bAcvLimp PtoCtrl_bAcvRednLvl1 PtoCtrl_bAcvRednLvl2 /end REF_MEASUREMENT
/end GROUP
/begin GROUP S1_RailPGovr "EcuIntgdSwGend/ControlSoftware/RailPGovr"
 /begin SUB_GROUP S11_Pressure_Control_Valve S11_Rail_Pressure_Control_FeedForward_Map_ S11_Rail_Pressure_PID_Controller S11_Rail_Pressure_Reference_Calculation S11_VCV_Valve_Control /end SUB_GROUP
 /begin REF_CHARACTERISTIC EG_ModEngCtlPwrOn_C EG_ModEngCtlStp_C RPG_PRailRefOvs_P RPG_PRailRefOvv_P /end REF_CHARACTERISTIC
 /begin REF_MEASUREMENT RPG_PRailRef RPG_bAcvPwrOnMod RPG_bAcvStpMod /end REF_MEASUREMENT
/end GROUP
/begin GROUP S1_SpdLimr "EcuIntgdSwGend/ControlSoftware/SpdLimr"
 /begin SUB_GROUP S12_Can_Message_and_Hardware_Check S12_Engine_Brake_Activation_Via_Speed_Limiter S12_Speed_Limiter S12_Speed_Limiter_PID /end SUB_GROUP
/end GROUP
/begin GROUP S1_StrtrCtl "EcuIntgdSwGend/ControlSoftware/StrtrCtl"
 /begin SUB_GROUP S13_Enabling___Disabling_Starter S13_Maximum_Allowable_Cranking_Time_Calculation S13_StartInhibitor S13_Start_Error_Detect_Algorithms_ S13_Starter_Locking /end SUB_GROUP
 /begin REF_CHARACTERISTIC EG_NmrSng0_C EG_TsSw_C SC_ActvCanTrsmEngCrkEna_C /end REF_CHARACTERISTIC
 /begin REF_MEASUREMENT SC_ActvCanTrsmEngCrkEna /end REF_MEASUREMENT
/end GROUP
/begin GROUP S1_TqCnvn "EcuIntgdSwGend/ControlSoftware/TqCnvn"
 /begin SUB_GROUP S14_Desired_Torque_Calculation_CAN_Signals S14_Main_Quantity_Correction S14_N_Map_Interpolation_for_Main_Quantity S14_N_Map_Interpolation_for_Pre_Quantity S14_Pilot_Quantity_Correction S14_Smoke_Limitation /end SUB_GROUP
 /begin REF_CHARACTERISTIC EG_NmrSng0_C /end REF_CHARACTERISTIC
 /begin REF_MEASUREMENT TrC_MMaiFuQntyCorr TrC_MPltFuQntyAllwd TrC_MTotFuQntyCorr /end REF_MEASUREMENT
/end GROUP
/begin GROUP S1_TqLim "EcuIntgdSwGend/ControlSoftware/TqLim"
 /begin SUB_GROUP S15_Engine_Protection S15_Indicated_Torque_Limitation S15_Limp_Mode_Limitation S15_Rate_Limiter_for_Factor_Limitation S15_Reduction_Limitation_Level_1 S15_Reduction_Limitation_Level_2 S15_Torque_Based_Limitation /end SUB_GROUP
/end GROUP
/begin GROUP S1_WarnMong "EcuIntgdSwGend/ControlSoftware/WarnMong" /begin SUB_GROUP S16_Warning_Reduction_Shutdown_Functions /end SUB_GROUP /end GROUP
/begin GROUP S1_WgtCtl "EcuIntgdSwGend/ControlSoftware/WgtCtl" /begin SUB_GROUP S17_TurbochargerSpeedEstimation S17_Wastegate_Control /end SUB_GROUP /end GROUP
/begin GROUP S2_Can_Message_and_Hardware_Check "EcuIntgdSwGend/ControlSoftware/CrsCtrl/Can Message and Hardware Check"
 /begin REF_CHARACTERISTIC CrsCtrl_ActvCanCrsCtrlEnaSwt_C CrsCtrl_ActvCanCrsCtrlResuSwt_C CrsCtrl_ActvCanCrsCtrlSetSwt_C CrsCtrl_ActvCanOrDigInEva_P EG_VldInpSt_C /end REF_CHARACTERISTIC
 /begin REF_MEASUREMENT CrsCtrl_ActvCrsCtrlOnOffBtn CrsCtrl_ActvCrsCtrlResuBtn CrsCtrl_ActvCrsCtrlSetBtn CrsCtrl_ErrCrsCtrlOnOffBtn CrsCtrl_ErrCrsCtrlResuBtn CrsCtrl_ErrCrsCtrlSetBtn /end REF_MEASUREMENT
/end GROUP
/begin GROUP S2_Cruise_Control_CAN_Signals "EcuIntgdSwGend/ControlSoftware/CrsCtrl/Cruise Control CAN Signals" /begin REF_CHARACTERISTIC CrsCtrl_TiCrsBtnThd_P EG_TsSw_C /end REF_CHARACTERISTIC /end GROUP
/begin GROUP S2_CruiseControl "EcuIntgdSwGend/ControlSoftware/CrsCtrl/CruiseControl" /begin SUB_GROUP S20_CruiseControlPIDController S20_Pos_Edge1 /end SUB_GROUP
 /begin REF_CHARACTERISTIC CrsCtrl_CrsCtrlModOn_C CrsCtrl_LongPsdTiThd_P CrsCtrl_MaxTarSpd_P CrsCtrl_MinTarSpd_P CrsCtrl_ShoPsdTiThd_P CrsCtrl_TqDmd_P CrsCtrl_VehVLongPsd_P CrsCtrl_VehVShoPsd_P EG_ModEngCtlIdleSpd_C EG_ModEngCtlOvspd_C EG_ModEngCtlStp_C EG_ModEngCtlTSC1_C EG_ModEngCtlTq_C EG_TsSw_C /end REF_CHARACTERISTIC
 /begin REF_MEASUREMENT CrsCtrl_ActvCrsCtrl CrsCtrl_CrsCtrlModSt CrsCtrl_CrsCtrlTq CrsCtrl_ErrCrsCtrlBtn CrsCtrl_ErrVehVRef CrsCtrl_TarSpd CrsCtrl_TarSpdPre /end REF_MEASUREMENT
/end GROUP
/begin GROUP S2_Engine_Brake_Activation_via_Cruise_Control "EcuIntgdSwGend/ControlSoftware/CrsCtrl/Engine Brake Activation via Cruise Control"
 /begin SUB_GROUP S21_Engine_Brake_Level_Activation_Condition S21_Engine_Brake_Level_Set /end SUB_GROUP
/end GROUP
/begin GROUP S3_Desired_Torque_Calculation_CAN_Signals "EcuIntgdSwGend/ControlSoftware/DesTqClcn/Desired Torque Calculation CAN Signals"
 /begin SUB_GROUP S38_Accelarator_Pedal_Override_Modes S38_EC1___Engine_Configuration_1 /end SUB_GROUP
 /begin REF_CHARACTERISTIC EG_NmrSng100_C /end REF_CHARACTERISTIC
 /begin REF_MEASUREMENT DTqC_FricPercTq /end REF_MEASUREMENT
/end GROUP
/begin GROUP S3_Friction_Torque_Calculation "EcuIntgdSwGend/ControlSoftware/DesTqClcn/Friction Torque Calculation" /begin REF_CHARACTERISTIC DTqC_TqFricOvs_P DTqC_TqFricOvv_P DTqC_TqFric_M /end REF_CHARACTERISTIC /begin REF_MEASUREMENT DTqC_TqFric /end REF_MEASUREMENT /end GROUP
/begin GROUP S3_Idle_Speed_Reference_Selector "EcuIntgdSwGend/ControlSoftware/DesTqClcn/Idle Speed Reference Selector" /begin SUB_GROUP S40_Engine_Idle_Reference S40_Turbo_Oil_Leakage_Protection /end SUB_GROUP
 /begin REF_CHARACTERISTIC DTqC_IdxGearNeut_C DTqC_NEngIdleRefMax_P DTqC_NEngIdleRefMin_P DTqC_NEngIdleRefOvs_P DTqC_NEngIdleRefOvv_P DTqC_NEngTrbChrgOilLeakgIdleRef_P EG_NmrSng0_C EG_TsSw_C /end REF_CHARACTERISTIC
 /begin REF_MEASUREMENT DTqC_NEngIdleRef /end REF_MEASUREMENT
/end GROUP
/begin GROUP S3_Power_On_Control "EcuIntgdSwGend/ControlSoftware/DesTqClcn/Power On Control" /begin REF_CHARACTERISTIC EG_NmrSngNeg10000_C /end REF_CHARACTERISTIC /begin REF_MEASUREMENT DTqC_TqBrkPwrOn /end REF_MEASUREMENT /end GROUP
/begin GROUP S3_Running_Mode "EcuIntgdSwGend/ControlSoftware/DesTqClcn/Running Mode"
 /begin SUB_GROUP S42_Driver_Demand_Torque_Calculation S42_EndSpeed_Governor S42_Idle_Speed_Controller S42_TSC1_Control_Purpose /end SUB_GROUP
 /begin REF_CHARACTERISTIC EG_ModEngCtlIdleSpd_C EG_NmrSng0_C /end REF_CHARACTERISTIC
 /begin REF_MEASUREMENT DTqC_IdleSpdCtrlActv DTqC_TqBrkAtRunngMod DTqC_TqBrkMax /end REF_MEASUREMENT
/end GROUP
/begin GROUP S3_Start_Control "EcuIntgdSwGend/ControlSoftware/DesTqClcn/Start Control"
 /begin REF_CHARACTERISTIC DTqC_TqBrkStrtCtlOvs_P DTqC_TqBrkStrtCtlOvv_P DTqC_TqStrt_M /end REF_CHARACTERISTIC
/end GROUP
/begin GROUP S3_Stop_Control "EcuIntgdSwGend/ControlSoftware/DesTqClcn/Stop Control" /begin REF_CHARACTERISTIC EG_NmrSngNeg10000_C /end REF_CHARACTERISTIC /begin REF_MEASUREMENT DTqC_TqBrkStpCtl /end REF_MEASUREMENT /end GROUP
/begin GROUP S3_saturation "EcuIntgdSwGend/ControlSoftware/DesTqClcn/saturation" /begin REF_MEASUREMENT DTqC_TqIndcd /end REF_MEASUREMENT /end GROUP
/begin GROUP S4_Actuator_Defect_Signals "EcuIntgdSwGend/ControlSoftware/EcuInpPrcsg/Actuator Defect Signals" /begin SUB_GROUP S81_Shutdown_For_Injector_Error /end SUB_GROUP
 /begin REF_CHARACTERISTIC EIP_ErrAmberWarnLampOvs_P EIP_ErrAmberWarnLampOvv_P EIP_ErrColdStrtLampOvs_P EIP_ErrColdStrtLampOvv_P EIP_ErrEngBrkSoln1Ovs_P EIP_ErrEngBrkSoln1Ovv_P EIP_ErrEngBrkSoln2Ovs_P EIP_ErrEngBrkSoln2Ovv_P EIP_ErrRedStopLampOvs_P EIP_ErrRedStopLampOvv_P EIP_ErrStrtrOvs_P EIP_ErrStrtrOvv_P EIP_bErrGridHeatrOvs_P EIP_bErrGridHeatrOvv_P EIP_bErrInjr1Ovs_P EIP_bErrInjr1Ovv_P EIP_bErrInjr2Ovs_P EIP_bErrInjr2Ovv_P EIP_bErrInjr3Ovs_P EIP_bErrInjr3Ovv_P EIP_bErrInjr4Ovs_P EIP_bErrInjr4Ovv_P EIP_bErrInjr5Ovs_P EIP_bErrInjr5Ovv_P EIP_bErrInjr6Ovs_P EIP_bErrInjr6Ovv_P EIP_bErrPCVOvs_P EIP_bErrPCVOvv_P EIP_bErrVCVOvs_P EIP_bErrVCVOvv_P EIP_bErrWgOvs_P EIP_bErrWgOvv_P /end REF_CHARACTERISTIC
 /begin REF_MEASUREMENT EIP_ErrAmberWarnLamp EIP_ErrColdStrtLamp EIP_ErrEngBrkSoln1 EIP_ErrEngBrkSoln2 EIP_ErrRedStopLamp EIP_ErrStrtr EIP_bErrGridHeatr EIP_bErrInjr1 EIP_bErrInjr2 EIP_bErrInjr3 EIP_bErrInjr4 EIP_bErrInjr5 EIP_bErrInjr6 EIP_bErrPCV EIP_bErrTotInjr EIP_bErrVCV EIP_bErrWg /end REF_MEASUREMENT
/end GROUP
/begin GROUP S4_Additionals "EcuIntgdSwGend/ControlSoftware/EcuInpPrcsg/Additionals"
 /begin SUB_GROUP S82_Cylinder_Balancing S82_Misfire_Detection S82_Shutdown_For_Cylinder_Misfire_Error /end SUB_GROUP
 /begin REF_CHARACTERISTIC EG_ModEngCtlIdleSpd_C /end REF_CHARACTERISTIC
 /begin REF_MEASUREMENT EIP_bAcvIdleSpdCtl /end REF_MEASUREMENT
/end GROUP
/begin GROUP S4_CAN_Signals "EcuIntgdSwGend/ControlSoftware/EcuInpPrcsg/CAN Signals"
 /begin SUB_GROUP S83_SPN_1624___Tachograph_vehicle_speed S83_SPN_1653___Vehicle_Limiting_Speed_Governor_Enable_Switch S83_SPN_1654___Vehicle_Limiting_Speed_Governor_Increment_Switch S83_SPN_1655___Vehicle_Limiting_Speed_Governor_Decrement_Switch S83_SPN_1717___Actual_Maximum_Available_Retarder___Percent_Torque S83_SPN_1787___Engine_Torque_Limit_Request___Maximum_Continuous S83_SPN_191___Transmission_Output_Shaft_Speed S83_SPN_2900___Transmission_Engine_Crank_Enable S83_SPN_2978___Estimated_Engine_Parasitic_Losses___Percent_Torque S83_SPN_3030___Transmission_Torque_Converter_Ratio S83_SPN_3645___Transfer_Case_Status S83_SPN_3809___Transmission_Oil_Level_Request S83_SPN_4191___Engine_Requested_Torque___High_Resolution S83_SPN_4206___Message_Counter S83_SPN_518___Engine_Requested_Torque__Torque_Limit S83_SPN_522___Percent_Clutch_Slip S83_SPN_523___Transmission_Current_Gear S83_SPN_524___Transmission_Selected_Gear S83_SPN_526___Transmission_Actual_Gear_Ratio S83_SPN_561___ASR_Engine_Control_Active S83_SPN_562___ASR_Brake_Control_Active S83_SPN_563___Anti_Lock_Braking__ABS__Active S83_SPN_573___Transmission_Torque_Converter_Lockup_Engaged S83_SPN_596___Cruise_Control_Enable_Switch S83_SPN_599___Cruise_Control_Set_Switch S83_SPN_601___Cruise_Control_Resume_Switch S83_SPN_695___Engine_Override_Control_Mode S83_SPN_84___Wheel_Based_Vehicle_Speed S83_SPN_897___Override_Control_Mode_Priority S83_SPN_898___Engine_Requested_Speed__Speed_Limit S83_SPN_96___Fuel_Level_1 S83_SPN_970___Engine_Auxiliary_Shutdown_Switch S83_SPN_975___Estimated_Percent_Fan_Speed S83_SPN_979___Engine_Remote_PTO_Governor_Pregrogrammed_Speed_Control_Switch S83_SPN_980___Engine_PTO_Governor_Enable_Switch S83_SPN_981___Engine_PTO_Governor_Accelerate_Switch S83_SPN_982___Engine_PTO_Governor_Resume_Switch S83_SPN_983___Engine_PTO_Governor_Coast__Decelerate_Switch S83_SPN_984___Engine_PTO_Governor_Set_Switch S83_SPN_986___Requested_Percent_Fan_Speed /end SUB_GROUP
/end GROUP
/begin GROUP S4_Distance_to_Travel "EcuIntgdSwGend/ControlSoftware/EcuInpPrcsg/Distance to Travel"
 /begin REF_CHARACTERISTIC EG_NmrSng0_C EIP_CoeffKmPerHrToMtrPerSec_C EIP_CoeffMtrToKm_C EIP_DstTrvldInKmOvs_P EIP_DstTrvldInKmOvv_P EIP_VehVThdForDstTrvld_P /end REF_CHARACTERISTIC
 /begin REF_MEASUREMENT EIP_DstTrvldInKm EIP_DstTrvldInMtr /end REF_MEASUREMENT
/end GROUP
/begin GROUP S4_Driver_Commands "EcuIntgdSwGend/ControlSoftware/EcuInpPrcsg/Driver Commands"
 /begin SUB_GROUP S85_Debouncer1 S85_Debouncer10 S85_Debouncer11 S85_Debouncer12 S85_Debouncer2 S85_Debouncer3 S85_Debouncer4 S85_Debouncer5 S85_Debouncer6 S85_Debouncer7 S85_Debouncer8 /end SUB_GROUP
 /begin REF_CHARACTERISTIC EG_NmrSng0_C EG_TsSw_C EIP_CrsAndPTOVehvActvdThd_P EIP_HndBrkPrkgOvs_P EIP_HndBrkPrkgOvv_P EIP_IgnSwtUThd_P EIP_TiBrkPedlDeb_P EIP_TiCmbtSwtDeb_P EIP_TiCrsCtrlOnOffBtnDeb_P EIP_TiDecCrsCtrlBtnDeb_P EIP_TiEngBrkReq1BtnDeb_P EIP_TiEngBrkReq2BtnDeb_P EIP_TiHndBrkPrkgDeb_P EIP_TiIgnSwtDeb_P EIP_TiIncCrsCtrlBtnDeb_P EIP_TiSpdLimrOnOffBtnDeb_P EIP_TiStrtReqSwtDeb_P EIP_TiTroubleshootingBtnDeb_P EIP_bAcvCmbtSwtOvs_P EIP_bAcvCmbtSwtOvv_P EIP_bAcvPtoOnOffBtnOvs_P EIP_bAcvPtoOnOffBtnOvv_P EIP_bAcvPtoResuBtnOvs_P EIP_bAcvPtoResuBtnOvv_P EIP_bAcvPtoSetBtnOvs_P EIP_bAcvPtoSetBtnOvv_P EIP_bBrkPedlOvs_P EIP_bBrkPedlOvv_P EIP_bCrsCtrlOnOffBtnOvs_P EIP_bCrsCtrlOnOffBtnOvv_P EIP_bDecCrsCtrlBtnOvs_P EIP_bDecCrsCtrlBtnOvv_P EIP_bDecSpdLimrBtnOvs_P EIP_bDecSpdLimrBtnOvv_P EIP_bEngBrkReq1BtnOvs_P EIP_bEngBrkReq1BtnOvv_P EIP_bEngBrkReq2BtnOvs_P EIP_bEngBrkReq2BtnOvv_P EIP_bIgnSwtOvs_P EIP_bIgnSwtOvv_P EIP_bIncCrsCtrlBtnOvs_P EIP_bIncCrsCtrlBtnOvv_P EIP_bInctSpdLimrBtnOvs_P EIP_bInctSpdLimrBtnOvv_P EIP_bSpdLimrOnOffBtnOvs_P EIP_bSpdLimrOnOffBtnOvv_P EIP_bStrtReqSwtOvs_P EIP_bStrtReqSwtOvv_P EIP_bTroubleshootingBtnOvs_P EIP_bTroubleshootingBtnOvv_P /end REF_CHARACTERISTIC
 /begin REF_MEASUREMENT EIP_HndBrkPrkg EIP_bAcvCmbtSwt EIP_bAcvPtoOnOffBtn EIP_bAcvPtoResuBtn EIP_bAcvPtoSetBtn EIP_bBrkPedl EIP_bCrsCtrlOnOffBtn EIP_bDecCrsCtrlBtn EIP_bDecSpdLimrBtn EIP_bEngBrkReq1Btn EIP_bEngBrkReq2Btn EIP_bIgnSwt EIP_bIncCrsCtrlBtn EIP_bInctSpdLimrBtn EIP_bSpdLimrOnOffBtn EIP_bStrtReqSwt EIP_bTroubleshootingBtn /end REF_MEASUREMENT
/end GROUP
/begin GROUP S4_ECU_Configuration "EcuIntgdSwGend/ControlSoftware/EcuInpPrcsg/ECU Configuration"
 /begin SUB_GROUP S86_Engine_Brake_Configuration S86_Engine_Brake_Level_Configuration S86_Injector_Configuration S86_Wastegate_Configuration /end SUB_GROUP
/end GROUP
/begin GROUP S4_Electrical_Contact_Signals "EcuIntgdSwGend/ControlSoftware/EcuInpPrcsg/Electrical Contact Signals"
 /begin SUB_GROUP S87_Battery_Voltage_Diagnostics_Info S87_Debouncer S87_LowPassFilter1 /end SUB_GROUP
 /begin REF_CHARACTERISTIC EG_NmrSng0_C EG_TsSw_C EIP_CoeffFilRat_P EIP_GrdtUClmp30_P EIP_TcUClmp30Fil_P EIP_TiUClmp30SnsrDeb_P EIP_UClmp30Dft_P EIP_UClmp30Max_P EIP_UClmp30Min_P EIP_UClmp30Ovs_P EIP_UClmp30Ovv_P EIP_bErrUClmp30SnsrOvs_P EIP_bErrUClmp30SnsrOvv_P /end REF_CHARACTERISTIC
 /begin REF_MEASUREMENT EIP_UClmp30 EIP_UClmp30GrdtAbsOut EIP_bErrUClmp30Grdt EIP_bErrUClmp30Rng EIP_bErrUClmp30Snsr /end REF_MEASUREMENT
/end GROUP
/begin GROUP S4_Engine_Hour_Calculation "EcuIntgdSwGend/ControlSoftware/EcuInpPrcsg/Engine Hour Calculation"
 /begin REF_CHARACTERISTIC EG_HrToMilliSec_C EG_NmrSng0_C EG_TsSw_C EIP_EngHrOvs_P EIP_EngHrOvv_P /end REF_CHARACTERISTIC
 /begin REF_MEASUREMENT EIP_EngHr EIP_EngTiCalcn /end REF_MEASUREMENT
/end GROUP
/begin GROUP S4_Level_Sensor_Signals "EcuIntgdSwGend/ControlSoftware/EcuInpPrcsg/Level Sensor Signals" /begin SUB_GROUP S90_Level_Sensor_Errors /end SUB_GROUP /begin REF_CHARACTERISTIC EIP_LvlOilDft_P EIP_LvlOilOvs_P EIP_LvlOilOvv_P /end REF_CHARACTERISTIC /begin REF_MEASUREMENT EIP_LvlOil /end REF_MEASUREMENT /end GROUP
/begin GROUP S4_NVM_Signals_from_BSW "EcuIntgdSwGend/ControlSoftware/EcuInpPrcsg/NVM Signals from BSW"
 /begin REF_CHARACTERISTIC EIP_DstTrvldMemOvs_P EIP_DstTrvldMemOvv_P EIP_EngHrMemOvs_P EIP_EngHrMemOvv_P EIP_FuelCnsMemOvs_P EIP_FuelCnsMemOvv_P EIP_TripMemOvs_P EIP_TripMemOvv_P /end REF_CHARACTERISTIC
 /begin REF_MEASUREMENT EIP_DstTrvldMem EIP_EngHrMem EIP_FuelCnsMem EIP_TripMem /end REF_MEASUREMENT
/end GROUP
/begin GROUP S4_Position___Speed_Sensor_Signals "EcuIntgdSwGend/ControlSoftware/EcuInpPrcsg/Position & Speed Sensor Signals"
 /begin SUB_GROUP S92_Accelerator_Pedal_Sensor_Monitoring S92_Accelerator_Under_Over_Condition S92_Engine_Shutdown_Overspeed S92_LowPassFilter S92_LowPassFilter1 S92_LowPassFilter2 S92_LowPassFilter3 S92_LowPassFilter4 /end SUB_GROUP
 /begin REF_CHARACTERISTIC EG_TsSw_C EIP_CamsftSpdOvs_P EIP_CamsftSpdOvv_P EIP_CrnksftSpdOvs_P EIP_CrnksftSpdOvv_P EIP_NEngOvs_P EIP_NEngOvv_P EIP_PercgAccr1Ovs_P EIP_PercgAccr1Ovv_P EIP_PercgAccr2Ovs_P EIP_PercgAccr2Ovv_P EIP_PercgAccrLvl0Max_P EIP_PercgAccrLvl1Max_P EIP_PercgAccrLvl2Max_P EIP_PercgAccrOvs_P EIP_PercgAccrOvv_P EIP_StAccrOvs_P EIP_StAccrOvv_P EIP_TcAccr1PosnFil_P EIP_TcAccr2PosnFil_P EIP_TcCamsftSpdFil_P EIP_TcCrnksftSpdFil_P EIP_TcNEngFil_P EIP_bErrAccrSnsr1Ovs_P EIP_bErrAccrSnsr1Ovv_P EIP_bErrAccrSnsr2Ovs_P EIP_bErrAccrSnsr2Ovv_P EIP_bErrCamCrankTotLossOvs_P EIP_bErrCamCrankTotLossOvv_P EIP_bErrCamsftSnsrOvs_P EIP_bErrCamsftSnsrOvv_P EIP_bErrCrnksftSnsrOvs_P EIP_bErrCrnksftSnsrOvv_P /end REF_CHARACTERISTIC
 /begin REF_MEASUREMENT EIP_CamsftSpd EIP_CrnksftSpd EIP_NEng EIP_PercgAccr EIP_PercgAccr1 EIP_PercgAccr2 EIP_StAccr EIP_bErrAccrSnsr1 EIP_bErrAccrSnsr2 EIP_bErrCamCrankTotLoss EIP_bErrCamsftSnsr EIP_bErrCrnksftSnsr EIP_bTranAccrLvl0To1 EIP_bTranAccrLvl1To0 EIP_bTranAccrLvl1To2 EIP_bTranAccrLvl2To1 EIP_bTranAccrLvl2To3 EIP_bTranAccrLvl3To2 /end REF_MEASUREMENT
/end GROUP
/begin GROUP S4_Pressure_Sensor_Signals "EcuIntgdSwGend/ControlSoftware/EcuInpPrcsg/Pressure Sensor Signals" /begin SUB_GROUP S93_Pressure_Sensor_Errors /end SUB_GROUP
 /begin REF_CHARACTERISTIC EIP_PAirBoostDft_P EIP_PAirBoostOvs_P EIP_PAirBoostOvv_P EIP_PAmbAirDft_P EIP_PAmbAirOvs_P EIP_PAmbAirOvv_P EIP_PFuDft_P EIP_PFuOvs_P EIP_PFuOvv_P EIP_POilDft_P EIP_POilOvs_P EIP_POilOvv_P EIP_PRailDft_P EIP_PRailOvs_P EIP_PRailOvv_P /end REF_CHARACTERISTIC
 /begin REF_MEASUREMENT EIP_PAirBoost EIP_PAmbAir EIP_PFu EIP_POil EIP_PRail /end REF_MEASUREMENT
/end GROUP
/begin GROUP S4_Status_Signal "EcuIntgdSwGend/ControlSoftware/EcuInpPrcsg/Status Signal" /begin REF_CHARACTERISTIC EIP_GridHeatrRlyFbOvs_P EIP_GridHeatrRlyFbOvv_P /end REF_CHARACTERISTIC /begin REF_MEASUREMENT EIP_GridHeatrRlyFb /end REF_MEASUREMENT /end GROUP
/begin GROUP S4_Switch__Button_Defect_Signals "EcuIntgdSwGend/ControlSoftware/EcuInpPrcsg/Switch//Button Defect Signals"
 /begin REF_CHARACTERISTIC EIP_bErrBrkPedlOvs_P EIP_bErrBrkPedlOvv_P EIP_bErrCmbtSwtOvs_P EIP_bErrCmbtSwtOvv_P EIP_bErrCrsCtrlOnOffBtnOvs_P EIP_bErrCrsCtrlOnOffBtnOvv_P EIP_bErrDecCrsCtrlBtnOvs_P EIP_bErrDecCrsCtrlBtnOvv_P EIP_bErrDecSpdLimrBtnOvs_P EIP_bErrDecSpdLimrBtnOvv_P EIP_bErrEngBrkReq1BtnOvs_P EIP_bErrEngBrkReq1BtnOvv_P EIP_bErrEngBrkReq2BtnOvs_P EIP_bErrEngBrkReq2BtnOvv_P EIP_bErrHndBrkPrkgOvs_P EIP_bErrHndBrkPrkgOvv_P EIP_bErrIgnSwtOvv_P EIP_bErrIgnSwtSwtOvs_P EIP_bErrIncCrsCtrlBtnOvs_P EIP_bErrIncCrsCtrlBtnOvv_P EIP_bErrInctSpdLimrBtnOvs_P EIP_bErrInctSpdLimrBtnOvv_P EIP_bErrPtoOnOffBtnOvs_P EIP_bErrPtoOnOffBtnOvv_P EIP_bErrPtoResuBtnOvs_P EIP_bErrPtoResuBtnOvv_P EIP_bErrPtoSetBtnOvs_P EIP_bErrPtoSetBtnOvv_P EIP_bErrSpdLimrOnOffBtnOvs_P EIP_bErrSpdLimrOnOffBtnOvv_P EIP_bErrStrtReqSwtOvs_P EIP_bErrStrtReqSwtOvv_P EIP_bErrTroublesootingBtnOvs_P EIP_bErrTroublesootingBtnOvv_P /end REF_CHARACTERISTIC
 /begin REF_MEASUREMENT EIP_bErrBrkPedl EIP_bErrCmbtSwt EIP_bErrCrsCtrlOnOffBtn EIP_bErrDecCrsCtrlBtn EIP_bErrDecSpdLimrBtn EIP_bErrEngBrkReq1Btn EIP_bErrEngBrkReq2Btn EIP_bErrHndBrkPrkg EIP_bErrIgnSwt EIP_bErrIncCrsCtrlBtn EIP_bErrInctSpdLimrBtn EIP_bErrPtoOnOffBtn EIP_bErrPtoResuBtn EIP_bErrPtoSetBtn EIP_bErrSpdLimrOnOffBtn EIP_bErrStrtReqSwt EIP_bErrTroublesootingBtn /end REF_MEASUREMENT
/end GROUP
/begin GROUP S4_Temperature_Sensor_Signals "EcuIntgdSwGend/ControlSoftware/EcuInpPrcsg/Temperature Sensor Signals" /begin SUB_GROUP S96_Temperature_Sensor_Errors /end SUB_GROUP
 /begin REF_CHARACTERISTIC EIP_TAirBoostDft_P EIP_TAirBoostOvs_P EIP_TAirBoostOvv_P EIP_TAmbAirDft_P EIP_TAmbAirOvs_P EIP_TAmbAirOvv_P EIP_TCooltDft_P EIP_TCooltFromTOil_M EIP_TCooltOvs_P EIP_TCooltOvv_P EIP_TEcuDft_P EIP_TEcuOvs_P EIP_TEcuOvv_P EIP_TFuDft_P EIP_TFuOvs_P EIP_TFuOvv_P EIP_TOilDft_P EIP_TOilFromTCoolt_M EIP_TOilOvs_P EIP_TOilOvv_P /end REF_CHARACTERISTIC
 /begin REF_MEASUREMENT EIP_TAirBoost EIP_TAmbAir EIP_TCoolt EIP_TCooltFromTOil EIP_TEcu EIP_TFu EIP_TOil EIP_TOilFromTCoolt /end REF_MEASUREMENT
/end GROUP
/begin GROUP S4_Vehicle_Velocity_Calculation "EcuIntgdSwGend/ControlSoftware/EcuInpPrcsg/Vehicle Velocity Calculation"
 /begin SUB_GROUP S97_Gear_Based_Vehicle_Speed_Calculation S97_LowPassFilter S97_Selection_Of_Source_1_and_Source_2 S97_Vehicle_Velocity_Calculation /end SUB_GROUP
 /begin REF_CHARACTERISTIC EG_TsSw_C EIP_VehVFilCon_P /end REF_CHARACTERISTIC
/end GROUP
/begin GROUP S5_Cruise_Control_Transition_to_Idle_Speed "EcuIntgdSwGend/ControlSoftware/EcuModSeln/Cruise Control Transition to Idle Speed" /begin REF_CHARACTERISTIC EG_CrsCtrlActvd_C /end REF_CHARACTERISTIC /begin REF_MEASUREMENT EMS_bTranCrsCtrlToIdleSpd /end REF_MEASUREMENT /end GROUP
/begin GROUP S5_Cruise_Control_Transition_to_Torque "EcuIntgdSwGend/ControlSoftware/EcuModSeln/Cruise Control Transition to Torque" /begin REF_CHARACTERISTIC EG_CrsCtrlActvd_C /end REF_CHARACTERISTIC /begin REF_MEASUREMENT EMS_bTranCrsCtrlToTq /end REF_MEASUREMENT /end GROUP
/begin GROUP S5_Cruise_Control_to_Stop_Transition "EcuIntgdSwGend/ControlSoftware/EcuModSeln/Cruise Control to Stop Transition" /begin SUB_GROUP S269_Neg_Edge /end SUB_GROUP /begin REF_CHARACTERISTIC EMS_NEngStopThd_P /end REF_CHARACTERISTIC /begin REF_MEASUREMENT EMS_bTranCrsCtrlToStop /end REF_MEASUREMENT /end GROUP
/begin GROUP S5_Cruise_Control_to_TSC1_Transition "EcuIntgdSwGend/ControlSoftware/EcuModSeln/Cruise Control to TSC1 Transition"
 /begin REF_CHARACTERISTIC EG_TSC1SpdCtrlMod_C EG_TSC1TqCtrlMod_C EG_TSC1TqSpdLimMod_C EG_VldInpSt_C /end REF_CHARACTERISTIC
 /begin REF_MEASUREMENT EMS_bTranCrsCtrlToTSC1 /end REF_MEASUREMENT
/end GROUP
/begin GROUP S5_Idle_Speed_to_Cruise_Control_Transition "EcuIntgdSwGend/ControlSoftware/EcuModSeln/Idle Speed to Cruise Control Transition" /begin REF_CHARACTERISTIC EG_CrsCtrlActvd_C /end REF_CHARACTERISTIC /begin REF_MEASUREMENT EMS_bTranIdlespdToCrsCtrl /end REF_MEASUREMENT /end GROUP
/begin GROUP S5_Idle_Speed_to_Overspeed_Transition "EcuIntgdSwGend/ControlSoftware/EcuModSeln/Idle Speed to Overspeed Transition" /begin REF_MEASUREMENT EMS_bTranIdlespdToOvspd /end REF_MEASUREMENT /end GROUP
/begin GROUP S5_Idle_Speed_to_PTO_Transition "EcuIntgdSwGend/ControlSoftware/EcuModSeln/Idle Speed to PTO Transition" /begin REF_MEASUREMENT EMS_bTranIdlespdToPTO /end REF_MEASUREMENT /end GROUP
/begin GROUP S5_Idle_Speed_to_Stop_Transition "EcuIntgdSwGend/ControlSoftware/EcuModSeln/Idle Speed to Stop Transition" /begin SUB_GROUP S274_Neg_Edge /end SUB_GROUP /begin REF_CHARACTERISTIC EMS_NEngStopThd_P /end REF_CHARACTERISTIC /begin REF_MEASUREMENT EMS_bTranIdlespdToStop /end REF_MEASUREMENT /end GROUP
/begin GROUP S5_Idle_Speed_to_TSC1_Transition1 "EcuIntgdSwGend/ControlSoftware/EcuModSeln/Idle Speed to TSC1 Transition1"
 /begin REF_CHARACTERISTIC EG_TSC1SpdCtrlMod_C EG_TSC1TqCtrlMod_C EG_TSC1TqSpdLimMod_C EG_VldInpSt_C /end REF_CHARACTERISTIC
 /begin REF_MEASUREMENT EMS_bTranIdlespdToTSC1 /end REF_MEASUREMENT
/end GROUP
/begin GROUP S5_Idle_Speed_to_Torque_Transiton "EcuIntgdSwGend/ControlSoftware/EcuModSeln/Idle Speed to Torque Transiton" /begin REF_CHARACTERISTIC EMS_NEngIdletoTqThd_P EMS_StAccrLvl0_C /end REF_CHARACTERISTIC /begin REF_MEASUREMENT EMS_bTranIdlespdToTq /end REF_MEASUREMENT /end GROUP
/begin GROUP S5_Overspeed_to_Stop_Transition "EcuIntgdSwGend/ControlSoftware/EcuModSeln/Overspeed to Stop Transition" /begin SUB_GROUP S277_Neg_Edge /end SUB_GROUP /begin REF_MEASUREMENT EMS_bTranOvspdToStop /end REF_MEASUREMENT /end GROUP
/begin GROUP S5_Overspeed_to_Torque_Transition "EcuIntgdSwGend/ControlSoftware/EcuModSeln/Overspeed to Torque Transition" /begin REF_MEASUREMENT EMS_bTranOvspdToTq /end REF_MEASUREMENT /end GROUP
/begin GROUP S5_PTO_to_Idle_Speed_Transition "EcuIntgdSwGend/ControlSoftware/EcuModSeln/PTO to Idle Speed Transition" /begin REF_MEASUREMENT EMS_bTranPTOToIdlespd /end REF_MEASUREMENT /end GROUP
/begin GROUP S5_PTO_to_Stop_Transition "EcuIntgdSwGend/ControlSoftware/EcuModSeln/PTO to Stop Transition" /begin SUB_GROUP S280_Neg_Edge /end SUB_GROUP /begin REF_CHARACTERISTIC EMS_NEngStopThd_P /end REF_CHARACTERISTIC /begin REF_MEASUREMENT EMS_bTranPTOToStop /end REF_MEASUREMENT /end GROUP
/begin GROUP S5_Power_On_to_Start_Transiton "EcuIntgdSwGend/ControlSoftware/EcuModSeln/Power On to Start Transiton" /begin REF_CHARACTERISTIC EMS_NEngStrtrAcvThd_P /end REF_CHARACTERISTIC /begin REF_MEASUREMENT EMS_bTranPwronToStrt /end REF_MEASUREMENT /end GROUP
/begin GROUP S5_Start_to_Idle_Speed_Transition "EcuIntgdSwGend/ControlSoftware/EcuModSeln/Start to Idle Speed Transition" /begin REF_CHARACTERISTIC EMS_NEngStrtToIdleThd_M /end REF_CHARACTERISTIC /begin REF_MEASUREMENT EMS_bTranStrtToIdlespd /end REF_MEASUREMENT /end GROUP
/begin GROUP S5_Start_to_Stop_Transition "EcuIntgdSwGend/ControlSoftware/EcuModSeln/Start to Stop Transition" /begin SUB_GROUP S283_Neg_Edge /end SUB_GROUP /begin REF_MEASUREMENT EMS_bTranStrtToStop /end REF_MEASUREMENT /end GROUP
/begin GROUP S5_Stop_to_Power_On_Transition "EcuIntgdSwGend/ControlSoftware/EcuModSeln/Stop to Power On Transition" /begin REF_CHARACTERISTIC EMS_DynoModOvs_P EMS_DynoModOvv_P EMS_NEngStrtrAcvThd_P /end REF_CHARACTERISTIC /begin REF_MEASUREMENT EMS_bTranStopToPwrOn /end REF_MEASUREMENT /end GROUP
/begin GROUP S5_TSC1_To_Torque_Transition "EcuIntgdSwGend/ControlSoftware/EcuModSeln/TSC1 To Torque Transition" /begin REF_CHARACTERISTIC EG_OvrdDis_C EG_VldInpSt_C /end REF_CHARACTERISTIC /begin REF_MEASUREMENT EMS_bTranTSC1ToTq /end REF_MEASUREMENT /end GROUP
/begin GROUP S5_TSC1_to_Cruise_Control_Transition "EcuIntgdSwGend/ControlSoftware/EcuModSeln/TSC1 to Cruise Control Transition" /begin REF_CHARACTERISTIC EG_CrsCtrlActvd_C /end REF_CHARACTERISTIC /begin REF_MEASUREMENT EMS_bTranTSC1ToCrsCtrl /end REF_MEASUREMENT /end GROUP
/begin GROUP S5_TSC1_to_Overspeed_Transition "EcuIntgdSwGend/ControlSoftware/EcuModSeln/TSC1 to Overspeed Transition" /begin REF_MEASUREMENT EMS_bTranTSC1ToOvspd /end REF_MEASUREMENT /end GROUP
/begin GROUP S5_TSC1_to_Stop_Transition "EcuIntgdSwGend/ControlSoftware/EcuModSeln/TSC1 to Stop Transition" /begin SUB_GROUP S288_Neg_Edge /end SUB_GROUP /begin REF_CHARACTERISTIC EMS_NEngStopThd_P /end REF_CHARACTERISTIC /begin REF_MEASUREMENT EMS_bTranTSC1ToStop /end REF_MEASUREMENT /end GROUP
/begin GROUP S5_Torque_to_Cruise_Control_Transition "EcuIntgdSwGend/ControlSoftware/EcuModSeln/Torque to Cruise Control Transition" /begin REF_CHARACTERISTIC EG_CrsCtrlActvd_C /end REF_CHARACTERISTIC /begin REF_MEASUREMENT EMS_bTranTqToCrsCtrl /end REF_MEASUREMENT /end GROUP
/begin GROUP S5_Torque_to_Idle_Speed_Transition "EcuIntgdSwGend/ControlSoftware/EcuModSeln/Torque to Idle Speed Transition" /begin REF_CHARACTERISTIC EMS_NEngTqtoIdleThd_P EMS_StAccrLvl0_C /end REF_CHARACTERISTIC /begin REF_MEASUREMENT EMS_bTranTqToIdlespd /end REF_MEASUREMENT /end GROUP
/begin GROUP S5_Torque_to_Overspeed_Transition "EcuIntgdSwGend/ControlSoftware/EcuModSeln/Torque to Overspeed Transition" /begin REF_MEASUREMENT EMS_bTranTqToOvspd /end REF_MEASUREMENT /end GROUP
/begin GROUP S5_Torque_to_Stop_Transition "EcuIntgdSwGend/ControlSoftware/EcuModSeln/Torque to Stop Transition" /begin SUB_GROUP S292_Neg_Edge /end SUB_GROUP /begin REF_CHARACTERISTIC EMS_NEngStopThd_P /end REF_CHARACTERISTIC /begin REF_MEASUREMENT EMS_bTranTqToStop /end REF_MEASUREMENT /end GROUP
/begin GROUP S5_Torque_to_TSC1_Transition "EcuIntgdSwGend/ControlSoftware/EcuModSeln/Torque to TSC1 Transition"
 /begin REF_CHARACTERISTIC EG_TSC1SpdCtrlMod_C EG_TSC1TqCtrlMod_C EG_TSC1TqSpdLimMod_C EG_VldInpSt_C /end REF_CHARACTERISTIC
 /begin REF_MEASUREMENT EMS_bTranTqToTSC1 /end REF_MEASUREMENT
/end GROUP
/begin GROUP S6_AuxiliaryOutputs "EcuIntgdSwGend/ControlSoftware/EcuOutpPrcsg/AuxiliaryOutputs" /begin REF_CHARACTERISTIC EOP_bAcvGridHeatrOvs_P EOP_bAcvGridHeatrOvv_P /end REF_CHARACTERISTIC /begin REF_MEASUREMENT EOP_bAcvGridHeatr /end REF_MEASUREMENT /end GROUP
/begin GROUP S6_CAN_Signals "EcuIntgdSwGend/ControlSoftware/EcuOutpPrcsg/CAN Signals"
 /begin SUB_GROUP 0 S302_SPN_100___Engine_Oil_Pressure S302_SPN_102___Engine_Intake_Manifold_1_Pressure S302_SPN_105___Engine_Intake_Manifold_1_Temperature S302_SPN_1081___Engine_Wait_to_Start_Lamp S302_SPN_108___Barometric_Pressure S302_SPN_1136___Engine_ECU_Temperature S302_SPN_1188___Engine_Turbocharger_Wastegate_Actuator_1_Position S302_SPN_1237___Engine_Shutdown_Override_Switch S302_SPN_1436___Engine_Actual_Ignition_Timing S302_SPN_157___Engine_Injector_Metering_Rail_1_Pressure S302_SPN_1636___Engine_Intake_Manifold_1_Air_Temperature__High_Resolution_ S302_SPN_1637___Engine_Coolant_Temperature__High_Resolution_ S302_SPN_166___Engine_Rated_Power S302_SPN_1675___Engine_Starter_Mode S302_SPN_168___Battery_Potential____Power_Input_1 S302_SPN_171___Ambient_Air_Temperature S302_SPN_174___Engine_Fuel_Temperature_1 S302_SPN_175___Engine_Oil_Temperature_1 S302_SPN_183___Engine_Fuel_Rate S302_SPN_1846___Engine_Default_Torque_Limit S302_SPN_188___Engine_Speed_At_Idle__Point_1 S302_SPN_189___Engine_Rated_Speed S302_SPN_190___Engine_Speed S302_SPN_247___Engine_Total_Hours_of_Operation S302_SPN_250___Engine_Total_Fuel_Used S302_SPN_2978___Estimated_Engine_Parasitic_Losses___Percent_Torque S302_SPN_3543___Engine_Operating_State S302_SPN_513___Actual_Engine___Percent_Torque S302_SPN_514___Nominal_Friction___Percent_Torque S302_SPN_528___Engine_Speed_At_Point_2 S302_SPN_529___Engine_Speed_At_Point_3 S302_SPN_530___Engine_Speed_At_Point_4 S302_SPN_531___Engine_Speed_At_Point_5 S302_SPN_532___Engine_Speed_At_High_Idle__Point_6 S302_SPN_533___Engine_Maximum_Momentary_Override_Speed__Point_7 S302_SPN_539___Engine_Percent_Torque_At_Idle__Point_1 S302_SPN_540___Engine_Percent_Torque_At_Point_2 S302_SPN_541___Engine_Percent_Torque_At_Point_3 S302_SPN_542___Engine_Percent_Torque_At_Point_4 S302_SPN_543___Engine_Percent_Torque_At_Point_5 S302_SPN_544___Engine_Reference_Torque S302_SPN_558___Accelerator_Pedal_1_Low_Idle_Switch S302_SPN_595___Cruise_Control_Active S302_SPN_596___Cruise_Control_Enable_Switch S302_SPN_597___Brake_Switch S302_SPN_599___Cruise_Control_Set_Switch S302_SPN_600___Cruise_Control_Coast__Decelerate__Switch S302_SPN_601___Cruise_Control_Resume_Switch S302_SPN_602___Cruise_Control_Accelerate_Switch S302_SPN_623___Red_Stop_Lamp S302_SPN_624___Amber_Warning_Lamp S302_SPN_70___Parking_Brake_Switch S302_SPN_84___Wheel_Based_Vehicle_Speed S302_SPN_86___Cruise_Control_Set_Speed S302_SPN_899___Engine_Torque_Mode S302_SPN_91___Accelerator_Pedal_Position_1 S302_SPN_92___Engine_Percent_Load_At_Current_Speed S302_SPN_94___Engine_Fuel_Delivery_Pressure S302_SPN_976___PTO_Governor_State S302_SPN_97___Water_In_Fuel_Indicator S302_SPN_98___Engine_Oil_Level /end SUB_GROUP
/end GROUP
/begin GROUP S6_Digital_Output "EcuIntgdSwGend/ControlSoftware/EcuOutpPrcsg/Digital Output"
 /begin REF_CHARACTERISTIC EOP_ActvEngBrkSoln1Ovs_P EOP_ActvEngBrkSoln1Ovv_P EOP_ActvEngBrkSoln2Ovs_P EOP_ActvEngBrkSoln2Ovv_P EOP_AmberWarnLampOvs_P EOP_AmberWarnLampOvv_P EOP_ColdStrtLampOvs_P EOP_ColdStrtLampOvv_P EOP_RedStopLampOvs_P EOP_RedStopLampOvv_P /end REF_CHARACTERISTIC
 /begin REF_MEASUREMENT EOP_ActvEngBrkSoln1 EOP_ActvEngBrkSoln2 EOP_AmberWarnLamp EOP_ColdStrtLamp EOP_RedStopLamp /end REF_MEASUREMENT
/end GROUP
/begin GROUP S90_Level_Sensor_Errors "EcuIntgdSwGend/ControlSoftware/EcuInpPrcsg/Level Sensor Signals/Level Sensor Errors" /begin REF_CHARACTERISTIC EIP_CoeffFilRat_P /end REF_CHARACTERISTIC /end GROUP
/begin GROUP S93_Pressure_Sensor_Errors "EcuIntgdSwGend/ControlSoftware/EcuInpPrcsg/Pressure Sensor Signals/Pressure Sensor Errors" /begin REF_CHARACTERISTIC EIP_CoeffFilRat_P /end REF_CHARACTERISTIC /end GROUP
/begin GROUP S96_Temperature_Sensor_Errors "EcuIntgdSwGend/ControlSoftware/EcuInpPrcsg/Temperature Sensor Signals/Temperature Sensor Errors" /begin REF_CHARACTERISTIC EIP_CoeffFilRat_P /end REF_CHARACTERISTIC /end GROUP
/* MATLAB_SECTION_END_1 */ /******************************* From MATLAB ***************************************/
/end MODULE
/end PROJECT
