ASAP2_VERSION 1 6
/begin PROJECT ECEMTAG_CR8 ""
/begin MODULE DIM ""
/begin MOD_COMMON "Mod Common Comment Here" DEPOSIT ABSOLUTE BYTE_ORDER MSB_FIRST /end MOD_COMMON
/begin COMPU_METHOD Duration_s_Scalex001_CM "Scale 0.001" RAT_FUNC "%20.0" "s" COEFFS 0 1 0 0 0 0.001 /end COMPU_METHOD
/begin COMPU_METHOD Duration_milli_s_CM "Scale 1" RAT_FUNC "%20.0" "ms" COEFFS 0 1 0 0 0 1 /end COMPU_METHOD
/begin COMPU_METHOD Duration_us_Scale1000000_CM "Scale 1000000" RAT_FUNC "%20.0" "us" COEFFS 0 1 0 0 0 1000000 /end COMPU_METHOD
/begin RECORD_LAYOUT FLOAT32_IEEE FNC_VALUES 1 FLOAT32_IEEE ROW_DIR DIRECT /end RECORD_LAYOUT
/begin RECORD_LAYOUT UBYTE FNC_VALUES 1 UBYTE ROW_DIR DIRECT /end RECORD_LAYOUT
/begin RECORD_LAYOUT SBYTE FNC_VALUES 1 SBYTE ROW_DIR DIRECT /end RECORD_LAYOUT
/******************************* From MATLAB ***************************************/ /* MATLAB_SECTION_START_1 */
/begin RECORD_LAYOUT Scalar_BOOLEAN FNC_VALUES 1 UBYTE ROW_DIR DIRECT /end RECORD_LAYOUT
/begin RECORD_LAYOUT Scalar_FLOAT32_IEEE FNC_VALUES 1 FLOAT32_IEEE ROW_DIR DIRECT /end RECORD_LAYOUT
/begin RECORD_LAYOUT Lookup1D_FLOAT32_IEEE FNC_VALUES 1 FLOAT32_IEEE ROW_DIR DIRECT /end RECORD_LAYOUT
/begin RECORD_LAYOUT Lookup1D_X_FLOAT32_IEEE AXIS_PTS_X 1 FLOAT32_IEEE INDEX_INCR DIRECT /end RECORD_LAYOUT
/begin RECORD_LAYOUT Lookup2D_FLOAT32_IEEE FNC_VALUES 1 FLOAT32_IEEE ROW_DIR DIRECT /end RECORD_LAYOUT
/begin RECORD_LAYOUT Lookup2D_X_FLOAT32_IEEE AXIS_PTS_X 1 FLOAT32_IEEE INDEX_INCR DIRECT /end RECORD_LAYOUT
/begin CHARACTERISTIC EOP_IRefPCV_M "Output Processing Current Reference Map for Pressure Control Valve" CURVE 0x40044D04 /* @ECU_Address@EOP_IRefPCV_M@ */ Lookup1D_FLOAT32_IEEE 0 EcuIntgdSwGend_CM_single_A 0.0 10000.0
 /begin AXIS_DESCR COM_AXIS RPG_PRailRefForPCV EcuIntgdSwGend_CM_single 10 0.0 3000.0 AXIS_PTS_REF EOP_PRailRefForPCV_A /end AXIS_DESCR
/end CHARACTERISTIC
/begin AXIS_PTS EOP_PRailRefForPCV_A "Output Processing Rail Pressure Reference Axis for Pressure Control Valve" 0x40044D5C /* @ECU_Address@EOP_PRailRefForPCV_A@ */ RPG_PRailRefForPCV Lookup1D_X_FLOAT32_IEEE 0 EcuIntgdSwGend_CM_single 10 0.0 3000.0 /end AXIS_PTS
/begin CHARACTERISTIC EOP_IRefVCV_M "Output Processing Current Reference Map for Volumetric Control Valve" CURVE 0x40044D2C /* @ECU_Address@EOP_IRefVCV_M@ */ Lookup1D_FLOAT32_IEEE 0 EcuIntgdSwGend_CM_single_A 0.0 10000.0
 /begin AXIS_DESCR COM_AXIS RPG_PercgVCVReq EcuIntgdSwGend_CM_single__ 10 0.0 100.0 AXIS_PTS_REF EOP_PercgVCVReq_A /end AXIS_DESCR
/end CHARACTERISTIC
/begin AXIS_PTS EOP_PercgVCVReq_A "Output Processing Pecentage Reqeust Axis of Volumetric Control Valve" 0x40044D84 /* @ECU_Address@EOP_PercgVCVReq_A@ */ RPG_PercgVCVReq Lookup1D_X_FLOAT32_IEEE 0 EcuIntgdSwGend_CM_single__ 10 0.0 100.0 /end AXIS_PTS
/begin CHARACTERISTIC EngBrk_ActEngBrkTq_M "Actual Engine Brake Torque Map" MAP 0x40044E2C /* @ECU_Address@EngBrk_ActEngBrkTq_M@ */ Lookup2D_FLOAT32_IEEE 0 EcuIntgdSwGend_CM_single_N_m 0.0 5000.0
 /begin AXIS_DESCR COM_AXIS EngBrk_DrvrBrkLvrPosn EcuIntgdSwGend_CM_single__ 3 0.0 100.0 AXIS_PTS_REF EngBrk_DrvrBrkLvrPosn_A /end AXIS_DESCR
 /begin AXIS_DESCR COM_AXIS EIP_NEng EcuIntgdSwGend_CM_single_rpm 10 0.0 3000.0 AXIS_PTS_REF EngBrk_NEngForActEngBrkTq_A /end AXIS_DESCR
/end CHARACTERISTIC
/begin AXIS_PTS EngBrk_DrvrBrkLvrPosn_A "Driver Brake Lever Position X Axis" 0x40044EBC /* @ECU_Address@EngBrk_DrvrBrkLvrPosn_A@ */ EngBrk_DrvrBrkLvrPosn Lookup2D_X_FLOAT32_IEEE 0 EcuIntgdSwGend_CM_single__ 3 0.0 100.0 /end AXIS_PTS
/begin AXIS_PTS EngBrk_NEngForActEngBrkTq_A "Engine Speed Values for Actual Engine Brake Torque Map" 0x40044F04 /* @ECU_Address@EngBrk_NEngForActEngBrkTq_A@ */ EIP_NEng Lookup2D_X_FLOAT32_IEEE 0 EcuIntgdSwGend_CM_single_rpm 10 0.0 3000.0 /end AXIS_PTS
/begin CHARACTERISTIC EngBrk_EngBrkTqMax_M "Engine Brake Torque Max Map" CURVE 0x40044ED0 /* @ECU_Address@EngBrk_EngBrkTqMax_M@ */ Lookup1D_FLOAT32_IEEE 0 EcuIntgdSwGend_CM_single_N_m 0.0 5000.0
 /begin AXIS_DESCR COM_AXIS EIP_NEng EcuIntgdSwGend_CM_single_rpm 10 0.0 3000.0 AXIS_PTS_REF EngBrk_NEngForEngBrkTqMax_A /end AXIS_DESCR
/end CHARACTERISTIC
/begin AXIS_PTS EngBrk_NEngForEngBrkTqMax_A "Engine Speed Values for Engine Brake Torque Max" 0x40044F2C /* @ECU_Address@EngBrk_NEngForEngBrkTqMax_A@ */ EIP_NEng Lookup1D_X_FLOAT32_IEEE 0 EcuIntgdSwGend_CM_single_rpm 10 0.0 3000.0 /end AXIS_PTS
/begin CHARACTERISTIC IC_FuInTank_M "Fuel in Tank Map" CURVE 0x400450D4 /* @ECU_Address@IC_FuInTank_M@ */ Lookup1D_FLOAT32_IEEE 0 EcuIntgdSwGend_CM_single_L 0.0 900.0
 /begin AXIS_DESCR COM_AXIS EIP_CanFuLvl1 EcuIntgdSwGend_CM_single__ 3 0.0 100.0 AXIS_PTS_REF IC_FuInTank_A /end AXIS_DESCR
/end CHARACTERISTIC
/begin AXIS_PTS IC_FuInTank_A "Fuel in Tank Axis" 0x400450C8 /* @ECU_Address@IC_FuInTank_A@ */ EIP_CanFuLvl1 Lookup1D_X_FLOAT32_IEEE 0 EcuIntgdSwGend_CM_single__ 3 0.0 100.0 /end AXIS_PTS
/begin CHARACTERISTIC IC_OfsPlt2MaiInj_M "Pilot to Main Injection Offset Map" CURVE 0x40045F18 /* @ECU_Address@IC_OfsPlt2MaiInj_M@ */ Lookup1D_FLOAT32_IEEE 0 EcuIntgdSwGend_CM_single_deg 0.0 5000.0
 /begin AXIS_DESCR COM_AXIS EIP_NEng EcuIntgdSwGend_CM_single_rpm 5 0.0 3200.0 AXIS_PTS_REF IC_NEngForOfsPlt2MaiInj_A /end AXIS_DESCR
/end CHARACTERISTIC
/begin AXIS_PTS IC_NEngForOfsPlt2MaiInj_A "Engine Speed Map Axis for Pilot to Main Injection Offset Map" 0x40045DEC /* @ECU_Address@IC_NEngForOfsPlt2MaiInj_A@ */ EIP_NEng Lookup1D_X_FLOAT32_IEEE 0 EcuIntgdSwGend_CM_single_rpm 5 0.0 3200.0 /end AXIS_PTS
/begin CHARACTERISTIC PHC_TiAcvnGridHeatr_M "PreHeating Time Calculation Map After Start" MAP 0x400486E0 /* @ECU_Address@PHC_TiAcvnGridHeatr_M@ */ Lookup2D_FLOAT32_IEEE 0 EcuIntgdSwGend_CM_single_ms 0.0 50000.0
 /begin AXIS_DESCR COM_AXIS EIP_PAmbAir EcuIntgdSwGend_CM_single_mbar 4 0.0 1600.0 AXIS_PTS_REF PHC_PAmbAirForTiAcvnGridHeatr_A /end AXIS_DESCR
 /begin AXIS_DESCR COM_AXIS NO_INPUT_QUANTITY EcuIntgdSwGend_CM_single_degC 10 -50.0 200.0 AXIS_PTS_REF PHC_TiAcvnGridHeatr_A /end AXIS_DESCR
/end CHARACTERISTIC
/begin AXIS_PTS PHC_PAmbAirForTiAcvnGridHeatr_A "Ambient Air Pressure Map Axis for Grid Heater Timer Activation" 0x40048694 /* @ECU_Address@PHC_PAmbAirForTiAcvnGridHeatr_A@ */ EIP_PAmbAir Lookup2D_X_FLOAT32_IEEE 0 EcuIntgdSwGend_CM_single_mbar 4 0.0 1600.0 /end AXIS_PTS
/begin AXIS_PTS PHC_TiAcvnGridHeatr_A "PreHeating Time Calculation Map Axis After Start" 0x400486B8 /* @ECU_Address@PHC_TiAcvnGridHeatr_A@ */ NO_INPUT_QUANTITY Lookup2D_X_FLOAT32_IEEE 0 EcuIntgdSwGend_CM_single_degC 10 -50.0 200.0 /end AXIS_PTS
/begin CHARACTERISTIC PHC_TiPreHeatg_M "PreHeating Time Calculation Map Before Start" MAP 0x400487B8 /* @ECU_Address@PHC_TiPreHeatg_M@ */ Lookup2D_FLOAT32_IEEE 0 EcuIntgdSwGend_CM_single_ms 0.0 500000.0
 /begin AXIS_DESCR COM_AXIS EIP_PAmbAir EcuIntgdSwGend_CM_single_mbar 4 0.0 1600.0 AXIS_PTS_REF PHC_PAmbAirForTiPreHeatgClcn_A /end AXIS_DESCR
 /begin AXIS_DESCR COM_AXIS NO_INPUT_QUANTITY EcuIntgdSwGend_CM_single_degC 10 -40.0 150.0 AXIS_PTS_REF PHC_TiPreHeatgClcn_A /end AXIS_DESCR
/end CHARACTERISTIC
/begin AXIS_PTS PHC_PAmbAirForTiPreHeatgClcn_A "Ambient Air Pressure Map Axis for Pre Grid Heater Timer Activation" 0x400486A4 /* @ECU_Address@PHC_PAmbAirForTiPreHeatgClcn_A@ */ EIP_PAmbAir Lookup2D_X_FLOAT32_IEEE 0 EcuIntgdSwGend_CM_single_mbar 4 0.0 1600.0 /end AXIS_PTS
/begin AXIS_PTS PHC_TiPreHeatgClcn_A "PreHeating Time Calculation Map Axis" 0x40048790 /* @ECU_Address@PHC_TiPreHeatgClcn_A@ */ NO_INPUT_QUANTITY Lookup2D_X_FLOAT32_IEEE 0 EcuIntgdSwGend_CM_single_degC 10 -40.0 150.0 /end AXIS_PTS
/begin CHARACTERISTIC PtoCtrl_CoeffDForPto_M "Derivative Coefficient Map Out Signal for PTO Controller" MAP 0x40048878 /* @ECU_Address@PtoCtrl_CoeffDForPto_M@ */ Lookup2D_FLOAT32_IEEE 0 EcuIntgdSwGend_CM_single -10000.0 10000.0
 /begin AXIS_DESCR COM_AXIS PtoCtrl_ErrNEngRef EcuIntgdSwGend_CM_single_rpm 10 -100000.0 100000.0 AXIS_PTS_REF PtoCtrl_ErrNEngRef_A /end AXIS_DESCR
 /begin AXIS_DESCR COM_AXIS EIP_TCoolt EcuIntgdSwGend_CM_single_degC 10 -50.0 200.0 AXIS_PTS_REF PtoCtrl_TCooltForSpdCtl_A /end AXIS_DESCR
/end CHARACTERISTIC
/begin AXIS_PTS PtoCtrl_ErrNEngRef_A "Axis Values of Error Engine Speed for PID Coefficient Maps" 0x40048EB8 /* @ECU_Address@PtoCtrl_ErrNEngRef_A@ */ PtoCtrl_ErrNEngRef Lookup2D_X_FLOAT32_IEEE 0 EcuIntgdSwGend_CM_single_rpm 10 -100000.0 100000.0 /end AXIS_PTS
/begin AXIS_PTS PtoCtrl_TCooltForSpdCtl_A "Coolant Temperature PID X Axis" 0x40049134 /* @ECU_Address@PtoCtrl_TCooltForSpdCtl_A@ */ EIP_TCoolt Lookup2D_X_FLOAT32_IEEE 0 EcuIntgdSwGend_CM_single_degC 10 -50.0 200.0 /end AXIS_PTS
/begin CHARACTERISTIC PtoCtrl_CoeffFiltForPto_M "Filter Coefficient Map for PTO Controller" MAP 0x40048A08 /* @ECU_Address@PtoCtrl_CoeffFiltForPto_M@ */ Lookup2D_FLOAT32_IEEE 0 EcuIntgdSwGend_CM_single -100000.0 100000.0
 /begin AXIS_DESCR COM_AXIS PtoCtrl_ErrNEngRef EcuIntgdSwGend_CM_single_rpm 10 -100000.0 100000.0 AXIS_PTS_REF PtoCtrl_ErrNEngRef_A /end AXIS_DESCR
 /begin AXIS_DESCR COM_AXIS EIP_TCoolt EcuIntgdSwGend_CM_single_degC 10 -50.0 200.0 AXIS_PTS_REF PtoCtrl_TCooltForSpdCtl_A /end AXIS_DESCR
/end CHARACTERISTIC
/begin CHARACTERISTIC PtoCtrl_CoeffIForPto_M "Integrator Coefficient Map for PTO Controller" MAP 0x40048B98 /* @ECU_Address@PtoCtrl_CoeffIForPto_M@ */ Lookup2D_FLOAT32_IEEE 0 EcuIntgdSwGend_CM_single -100000.0 100000.0
 /begin AXIS_DESCR COM_AXIS PtoCtrl_ErrNEngRef EcuIntgdSwGend_CM_single_rpm 10 -100000.0 100000.0 AXIS_PTS_REF PtoCtrl_ErrNEngRef_A /end AXIS_DESCR
 /begin AXIS_DESCR COM_AXIS EIP_TCoolt EcuIntgdSwGend_CM_single_degC 10 -50.0 200.0 AXIS_PTS_REF PtoCtrl_TCooltForSpdCtl_A /end AXIS_DESCR
/end CHARACTERISTIC
/begin CHARACTERISTIC PtoCtrl_CoeffPForPto_M "PID Controller Proportional Map For PTO Controller" MAP 0x40048D28 /* @ECU_Address@PtoCtrl_CoeffPForPto_M@ */ Lookup2D_FLOAT32_IEEE 0 EcuIntgdSwGend_CM_single -100000.0 100000.0
 /begin AXIS_DESCR COM_AXIS PtoCtrl_ErrNEngRef EcuIntgdSwGend_CM_single_rpm 10 -100000.0 100000.0 AXIS_PTS_REF PtoCtrl_ErrNEngRef_A /end AXIS_DESCR
 /begin AXIS_DESCR COM_AXIS EIP_TCoolt EcuIntgdSwGend_CM_single_degC 10 -50.0 200.0 AXIS_PTS_REF PtoCtrl_TCooltForSpdCtl_A /end AXIS_DESCR
/end CHARACTERISTIC
/begin CHARACTERISTIC PtoCtrl_PtoCtrlFF_M "PID Feed Forward Map For PTO" MAP 0x40048F78 /* @ECU_Address@PtoCtrl_PtoCtrlFF_M@ */ Lookup2D_FLOAT32_IEEE 0 EcuIntgdSwGend_CM_single_N_m -100000.0 100000.0
 /begin AXIS_DESCR COM_AXIS EIP_TCoolt EcuIntgdSwGend_CM_single_degC 10 -50.0 200.0 AXIS_PTS_REF PtoCtrl_TCooltForPtoCtrlFF_A /end AXIS_DESCR
 /begin AXIS_DESCR COM_AXIS EIP_NEng EcuIntgdSwGend_CM_single_rpm 10 0.0 5000.0 AXIS_PTS_REF PtoCtrl_NEngForPtoCtrlFF_A /end AXIS_DESCR
/end CHARACTERISTIC
/begin AXIS_PTS PtoCtrl_TCooltForPtoCtrlFF_A "Coolant Temperature Feed Forward X Axis" 0x4004910C /* @ECU_Address@PtoCtrl_TCooltForPtoCtrlFF_A@ */ EIP_TCoolt Lookup2D_X_FLOAT32_IEEE 0 EcuIntgdSwGend_CM_single_degC 10 -50.0 200.0 /end AXIS_PTS
/begin AXIS_PTS PtoCtrl_NEngForPtoCtrlFF_A "PID Feed Forward Engine Speed X Axis" 0x40048EFC /* @ECU_Address@PtoCtrl_NEngForPtoCtrlFF_A@ */ EIP_NEng Lookup2D_X_FLOAT32_IEEE 0 EcuIntgdSwGend_CM_single_rpm 10 0.0 5000.0 /end AXIS_PTS
/begin CHARACTERISTIC RPG_PercgVolCtrlVlvFFLeakg1_M "Percentage Volumetric Control Valve FeedForward Leakage Map 1" MAP 0x4004A620 /* @ECU_Address@RPG_PercgVolCtrlVlvFFLeakg1_M@ */ Lookup2D_FLOAT32_IEEE 0 EcuIntgdSwGend_CM_single__ 0.0 100.0
 /begin AXIS_DESCR COM_AXIS TL_TqIndcdLimd EcuIntgdSwGend_CM_single 15 0.0 5000.0 AXIS_PTS_REF RPG_TqIndcdLimdForFFLeakg1_A /end AXIS_DESCR
 /begin AXIS_DESCR COM_AXIS EIP_NEng EcuIntgdSwGend_CM_single_rpm 15 0.0 3500.0 AXIS_PTS_REF RPG_NEngQntyForFFLeakg1_A /end AXIS_DESCR
/end CHARACTERISTIC
/begin AXIS_PTS RPG_TqIndcdLimdForFFLeakg1_A "Indicated Torque Limitation Map1 Axis for FeedForward Leakage" 0x4004B11C /* @ECU_Address@RPG_TqIndcdLimdForFFLeakg1_A@ */ TL_TqIndcdLimd Lookup2D_X_FLOAT32_IEEE 0 EcuIntgdSwGend_CM_single 15 0.0 5000.0 /end AXIS_PTS
/begin AXIS_PTS RPG_NEngQntyForFFLeakg1_A "Engine Speed Quantity Map 1 Axis for FeedForward Leakage" 0x400498B4 /* @ECU_Address@RPG_NEngQntyForFFLeakg1_A@ */ EIP_NEng Lookup2D_X_FLOAT32_IEEE 0 EcuIntgdSwGend_CM_single_rpm 15 0.0 3500.0 /end AXIS_PTS
/begin CHARACTERISTIC RPG_PercgVolCtrlVlvFFLeakg2_M "Percentage Volumetric Control Valve FeedForward Leakage Map 2" MAP 0x4004A9A4 /* @ECU_Address@RPG_PercgVolCtrlVlvFFLeakg2_M@ */ Lookup2D_FLOAT32_IEEE 0 EcuIntgdSwGend_CM_single__ 0.0 100.0
 /begin AXIS_DESCR COM_AXIS TL_TqIndcdLimd EcuIntgdSwGend_CM_single 15 0.0 5000.0 AXIS_PTS_REF RPG_TqIndcdLimdForFFLeakg2_A /end AXIS_DESCR
 /begin AXIS_DESCR COM_AXIS EIP_NEng EcuIntgdSwGend_CM_single_rpm 15 0.0 3500.0 AXIS_PTS_REF RPG_NEngQntyForFFLeakg2_A /end AXIS_DESCR
/end CHARACTERISTIC
/begin AXIS_PTS RPG_TqIndcdLimdForFFLeakg2_A "Indicated Torque Limitation Map2 Axis for FeedForward Leakage" 0x4004B158 /* @ECU_Address@RPG_TqIndcdLimdForFFLeakg2_A@ */ TL_TqIndcdLimd Lookup2D_X_FLOAT32_IEEE 0 EcuIntgdSwGend_CM_single 15 0.0 5000.0 /end AXIS_PTS
/begin AXIS_PTS RPG_NEngQntyForFFLeakg2_A "Engine Speed Quantity Map 2 Axis for FeedForward Leakage" 0x400498F0 /* @ECU_Address@RPG_NEngQntyForFFLeakg2_A@ */ EIP_NEng Lookup2D_X_FLOAT32_IEEE 0 EcuIntgdSwGend_CM_single_rpm 15 0.0 3500.0 /end AXIS_PTS
/begin CHARACTERISTIC RPG_PercgVolCtrlVlvFFLeakg3_M "Percentage Volumetric Control Valve FeedForward Leakage Map 3" MAP 0x4004AD28 /* @ECU_Address@RPG_PercgVolCtrlVlvFFLeakg3_M@ */ Lookup2D_FLOAT32_IEEE 0 EcuIntgdSwGend_CM_single__ 0.0 100.0
 /begin AXIS_DESCR COM_AXIS TL_TqIndcdLimd EcuIntgdSwGend_CM_single 15 0.0 5000.0 AXIS_PTS_REF RPG_TqIndcdLimdForFFLeakg3_A /end AXIS_DESCR
 /begin AXIS_DESCR COM_AXIS EIP_NEng EcuIntgdSwGend_CM_single_rpm 15 0.0 3500.0 AXIS_PTS_REF RPG_NEngQntyForFFLeakg3_A /end AXIS_DESCR
/end CHARACTERISTIC
/begin AXIS_PTS RPG_TqIndcdLimdForFFLeakg3_A "Indicated Torque Limitation Map3 Axis for FeedForward Leakage" 0x4004B194 /* @ECU_Address@RPG_TqIndcdLimdForFFLeakg3_A@ */ TL_TqIndcdLimd Lookup2D_X_FLOAT32_IEEE 0 EcuIntgdSwGend_CM_single 15 0.0 5000.0 /end AXIS_PTS
/begin AXIS_PTS RPG_NEngQntyForFFLeakg3_A "Engine Speed Quantity Map 3 Axis for FeedForward Leakage" 0x4004992C /* @ECU_Address@RPG_NEngQntyForFFLeakg3_A@ */ EIP_NEng Lookup2D_X_FLOAT32_IEEE 0 EcuIntgdSwGend_CM_single_rpm 15 0.0 3500.0 /end AXIS_PTS
/begin CHARACTERISTIC RPG_CoeffDForPRailCtl_M "Rail Pressure Controller D Coefficient Map" MAP 0x400491A8 /* @ECU_Address@RPG_CoeffDForPRailCtl_M@ */ Lookup2D_FLOAT32_IEEE 0 EcuIntgdSwGend_CM_single -100000.0 100000.0
 /begin AXIS_DESCR COM_AXIS RPG_ErrPRail EcuIntgdSwGend_CM_single_bar 10 -500.0 500.0 AXIS_PTS_REF RPG_ErrPRail_A /end AXIS_DESCR
 /begin AXIS_DESCR COM_AXIS EIP_TFu EcuIntgdSwGend_CM_single_degC 10 -40.0 250.0 AXIS_PTS_REF RPG_TFuForPRailCtl_A /end AXIS_DESCR
/end CHARACTERISTIC
/begin AXIS_PTS RPG_ErrPRail_A "Rail Pressure Controller Rail Pressure Error Axis for PID Coefficient Calculation Maps" 0x400497E8 /* @ECU_Address@RPG_ErrPRail_A@ */ RPG_ErrPRail Lookup2D_X_FLOAT32_IEEE 0 EcuIntgdSwGend_CM_single_bar 10 -500.0 500.0 /end AXIS_PTS
/begin AXIS_PTS RPG_TFuForPRailCtl_A "Fuel Temperature Axis for PID Coefficient Calculation Maps" 0x4004B0EC /* @ECU_Address@RPG_TFuForPRailCtl_A@ */ EIP_TFu Lookup2D_X_FLOAT32_IEEE 0 EcuIntgdSwGend_CM_single_degC 10 -40.0 250.0 /end AXIS_PTS
/begin CHARACTERISTIC RPG_CoeffFiltForPRailCtl_M "Rail Pressure Controller D Filter Coefficient Map" MAP 0x40049338 /* @ECU_Address@RPG_CoeffFiltForPRailCtl_M@ */ Lookup2D_FLOAT32_IEEE 0 EcuIntgdSwGend_CM_single -100000.0 100000.0
 /begin AXIS_DESCR COM_AXIS RPG_ErrPRail EcuIntgdSwGend_CM_single_bar 10 -500.0 500.0 AXIS_PTS_REF RPG_ErrPRail_A /end AXIS_DESCR
 /begin AXIS_DESCR COM_AXIS EIP_TFu EcuIntgdSwGend_CM_single_degC 10 -40.0 250.0 AXIS_PTS_REF RPG_TFuForPRailCtl_A /end AXIS_DESCR
/end CHARACTERISTIC
/begin CHARACTERISTIC RPG_CoeffIForPRailCtl_M "Rail Pressure Controller I Coefficient Map" MAP 0x400494C8 /* @ECU_Address@RPG_CoeffIForPRailCtl_M@ */ Lookup2D_FLOAT32_IEEE 0 EcuIntgdSwGend_CM_single -100000.0 100000.0
 /begin AXIS_DESCR COM_AXIS RPG_ErrPRail EcuIntgdSwGend_CM_single_bar 10 -500.0 500.0 AXIS_PTS_REF RPG_ErrPRail_A /end AXIS_DESCR
 /begin AXIS_DESCR COM_AXIS EIP_TFu EcuIntgdSwGend_CM_single_degC 10 -40.0 250.0 AXIS_PTS_REF RPG_TFuForPRailCtl_A /end AXIS_DESCR
/end CHARACTERISTIC
/begin CHARACTERISTIC RPG_CoeffPForPRailCtl_M "Rail Pressure Controller P Coefficient Map" MAP 0x40049658 /* @ECU_Address@RPG_CoeffPForPRailCtl_M@ */ Lookup2D_FLOAT32_IEEE 0 EcuIntgdSwGend_CM_single -100000.0 100000.0
 /begin AXIS_DESCR COM_AXIS RPG_ErrPRail EcuIntgdSwGend_CM_single_bar 10 -500.0 500.0 AXIS_PTS_REF RPG_ErrPRail_A /end AXIS_DESCR
 /begin AXIS_DESCR COM_AXIS EIP_TFu EcuIntgdSwGend_CM_single_degC 10 -40.0 250.0 AXIS_PTS_REF RPG_TFuForPRailCtl_A /end AXIS_DESCR
/end CHARACTERISTIC
/begin CHARACTERISTIC RPG_PAmbAirCorrForPRail_M "Ambient Air Pressure Correction Map for Rail Pressure" CURVE 0x40049970 /* @ECU_Address@RPG_PAmbAirCorrForPRail_M@ */ Lookup1D_FLOAT32_IEEE 0 EcuIntgdSwGend_CM_single_bar 0.0 100.0
 /begin AXIS_DESCR COM_AXIS EIP_PAmbAir EcuIntgdSwGend_CM_single_bar 5 0.0 3000.0 AXIS_PTS_REF RPG_PAmbAirCorrPRail_A /end AXIS_DESCR
/end CHARACTERISTIC
/begin AXIS_PTS RPG_PAmbAirCorrPRail_A "Ambient Air Pressure Correction Map Axis for Rail Pressure" 0x40049984 /* @ECU_Address@RPG_PAmbAirCorrPRail_A@ */ EIP_PAmbAir Lookup1D_X_FLOAT32_IEEE 0 EcuIntgdSwGend_CM_single_bar 5 0.0 3000.0 /end AXIS_PTS
/begin CHARACTERISTIC RPG_PRailCorrPAmbAir_M "Rail Pressure Correction for Ambient Air Pressure Map" MAP 0x400499C0 /* @ECU_Address@RPG_PRailCorrPAmbAir_M@ */ Lookup2D_FLOAT32_IEEE 0 EcuIntgdSwGend_CM_single_bar 0.0 2500.0
 /begin AXIS_DESCR COM_AXIS TL_TqIndcdLimd EcuIntgdSwGend_CM_single_N_m 5 0.0 5000.0 AXIS_PTS_REF RPG_TqIndcdLimdForPAmbAirCorr_A /end AXIS_DESCR
 /begin AXIS_DESCR COM_AXIS EIP_NEng EcuIntgdSwGend_CM_single_rpm 20 0.0 3200.0 AXIS_PTS_REF RPG_NEngCorrForPAmbAirCorr_A /end AXIS_DESCR
/end CHARACTERISTIC
/begin AXIS_PTS RPG_TqIndcdLimdForPAmbAirCorr_A "Limited Indicated Torque Map Axis for Rail Pressure Correction wrt Ambient Air Pressure Map" 0x4004B1D0 /* @ECU_Address@RPG_TqIndcdLimdForPAmbAirCorr_A@ */ TL_TqIndcdLimd Lookup2D_X_FLOAT32_IEEE 0 EcuIntgdSwGend_CM_single_N_m 5 0.0 5000.0 /end AXIS_PTS
/begin AXIS_PTS RPG_NEngCorrForPAmbAirCorr_A "Engine Speed Correction Map Axis for Corrected Ambient Air Pressure" 0x40049828 /* @ECU_Address@RPG_NEngCorrForPAmbAirCorr_A@ */ EIP_NEng Lookup2D_X_FLOAT32_IEEE 0 EcuIntgdSwGend_CM_single_rpm 20 0.0 3200.0 /end AXIS_PTS
/begin CHARACTERISTIC RPG_TCorrForPRail_M "Rail Pressure Temperature Correction Map" CURVE 0x4004B0D8 /* @ECU_Address@RPG_TCorrForPRail_M@ */ Lookup1D_FLOAT32_IEEE 0 EcuIntgdSwGend_CM_single_bar 0.0 2500.0
 /begin AXIS_DESCR COM_AXIS NO_INPUT_QUANTITY EcuIntgdSwGend_CM_single_degC 5 -100.0 200.0 AXIS_PTS_REF RPG_TCorrForPRail_A /end AXIS_DESCR
/end CHARACTERISTIC
/begin AXIS_PTS RPG_TCorrForPRail_A "Rail Pressure Temperature Correction Map Axis" 0x4004B0C4 /* @ECU_Address@RPG_TCorrForPRail_A@ */ NO_INPUT_QUANTITY Lookup1D_X_FLOAT32_IEEE 0 EcuIntgdSwGend_CM_single_degC 5 -100.0 200.0 /end AXIS_PTS
/begin CHARACTERISTIC SC_TiMaxAllwblCrnkg_M "Maximum Allowable Cranking Time Calculation Map" CURVE 0x4004B298 /* @ECU_Address@SC_TiMaxAllwblCrnkg_M@ */ Lookup1D_FLOAT32_IEEE 0 EcuIntgdSwGend_CM_single_ms 0.0 50000.0
 /begin AXIS_DESCR COM_AXIS NO_INPUT_QUANTITY EcuIntgdSwGend_CM_single_degC 5 -40.0 150.0 AXIS_PTS_REF SC_TiCrnkg_A /end AXIS_DESCR
/end CHARACTERISTIC
/begin AXIS_PTS SC_TiCrnkg_A "Cranking Time Map Axis" 0x4004B264 /* @ECU_Address@SC_TiCrnkg_A@ */ NO_INPUT_QUANTITY Lookup1D_X_FLOAT32_IEEE 0 EcuIntgdSwGend_CM_single_degC 5 -40.0 150.0 /end AXIS_PTS
/begin CHARACTERISTIC TrC_FuQntyToTq_M "Fuel Quantity To Torque Maps" MAP 0x4004C74C /* @ECU_Address@TrC_FuQntyToTq_M@ */ Lookup2D_FLOAT32_IEEE 0 EcuIntgdSwGend_CM_single_N_m 0.0 2000.0
 /begin AXIS_DESCR COM_AXIS TrC_MMaiFuQntyLimd EcuIntgdSwGend_CM_single_mm_3 20 0.0 300.0 AXIS_PTS_REF TrC_FuQntyForQntyCnvn_A /end AXIS_DESCR
 /begin AXIS_DESCR COM_AXIS EIP_NEng EcuIntgdSwGend_CM_single_rpm 25 0.0 3000.0 AXIS_PTS_REF TrC_NEngForQntyCnvn_A /end AXIS_DESCR
/end CHARACTERISTIC
/begin AXIS_PTS TrC_FuQntyForQntyCnvn_A "Fuel Quantity Axis Values for Quantity Conversion" 0x4004C6FC /* @ECU_Address@TrC_FuQntyForQntyCnvn_A@ */ TrC_MMaiFuQntyLimd Lookup2D_X_FLOAT32_IEEE 0 EcuIntgdSwGend_CM_single_mm_3 20 0.0 300.0 /end AXIS_PTS
/begin AXIS_PTS TrC_NEngForQntyCnvn_A "Engine Speed Axis Values for Quantity Conversion" 0x40050820 /* @ECU_Address@TrC_NEngForQntyCnvn_A@ */ EIP_NEng Lookup2D_X_FLOAT32_IEEE 0 EcuIntgdSwGend_CM_single_rpm 25 0.0 3000.0 /end AXIS_PTS
/begin CHARACTERISTIC TrC_MaiFuPAmbAirCorr_M "Main Fuel Quantity - Ambient Air Pressure Correction" MAP 0x4004FDF8 /* @ECU_Address@TrC_MaiFuPAmbAirCorr_M@ */ Lookup2D_FLOAT32_IEEE 0 EcuIntgdSwGend_CM_single_mm_3_stk -500.0 1000.0
 /begin AXIS_DESCR COM_AXIS TL_TqIndcdLimd EcuIntgdSwGend_CM_single_N_m 10 0.0 4000.0 AXIS_PTS_REF TrC_TqIndcdLimdForMaiFuCorr_A /end AXIS_DESCR
 /begin AXIS_DESCR COM_AXIS EIP_PAmbAir EcuIntgdSwGend_CM_single_mbar 10 0.0 30000.0 AXIS_PTS_REF TrC_MaiFuPAmbAirCorr_A /end AXIS_DESCR
/end CHARACTERISTIC
/begin AXIS_PTS TrC_TqIndcdLimdForMaiFuCorr_A "Indicated Torque for Main Fuel Quantity Correction" 0x40050AF4 /* @ECU_Address@TrC_TqIndcdLimdForMaiFuCorr_A@ */ TL_TqIndcdLimd Lookup2D_X_FLOAT32_IEEE 0 EcuIntgdSwGend_CM_single_N_m 10 0.0 4000.0 /end AXIS_PTS
/begin AXIS_PTS TrC_MaiFuPAmbAirCorr_A "Main Fuel Quantity - Axis of Ambient Air Pressure Correction" 0x4004FDD0 /* @ECU_Address@TrC_MaiFuPAmbAirCorr_A@ */ EIP_PAmbAir Lookup2D_X_FLOAT32_IEEE 0 EcuIntgdSwGend_CM_single_mbar 10 0.0 30000.0 /end AXIS_PTS
/begin CHARACTERISTIC TrC_MaiFuTAirBoostCorr_M "Main Fuel Quantity - Airboost Temperature Correction" MAP 0x4004FFB0 /* @ECU_Address@TrC_MaiFuTAirBoostCorr_M@ */ Lookup2D_FLOAT32_IEEE 0 EcuIntgdSwGend_CM_single_mm_3_stk -500.0 1000.0
 /begin AXIS_DESCR COM_AXIS TL_TqIndcdLimd EcuIntgdSwGend_CM_single_N_m 10 0.0 4000.0 AXIS_PTS_REF TrC_TqIndcdLimdForMaiFuCorr_A /end AXIS_DESCR
 /begin AXIS_DESCR COM_AXIS EIP_TAirBoost EcuIntgdSwGend_CM_single_degC 10 -50.0 250.0 AXIS_PTS_REF TrC_MaiFuTAirBoostCorr_A /end AXIS_DESCR
/end CHARACTERISTIC
/begin AXIS_PTS TrC_MaiFuTAirBoostCorr_A "Main Fuel Quantity - Axis of Airboost Temperature Correction" 0x4004FF88 /* @ECU_Address@TrC_MaiFuTAirBoostCorr_A@ */ EIP_TAirBoost Lookup2D_X_FLOAT32_IEEE 0 EcuIntgdSwGend_CM_single_degC 10 -50.0 250.0 /end AXIS_PTS
/begin CHARACTERISTIC TrC_MaiFuTAmbAirCorr_M "Main Fuel Quantity - Ambient Air Temperature Correction" MAP 0x40050168 /* @ECU_Address@TrC_MaiFuTAmbAirCorr_M@ */ Lookup2D_FLOAT32_IEEE 0 EcuIntgdSwGend_CM_single_mm_3_stk -500.0 1000.0
 /begin AXIS_DESCR COM_AXIS TL_TqIndcdLimd EcuIntgdSwGend_CM_single_N_m 10 0.0 4000.0 AXIS_PTS_REF TrC_TqIndcdLimdForMaiFuCorr_A /end AXIS_DESCR
 /begin AXIS_DESCR COM_AXIS EIP_TAmbAir EcuIntgdSwGend_CM_single_degC 10 -50.0 250.0 AXIS_PTS_REF TrC_MaiFuTAmbAirCorr_A /end AXIS_DESCR
/end CHARACTERISTIC
/begin AXIS_PTS TrC_MaiFuTAmbAirCorr_A "Main Fuel Quantity - Axis of Ambient Air Temperature Correction" 0x40050140 /* @ECU_Address@TrC_MaiFuTAmbAirCorr_A@ */ EIP_TAmbAir Lookup2D_X_FLOAT32_IEEE 0 EcuIntgdSwGend_CM_single_degC 10 -50.0 250.0 /end AXIS_PTS
/begin CHARACTERISTIC TrC_MaiFuTCooltCorr_M "Main Fuel Quantity - Coolant Temperature Correction" MAP 0x40050320 /* @ECU_Address@TrC_MaiFuTCooltCorr_M@ */ Lookup2D_FLOAT32_IEEE 0 EcuIntgdSwGend_CM_single_mm_3_stk -500.0 1000.0
 /begin AXIS_DESCR COM_AXIS TL_TqIndcdLimd EcuIntgdSwGend_CM_single_N_m 10 0.0 4000.0 AXIS_PTS_REF TrC_TqIndcdLimdForMaiFuCorr_A /end AXIS_DESCR
 /begin AXIS_DESCR COM_AXIS EIP_TCoolt EcuIntgdSwGend_CM_single_degC 10 -50.0 250.0 AXIS_PTS_REF TrC_MaiFuTCooltCorr_A /end AXIS_DESCR
/end CHARACTERISTIC
/begin AXIS_PTS TrC_MaiFuTCooltCorr_A "Main Fuel Quantity - Axis of Coolant Temperature Correction" 0x400502F8 /* @ECU_Address@TrC_MaiFuTCooltCorr_A@ */ EIP_TCoolt Lookup2D_X_FLOAT32_IEEE 0 EcuIntgdSwGend_CM_single_degC 10 -50.0 250.0 /end AXIS_PTS
/begin CHARACTERISTIC TrC_MaiFuTOilCorr_M "Main Fuel Quantity - Oil Temperature Correction" MAP 0x400504D8 /* @ECU_Address@TrC_MaiFuTOilCorr_M@ */ Lookup2D_FLOAT32_IEEE 0 EcuIntgdSwGend_CM_single_mm_3_stk -500.0 1000.0
 /begin AXIS_DESCR COM_AXIS TL_TqIndcdLimd EcuIntgdSwGend_CM_single_N_m 10 0.0 4000.0 AXIS_PTS_REF TrC_TqIndcdLimdForMaiFuCorr_A /end AXIS_DESCR
 /begin AXIS_DESCR COM_AXIS EIP_TOil EcuIntgdSwGend_CM_single_degC 10 -50.0 250.0 AXIS_PTS_REF TrC_MaiFuTOilCorr_A /end AXIS_DESCR
/end CHARACTERISTIC
/begin AXIS_PTS TrC_MaiFuTOilCorr_A "Main Fuel Quantity - Axis of Oil Temperature Correction" 0x400504B0 /* @ECU_Address@TrC_MaiFuTOilCorr_A@ */ EIP_TOil Lookup2D_X_FLOAT32_IEEE 0 EcuIntgdSwGend_CM_single_degC 10 -50.0 250.0 /end AXIS_PTS
/begin CHARACTERISTIC TrC_MaiFuUClmp30Corr_M "Main Fuel Quantity - Battery Voltage Correction" MAP 0x40050690 /* @ECU_Address@TrC_MaiFuUClmp30Corr_M@ */ Lookup2D_FLOAT32_IEEE 0 EcuIntgdSwGend_CM_single_mm_3_stk -500.0 1000.0
 /begin AXIS_DESCR COM_AXIS TL_TqIndcdLimd EcuIntgdSwGend_CM_single_N_m 10 0.0 4000.0 AXIS_PTS_REF TrC_TqIndcdLimdForMaiFuCorr_A /end AXIS_DESCR
 /begin AXIS_DESCR COM_AXIS EIP_UClmp30 EcuIntgdSwGend_CM_single_V 10 0.0 50.0 AXIS_PTS_REF TrC_MaiFuUClmp30Corr_A /end AXIS_DESCR
/end CHARACTERISTIC
/begin AXIS_PTS TrC_MaiFuUClmp30Corr_A "Main Fuel Quantity - Axis of Battery Voltage Correction" 0x40050668 /* @ECU_Address@TrC_MaiFuUClmp30Corr_A@ */ EIP_UClmp30 Lookup2D_X_FLOAT32_IEEE 0 EcuIntgdSwGend_CM_single_V 10 0.0 50.0 /end AXIS_PTS
/begin CHARACTERISTIC EMS_NEngTqtoIdleThd_P "Torque To Idle Mode Engine Speed Threshold Parameter" VALUE 0x400449A0 /* @ECU_Address@EMS_NEngTqtoIdleThd_P@ */ Scalar_FLOAT32_IEEE 0 EcuIntgdSwGend_CM_single_rpm 0.0 5000.0 /end CHARACTERISTIC
/begin CHARACTERISTIC EOP_DstTrvldInKmOvv_P "Output Processing Distance Travel In Kilometer Override Value Parameter" VALUE 0x40044C5C /* @ECU_Address@EOP_DstTrvldInKmOvv_P@ */ Scalar_FLOAT32_IEEE 0 EcuIntgdSwGend_CM_single_km 0.0 1.0E+6 /end CHARACTERISTIC
/begin CHARACTERISTIC EOP_DurMaiInj1Ovv_P "Output Processing Main Injection Duration for Cylinder 1 Override Value Parameter" VALUE 0x40044C64 /* @ECU_Address@EOP_DurMaiInj1Ovv_P@ */ Scalar_FLOAT32_IEEE 0 EcuIntgdSwGend_CM_single_us 0.0 10000.0 /end CHARACTERISTIC
/begin CHARACTERISTIC EOP_DurMaiInj2Ovv_P "Output Processing Main Injection Duration for Cylinder 2 Override Value Parameter" VALUE 0x40044C6C /* @ECU_Address@EOP_DurMaiInj2Ovv_P@ */ Scalar_FLOAT32_IEEE 0 EcuIntgdSwGend_CM_single_us 0.0 10000.0 /end CHARACTERISTIC
/begin CHARACTERISTIC EOP_DurMaiInj3Ovv_P "Output Processing Main Injection Duration for Cylinder 3 Override Value Parameter" VALUE 0x40044C74 /* @ECU_Address@EOP_DurMaiInj3Ovv_P@ */ Scalar_FLOAT32_IEEE 0 EcuIntgdSwGend_CM_single_us 0.0 10000.0 /end CHARACTERISTIC
/begin CHARACTERISTIC EOP_DurMaiInj4Ovv_P "Output Processing Main Injection Duration for Cylinder 4 Override Value Parameter" VALUE 0x40044C7C /* @ECU_Address@EOP_DurMaiInj4Ovv_P@ */ Scalar_FLOAT32_IEEE 0 EcuIntgdSwGend_CM_single_us 0.0 10000.0 /end CHARACTERISTIC
/begin CHARACTERISTIC EOP_DurMaiInj5Ovv_P "Output Processing Main Injection Duration for Cylinder 5 Override Value Parameter" VALUE 0x40044C84 /* @ECU_Address@EOP_DurMaiInj5Ovv_P@ */ Scalar_FLOAT32_IEEE 0 EcuIntgdSwGend_CM_single_us 0.0 10000.0 /end CHARACTERISTIC
/begin CHARACTERISTIC EOP_DurMaiInj6Ovv_P "Output Processing Main Injection Duration for Cylinder 6 Override Value Parameter" VALUE 0x40044C8C /* @ECU_Address@EOP_DurMaiInj6Ovv_P@ */ Scalar_FLOAT32_IEEE 0 EcuIntgdSwGend_CM_single_us 0.0 10000.0 /end CHARACTERISTIC
/begin CHARACTERISTIC EOP_DurPltInj1Ovv_P "Output Processing Pre Pilot Injection Duration for Cylinder 1 Override Value Parameter" VALUE 0x40044C94 /* @ECU_Address@EOP_DurPltInj1Ovv_P@ */ Scalar_FLOAT32_IEEE 0 EcuIntgdSwGend_CM_single_us 0.0 10000.0 /end CHARACTERISTIC
/begin CHARACTERISTIC EOP_DurPltInj2Ovv_P "Output Processing Pre Pilot Injection Duration for Cylinder 2 Override Value Parameter" VALUE 0x40044C9C /* @ECU_Address@EOP_DurPltInj2Ovv_P@ */ Scalar_FLOAT32_IEEE 0 EcuIntgdSwGend_CM_single_us 0.0 10000.0 /end CHARACTERISTIC
/begin CHARACTERISTIC EOP_DurPltInj3Ovv_P "Output Processing Pre Pilot Injection Duration for Cylinder 3 Override Value Parameter" VALUE 0x40044CA4 /* @ECU_Address@EOP_DurPltInj3Ovv_P@ */ Scalar_FLOAT32_IEEE 0 EcuIntgdSwGend_CM_single_us 0.0 10000.0 /end CHARACTERISTIC
/begin CHARACTERISTIC EOP_DurPltInj4Ovv_P "Output Processing Pre Pilot Injection Duration for Cylinder 4 Override Value Parameter" VALUE 0x40044CAC /* @ECU_Address@EOP_DurPltInj4Ovv_P@ */ Scalar_FLOAT32_IEEE 0 EcuIntgdSwGend_CM_single_us 0.0 10000.0 /end CHARACTERISTIC
/begin CHARACTERISTIC EOP_DurPltInj5Ovv_P "Output Processing Pre Pilot Injection Duration for Cylinder 5 Override Value Parameter" VALUE 0x40044CB4 /* @ECU_Address@EOP_DurPltInj5Ovv_P@ */ Scalar_FLOAT32_IEEE 0 EcuIntgdSwGend_CM_single_us 0.0 10000.0 /end CHARACTERISTIC
/begin CHARACTERISTIC EOP_DurPltInj6Ovv_P "Output Processing Pre Pilot Injection Duration for Cylinder 6 Override Value Parameter" VALUE 0x40044CBC /* @ECU_Address@EOP_DurPltInj6Ovv_P@ */ Scalar_FLOAT32_IEEE 0 EcuIntgdSwGend_CM_single_us 0.0 10000.0 /end CHARACTERISTIC
/begin CHARACTERISTIC EOP_DutyVlvReqOvv_P "Output Processing Duty Valve Request Override Value Parameter" VALUE 0x40044CC4 /* @ECU_Address@EOP_DutyVlvReqOvv_P@ */ Scalar_FLOAT32_IEEE 0 EcuIntgdSwGend_CM_single__ 0.0 100.0 /end CHARACTERISTIC
/begin CHARACTERISTIC EOP_DynRateVCVLoLim_P "Output Processing Dynamic Rate Limiter Low Limitation Parameter for Volumetric Control Valve" VALUE 0x40044CCC /* @ECU_Address@EOP_DynRateVCVLoLim_P@ */ Scalar_FLOAT32_IEEE 0 EcuIntgdSwGend_CM_single -1000.0 0.0 /end CHARACTERISTIC
/begin CHARACTERISTIC EOP_DynRateVCVUpLim_P "Output Processing Dynamic Rate Limiter Up Limitation Parameter for Volumetric Control Valve" VALUE 0x40044CD0 /* @ECU_Address@EOP_DynRateVCVUpLim_P@ */ Scalar_FLOAT32_IEEE 0 EcuIntgdSwGend_CM_single 0.0 1000.0 /end CHARACTERISTIC
/begin CHARACTERISTIC EOP_EngDftTqLimOvv_P "Engine Default Torque Limit For Memory - Override Value" VALUE 0x40044CD8 /* @ECU_Address@EOP_EngDftTqLimOvv_P@ */ Scalar_FLOAT32_IEEE 0 EcuIntgdSwGend_CM_single_N_m 0.0 64255.0 /end CHARACTERISTIC
/begin CHARACTERISTIC EOP_EngHrOvv_P "Output Processing Engine Hour Override Value Parameter" VALUE 0x40044CE0 /* @ECU_Address@EOP_EngHrOvv_P@ */ Scalar_FLOAT32_IEEE 0 EcuIntgdSwGend_CM_single_h 0.0 1.0E+6 /end CHARACTERISTIC
/begin CHARACTERISTIC EOP_FuCnsOvv_P "Output Processing Fuel Consumption Override Value Parameter" VALUE 0x40044CF4 /* @ECU_Address@EOP_FuCnsOvv_P@ */ Scalar_FLOAT32_IEEE 0 EcuIntgdSwGend_CM_single_l_100km 0.0 100.0 /end CHARACTERISTIC
/begin CHARACTERISTIC EOP_IRefPCVOvv_P "Output Processing Current Reference for Pressure Control Valve Override Value Parameter" VALUE 0x40044D00 /* @ECU_Address@EOP_IRefPCVOvv_P@ */ Scalar_FLOAT32_IEEE 0 EcuIntgdSwGend_CM_single_A 0.0 10000.0 /end CHARACTERISTIC
/begin CHARACTERISTIC EOP_IVCVReqOvv_P "Output Processing Volumetric Control Valve Current Request Override Value Parameter" VALUE 0x40044D58 /* @ECU_Address@EOP_IVCVReqOvv_P@ */ Scalar_FLOAT32_IEEE 0 EcuIntgdSwGend_CM_single_A 0.0 10000.0 /end CHARACTERISTIC
/begin CHARACTERISTIC EOP_SoiMaiInj1Ovv_P "Output Processing Start of Main Injection 1 Override Value Parameter" VALUE 0x40044DB8 /* @ECU_Address@EOP_SoiMaiInj1Ovv_P@ */ Scalar_FLOAT32_IEEE 0 EcuIntgdSwGend_CM_single_deg -100.0 100.0 /end CHARACTERISTIC
/begin CHARACTERISTIC EOP_SoiMaiInj2Ovv_P "Output Processing Start of Main Injection 2 Override Value Parameter" VALUE 0x40044DC0 /* @ECU_Address@EOP_SoiMaiInj2Ovv_P@ */ Scalar_FLOAT32_IEEE 0 EcuIntgdSwGend_CM_single_deg -100.0 100.0 /end CHARACTERISTIC
/begin CHARACTERISTIC EOP_SoiMaiInj3Ovv_P "Output Processing Start of Main Injection 3 Override Value Parameter" VALUE 0x40044DC8 /* @ECU_Address@EOP_SoiMaiInj3Ovv_P@ */ Scalar_FLOAT32_IEEE 0 EcuIntgdSwGend_CM_single_deg -100.0 100.0 /end CHARACTERISTIC
/begin CHARACTERISTIC EOP_SoiMaiInj4Ovv_P "Output Processing Start of Main Injection 4 Override Value Parameter" VALUE 0x40044DD0 /* @ECU_Address@EOP_SoiMaiInj4Ovv_P@ */ Scalar_FLOAT32_IEEE 0 EcuIntgdSwGend_CM_single_deg -100.0 100.0 /end CHARACTERISTIC
/begin CHARACTERISTIC EOP_SoiMaiInj5Ovv_P "Output Processing Start of Main Injection 5 Override Value Parameter" VALUE 0x40044DD8 /* @ECU_Address@EOP_SoiMaiInj5Ovv_P@ */ Scalar_FLOAT32_IEEE 0 EcuIntgdSwGend_CM_single_deg -100.0 100.0 /end CHARACTERISTIC
/begin CHARACTERISTIC EOP_SoiMaiInj6Ovv_P "Output Processing Start of Main Injection 6 Override Value Parameter" VALUE 0x40044DE0 /* @ECU_Address@EOP_SoiMaiInj6Ovv_P@ */ Scalar_FLOAT32_IEEE 0 EcuIntgdSwGend_CM_single_deg -100.0 100.0 /end CHARACTERISTIC
/begin CHARACTERISTIC EOP_SoiPltInj1Ovv_P "Output Processing Start of Pilot Injection 1 Override Value Parameter" VALUE 0x40044DE8 /* @ECU_Address@EOP_SoiPltInj1Ovv_P@ */ Scalar_FLOAT32_IEEE 0 EcuIntgdSwGend_CM_single_deg -100.0 100.0 /end CHARACTERISTIC
/begin CHARACTERISTIC EOP_SoiPltInj2Ovv_P "Output Processing Start of Pilot Injection 2 Override Value Parameter" VALUE 0x40044DF0 /* @ECU_Address@EOP_SoiPltInj2Ovv_P@ */ Scalar_FLOAT32_IEEE 0 EcuIntgdSwGend_CM_single_deg -100.0 100.0 /end CHARACTERISTIC
/begin CHARACTERISTIC EOP_SoiPltInj3Ovv_P "Output Processing Start of Pilot Injection 3 Override Value Parameter" VALUE 0x40044DF8 /* @ECU_Address@EOP_SoiPltInj3Ovv_P@ */ Scalar_FLOAT32_IEEE 0 EcuIntgdSwGend_CM_single_deg -100.0 100.0 /end CHARACTERISTIC
/begin CHARACTERISTIC EOP_SoiPltInj4Ovv_P "Output Processing Start of Pilot Injection 4 Override Value Parameter" VALUE 0x40044E00 /* @ECU_Address@EOP_SoiPltInj4Ovv_P@ */ Scalar_FLOAT32_IEEE 0 EcuIntgdSwGend_CM_single_deg -100.0 100.0 /end CHARACTERISTIC
/begin CHARACTERISTIC EOP_SoiPltInj5Ovv_P "Output Processing Start of Pilot Injection 5 Override Value Parameter" VALUE 0x40044E08 /* @ECU_Address@EOP_SoiPltInj5Ovv_P@ */ Scalar_FLOAT32_IEEE 0 EcuIntgdSwGend_CM_single_deg -100.0 100.0 /end CHARACTERISTIC
/begin CHARACTERISTIC EOP_SoiPltInj6Ovv_P "Output Processing Start of Pilot Injection 6 Override Value Parameter" VALUE 0x40044E10 /* @ECU_Address@EOP_SoiPltInj6Ovv_P@ */ Scalar_FLOAT32_IEEE 0 EcuIntgdSwGend_CM_single_deg -100.0 100.0 /end CHARACTERISTIC
/begin CHARACTERISTIC EOP_TripOvv_P "" VALUE 0x40044E18 /* @ECU_Address@EOP_TripOvv_P@ */ Scalar_FLOAT32_IEEE 0 EcuIntgdSwGend_CM_single_km 0.0 1.0E+6 /end CHARACTERISTIC
/begin CHARACTERISTIC EngBrk_EngBrkPercTqLoLim_P "Engine Brake Percent Torque Low Limit" VALUE 0x40044EC8 /* @ECU_Address@EngBrk_EngBrkPercTqLoLim_P@ */ Scalar_FLOAT32_IEEE 0 EcuIntgdSwGend_CM_single__ -125.0 125.0 /end CHARACTERISTIC
/begin CHARACTERISTIC EngBrk_EngBrkPercTqUpLim_P "Engine Brake Percent Torque Up Limit" VALUE 0x40044ECC /* @ECU_Address@EngBrk_EngBrkPercTqUpLim_P@ */ Scalar_FLOAT32_IEEE 0 EcuIntgdSwGend_CM_single__ -125.0 125.0 /end CHARACTERISTIC
/begin CHARACTERISTIC EngBrk_EngBrkTqMin_P "Engine Brake Torque Min " VALUE 0x40044EF8 /* @ECU_Address@EngBrk_EngBrkTqMin_P@ */ Scalar_FLOAT32_IEEE 0 EcuIntgdSwGend_CM_single_N_m 0.0 5000.0 /end CHARACTERISTIC
/begin CHARACTERISTIC EngBrk_NEngActvThd_P "Engine Speed Activation Threshold Parameter" VALUE 0x40044EFC /* @ECU_Address@EngBrk_NEngActvThd_P@ */ Scalar_FLOAT32_IEEE 0 EcuIntgdSwGend_CM_single_rpm 0.0 3000.0 /end CHARACTERISTIC
/begin CHARACTERISTIC EngBrk_NEngDeacThd_P "Engine Speed Deactivation Threshold Parameter" VALUE 0x40044F00 /* @ECU_Address@EngBrk_NEngDeacThd_P@ */ Scalar_FLOAT32_IEEE 0 EcuIntgdSwGend_CM_single_rpm 0.0 3000.0 /end CHARACTERISTIC
/begin CHARACTERISTIC EngBrk_PAirBoostMaxThd_P "Air Boost Pressure Maximum Threshold Parameter" VALUE 0x40044F54 /* @ECU_Address@EngBrk_PAirBoostMaxThd_P@ */ Scalar_FLOAT32_IEEE 0 EcuIntgdSwGend_CM_single_mbar 0.0 15000.0 /end CHARACTERISTIC
/begin CHARACTERISTIC EngBrk_PercgAccrThd_P "Percentage Accelerate Threshold Parameter" VALUE 0x40044F58 /* @ECU_Address@EngBrk_PercgAccrThd_P@ */ Scalar_FLOAT32_IEEE 0 EcuIntgdSwGend_CM_single__ 0.0 100.0 /end CHARACTERISTIC
/begin CHARACTERISTIC EngBrk_RefEngBrkTq_P "Reference Engine Brake Torque Parameter" VALUE 0x40044F5C /* @ECU_Address@EngBrk_RefEngBrkTq_P@ */ Scalar_FLOAT32_IEEE 0 EcuIntgdSwGend_CM_single_N_m 0.0 5000.0 /end CHARACTERISTIC
/begin CHARACTERISTIC EngBrk_VehVMinThd_P "Vehicle Velocity Minimum Threshold Prameter" VALUE 0x40044F68 /* @ECU_Address@EngBrk_VehVMinThd_P@ */ Scalar_FLOAT32_IEEE 0 EcuIntgdSwGend_CM_single_km 0.0 150.0 /end CHARACTERISTIC
/begin CHARACTERISTIC IC_CnvnHtoSec_P "" VALUE 0x40044F6C /* @ECU_Address@IC_CnvnHtoSec_P@ */ Scalar_FLOAT32_IEEE 0 EcuIntgdSwGend_CM_single 3600.0 3600.0 /end CHARACTERISTIC
/begin CHARACTERISTIC IC_CnvnInstFuCnsLtPerHourToSec_P "" VALUE 0x40044F70 /* @ECU_Address@IC_CnvnInstFuCnsLtPerHourToSec_P@ */ Scalar_FLOAT32_IEEE 0 EcuIntgdSwGend_CM_single 3600.0 3600.0 /end CHARACTERISTIC
/begin CHARACTERISTIC IC_CnvnMTotFuQntyCorrdToInstFuCnsLtPerHour_P "Conversion Factor of Instant Fuel Consumption Per Hour" VALUE 0x40044F74 /* @ECU_Address@IC_CnvnMTotFuQntyCorrdToInstFuCnsLtPerHour_P@ */ Scalar_FLOAT32_IEEE 0 EcuIntgdSwGend_CM_single 0.0 10000.0 /end CHARACTERISTIC
/begin CHARACTERISTIC IC_DstToEmptyOvv_P "Distance to Empty - Override Value Parameter" VALUE 0x40044F7C /* @ECU_Address@IC_DstToEmptyOvv_P@ */ Scalar_FLOAT32_IEEE 0 EcuIntgdSwGend_CM_single_km 0.0 100.0 /end CHARACTERISTIC
/begin CHARACTERISTIC IC_DurMaiCyl1BalOvv_P "Main Injection Duration Balance for Cylinder 1 - Override Value Parameter" VALUE 0x40044F84 /* @ECU_Address@IC_DurMaiCyl1BalOvv_P@ */ Scalar_FLOAT32_IEEE 0 EcuIntgdSwGend_CM_single_us 0.0 10000.0 /end CHARACTERISTIC
/begin CHARACTERISTIC IC_DurMaiCyl2BalOvv_P "Main Injection Duration Balance for Cylinder 2 - Override Value Parameter" VALUE 0x40044F90 /* @ECU_Address@IC_DurMaiCyl2BalOvv_P@ */ Scalar_FLOAT32_IEEE 0 EcuIntgdSwGend_CM_single_us 0.0 10000.0 /end CHARACTERISTIC
/begin CHARACTERISTIC IC_DurMaiCyl3BalOvv_P "Main Injection Duration Balance for Cylinder 3 - Override Value Parameter" VALUE 0x40044F9C /* @ECU_Address@IC_DurMaiCyl3BalOvv_P@ */ Scalar_FLOAT32_IEEE 0 EcuIntgdSwGend_CM_single_us 0.0 10000.0 /end CHARACTERISTIC
/begin CHARACTERISTIC IC_DurMaiCyl4BalOvv_P "Main Injection Duration Balance for Cylinder 4 - Override Value Parameter" VALUE 0x40044FA8 /* @ECU_Address@IC_DurMaiCyl4BalOvv_P@ */ Scalar_FLOAT32_IEEE 0 EcuIntgdSwGend_CM_single_us 0.0 10000.0 /end CHARACTERISTIC
/begin CHARACTERISTIC IC_DurMaiCyl5BalOvv_P "Main Injection Duration Balance for Cylinder 5 - Override Value Parameter" VALUE 0x40044FB4 /* @ECU_Address@IC_DurMaiCyl5BalOvv_P@ */ Scalar_FLOAT32_IEEE 0 EcuIntgdSwGend_CM_single_us 0.0 10000.0 /end CHARACTERISTIC
/begin CHARACTERISTIC IC_DurMaiCyl6BalOvv_P "Main Injection Duration Balance for Cylinder 6 - Override Value Parameter" VALUE 0x40044FC0 /* @ECU_Address@IC_DurMaiCyl6BalOvv_P@ */ Scalar_FLOAT32_IEEE 0 EcuIntgdSwGend_CM_single_us 0.0 10000.0 /end CHARACTERISTIC
/begin CHARACTERISTIC IC_DurMaiLimdHi_P "High Limited Main Injection Duration Parameter" VALUE 0x40044FC8 /* @ECU_Address@IC_DurMaiLimdHi_P@ */ Scalar_FLOAT32_IEEE 0 EcuIntgdSwGend_CM_single_us 0.0 5000.0 /end CHARACTERISTIC
/begin CHARACTERISTIC IC_DurMaiLimdLo_P "Low Limited Main Injection Duration Parameter" VALUE 0x40044FCC /* @ECU_Address@IC_DurMaiLimdLo_P@ */ Scalar_FLOAT32_IEEE 0 EcuIntgdSwGend_CM_single_us 0.0 1000.0 /end CHARACTERISTIC
/begin CHARACTERISTIC IC_DurPltInj1PreOvv_P "Pre Pilot Injection Duration for Cylinder 1 - Override Value Parameter" VALUE 0x40045014 /* @ECU_Address@IC_DurPltInj1PreOvv_P@ */ Scalar_FLOAT32_IEEE 0 EcuIntgdSwGend_CM_single_us 0.0 10000.0 /end CHARACTERISTIC
/begin CHARACTERISTIC IC_DurPltInj2PreOvv_P "Pre Pilot Injection Duration for Cylinder 2 - Override Value Parameter" VALUE 0x4004501C /* @ECU_Address@IC_DurPltInj2PreOvv_P@ */ Scalar_FLOAT32_IEEE 0 EcuIntgdSwGend_CM_single_us 0.0 10000.0 /end CHARACTERISTIC
/begin CHARACTERISTIC IC_DurPltInj3PreOvv_P "Pre Pilot Injection Duration for Cylinder 3 - Override Value Parameter" VALUE 0x40045024 /* @ECU_Address@IC_DurPltInj3PreOvv_P@ */ Scalar_FLOAT32_IEEE 0 EcuIntgdSwGend_CM_single_us 0.0 10000.0 /end CHARACTERISTIC
/begin CHARACTERISTIC IC_DurPltInj4PreOvv_P "Pre Pilot Injection Duration for Cylinder 4 - Override Value Parameter" VALUE 0x4004502C /* @ECU_Address@IC_DurPltInj4PreOvv_P@ */ Scalar_FLOAT32_IEEE 0 EcuIntgdSwGend_CM_single_us 0.0 10000.0 /end CHARACTERISTIC
/begin CHARACTERISTIC IC_DurPltInj5PreOvv_P "Pre Pilot Injection Duration for Cylinder 5 - Override Value Parameter" VALUE 0x40045034 /* @ECU_Address@IC_DurPltInj5PreOvv_P@ */ Scalar_FLOAT32_IEEE 0 EcuIntgdSwGend_CM_single_us 0.0 10000.0 /end CHARACTERISTIC
/begin CHARACTERISTIC IC_DurPltInj6PreOvv_P "Pre Pilot Injection Duration for Cylinder 6 - Override Value Parameter" VALUE 0x4004503C /* @ECU_Address@IC_DurPltInj6PreOvv_P@ */ Scalar_FLOAT32_IEEE 0 EcuIntgdSwGend_CM_single_us 0.0 10000.0 /end CHARACTERISTIC
/begin CHARACTERISTIC IC_DurPltLimdHi_P "High Limited Pilot Injection Duration Parameter" VALUE 0x40045040 /* @ECU_Address@IC_DurPltLimdHi_P@ */ Scalar_FLOAT32_IEEE 0 EcuIntgdSwGend_CM_single_us 0.0 5000.0 /end CHARACTERISTIC
/begin CHARACTERISTIC IC_DurPltLimdLo_P "Low Limited Pilot Injection Duration Parameter" VALUE 0x40045044 /* @ECU_Address@IC_DurPltLimdLo_P@ */ Scalar_FLOAT32_IEEE 0 EcuIntgdSwGend_CM_single_us 0.0 1000.0 /end CHARACTERISTIC
/begin CHARACTERISTIC IC_FuCnsAveOvv_P "Fuel Consumption Average Override Value Parameter" VALUE 0x400450BC /* @ECU_Address@IC_FuCnsAveOvv_P@ */ Scalar_FLOAT32_IEEE 0 EcuIntgdSwGend_CM_single_L_100km 0.0 1.0 /end CHARACTERISTIC
/begin CHARACTERISTIC IC_FuCnsOvv_P "Fuel Consumption - Override Value Parameter" VALUE 0x400450C4 /* @ECU_Address@IC_FuCnsOvv_P@ */ Scalar_FLOAT32_IEEE 0 EcuIntgdSwGend_CM_single_L_100km 0.0 1000.0 /end CHARACTERISTIC
/begin CHARACTERISTIC IC_IntglRst_P "" VALUE 0x40045C98 /* @ECU_Address@IC_IntglRst_P@ */ Scalar_FLOAT32_IEEE 0 EcuIntgdSwGend_CM_single 0.0 1.0 /end CHARACTERISTIC
/begin CHARACTERISTIC IC_MMaiFuQntyCorrdOvv_P "Corrected Main Fuel Quantity Mass - Override Value Parameter" VALUE 0x40045DC8 /* @ECU_Address@IC_MMaiFuQntyCorrdOvv_P@ */ Scalar_FLOAT32_IEEE 0 EcuIntgdSwGend_CM_single_mm_3_stk 0.0 5000.0 /end CHARACTERISTIC
/begin CHARACTERISTIC IC_MMaiLimdHi_P "High Limited Main Fuel Quantity Mass Parameter" VALUE 0x40045DCC /* @ECU_Address@IC_MMaiLimdHi_P@ */ Scalar_FLOAT32_IEEE 0 EcuIntgdSwGend_CM_single_mm_3_stk 0.0 1000.0 /end CHARACTERISTIC
/begin CHARACTERISTIC IC_MMaiLimdLo_P "Low Limited Main Fuel Quantity Mass Parameter" VALUE 0x40045DD0 /* @ECU_Address@IC_MMaiLimdLo_P@ */ Scalar_FLOAT32_IEEE 0 EcuIntgdSwGend_CM_single_mm_3_stk 0.0 1000.0 /end CHARACTERISTIC
/begin CHARACTERISTIC IC_MPltFuQntyCorrdOvv_P "Corrected Pilot Fuel Quantity Mass - Override Value Parameter" VALUE 0x40045DD8 /* @ECU_Address@IC_MPltFuQntyCorrdOvv_P@ */ Scalar_FLOAT32_IEEE 0 EcuIntgdSwGend_CM_single_mm_3_stk 0.0 5000.0 /end CHARACTERISTIC
/begin CHARACTERISTIC IC_MPltLimdHi_P "High Limited Pilot Fuel Quantity Mass Parameter" VALUE 0x40045DDC /* @ECU_Address@IC_MPltLimdHi_P@ */ Scalar_FLOAT32_IEEE 0 EcuIntgdSwGend_CM_single_mm_3_stk 0.0 1000.0 /end CHARACTERISTIC
/begin CHARACTERISTIC IC_MPltLimdLo_P "Low Limited Pilot Fuel Quantity Mass Parameter" VALUE 0x40045DE0 /* @ECU_Address@IC_MPltLimdLo_P@ */ Scalar_FLOAT32_IEEE 0 EcuIntgdSwGend_CM_single_mm_3_stk 0.0 1000.0 /end CHARACTERISTIC
/begin CHARACTERISTIC IC_NoInjCodeForInj1_P "Injection Code Number For Injector 1 Parameter" VALUE 0x40045F00 /* @ECU_Address@IC_NoInjCodeForInj1_P@ */ Scalar_FLOAT32_IEEE 0 EcuIntgdSwGend_CM_single 1.0 5.0 /end CHARACTERISTIC
/begin CHARACTERISTIC IC_NoInjCodeForInj2_P "Injection Code Number For Injector 2 Parameter" VALUE 0x40045F04 /* @ECU_Address@IC_NoInjCodeForInj2_P@ */ Scalar_FLOAT32_IEEE 0 EcuIntgdSwGend_CM_single 1.0 5.0 /end CHARACTERISTIC
/begin CHARACTERISTIC IC_NoInjCodeForInj3_P "Injection Code Number For Injector 3 Parameter" VALUE 0x40045F08 /* @ECU_Address@IC_NoInjCodeForInj3_P@ */ Scalar_FLOAT32_IEEE 0 EcuIntgdSwGend_CM_single 1.0 5.0 /end CHARACTERISTIC
/begin CHARACTERISTIC IC_NoInjCodeForInj4_P "Injection Code Number For Injector 4 Parameter" VALUE 0x40045F0C /* @ECU_Address@IC_NoInjCodeForInj4_P@ */ Scalar_FLOAT32_IEEE 0 EcuIntgdSwGend_CM_single 1.0 5.0 /end CHARACTERISTIC
/begin CHARACTERISTIC IC_NoInjCodeForInj5_P "Injection Code Number For Injector 5 Parameter" VALUE 0x40045F10 /* @ECU_Address@IC_NoInjCodeForInj5_P@ */ Scalar_FLOAT32_IEEE 0 EcuIntgdSwGend_CM_single 1.0 5.0 /end CHARACTERISTIC
/begin CHARACTERISTIC IC_NoInjCodeForInj6_P "Injection Code Number For Injector 6 Parameter" VALUE 0x40045F14 /* @ECU_Address@IC_NoInjCodeForInj6_P@ */ Scalar_FLOAT32_IEEE 0 EcuIntgdSwGend_CM_single 1.0 5.0 /end CHARACTERISTIC
/begin CHARACTERISTIC IC_PercgAccrForFuCns_P "" VALUE 0x40045FE4 /* @ECU_Address@IC_PercgAccrForFuCns_P@ */ Scalar_FLOAT32_IEEE 0 EcuIntgdSwGend_CM_single__ 0.0 100.0 /end CHARACTERISTIC
/begin CHARACTERISTIC IC_TcDstToEmptyFil_P "" VALUE 0x40048670 /* @ECU_Address@IC_TcDstToEmptyFil_P@ */ Scalar_FLOAT32_IEEE 0 EcuIntgdSwGend_CM_single_ms 0.0 50000.0 /end CHARACTERISTIC
/begin CHARACTERISTIC IC_TcFuCnsAveFil_P "" VALUE 0x40048674 /* @ECU_Address@IC_TcFuCnsAveFil_P@ */ Scalar_FLOAT32_IEEE 0 EcuIntgdSwGend_CM_single_ms 0.0 50000.0 /end CHARACTERISTIC
/begin CHARACTERISTIC IC_TcFuCnsFil_P "" VALUE 0x40048678 /* @ECU_Address@IC_TcFuCnsFil_P@ */ Scalar_FLOAT32_IEEE 0 EcuIntgdSwGend_CM_single_ms 0.0 50000.0 /end CHARACTERISTIC
/begin CHARACTERISTIC IC_VehVThdForFuCns_P "" VALUE 0x4004867C /* @ECU_Address@IC_VehVThdForFuCns_P@ */ Scalar_FLOAT32_IEEE 0 EcuIntgdSwGend_CM_single_km 0.0 200.0 /end CHARACTERISTIC
/begin CHARACTERISTIC PHC_GridHeatrRlyFbOffStsThd_P "Grid Heater Relay Feedback Off Status Threshold Parameter" VALUE 0x40048688 /* @ECU_Address@PHC_GridHeatrRlyFbOffStsThd_P@ */ Scalar_FLOAT32_IEEE 0 EcuIntgdSwGend_CM_single_V 0.0 50.0 /end CHARACTERISTIC
/begin CHARACTERISTIC PHC_GridHeatrRlyFbOnStsThd_P "Grid Heater Relay Feedback On Status Threshold Parameter" VALUE 0x4004868C /* @ECU_Address@PHC_GridHeatrRlyFbOnStsThd_P@ */ Scalar_FLOAT32_IEEE 0 EcuIntgdSwGend_CM_single_V 0.0 50.0 /end CHARACTERISTIC
/begin CHARACTERISTIC PHC_NEngPostAcvnGridHeatr_P "Engine Speed Threshold for Grid Heater After Starter Activation" VALUE 0x40048690 /* @ECU_Address@PHC_NEngPostAcvnGridHeatr_P@ */ Scalar_FLOAT32_IEEE 0 EcuIntgdSwGend_CM_single_rpm 0.0 4500.0 /end CHARACTERISTIC
/begin CHARACTERISTIC PHC_StUsrForTiPreHeatg_P "User State for Parameter of Timer PreHeating Before Starter" VALUE 0x400486B4 /* @ECU_Address@PHC_StUsrForTiPreHeatg_P@ */ Scalar_FLOAT32_IEEE 0 EcuIntgdSwGend_CM_single 0.0 2.0 /end CHARACTERISTIC
/begin CHARACTERISTIC PHC_TiAftrAcvnGridHeatrForSnsrErr_P "Default Timer Value of Grid Heater After Starter Activation for Sensor Error" VALUE 0x40048780 /* @ECU_Address@PHC_TiAftrAcvnGridHeatrForSnsrErr_P@ */ Scalar_FLOAT32_IEEE 0 EcuIntgdSwGend_CM_single_ms 0.0 100000.0 /end CHARACTERISTIC
/begin CHARACTERISTIC PHC_TiGridHeatErrOfStsDeb_P "Default Debounce Time Parameter of Error Grid Heater Off Status" VALUE 0x40048784 /* @ECU_Address@PHC_TiGridHeatErrOfStsDeb_P@ */ Scalar_FLOAT32_IEEE 0 EcuIntgdSwGend_CM_single_ms 0.0 100000.0 /end CHARACTERISTIC
/begin CHARACTERISTIC PHC_TiGridHeatErrOnStsDeb_P "Default Debounce Time Parameter of Error Grid Heater On Status" VALUE 0x40048788 /* @ECU_Address@PHC_TiGridHeatErrOnStsDeb_P@ */ Scalar_FLOAT32_IEEE 0 EcuIntgdSwGend_CM_single_ms 0.0 100000.0 /end CHARACTERISTIC
/begin CHARACTERISTIC PHC_TiPreAcvnGridHeatrForSnsrErr_P "Default Timer Value of Grid Heater Before Starter Activation for Sensor Error" VALUE 0x4004878C /* @ECU_Address@PHC_TiPreAcvnGridHeatrForSnsrErr_P@ */ Scalar_FLOAT32_IEEE 0 EcuIntgdSwGend_CM_single_ms 0.0 100000.0 /end CHARACTERISTIC
/begin CHARACTERISTIC PtoCtrl_FacSclPIDCoeff_P "Factor Scaling Parameter for PID" VALUE 0x40048EE0 /* @ECU_Address@PtoCtrl_FacSclPIDCoeff_P@ */ Scalar_FLOAT32_IEEE 0 EcuIntgdSwGend_CM_single 1.0 10000.0 /end CHARACTERISTIC
/begin CHARACTERISTIC PtoCtrl_LongPsdTiThd_P "PTO Long Pressed Timer Threshold" VALUE 0x40048EE4 /* @ECU_Address@PtoCtrl_LongPsdTiThd_P@ */ Scalar_FLOAT32_IEEE 0 EcuIntgdSwGend_CM_single_ms 0.0 50000.0 /end CHARACTERISTIC
/begin CHARACTERISTIC PtoCtrl_LowrNEngThdForCabPto_P "Engine Speed Lower Threshold for Cabin PTO Activation" VALUE 0x40048EE8 /* @ECU_Address@PtoCtrl_LowrNEngThdForCabPto_P@ */ Scalar_FLOAT32_IEEE 0 EcuIntgdSwGend_CM_single_rpm 0.0 2000.0 /end CHARACTERISTIC
/begin CHARACTERISTIC PtoCtrl_LowrNEngThdForRemPto_P "Engine Speed Lower Threshold for Remote PTO Activation" VALUE 0x40048EEC /* @ECU_Address@PtoCtrl_LowrNEngThdForRemPto_P@ */ Scalar_FLOAT32_IEEE 0 EcuIntgdSwGend_CM_single_rpm 0.0 2000.0 /end CHARACTERISTIC
/begin CHARACTERISTIC PtoCtrl_LowrVehVForCabPto_P "Vehicle Speed Lower Threshold for Cabin PTO Activation" VALUE 0x40048EF0 /* @ECU_Address@PtoCtrl_LowrVehVForCabPto_P@ */ Scalar_FLOAT32_IEEE 0 EcuIntgdSwGend_CM_single_km_h 0.0 50.0 /end CHARACTERISTIC
/begin CHARACTERISTIC PtoCtrl_LowrVehVForRemPto_P "Vehicle Speed Lower Threshold for Remote PTO Activation" VALUE 0x40048EF4 /* @ECU_Address@PtoCtrl_LowrVehVForRemPto_P@ */ Scalar_FLOAT32_IEEE 0 EcuIntgdSwGend_CM_single_km_h 0.0 50.0 /end CHARACTERISTIC
/begin CHARACTERISTIC PtoCtrl_NEngForCabPto_P "Engine Speed Parameter for Cabin PTO" VALUE 0x40048EF8 /* @ECU_Address@PtoCtrl_NEngForCabPto_P@ */ Scalar_FLOAT32_IEEE 0 EcuIntgdSwGend_CM_single_rpm 0.0 2000.0 /end CHARACTERISTIC
/begin CHARACTERISTIC PtoCtrl_NEngLongPsd_P "Engine Speed Long Time Parameter" VALUE 0x40048F24 /* @ECU_Address@PtoCtrl_NEngLongPsd_P@ */ Scalar_FLOAT32_IEEE 0 EcuIntgdSwGend_CM_single_rpm 0.0 2000.0 /end CHARACTERISTIC
/begin CHARACTERISTIC PtoCtrl_NEngMaxSpd_P "Maximum Engine Speed Parameter" VALUE 0x40048F28 /* @ECU_Address@PtoCtrl_NEngMaxSpd_P@ */ Scalar_FLOAT32_IEEE 0 EcuIntgdSwGend_CM_single_rpm 0.0 2000.0 /end CHARACTERISTIC
/begin CHARACTERISTIC PtoCtrl_NEngSetSpd1_P "Engine Set Speed 1 Parameter for Remote PTO" VALUE 0x40048F2C /* @ECU_Address@PtoCtrl_NEngSetSpd1_P@ */ Scalar_FLOAT32_IEEE 0 EcuIntgdSwGend_CM_single_rpm 0.0 2000.0 /end CHARACTERISTIC
/begin CHARACTERISTIC PtoCtrl_NEngSetSpd2_P "Engine Set Speed 2 Parameter for Remote PTO" VALUE 0x40048F30 /* @ECU_Address@PtoCtrl_NEngSetSpd2_P@ */ Scalar_FLOAT32_IEEE 0 EcuIntgdSwGend_CM_single_rpm 0.0 2000.0 /end CHARACTERISTIC
/begin CHARACTERISTIC PtoCtrl_NEngSetSpd3_P "Engine Set Speed 3 Parameter for Remote PTO" VALUE 0x40048F34 /* @ECU_Address@PtoCtrl_NEngSetSpd3_P@ */ Scalar_FLOAT32_IEEE 0 EcuIntgdSwGend_CM_single_rpm 0.0 2000.0 /end CHARACTERISTIC
/begin CHARACTERISTIC PtoCtrl_NEngSetSpd4_P "Engine Set Speed 4 Parameter for Remote PTO" VALUE 0x40048F38 /* @ECU_Address@PtoCtrl_NEngSetSpd4_P@ */ Scalar_FLOAT32_IEEE 0 EcuIntgdSwGend_CM_single_rpm 0.0 2000.0 /end CHARACTERISTIC
/begin CHARACTERISTIC PtoCtrl_NEngSetSpd5_P "Engine Set Speed 5 Parameter for Remote PTO" VALUE 0x40048F3C /* @ECU_Address@PtoCtrl_NEngSetSpd5_P@ */ Scalar_FLOAT32_IEEE 0 EcuIntgdSwGend_CM_single_rpm 0.0 2000.0 /end CHARACTERISTIC
/begin CHARACTERISTIC PtoCtrl_NEngShoPsd_P "Engine speed short press increase amount" VALUE 0x40048F40 /* @ECU_Address@PtoCtrl_NEngShoPsd_P@ */ Scalar_FLOAT32_IEEE 0 EcuIntgdSwGend_CM_single_rpm 0.0 2000.0 /end CHARACTERISTIC
/begin CHARACTERISTIC PtoCtrl_PIDCoeffDOvv_P "PID Derivative Coefficient for PTO Controller - Override Value" VALUE 0x40048F4C /* @ECU_Address@PtoCtrl_PIDCoeffDOvv_P@ */ Scalar_FLOAT32_IEEE 0 EcuIntgdSwGend_CM_single -10000.0 10000.0 /end CHARACTERISTIC
/begin CHARACTERISTIC PtoCtrl_PIDCoeffFiltOvv_P "PID Filter Coefficient for PTO Controller - Override Value" VALUE 0x40048F54 /* @ECU_Address@PtoCtrl_PIDCoeffFiltOvv_P@ */ Scalar_FLOAT32_IEEE 0 EcuIntgdSwGend_CM_single -10000.0 10000.0 /end CHARACTERISTIC
/begin CHARACTERISTIC PtoCtrl_PIDCoeffIOvv_P "PID Integrator Coefficient for PTO Controller - Override Value" VALUE 0x40048F5C /* @ECU_Address@PtoCtrl_PIDCoeffIOvv_P@ */ Scalar_FLOAT32_IEEE 0 EcuIntgdSwGend_CM_single -10000.0 10000.0 /end CHARACTERISTIC
/begin CHARACTERISTIC PtoCtrl_PIDCoeffPOvv_P "PID Proportional Coefficient for PTO Controller - Override Value" VALUE 0x40048F64 /* @ECU_Address@PtoCtrl_PIDCoeffPOvv_P@ */ Scalar_FLOAT32_IEEE 0 EcuIntgdSwGend_CM_single -10000.0 10000.0 /end CHARACTERISTIC
/begin CHARACTERISTIC PtoCtrl_PIDMaxForCabPto_P "PID Max Value For Cabin PTO" VALUE 0x40048F68 /* @ECU_Address@PtoCtrl_PIDMaxForCabPto_P@ */ Scalar_FLOAT32_IEEE 0 EcuIntgdSwGend_CM_single_N_m -10000.0 10000.0 /end CHARACTERISTIC
/begin CHARACTERISTIC PtoCtrl_PIDMaxForRemPto_P "PID Max Value For Remote PTO" VALUE 0x40048F6C /* @ECU_Address@PtoCtrl_PIDMaxForRemPto_P@ */ Scalar_FLOAT32_IEEE 0 EcuIntgdSwGend_CM_single_N_m -10000.0 10000.0 /end CHARACTERISTIC
/begin CHARACTERISTIC PtoCtrl_PIDMinForCabPto_P "PID Min Value for Cabin PTO" VALUE 0x40048F70 /* @ECU_Address@PtoCtrl_PIDMinForCabPto_P@ */ Scalar_FLOAT32_IEEE 0 EcuIntgdSwGend_CM_single_N_m -10000.0 10000.0 /end CHARACTERISTIC
/begin CHARACTERISTIC PtoCtrl_PIDMinForRemPto_P "PID Min Value for Remote PTO" VALUE 0x40048F74 /* @ECU_Address@PtoCtrl_PIDMinForRemPto_P@ */ Scalar_FLOAT32_IEEE 0 EcuIntgdSwGend_CM_single_N_m -10000.0 10000.0 /end CHARACTERISTIC
/begin CHARACTERISTIC PtoCtrl_ShoPsdTiThd_P "PTO Short Pressed Timer Threshold Value" VALUE 0x40049108 /* @ECU_Address@PtoCtrl_ShoPsdTiThd_P@ */ Scalar_FLOAT32_IEEE 0 EcuIntgdSwGend_CM_single_ms 0.0 50000.0 /end CHARACTERISTIC
/begin CHARACTERISTIC PtoCtrl_UpprNEngThdForCabPto_P "Engine Speed Upper Threshold for Cabin PTO" VALUE 0x40049168 /* @ECU_Address@PtoCtrl_UpprNEngThdForCabPto_P@ */ Scalar_FLOAT32_IEEE 0 EcuIntgdSwGend_CM_single_rpm 0.0 2500.0 /end CHARACTERISTIC
/begin CHARACTERISTIC PtoCtrl_UpprNEngThdForRemPto_P "Engine Speed Upper Threshold for Remote PTO" VALUE 0x4004916C /* @ECU_Address@PtoCtrl_UpprNEngThdForRemPto_P@ */ Scalar_FLOAT32_IEEE 0 EcuIntgdSwGend_CM_single_rpm 0.0 2500.0 /end CHARACTERISTIC
/begin CHARACTERISTIC PtoCtrl_UpprVehVForCabPto_P "Vehicle Speed Upper Threshold for Cabin PTO" VALUE 0x40049170 /* @ECU_Address@PtoCtrl_UpprVehVForCabPto_P@ */ Scalar_FLOAT32_IEEE 0 EcuIntgdSwGend_CM_single_km_h 0.0 50.0 /end CHARACTERISTIC
/begin CHARACTERISTIC PtoCtrl_UpprVehVForRemPto_P "Vehicle Speed Upper Threshold for Remote PTO" VALUE 0x40049174 /* @ECU_Address@PtoCtrl_UpprVehVForRemPto_P@ */ Scalar_FLOAT32_IEEE 0 EcuIntgdSwGend_CM_single_km_h 0.0 50.0 /end CHARACTERISTIC
/begin CHARACTERISTIC RPG_FFLeakgSetPointOvv_P "FeedForward Leakage Set Point Override Value Parameter" VALUE 0x40049814 /* @ECU_Address@RPG_FFLeakgSetPointOvv_P@ */ Scalar_FLOAT32_IEEE 0 EcuIntgdSwGend_CM_single__ 0.0 5000.0 /end CHARACTERISTIC
/begin CHARACTERISTIC RPG_FacSclPIDCoeff_P "Rail Pressure Controller PID Coefficients Scaling Factor Parameter" VALUE 0x40049818 /* @ECU_Address@RPG_FacSclPIDCoeff_P@ */ Scalar_FLOAT32_IEEE 0 EcuIntgdSwGend_CM_single 1000.0 1000.0 /end CHARACTERISTIC
/begin CHARACTERISTIC RPG_NEngThdAcvnPRailCorr_P "Engine Speed Threshold for Rail Pressure Correction Activation Parameter" VALUE 0x40049968 /* @ECU_Address@RPG_NEngThdAcvnPRailCorr_P@ */ Scalar_FLOAT32_IEEE 0 EcuIntgdSwGend_CM_single_rpm 0.0 3200.0 /end CHARACTERISTIC
/begin CHARACTERISTIC RPG_OfsPRailRefForPCV_P "Rail Pressure Reference Offset for Pressure Control Valve 1 Parameter" VALUE 0x4004996C /* @ECU_Address@RPG_OfsPRailRefForPCV_P@ */ Scalar_FLOAT32_IEEE 0 EcuIntgdSwGend_CM_single_bar 0.0 2500.0 /end CHARACTERISTIC
/begin CHARACTERISTIC RPG_PIDCoeffDOvv_P "Low Limited Rail Pressure Threshold Parameter" VALUE 0x4004999C /* @ECU_Address@RPG_PIDCoeffDOvv_P@ */ Scalar_FLOAT32_IEEE 0 EcuIntgdSwGend_CM_single -100.0 100.0 /end CHARACTERISTIC
/begin CHARACTERISTIC RPG_PIDCoeffFiltOvv_P "Rail Pressure Controller D Filter Coefficient - Override Value Parameter" VALUE 0x400499A4 /* @ECU_Address@RPG_PIDCoeffFiltOvv_P@ */ Scalar_FLOAT32_IEEE 0 EcuIntgdSwGend_CM_single -100.0 100.0 /end CHARACTERISTIC
/begin CHARACTERISTIC RPG_PIDCoeffIOvv_P "Rail Pressure Controller I Coefficient - Override Value Parameter" VALUE 0x400499AC /* @ECU_Address@RPG_PIDCoeffIOvv_P@ */ Scalar_FLOAT32_IEEE 0 EcuIntgdSwGend_CM_single -100.0 100.0 /end CHARACTERISTIC
/begin CHARACTERISTIC RPG_PIDCoeffPOvv_P "Rail Pressure Controller P Coefficient - Override Value Parameter" VALUE 0x400499B4 /* @ECU_Address@RPG_PIDCoeffPOvv_P@ */ Scalar_FLOAT32_IEEE 0 EcuIntgdSwGend_CM_single -100.0 100.0 /end CHARACTERISTIC
/begin CHARACTERISTIC RPG_PIDMax_P "Rail Pressure Controller Maximum Saturation Percentage Parameter" VALUE 0x400499B8 /* @ECU_Address@RPG_PIDMax_P@ */ Scalar_FLOAT32_IEEE 0 EcuIntgdSwGend_CM_single__ -1000.0 1000.0 /end CHARACTERISTIC
/begin CHARACTERISTIC RPG_PIDMin_P "Rail Pressure Controller Minimum Saturation Percentage Parameter" VALUE 0x400499BC /* @ECU_Address@RPG_PIDMin_P@ */ Scalar_FLOAT32_IEEE 0 EcuIntgdSwGend_CM_single__ -1000.0 1000.0 /end CHARACTERISTIC
/begin CHARACTERISTIC RPG_PRailLimdHi_P "High Limit Rail Pressure Threshold Parameter" VALUE 0x40049B50 /* @ECU_Address@RPG_PRailLimdHi_P@ */ Scalar_FLOAT32_IEEE 0 EcuIntgdSwGend_CM_single_bar 0.0 5000.0 /end CHARACTERISTIC
/begin CHARACTERISTIC RPG_PRailLimdLo_P "Low Limited Rail Pressure Threshold Parameter" VALUE 0x40049B54 /* @ECU_Address@RPG_PRailLimdLo_P@ */ Scalar_FLOAT32_IEEE 0 EcuIntgdSwGend_CM_single_bar 0.0 2500.0 /end CHARACTERISTIC
/begin CHARACTERISTIC RPG_PRailRefForPCVOvv_P "Reference Rail Pressure for Pressure Control Valve 1 - Override Value Parameter" VALUE 0x40049B5C /* @ECU_Address@RPG_PRailRefForPCVOvv_P@ */ Scalar_FLOAT32_IEEE 0 EcuIntgdSwGend_CM_single_bar 0.0 2500.0 /end CHARACTERISTIC
/begin CHARACTERISTIC RPG_PRailRefForPCVPwrOnCtlMod_P "Reference Rail Pressure for Pressure Control Valve 1 for Power On Control Mode Parameter" VALUE 0x40049B60 /* @ECU_Address@RPG_PRailRefForPCVPwrOnCtlMod_P@ */ Scalar_FLOAT32_IEEE 0 EcuIntgdSwGend_CM_single_bar 0.0 2500.0 /end CHARACTERISTIC
/begin CHARACTERISTIC RPG_PRailRefForPCVStpCtlMod_P "Reference Rail Pressure for Pressure Control Valve 1 for Stop Control Mode Parameter" VALUE 0x40049B64 /* @ECU_Address@RPG_PRailRefForPCVStpCtlMod_P@ */ Scalar_FLOAT32_IEEE 0 EcuIntgdSwGend_CM_single_bar 0.0 2500.0 /end CHARACTERISTIC
/begin CHARACTERISTIC RPG_PercgLowrLim_P "Fuel Metering Unit Valve Lower Limit Percentage Parameter" VALUE 0x4004A608 /* @ECU_Address@RPG_PercgLowrLim_P@ */ Scalar_FLOAT32_IEEE 0 EcuIntgdSwGend_CM_single__ 0.0 100.0 /end CHARACTERISTIC
/begin CHARACTERISTIC RPG_PercgUpprLim_P "Fuel Metering Unit Valve Upper Limit Percentage Parameter" VALUE 0x4004A60C /* @ECU_Address@RPG_PercgUpprLim_P@ */ Scalar_FLOAT32_IEEE 0 EcuIntgdSwGend_CM_single__ 0.0 100.0 /end CHARACTERISTIC
/begin CHARACTERISTIC RPG_PercgVCVPwrOnCtlMod_P "FMU Valve Percentage for Power On Control Mode Parameter" VALUE 0x4004A610 /* @ECU_Address@RPG_PercgVCVPwrOnCtlMod_P@ */ Scalar_FLOAT32_IEEE 0 EcuIntgdSwGend_CM_single__ 0.0 100.0 /end CHARACTERISTIC
/begin CHARACTERISTIC RPG_PercgVCVReqOvv_P "FMU Valve 1 Percentage Request - Override Value Parameter" VALUE 0x4004A618 /* @ECU_Address@RPG_PercgVCVReqOvv_P@ */ Scalar_FLOAT32_IEEE 0 EcuIntgdSwGend_CM_single__ 0.0 100.0 /end CHARACTERISTIC
/begin CHARACTERISTIC RPG_PercgVCVStpCtlMod_P "FMU Valve Percentage for Stop Control Mode Parameter" VALUE 0x4004A61C /* @ECU_Address@RPG_PercgVCVStpCtlMod_P@ */ Scalar_FLOAT32_IEEE 0 EcuIntgdSwGend_CM_single__ 0.0 100.0 /end CHARACTERISTIC
/begin CHARACTERISTIC RPG_TCooltFFLeakgMap1Thd_P "Coolant Temperature Threshold Parameter for FeedForward Leakage Map1" VALUE 0x4004B0AC /* @ECU_Address@RPG_TCooltFFLeakgMap1Thd_P@ */ Scalar_FLOAT32_IEEE 0 EcuIntgdSwGend_CM_single_degC -40.0 250.0 /end CHARACTERISTIC
/begin CHARACTERISTIC RPG_TCooltFFLeakgMap2Thd_P "Coolant Temperature Threshold Parameter for FeedForward Leakage Map2" VALUE 0x4004B0B0 /* @ECU_Address@RPG_TCooltFFLeakgMap2Thd_P@ */ Scalar_FLOAT32_IEEE 0 EcuIntgdSwGend_CM_single_degC -40.0 250.0 /end CHARACTERISTIC
/begin CHARACTERISTIC RPG_TCooltFFLeakgMap3Thd_P "Coolant Temperature Threshold Parameter for FeedForward Leakage Map3" VALUE 0x4004B0B4 /* @ECU_Address@RPG_TCooltFFLeakgMap3Thd_P@ */ Scalar_FLOAT32_IEEE 0 EcuIntgdSwGend_CM_single_degC -40.0 250.0 /end CHARACTERISTIC
/begin CHARACTERISTIC RPG_TiDebAcvnPRailCorr_P "Debouncer Timer Value for Rail Pressure Correction Activation Parameter" VALUE 0x4004B114 /* @ECU_Address@RPG_TiDebAcvnPRailCorr_P@ */ Scalar_FLOAT32_IEEE 0 EcuIntgdSwGend_CM_single_ms 0.0 50000.0 /end CHARACTERISTIC
/begin CHARACTERISTIC SC_NEngAcvStrtLock_P "Starter Locking Engine Speed Threshold Parameter" VALUE 0x4004B23C /* @ECU_Address@SC_NEngAcvStrtLock_P@ */ Scalar_FLOAT32_IEEE 0 EcuIntgdSwGend_CM_single_rpm 0.0 3200.0 /end CHARACTERISTIC
/begin CHARACTERISTIC SC_NEngRunDeacThd_P "Deactivation Running Engine Speed Threshold Value Parameter" VALUE 0x4004B240 /* @ECU_Address@SC_NEngRunDeacThd_P@ */ Scalar_FLOAT32_IEEE 0 EcuIntgdSwGend_CM_single_rpm 0.0 3200.0 /end CHARACTERISTIC
/begin CHARACTERISTIC SC_NEngStrtrInhThd_P "Start Inhibition Engine Speed Threshold Value Parameter" VALUE 0x4004B244 /* @ECU_Address@SC_NEngStrtrInhThd_P@ */ Scalar_FLOAT32_IEEE 0 EcuIntgdSwGend_CM_single_rpm 0.0 3200.0 /end CHARACTERISTIC
/begin CHARACTERISTIC SC_TiDebEngAlrdyRunngThd_P "Engine Running Activation Debouncer for Engine Already Running" VALUE 0x4004B278 /* @ECU_Address@SC_TiDebEngAlrdyRunngThd_P@ */ Scalar_FLOAT32_IEEE 0 EcuIntgdSwGend_CM_single_ms 0.0 100000.0 /end CHARACTERISTIC
/begin CHARACTERISTIC SC_TiDebNEngAcvStrtLock_P "Debouncer Timer Value for Engine Speed Threshold to Active Starter Locking Parameter" VALUE 0x4004B27C /* @ECU_Address@SC_TiDebNEngAcvStrtLock_P@ */ Scalar_FLOAT32_IEEE 0 EcuIntgdSwGend_CM_single_ms 0.0 50000.0 /end CHARACTERISTIC
/begin CHARACTERISTIC SC_TiDebNEngRunAcvn_P "Debouncer Timer Value for Activation Running Engine Speed Parameter" VALUE 0x4004B280 /* @ECU_Address@SC_TiDebNEngRunAcvn_P@ */ Scalar_FLOAT32_IEEE 0 EcuIntgdSwGend_CM_single_ms 0.0 50000.0 /end CHARACTERISTIC
/begin CHARACTERISTIC SC_TiDebNEngRunDeac_P "Debouncer Timer Value for Deactivation Running Engine Speed Parameter" VALUE 0x4004B284 /* @ECU_Address@SC_TiDebNEngRunDeac_P@ */ Scalar_FLOAT32_IEEE 0 EcuIntgdSwGend_CM_single_ms 0.0 50000.0 /end CHARACTERISTIC
/begin CHARACTERISTIC SC_TiMaxAllwblCrnkgOvv_P "Maximum Allowable Cranking Time Calculation Map - Override Value Parameter" VALUE 0x4004B294 /* @ECU_Address@SC_TiMaxAllwblCrnkgOvv_P@ */ Scalar_FLOAT32_IEEE 0 EcuIntgdSwGend_CM_single_ms 0.0 100000.0 /end CHARACTERISTIC
/begin CHARACTERISTIC SpdLimr_LongPsdTiThd_P "Long Pressed Time Threahold Parameter" VALUE 0x4004B49C /* @ECU_Address@SpdLimr_LongPsdTiThd_P@ */ Scalar_FLOAT32_IEEE 0 EcuIntgdSwGend_CM_single_ms 0.0 10000.0 /end CHARACTERISTIC
/begin CHARACTERISTIC SpdLimr_MaxTarSpd_P "Maximum Target Speed Parameter" VALUE 0x4004B4A0 /* @ECU_Address@SpdLimr_MaxTarSpd_P@ */ Scalar_FLOAT32_IEEE 0 EcuIntgdSwGend_CM_single_km_h 0.0 300.0 /end CHARACTERISTIC
/begin CHARACTERISTIC SpdLimr_MaxVehSpdHys_P "Max Vehicle Speed Deactivation Hysteresis" VALUE 0x4004B4A4 /* @ECU_Address@SpdLimr_MaxVehSpdHys_P@ */ Scalar_FLOAT32_IEEE 0 EcuIntgdSwGend_CM_single_km_h 0.0 300.0 /end CHARACTERISTIC
/begin CHARACTERISTIC SpdLimr_MaxVehSpd_P "Max Vehicle Speed" VALUE 0x4004B4A8 /* @ECU_Address@SpdLimr_MaxVehSpd_P@ */ Scalar_FLOAT32_IEEE 0 EcuIntgdSwGend_CM_single_km_h 0.0 300.0 /end CHARACTERISTIC
/begin CHARACTERISTIC SpdLimr_MinTarSpd_P "Minimum Target Speed Parameter" VALUE 0x4004B4AC /* @ECU_Address@SpdLimr_MinTarSpd_P@ */ Scalar_FLOAT32_IEEE 0 EcuIntgdSwGend_CM_single_km_h 0.0 300.0 /end CHARACTERISTIC
/begin CHARACTERISTIC SpdLimr_ShoPsdTiThd_P "Short Pressed Time Threshold Parameter" VALUE 0x4004B57C /* @ECU_Address@SpdLimr_ShoPsdTiThd_P@ */ Scalar_FLOAT32_IEEE 0 EcuIntgdSwGend_CM_single_ms 0.0 10000.0 /end CHARACTERISTIC
/begin CHARACTERISTIC SpdLimr_SpdLimrTq_P "Speed Limiter Torque Parameter" VALUE 0x4004B580 /* @ECU_Address@SpdLimr_SpdLimrTq_P@ */ Scalar_FLOAT32_IEEE 0 EcuIntgdSwGend_CM_single_N_m -1000.0 10000.0 /end CHARACTERISTIC
/begin CHARACTERISTIC SpdLimr_VehVLongPsd_P "Speed Limiter Long Pressed Vehicle Speed Parameter" VALUE 0x4004B60C /* @ECU_Address@SpdLimr_VehVLongPsd_P@ */ Scalar_FLOAT32_IEEE 0 EcuIntgdSwGend_CM_single_km_h 0.0 300.0 /end CHARACTERISTIC
/begin CHARACTERISTIC SpdLimr_VehVShoPsd_P "Speed Limiter Short Pressed Vehicle Speed Parameter" VALUE 0x4004B610 /* @ECU_Address@SpdLimr_VehVShoPsd_P@ */ Scalar_FLOAT32_IEEE 0 EcuIntgdSwGend_CM_single_km_h 0.0 300.0 /end CHARACTERISTIC
/begin CHARACTERISTIC EMS_DynoModOvs_P "Starter Dyno Mode Override Switch" VALUE 0x40044960 /* @ECU_Address@EMS_DynoModOvs_P@ */ Scalar_BOOLEAN 0 EcuIntgdSwGend_CM_boolean 0.0 1.0 /end CHARACTERISTIC
/begin CHARACTERISTIC EMS_DynoModOvv_P "Starter Dyno Mode Override Value" VALUE 0x40044964 /* @ECU_Address@EMS_DynoModOvv_P@ */ Scalar_BOOLEAN 0 EcuIntgdSwGend_CM_boolean 0.0 1.0 /end CHARACTERISTIC
/begin CHARACTERISTIC EOP_ActvEngBrkSoln1Ovs_P "" VALUE 0x400449D4 /* @ECU_Address@EOP_ActvEngBrkSoln1Ovs_P@ */ Scalar_BOOLEAN 0 EcuIntgdSwGend_CM_boolean 0.0 1.0 /end CHARACTERISTIC
/begin CHARACTERISTIC EOP_ActvEngBrkSoln1Ovv_P "" VALUE 0x400449D8 /* @ECU_Address@EOP_ActvEngBrkSoln1Ovv_P@ */ Scalar_BOOLEAN 0 EcuIntgdSwGend_CM_boolean 0.0 1.0 /end CHARACTERISTIC
/begin CHARACTERISTIC EOP_ActvEngBrkSoln2Ovs_P "" VALUE 0x400449DC /* @ECU_Address@EOP_ActvEngBrkSoln2Ovs_P@ */ Scalar_BOOLEAN 0 EcuIntgdSwGend_CM_boolean 0.0 1.0 /end CHARACTERISTIC
/begin CHARACTERISTIC EOP_ActvEngBrkSoln2Ovv_P "" VALUE 0x400449E0 /* @ECU_Address@EOP_ActvEngBrkSoln2Ovv_P@ */ Scalar_BOOLEAN 0 EcuIntgdSwGend_CM_boolean 0.0 1.0 /end CHARACTERISTIC
/begin CHARACTERISTIC EOP_AmberWarnLampOvs_P "Amber Warning Lamp (AWL) Override Switch Parameter" VALUE 0x400449E4 /* @ECU_Address@EOP_AmberWarnLampOvs_P@ */ Scalar_BOOLEAN 0 EcuIntgdSwGend_CM_boolean 0.0 1.0 /end CHARACTERISTIC
/begin CHARACTERISTIC EOP_AmberWarnLampOvv_P "Amber Warning Lamp (AWL) Override Value Parameter" VALUE 0x400449E8 /* @ECU_Address@EOP_AmberWarnLampOvv_P@ */ Scalar_BOOLEAN 0 EcuIntgdSwGend_CM_boolean 0.0 1.0 /end CHARACTERISTIC
/begin CHARACTERISTIC EOP_ColdStrtLampOvs_P "Check System Lamp (CSL) Override Switch Parameter" VALUE 0x40044C3C /* @ECU_Address@EOP_ColdStrtLampOvs_P@ */ Scalar_BOOLEAN 0 EcuIntgdSwGend_CM_boolean 0.0 1.0 /end CHARACTERISTIC
/begin CHARACTERISTIC EOP_ColdStrtLampOvv_P "Check System Lamp (CSL) Override Value Parameter" VALUE 0x40044C40 /* @ECU_Address@EOP_ColdStrtLampOvv_P@ */ Scalar_BOOLEAN 0 EcuIntgdSwGend_CM_boolean 0.0 1.0 /end CHARACTERISTIC
/begin CHARACTERISTIC EOP_DstTrvldInKmOvs_P "Output Processing Distance Travel In Kilometer Override Switch Parameter" VALUE 0x40044C58 /* @ECU_Address@EOP_DstTrvldInKmOvs_P@ */ Scalar_BOOLEAN 0 EcuIntgdSwGend_CM_boolean 0.0 1.0 /end CHARACTERISTIC
/begin CHARACTERISTIC EOP_DurMaiInj1Ovs_P "Output Processing Main Injection Duration for Cylinder 1 Override Switch Parameter" VALUE 0x40044C60 /* @ECU_Address@EOP_DurMaiInj1Ovs_P@ */ Scalar_BOOLEAN 0 EcuIntgdSwGend_CM_boolean 0.0 1.0 /end CHARACTERISTIC
/begin CHARACTERISTIC EOP_DurMaiInj2Ovs_P "Output Processing Main Injection Duration for Cylinder 2 Override Switch Parameter" VALUE 0x40044C68 /* @ECU_Address@EOP_DurMaiInj2Ovs_P@ */ Scalar_BOOLEAN 0 EcuIntgdSwGend_CM_boolean 0.0 1.0 /end CHARACTERISTIC
/begin CHARACTERISTIC EOP_DurMaiInj3Ovs_P "Output Processing Main Injection Duration for Cylinder 3 Override Switch Parameter" VALUE 0x40044C70 /* @ECU_Address@EOP_DurMaiInj3Ovs_P@ */ Scalar_BOOLEAN 0 EcuIntgdSwGend_CM_boolean 0.0 1.0 /end CHARACTERISTIC
/begin CHARACTERISTIC EOP_DurMaiInj4Ovs_P "Output Processing Main Injection Duration for Cylinder 4 Override Switch Parameter" VALUE 0x40044C78 /* @ECU_Address@EOP_DurMaiInj4Ovs_P@ */ Scalar_BOOLEAN 0 EcuIntgdSwGend_CM_boolean 0.0 1.0 /end CHARACTERISTIC
/begin CHARACTERISTIC EOP_DurMaiInj5Ovs_P "Output Processing Main Injection Duration for Cylinder 5 Override Switch Parameter" VALUE 0x40044C80 /* @ECU_Address@EOP_DurMaiInj5Ovs_P@ */ Scalar_BOOLEAN 0 EcuIntgdSwGend_CM_boolean 0.0 1.0 /end CHARACTERISTIC
/begin CHARACTERISTIC EOP_DurMaiInj6Ovs_P "Output Processing Main Injection Duration for Cylinder 6 Override Switch Parameter" VALUE 0x40044C88 /* @ECU_Address@EOP_DurMaiInj6Ovs_P@ */ Scalar_BOOLEAN 0 EcuIntgdSwGend_CM_boolean 0.0 1.0 /end CHARACTERISTIC
/begin CHARACTERISTIC EOP_DurPltInj1Ovs_P "Output Processing Pre Pilot Injection Duration for Cylinder 1 Override Switch Parameter" VALUE 0x40044C90 /* @ECU_Address@EOP_DurPltInj1Ovs_P@ */ Scalar_BOOLEAN 0 EcuIntgdSwGend_CM_boolean 0.0 1.0 /end CHARACTERISTIC
/begin CHARACTERISTIC EOP_DurPltInj2Ovs_P "Output Processing Pre Pilot Injection Duration for Cylinder 2 Override Switch Parameter" VALUE 0x40044C98 /* @ECU_Address@EOP_DurPltInj2Ovs_P@ */ Scalar_BOOLEAN 0 EcuIntgdSwGend_CM_boolean 0.0 1.0 /end CHARACTERISTIC
/begin CHARACTERISTIC EOP_DurPltInj3Ovs_P "Output Processing Pre Pilot Injection Duration for Cylinder 3 Override Switch Parameter" VALUE 0x40044CA0 /* @ECU_Address@EOP_DurPltInj3Ovs_P@ */ Scalar_BOOLEAN 0 EcuIntgdSwGend_CM_boolean 0.0 1.0 /end CHARACTERISTIC
/begin CHARACTERISTIC EOP_DurPltInj4Ovs_P "Output Processing Pre Pilot Injection Duration for Cylinder 4 Override Switch Parameter" VALUE 0x40044CA8 /* @ECU_Address@EOP_DurPltInj4Ovs_P@ */ Scalar_BOOLEAN 0 EcuIntgdSwGend_CM_boolean 0.0 1.0 /end CHARACTERISTIC
/begin CHARACTERISTIC EOP_DurPltInj5Ovs_P "Output Processing Pre Pilot Injection Duration for Cylinder 5 Override Switch Parameter" VALUE 0x40044CB0 /* @ECU_Address@EOP_DurPltInj5Ovs_P@ */ Scalar_BOOLEAN 0 EcuIntgdSwGend_CM_boolean 0.0 1.0 /end CHARACTERISTIC
/begin CHARACTERISTIC EOP_DurPltInj6Ovs_P "Output Processing Pre Pilot Injection Duration for Cylinder 6 Override Switch Parameter" VALUE 0x40044CB8 /* @ECU_Address@EOP_DurPltInj6Ovs_P@ */ Scalar_BOOLEAN 0 EcuIntgdSwGend_CM_boolean 0.0 1.0 /end CHARACTERISTIC
/begin CHARACTERISTIC EOP_DutyVlvReqOvs_P "Output Processing Duty Valve Request Override Switch Parameter" VALUE 0x40044CC0 /* @ECU_Address@EOP_DutyVlvReqOvs_P@ */ Scalar_BOOLEAN 0 EcuIntgdSwGend_CM_boolean 0.0 1.0 /end CHARACTERISTIC
/begin CHARACTERISTIC EOP_DynRateVCVActvnSwt_P "Output Processing Dynamic Rate Limiter Activation Parameter for Volumetric Control Valve" VALUE 0x40044CC8 /* @ECU_Address@EOP_DynRateVCVActvnSwt_P@ */ Scalar_BOOLEAN 0 EcuIntgdSwGend_CM_boolean 0.0 1.0 /end CHARACTERISTIC
/begin CHARACTERISTIC EOP_EngDftTqLimOvs_P "Engine Default Torque Limit For Memory - Override Switch" VALUE 0x40044CD4 /* @ECU_Address@EOP_EngDftTqLimOvs_P@ */ Scalar_BOOLEAN 0 EcuIntgdSwGend_CM_boolean 0.0 1.0 /end CHARACTERISTIC
/begin CHARACTERISTIC EOP_EngHrOvs_P "Output Processing Engine Hour Override Switch Parameter" VALUE 0x40044CDC /* @ECU_Address@EOP_EngHrOvs_P@ */ Scalar_BOOLEAN 0 EcuIntgdSwGend_CM_boolean 0.0 1.0 /end CHARACTERISTIC
/begin CHARACTERISTIC EOP_FuCnsOvs_P "Output Processing Fuel Consumption Override Switch Parameter" VALUE 0x40044CF0 /* @ECU_Address@EOP_FuCnsOvs_P@ */ Scalar_BOOLEAN 0 EcuIntgdSwGend_CM_boolean 0.0 1.0 /end CHARACTERISTIC
/begin CHARACTERISTIC EOP_IRefPCVOvs_P "Output Processing Current Reference for Pressure Control Valve Override Switch Parameter" VALUE 0x40044CFC /* @ECU_Address@EOP_IRefPCVOvs_P@ */ Scalar_BOOLEAN 0 EcuIntgdSwGend_CM_boolean 0.0 1.0 /end CHARACTERISTIC
/begin CHARACTERISTIC EOP_IVCVReqOvs_P "Output Processing Volumetric Control Valve Current Request Override Switch Parameter" VALUE 0x40044D54 /* @ECU_Address@EOP_IVCVReqOvs_P@ */ Scalar_BOOLEAN 0 EcuIntgdSwGend_CM_boolean 0.0 1.0 /end CHARACTERISTIC
/begin CHARACTERISTIC EOP_RedStopLampOvs_P "Red Stop Lamp (RSL) Override Switch Parameter" VALUE 0x40044DAC /* @ECU_Address@EOP_RedStopLampOvs_P@ */ Scalar_BOOLEAN 0 EcuIntgdSwGend_CM_boolean 0.0 1.0 /end CHARACTERISTIC
/begin CHARACTERISTIC EOP_RedStopLampOvv_P "Red Stop Lamp (RSL) Override Value Parameter" VALUE 0x40044DB0 /* @ECU_Address@EOP_RedStopLampOvv_P@ */ Scalar_BOOLEAN 0 EcuIntgdSwGend_CM_boolean 0.0 1.0 /end CHARACTERISTIC
/begin CHARACTERISTIC EOP_SoiMaiInj1Ovs_P "Output Processing Start of Main Injection 1 Override Switch Parameter" VALUE 0x40044DB4 /* @ECU_Address@EOP_SoiMaiInj1Ovs_P@ */ Scalar_BOOLEAN 0 EcuIntgdSwGend_CM_boolean 0.0 1.0 /end CHARACTERISTIC
/begin CHARACTERISTIC EOP_SoiMaiInj2Ovs_P "Output Processing Start of Main Injection 2 Override Switch Parameter" VALUE 0x40044DBC /* @ECU_Address@EOP_SoiMaiInj2Ovs_P@ */ Scalar_BOOLEAN 0 EcuIntgdSwGend_CM_boolean 0.0 1.0 /end CHARACTERISTIC
/begin CHARACTERISTIC EOP_SoiMaiInj3Ovs_P "Output Processing Start of Main Injection 3 Override Switch Parameter" VALUE 0x40044DC4 /* @ECU_Address@EOP_SoiMaiInj3Ovs_P@ */ Scalar_BOOLEAN 0 EcuIntgdSwGend_CM_boolean 0.0 1.0 /end CHARACTERISTIC
/begin CHARACTERISTIC EOP_SoiMaiInj4Ovs_P "Output Processing Start of Main Injection 4 Override Switch Parameter" VALUE 0x40044DCC /* @ECU_Address@EOP_SoiMaiInj4Ovs_P@ */ Scalar_BOOLEAN 0 EcuIntgdSwGend_CM_boolean 0.0 1.0 /end CHARACTERISTIC
/begin CHARACTERISTIC EOP_SoiMaiInj5Ovs_P "Output Processing Start of Main Injection 5 Override Switch Parameter" VALUE 0x40044DD4 /* @ECU_Address@EOP_SoiMaiInj5Ovs_P@ */ Scalar_BOOLEAN 0 EcuIntgdSwGend_CM_boolean 0.0 1.0 /end CHARACTERISTIC
/begin CHARACTERISTIC EOP_SoiMaiInj6Ovs_P "Output Processing Start of Main Injection 6 Override Switch Parameter" VALUE 0x40044DDC /* @ECU_Address@EOP_SoiMaiInj6Ovs_P@ */ Scalar_BOOLEAN 0 EcuIntgdSwGend_CM_boolean 0.0 1.0 /end CHARACTERISTIC
/begin CHARACTERISTIC EOP_SoiPltInj1Ovs_P "Output Processing Start of Pilot Injection 1 Override Switch Parameter" VALUE 0x40044DE4 /* @ECU_Address@EOP_SoiPltInj1Ovs_P@ */ Scalar_BOOLEAN 0 EcuIntgdSwGend_CM_boolean 0.0 1.0 /end CHARACTERISTIC
/begin CHARACTERISTIC EOP_SoiPltInj2Ovs_P "Output Processing Start of Pilot Injection 2 Override Switch Parameter" VALUE 0x40044DEC /* @ECU_Address@EOP_SoiPltInj2Ovs_P@ */ Scalar_BOOLEAN 0 EcuIntgdSwGend_CM_boolean 0.0 1.0 /end CHARACTERISTIC
/begin CHARACTERISTIC EOP_SoiPltInj3Ovs_P "Output Processing Start of Pilot Injection 3 Override Switch Parameter" VALUE 0x40044DF4 /* @ECU_Address@EOP_SoiPltInj3Ovs_P@ */ Scalar_BOOLEAN 0 EcuIntgdSwGend_CM_boolean 0.0 1.0 /end CHARACTERISTIC
/begin CHARACTERISTIC EOP_SoiPltInj4Ovs_P "Output Processing Start of Pilot Injection 4 Override Switch Parameter" VALUE 0x40044DFC /* @ECU_Address@EOP_SoiPltInj4Ovs_P@ */ Scalar_BOOLEAN 0 EcuIntgdSwGend_CM_boolean 0.0 1.0 /end CHARACTERISTIC
/begin CHARACTERISTIC EOP_SoiPltInj5Ovs_P "Output Processing Start of Pilot Injection 5 Override Switch Parameter" VALUE 0x40044E04 /* @ECU_Address@EOP_SoiPltInj5Ovs_P@ */ Scalar_BOOLEAN 0 EcuIntgdSwGend_CM_boolean 0.0 1.0 /end CHARACTERISTIC
/begin CHARACTERISTIC EOP_SoiPltInj6Ovs_P "Output Processing Start of Pilot Injection 6 Override Switch Parameter" VALUE 0x40044E0C /* @ECU_Address@EOP_SoiPltInj6Ovs_P@ */ Scalar_BOOLEAN 0 EcuIntgdSwGend_CM_boolean 0.0 1.0 /end CHARACTERISTIC
/begin CHARACTERISTIC EOP_TripOvs_P "" VALUE 0x40044E14 /* @ECU_Address@EOP_TripOvs_P@ */ Scalar_BOOLEAN 0 EcuIntgdSwGend_CM_boolean 0.0 1.0 /end CHARACTERISTIC
/begin CHARACTERISTIC EOP_bAcvGridHeatrOvs_P "Output Processing Grid Heater Activation Override Switch Parameter" VALUE 0x40044E1C /* @ECU_Address@EOP_bAcvGridHeatrOvs_P@ */ Scalar_BOOLEAN 0 EcuIntgdSwGend_CM_boolean 0.0 1.0 /end CHARACTERISTIC
/begin CHARACTERISTIC EOP_bAcvGridHeatrOvv_P "Output Processing Grid Heater Activation Override Value Parameter" VALUE 0x40044E20 /* @ECU_Address@EOP_bAcvGridHeatrOvv_P@ */ Scalar_BOOLEAN 0 EcuIntgdSwGend_CM_boolean 0.0 1.0 /end CHARACTERISTIC
/begin CHARACTERISTIC EOP_bAcvStrtrOvs_P "Output Processing Starter Activaiton Override Switch Parameter" VALUE 0x40044E24 /* @ECU_Address@EOP_bAcvStrtrOvs_P@ */ Scalar_BOOLEAN 0 EcuIntgdSwGend_CM_boolean 0.0 1.0 /end CHARACTERISTIC
/begin CHARACTERISTIC EOP_bAcvStrtrOvv_P "Output Processing Starter Activaiton Override Value Parameter" VALUE 0x40044E28 /* @ECU_Address@EOP_bAcvStrtrOvv_P@ */ Scalar_BOOLEAN 0 EcuIntgdSwGend_CM_boolean 0.0 1.0 /end CHARACTERISTIC
/begin CHARACTERISTIC EngBrk_ActvEngBrkFromCan_P "Digital Input or Can Input Active Override Switch Parameter" VALUE 0x40044EA4 /* @ECU_Address@EngBrk_ActvEngBrkFromCan_P@ */ Scalar_BOOLEAN 0 EcuIntgdSwGend_CM_boolean 0.0 1.0 /end CHARACTERISTIC
/begin CHARACTERISTIC EngBrk_BrkPedlEvln_P "Brake Pedal Evaluation	Parameter" VALUE 0x40044EA8 /* @ECU_Address@EngBrk_BrkPedlEvln_P@ */ Scalar_BOOLEAN 0 EcuIntgdSwGend_CM_boolean 0.0 1.0 /end CHARACTERISTIC
/begin CHARACTERISTIC EngBrk_CanABSAcvEvln_P "ABS Can Evaluation Parameter" VALUE 0x40044EAC /* @ECU_Address@EngBrk_CanABSAcvEvln_P@ */ Scalar_BOOLEAN 0 EcuIntgdSwGend_CM_boolean 0.0 1.0 /end CHARACTERISTIC
/begin CHARACTERISTIC EngBrk_TrsmCurrentGearEvln_P "Transmission Current Gear Evaluation Parameter" VALUE 0x40044F60 /* @ECU_Address@EngBrk_TrsmCurrentGearEvln_P@ */ Scalar_BOOLEAN 0 EcuIntgdSwGend_CM_boolean 0.0 1.0 /end CHARACTERISTIC
/begin CHARACTERISTIC EngBrk_TrsmLockUpEngdEvln_P "Transmission Lock Up Engaged Evaluation Parameter" VALUE 0x40044F64 /* @ECU_Address@EngBrk_TrsmLockUpEngdEvln_P@ */ Scalar_BOOLEAN 0 EcuIntgdSwGend_CM_boolean 0.0 1.0 /end CHARACTERISTIC
/begin CHARACTERISTIC IC_DstToEmptyOvs_P "Distance to Empty - Override Switch Parameter" VALUE 0x40044F78 /* @ECU_Address@IC_DstToEmptyOvs_P@ */ Scalar_BOOLEAN 0 EcuIntgdSwGend_CM_boolean 0.0 1.0 /end CHARACTERISTIC
/begin CHARACTERISTIC IC_DurMaiCyl1BalOvs_P "Main Injection Duration Balance for Cylinder 1 - Override Switch Parameter" VALUE 0x40044F80 /* @ECU_Address@IC_DurMaiCyl1BalOvs_P@ */ Scalar_BOOLEAN 0 EcuIntgdSwGend_CM_boolean 0.0 1.0 /end CHARACTERISTIC
/begin CHARACTERISTIC IC_DurMaiCyl2BalOvs_P "Main Injection Duration Balance for Cylinder 2 - Override Switch Parameter" VALUE 0x40044F8C /* @ECU_Address@IC_DurMaiCyl2BalOvs_P@ */ Scalar_BOOLEAN 0 EcuIntgdSwGend_CM_boolean 0.0 1.0 /end CHARACTERISTIC
/begin CHARACTERISTIC IC_DurMaiCyl3BalOvs_P "Main Injection Duration Balance for Cylinder 3 - Override Switch Parameter" VALUE 0x40044F98 /* @ECU_Address@IC_DurMaiCyl3BalOvs_P@ */ Scalar_BOOLEAN 0 EcuIntgdSwGend_CM_boolean 0.0 1.0 /end CHARACTERISTIC
/begin CHARACTERISTIC IC_DurMaiCyl4BalOvs_P "Main Injection Duration Balance for Cylinder 4 - Override Switch Parameter" VALUE 0x40044FA4 /* @ECU_Address@IC_DurMaiCyl4BalOvs_P@ */ Scalar_BOOLEAN 0 EcuIntgdSwGend_CM_boolean 0.0 1.0 /end CHARACTERISTIC
/begin CHARACTERISTIC IC_DurMaiCyl5BalOvs_P "Main Injection Duration Balance for Cylinder 5 - Override Switch Parameter" VALUE 0x40044FB0 /* @ECU_Address@IC_DurMaiCyl5BalOvs_P@ */ Scalar_BOOLEAN 0 EcuIntgdSwGend_CM_boolean 0.0 1.0 /end CHARACTERISTIC
/begin CHARACTERISTIC IC_DurMaiCyl6BalOvs_P "Main Injection Duration Balance for Cylinder 6 - Override Switch Parameter" VALUE 0x40044FBC /* @ECU_Address@IC_DurMaiCyl6BalOvs_P@ */ Scalar_BOOLEAN 0 EcuIntgdSwGend_CM_boolean 0.0 1.0 /end CHARACTERISTIC
/begin CHARACTERISTIC IC_DurPltInj1PreOvs_P "Pre Pilot Injection Duration for Cylinder 1 - Override Switch Parameter" VALUE 0x40045010 /* @ECU_Address@IC_DurPltInj1PreOvs_P@ */ Scalar_BOOLEAN 0 EcuIntgdSwGend_CM_boolean 0.0 1.0 /end CHARACTERISTIC
/begin CHARACTERISTIC IC_DurPltInj2PreOvs_P "Pre Pilot Injection Duration for Cylinder 2 - Override Switch Parameter" VALUE 0x40045018 /* @ECU_Address@IC_DurPltInj2PreOvs_P@ */ Scalar_BOOLEAN 0 EcuIntgdSwGend_CM_boolean 0.0 1.0 /end CHARACTERISTIC
/begin CHARACTERISTIC IC_DurPltInj3PreOvs_P "Pre Pilot Injection Duration for Cylinder 3 - Override Switch Parameter" VALUE 0x40045020 /* @ECU_Address@IC_DurPltInj3PreOvs_P@ */ Scalar_BOOLEAN 0 EcuIntgdSwGend_CM_boolean 0.0 1.0 /end CHARACTERISTIC
/begin CHARACTERISTIC IC_DurPltInj4PreOvs_P "Pre Pilot Injection Duration for Cylinder 4 - Override Switch Parameter" VALUE 0x40045028 /* @ECU_Address@IC_DurPltInj4PreOvs_P@ */ Scalar_BOOLEAN 0 EcuIntgdSwGend_CM_boolean 0.0 1.0 /end CHARACTERISTIC
/begin CHARACTERISTIC IC_DurPltInj5PreOvs_P "Pre Pilot Injection Duration for Cylinder 5 - Override Switch Parameter" VALUE 0x40045030 /* @ECU_Address@IC_DurPltInj5PreOvs_P@ */ Scalar_BOOLEAN 0 EcuIntgdSwGend_CM_boolean 0.0 1.0 /end CHARACTERISTIC
/begin CHARACTERISTIC IC_DurPltInj6PreOvs_P "Pre Pilot Injection Duration for Cylinder 6 - Override Switch Parameter" VALUE 0x40045038 /* @ECU_Address@IC_DurPltInj6PreOvs_P@ */ Scalar_BOOLEAN 0 EcuIntgdSwGend_CM_boolean 0.0 1.0 /end CHARACTERISTIC
/begin CHARACTERISTIC IC_FuCnsAveOvs_P "Fuel Consumption Average Override Switch Parameter" VALUE 0x400450B8 /* @ECU_Address@IC_FuCnsAveOvs_P@ */ Scalar_BOOLEAN 0 EcuIntgdSwGend_CM_boolean 0.0 1.0 /end CHARACTERISTIC
/begin CHARACTERISTIC IC_FuCnsOvs_P "Fuel Consumption - Override Switch Parameter" VALUE 0x400450C0 /* @ECU_Address@IC_FuCnsOvs_P@ */ Scalar_BOOLEAN 0 EcuIntgdSwGend_CM_boolean 0.0 1.0 /end CHARACTERISTIC
/begin CHARACTERISTIC IC_MMaiFuQntyCorrdOvs_P "Corrected Main Fuel Quantity Mass - Override Switch Parameter" VALUE 0x40045DC4 /* @ECU_Address@IC_MMaiFuQntyCorrdOvs_P@ */ Scalar_BOOLEAN 0 EcuIntgdSwGend_CM_boolean 0.0 1.0 /end CHARACTERISTIC
/begin CHARACTERISTIC IC_MPltFuQntyCorrdOvs_P "Corrected Pilot Fuel Quantity Mass - Override Switch Parameter" VALUE 0x40045DD4 /* @ECU_Address@IC_MPltFuQntyCorrdOvs_P@ */ Scalar_BOOLEAN 0 EcuIntgdSwGend_CM_boolean 0.0 1.0 /end CHARACTERISTIC
/begin CHARACTERISTIC IC_bAcvPltAllwdOvs_P "Pilot Injection Allowance Flag - Override Switch Parameter" VALUE 0x40048680 /* @ECU_Address@IC_bAcvPltAllwdOvs_P@ */ Scalar_BOOLEAN 0 EcuIntgdSwGend_CM_boolean 0.0 1.0 /end CHARACTERISTIC
/begin CHARACTERISTIC IC_bAcvPltAllwdOvv_P "Pilot Injection Allowance Flag - Override Value Parameter" VALUE 0x40048684 /* @ECU_Address@IC_bAcvPltAllwdOvv_P@ */ Scalar_BOOLEAN 0 EcuIntgdSwGend_CM_boolean 0.0 1.0 /end CHARACTERISTIC
/begin CHARACTERISTIC PHC_bAcvGridHeatrOvs_P "Grid Heater is Active Flag - Override Switch Parameter" VALUE 0x40048858 /* @ECU_Address@PHC_bAcvGridHeatrOvs_P@ */ Scalar_BOOLEAN 0 EcuIntgdSwGend_CM_boolean 0.0 1.0 /end CHARACTERISTIC
/begin CHARACTERISTIC PHC_bAcvGridHeatrOvv_P "Grid Heater is Active Flag - Override Value Parameter" VALUE 0x4004885C /* @ECU_Address@PHC_bAcvGridHeatrOvv_P@ */ Scalar_BOOLEAN 0 EcuIntgdSwGend_CM_boolean 0.0 1.0 /end CHARACTERISTIC
/begin CHARACTERISTIC PHC_bAcvPostGridHeatrOvs_P "Grid Heater Activation with After Starter - Override Switch Parameter" VALUE 0x40048860 /* @ECU_Address@PHC_bAcvPostGridHeatrOvs_P@ */ Scalar_BOOLEAN 0 EcuIntgdSwGend_CM_boolean 0.0 1.0 /end CHARACTERISTIC
/begin CHARACTERISTIC PHC_bAcvPostGridHeatrOvv_P "Grid Heater Activation with After Starter - Override Value Parameter" VALUE 0x40048864 /* @ECU_Address@PHC_bAcvPostGridHeatrOvv_P@ */ Scalar_BOOLEAN 0 EcuIntgdSwGend_CM_boolean 0.0 1.0 /end CHARACTERISTIC
/begin CHARACTERISTIC PHC_bAcvPreAcvnGridHeatrOvs_P "Grid Heater is Active Flag Before Starter - Override Switch Parameter" VALUE 0x40048868 /* @ECU_Address@PHC_bAcvPreAcvnGridHeatrOvs_P@ */ Scalar_BOOLEAN 0 EcuIntgdSwGend_CM_boolean 0.0 1.0 /end CHARACTERISTIC
/begin CHARACTERISTIC PHC_bAcvPreAcvnGridHeatrOvv_P "Grid Heater is Active Flag Before Starter - Override Value Parameter" VALUE 0x4004886C /* @ECU_Address@PHC_bAcvPreAcvnGridHeatrOvv_P@ */ Scalar_BOOLEAN 0 EcuIntgdSwGend_CM_boolean 0.0 1.0 /end CHARACTERISTIC
/begin CHARACTERISTIC PHC_bErrAcvGridHeatrOvs_P "Grid Heater Error Override Switch Parameter" VALUE 0x40048870 /* @ECU_Address@PHC_bErrAcvGridHeatrOvs_P@ */ Scalar_BOOLEAN 0 EcuIntgdSwGend_CM_boolean 0.0 1.0 /end CHARACTERISTIC
/begin CHARACTERISTIC PHC_bErrAcvGridHeatrOvv_P "Grid Heater Error Override Value Parameter" VALUE 0x40048874 /* @ECU_Address@PHC_bErrAcvGridHeatrOvv_P@ */ Scalar_BOOLEAN 0 EcuIntgdSwGend_CM_boolean 0.0 1.0 /end CHARACTERISTIC
/begin CHARACTERISTIC PtoCtrl_NotAvlAcv_P "PTO Governer State Not Available" VALUE 0x40048F44 /* @ECU_Address@PtoCtrl_NotAvlAcv_P@ */ Scalar_BOOLEAN 0 EcuIntgdSwGend_CM_boolean 0.0 1.0 /end CHARACTERISTIC
/begin CHARACTERISTIC PtoCtrl_PIDCoeffDOvs_P "PID Derivative Coefficient for PTO Controller - Override Switch" VALUE 0x40048F48 /* @ECU_Address@PtoCtrl_PIDCoeffDOvs_P@ */ Scalar_BOOLEAN 0 EcuIntgdSwGend_CM_boolean 0.0 1.0 /end CHARACTERISTIC
/begin CHARACTERISTIC PtoCtrl_PIDCoeffFiltOvs_P "PID Filter Coefficient for PTO Controller - Override Switch" VALUE 0x40048F50 /* @ECU_Address@PtoCtrl_PIDCoeffFiltOvs_P@ */ Scalar_BOOLEAN 0 EcuIntgdSwGend_CM_boolean 0.0 1.0 /end CHARACTERISTIC
/begin CHARACTERISTIC PtoCtrl_PIDCoeffIOvs_P "PID Integrator Coefficient for PTO Controller - Override Switch" VALUE 0x40048F58 /* @ECU_Address@PtoCtrl_PIDCoeffIOvs_P@ */ Scalar_BOOLEAN 0 EcuIntgdSwGend_CM_boolean 0.0 1.0 /end CHARACTERISTIC
/begin CHARACTERISTIC PtoCtrl_PIDCoeffPOvs_P "PID Proportional Coefficient for PTO Controller - Override Switch" VALUE 0x40048F60 /* @ECU_Address@PtoCtrl_PIDCoeffPOvs_P@ */ Scalar_BOOLEAN 0 EcuIntgdSwGend_CM_boolean 0.0 1.0 /end CHARACTERISTIC
/begin CHARACTERISTIC PtoCtrl_bAcvCabPtoCanOrDigInpOvs_P "Cabin PTO Can Or Digital Input Select Parameter" VALUE 0x40049178 /* @ECU_Address@PtoCtrl_bAcvCabPtoCanOrDigInpOvs_P@ */ Scalar_BOOLEAN 0 EcuIntgdSwGend_CM_boolean 0.0 1.0 /end CHARACTERISTIC
/begin CHARACTERISTIC PtoCtrl_bAcvCabPtoOvs_P "Cabin PTO Activation Override Switch Parameter" VALUE 0x4004917C /* @ECU_Address@PtoCtrl_bAcvCabPtoOvs_P@ */ Scalar_BOOLEAN 0 EcuIntgdSwGend_CM_boolean 0.0 1.0 /end CHARACTERISTIC
/begin CHARACTERISTIC PtoCtrl_bAcvCabPtoOvv_P "Cabin PTO Activation Override Value Parameter" VALUE 0x40049180 /* @ECU_Address@PtoCtrl_bAcvCabPtoOvv_P@ */ Scalar_BOOLEAN 0 EcuIntgdSwGend_CM_boolean 0.0 1.0 /end CHARACTERISTIC
/begin CHARACTERISTIC PtoCtrl_bAcvHndBrkPrkgForRemPto_P "Hand Brake Parking Active Parameter For Remote PTO" VALUE 0x40049184 /* @ECU_Address@PtoCtrl_bAcvHndBrkPrkgForRemPto_P@ */ Scalar_BOOLEAN 0 EcuIntgdSwGend_CM_boolean 0.0 1.0 /end CHARACTERISTIC
/begin CHARACTERISTIC PtoCtrl_bAcvHndBrkPrkg_P "Hand Brake Parking Active Parameter" VALUE 0x40049188 /* @ECU_Address@PtoCtrl_bAcvHndBrkPrkg_P@ */ Scalar_BOOLEAN 0 EcuIntgdSwGend_CM_boolean 0.0 1.0 /end CHARACTERISTIC
/begin CHARACTERISTIC PtoCtrl_bAcvRemPtoOvs_P "Remote PTO Activation Override Switch Parameter" VALUE 0x40049198 /* @ECU_Address@PtoCtrl_bAcvRemPtoOvs_P@ */ Scalar_BOOLEAN 0 EcuIntgdSwGend_CM_boolean 0.0 1.0 /end CHARACTERISTIC
/begin CHARACTERISTIC PtoCtrl_bAcvRemPtoOvv_P "Remote PTO Activation Override Value Parameter" VALUE 0x4004919C /* @ECU_Address@PtoCtrl_bAcvRemPtoOvv_P@ */ Scalar_BOOLEAN 0 EcuIntgdSwGend_CM_boolean 0.0 1.0 /end CHARACTERISTIC
/begin CHARACTERISTIC PtoCtrl_bAcvTrsmCurrentGearForRemPto_P "Transmission Current Gear Neutral For Remote PTO" VALUE 0x400491A0 /* @ECU_Address@PtoCtrl_bAcvTrsmCurrentGearForRemPto_P@ */ Scalar_BOOLEAN 0 EcuIntgdSwGend_CM_boolean 0.0 1.0 /end CHARACTERISTIC
/begin CHARACTERISTIC PtoCtrl_bAcvTrsmCurrentGear_P "Transmission Current Gear - Override Switch" VALUE 0x400491A4 /* @ECU_Address@PtoCtrl_bAcvTrsmCurrentGear_P@ */ Scalar_BOOLEAN 0 EcuIntgdSwGend_CM_boolean 0.0 1.0 /end CHARACTERISTIC
/begin CHARACTERISTIC RPG_FFLeakgSetPointOvs_P "FeedForward Leakage Set Point Override Switch Parameter" VALUE 0x40049810 /* @ECU_Address@RPG_FFLeakgSetPointOvs_P@ */ Scalar_BOOLEAN 0 EcuIntgdSwGend_CM_boolean 0.0 1.0 /end CHARACTERISTIC
/begin CHARACTERISTIC RPG_PIDCoeffDOvs_P "Rail Pressure Controller D Coefficient - Override Switch Parameter" VALUE 0x40049998 /* @ECU_Address@RPG_PIDCoeffDOvs_P@ */ Scalar_BOOLEAN 0 EcuIntgdSwGend_CM_boolean 0.0 1.0 /end CHARACTERISTIC
/begin CHARACTERISTIC RPG_PIDCoeffFiltOvs_P "Rail Pressure Controller D Filter Coefficient - Override Switch Parameter" VALUE 0x400499A0 /* @ECU_Address@RPG_PIDCoeffFiltOvs_P@ */ Scalar_BOOLEAN 0 EcuIntgdSwGend_CM_boolean 0.0 1.0 /end CHARACTERISTIC
/begin CHARACTERISTIC RPG_PIDCoeffIOvs_P "Rail Pressure Controller I Coefficient - Override Switch Parameter" VALUE 0x400499A8 /* @ECU_Address@RPG_PIDCoeffIOvs_P@ */ Scalar_BOOLEAN 0 EcuIntgdSwGend_CM_boolean 0.0 1.0 /end CHARACTERISTIC
/begin CHARACTERISTIC RPG_PIDCoeffPOvs_P "Rail Pressure Controller P Coefficient - Override Switch Parameter" VALUE 0x400499B0 /* @ECU_Address@RPG_PIDCoeffPOvs_P@ */ Scalar_BOOLEAN 0 EcuIntgdSwGend_CM_boolean 0.0 1.0 /end CHARACTERISTIC
/begin CHARACTERISTIC RPG_PRailRefForPCVOvs_P "Reference Rail Pressure for Pressure Control Valve 1 - Override Switch Parameter" VALUE 0x40049B58 /* @ECU_Address@RPG_PRailRefForPCVOvs_P@ */ Scalar_BOOLEAN 0 EcuIntgdSwGend_CM_boolean 0.0 1.0 /end CHARACTERISTIC
/begin CHARACTERISTIC RPG_PRailRefNotCorrdOvs_P "Reference Rail Pressure is Not Corrected - Override Switch Parameter" VALUE 0x40049B68 /* @ECU_Address@RPG_PRailRefNotCorrdOvs_P@ */ Scalar_BOOLEAN 0 EcuIntgdSwGend_CM_boolean 0.0 1.0 /end CHARACTERISTIC
/begin CHARACTERISTIC RPG_PercgVCVReqOvs_P "FMU Valve 1 Percentage Request - Override Switch Parameter" VALUE 0x4004A614 /* @ECU_Address@RPG_PercgVCVReqOvs_P@ */ Scalar_BOOLEAN 0 EcuIntgdSwGend_CM_boolean 0.0 1.0 /end CHARACTERISTIC
/begin CHARACTERISTIC RPG_bAcvTCorrForPRail_P "Temperature Correction is Active for Rail Pressure Parameter" VALUE 0x4004B220 /* @ECU_Address@RPG_bAcvTCorrForPRail_P@ */ Scalar_BOOLEAN 0 EcuIntgdSwGend_CM_boolean 0.0 1.0 /end CHARACTERISTIC
/begin CHARACTERISTIC SC_StUsrForAllwblCrnkg_P "User State Parameter of Allowable Cranking Time" VALUE 0x4004B250 /* @ECU_Address@SC_StUsrForAllwblCrnkg_P@ */ Scalar_BOOLEAN 0 EcuIntgdSwGend_CM_boolean 0.0 1.0 /end CHARACTERISTIC
/begin CHARACTERISTIC SC_TiMaxAllwblCrnkgOvs_P "Maximum Allowable Cranking Time Calculation Map - Override Switch Parameter" VALUE 0x4004B290 /* @ECU_Address@SC_TiMaxAllwblCrnkgOvs_P@ */ Scalar_BOOLEAN 0 EcuIntgdSwGend_CM_boolean 0.0 1.0 /end CHARACTERISTIC
/begin CHARACTERISTIC SC_bAcvDisStrtOvs_P "Starter is Disabled Flag - Override Switch Parameter" VALUE 0x4004B2AC /* @ECU_Address@SC_bAcvDisStrtOvs_P@ */ Scalar_BOOLEAN 0 EcuIntgdSwGend_CM_boolean 0.0 1.0 /end CHARACTERISTIC
/begin CHARACTERISTIC SC_bAcvDisStrtOvv_P "Starter is Disabled Flag - Override Value Parameter" VALUE 0x4004B2B0 /* @ECU_Address@SC_bAcvDisStrtOvv_P@ */ Scalar_BOOLEAN 0 EcuIntgdSwGend_CM_boolean 0.0 1.0 /end CHARACTERISTIC
/begin CHARACTERISTIC SC_bAcvStrtrLockOvs_P "Starter Locking is Active Flag - Override Switch Parameter" VALUE 0x4004B2B4 /* @ECU_Address@SC_bAcvStrtrLockOvs_P@ */ Scalar_BOOLEAN 0 EcuIntgdSwGend_CM_boolean 0.0 1.0 /end CHARACTERISTIC
/begin CHARACTERISTIC SC_bAcvStrtrLockOvv_P "Starter Locking is Active Flag - Override Value Parameter" VALUE 0x4004B2B8 /* @ECU_Address@SC_bAcvStrtrLockOvv_P@ */ Scalar_BOOLEAN 0 EcuIntgdSwGend_CM_boolean 0.0 1.0 /end CHARACTERISTIC
/begin CHARACTERISTIC SC_bAcvStrtrOvs_P "Starter is Active Flag - Override Switch Parameter" VALUE 0x4004B2C4 /* @ECU_Address@SC_bAcvStrtrOvs_P@ */ Scalar_BOOLEAN 0 EcuIntgdSwGend_CM_boolean 0.0 1.0 /end CHARACTERISTIC
/begin CHARACTERISTIC SC_bAcvStrtrOvv_P "Starter is Active Flag - Override Value Parameter" VALUE 0x4004B2C8 /* @ECU_Address@SC_bAcvStrtrOvv_P@ */ Scalar_BOOLEAN 0 EcuIntgdSwGend_CM_boolean 0.0 1.0 /end CHARACTERISTIC
/begin CHARACTERISTIC SC_bInhEngStrtOvs_P "Inhibition Engine Start - Override Switch" VALUE 0x4004B2D4 /* @ECU_Address@SC_bInhEngStrtOvs_P@ */ Scalar_BOOLEAN 0 EcuIntgdSwGend_CM_boolean 0.0 1.0 /end CHARACTERISTIC
/begin CHARACTERISTIC SC_bInhEngStrtOvv_P "Inhibition Engine Start - Override Value" VALUE 0x4004B2D8 /* @ECU_Address@SC_bInhEngStrtOvv_P@ */ Scalar_BOOLEAN 0 EcuIntgdSwGend_CM_boolean 0.0 1.0 /end CHARACTERISTIC
/begin CHARACTERISTIC SpdLimr_ActvCanOrDigInEva_P "Activaiton for Can or Digital Input Evaluation Parameter" VALUE 0x4004B2DC /* @ECU_Address@SpdLimr_ActvCanOrDigInEva_P@ */ Scalar_BOOLEAN 0 EcuIntgdSwGend_CM_boolean 0.0 1.0 /end CHARACTERISTIC
/begin MEASUREMENT TrC_MMaiFuQntyCorrTCoolt "" FLOAT32_IEEE EcuIntgdSwGend_CM_single_mm_3_stk 0 0 -500.0 1000.0 ECU_ADDRESS 0x4000D8D4 /* @ECU_Address@TrC_MMaiFuQntyCorrTCoolt@ */ /end MEASUREMENT
/begin MEASUREMENT TrC_MMaiFuQntyCorrPAmbAir "Main Fuel Quantity Ambient Pressure Correction" FLOAT32_IEEE EcuIntgdSwGend_CM_single_mm_3_stk 0 0 0.0 1000.0 ECU_ADDRESS 0x4000E644 /* @ECU_Address@TrC_MMaiFuQntyCorrPAmbAir@ */ /end MEASUREMENT
/begin MEASUREMENT TrC_MMaiFuQntyCorrTAmbAir "" FLOAT32_IEEE EcuIntgdSwGend_CM_single_mm_3_stk 0 0 -500.0 1000.0 ECU_ADDRESS 0x4000E970 /* @ECU_Address@TrC_MMaiFuQntyCorrTAmbAir@ */ /end MEASUREMENT
/begin MEASUREMENT TrC_MMaiFuQntyCorrTOil "" FLOAT32_IEEE EcuIntgdSwGend_CM_single_mm_3_stk 0 0 -500.0 1000.0 ECU_ADDRESS 0x4000D8AC /* @ECU_Address@TrC_MMaiFuQntyCorrTOil@ */ /end MEASUREMENT
/begin MEASUREMENT TrC_MMaiFuQntyCorrTAirBoost "" FLOAT32_IEEE EcuIntgdSwGend_CM_single_mm_3_stk 0 0 -500.0 1000.0 ECU_ADDRESS 0x4000E3F4 /* @ECU_Address@TrC_MMaiFuQntyCorrTAirBoost@ */ /end MEASUREMENT
/begin MEASUREMENT TrC_MMaiFuQntyCorrUClmp30 "" FLOAT32_IEEE EcuIntgdSwGend_CM_single_mm_3_stk 0 0 -500.0 1000.0 ECU_ADDRESS 0x4000DF5C /* @ECU_Address@TrC_MMaiFuQntyCorrUClmp30@ */ /end MEASUREMENT
/begin MEASUREMENT TrC_MMaiFuQntyCorrd "Corrected Main Fuel Quantity" FLOAT32_IEEE EcuIntgdSwGend_CM_single_mm_3_stk 0 0 0.0 1000.0 ECU_ADDRESS 0x4000E9A0 /* @ECU_Address@TrC_MMaiFuQntyCorrd@ */ /end MEASUREMENT
/begin MEASUREMENT TrC_ActEngTq "Actual Engine Torque" FLOAT32_IEEE EcuIntgdSwGend_CM_single_N_m 0 0 0.0 2000.0 ECU_ADDRESS 0x4000DB64 /* @ECU_Address@TrC_ActEngTq@ */ /end MEASUREMENT
/begin MEASUREMENT TrC_ActEngPercTq "Actual Engine - Percent Torque" FLOAT32_IEEE EcuIntgdSwGend_CM_single__ 0 0 0.0 125.0 ECU_ADDRESS 0x4000DC00 /* @ECU_Address@TrC_ActEngPercTq@ */ /end MEASUREMENT
/begin MEASUREMENT TrC_EngDmdTq "" FLOAT32_IEEE EcuIntgdSwGend_CM_single_N_m 0 0 0.0 5000.0 ECU_ADDRESS 0x4000DD98 /* @ECU_Address@TrC_EngDmdTq@ */ /end MEASUREMENT
/begin MEASUREMENT TrC_EngDmdPercTq "" FLOAT32_IEEE EcuIntgdSwGend_CM_single__ 0 0 0.0 125.0 ECU_ADDRESS 0x4000D86C /* @ECU_Address@TrC_EngDmdPercTq@ */ /end MEASUREMENT
/begin MEASUREMENT SC_TiMaxAllwblCrnkg "Timer Value for Maximum Allowable Cranking Time" FLOAT32_IEEE EcuIntgdSwGend_CM_single_ms 0 0 0.0 50000.0 ECU_ADDRESS 0x4000E64C /* @ECU_Address@SC_TiMaxAllwblCrnkg@ */ /end MEASUREMENT
/begin MEASUREMENT SpdLimr_ErrVehVRef "Vehicle Speed Reference Error" FLOAT32_IEEE EcuIntgdSwGend_CM_single_km_h 0 0 -200.0 200.0 ECU_ADDRESS 0x4000E2F4 /* @ECU_Address@SpdLimr_ErrVehVRef@ */ /end MEASUREMENT
/begin MEASUREMENT SpdLimr_EngBrkLvl "Engine Brake Level via Speed Limiter" FLOAT32_IEEE EcuIntgdSwGend_CM_single 0 0 0.0 2.0 ECU_ADDRESS 0x4000DD10 /* @ECU_Address@SpdLimr_EngBrkLvl@ */ /end MEASUREMENT
/begin MEASUREMENT SpdLimr_SpdLimrTq "Speed Limiter Torque" FLOAT32_IEEE EcuIntgdSwGend_CM_single_N_m 0 0 0.0 10000.0 ECU_ADDRESS 0x4000E7A8 /* @ECU_Address@SpdLimr_SpdLimrTq@ */ /end MEASUREMENT
/begin MEASUREMENT SpdLimr_TarSpd "Speed Limiter Target Speed" FLOAT32_IEEE EcuIntgdSwGend_CM_single_km_h 0 0 0.0 300.0 ECU_ADDRESS 0x4000E3D8 /* @ECU_Address@SpdLimr_TarSpd@ */ /end MEASUREMENT
/begin MEASUREMENT SpdLimr_ActvSpdLimr "Speed Limiter Activation" FLOAT32_IEEE EcuIntgdSwGend_CM_single 0 0 0.0 3.0 ECU_ADDRESS 0x4000DABC /* @ECU_Address@SpdLimr_ActvSpdLimr@ */ /end MEASUREMENT
/begin MEASUREMENT SpdLimr_TarSpdPre "Speed Limiter Target Speed Pre" FLOAT32_IEEE EcuIntgdSwGend_CM_single_km_h 0 0 0.0 300.0 ECU_ADDRESS 0x4000DF3C /* @ECU_Address@SpdLimr_TarSpdPre@ */ /end MEASUREMENT
/begin MEASUREMENT RPG_TCorrForPRail "Rail Pressure Temperature Correction" FLOAT32_IEEE EcuIntgdSwGend_CM_single_bar 0 0 0.0 2500.0 ECU_ADDRESS 0x4000E628 /* @ECU_Address@RPG_TCorrForPRail@ */ /end MEASUREMENT
/begin MEASUREMENT RPG_PRailCorrPAmbAir "Rail Pressure Correction for Ambient Air Pressure" FLOAT32_IEEE EcuIntgdSwGend_CM_single_bar 0 0 0.0 2500.0 ECU_ADDRESS 0x4000E7E0 /* @ECU_Address@RPG_PRailCorrPAmbAir@ */ /end MEASUREMENT
/begin MEASUREMENT RPG_PRailSetpointCorr "Rail Pressure Set Point Correction" FLOAT32_IEEE EcuIntgdSwGend_CM_single_bar 0 0 0.0 5000.0 ECU_ADDRESS 0x4000E3C4 /* @ECU_Address@RPG_PRailSetpointCorr@ */ /end MEASUREMENT
/begin MEASUREMENT RPG_PRailRefNotCorrd "Reference Rail Pressure is Not Corrected" FLOAT32_IEEE EcuIntgdSwGend_CM_single_bar 0 0 0.0 10000.0 ECU_ADDRESS 0x4000D8D8 /* @ECU_Address@RPG_PRailRefNotCorrd@ */ /end MEASUREMENT
/begin MEASUREMENT RPG_ErrPRail "Rail Pressure Controller Rail Pressure Error" FLOAT32_IEEE EcuIntgdSwGend_CM_single_bar 0 0 -1000.0 1000.0 ECU_ADDRESS 0x4000E4BC /* @ECU_Address@RPG_ErrPRail@ */ /end MEASUREMENT
/begin MEASUREMENT RPG_CoeffPForPRailCtlMapOut "Rail Pressure Controller P Coefficient Map Out" FLOAT32_IEEE EcuIntgdSwGend_CM_single 0 0 -100000.0 100000.0 ECU_ADDRESS 0x4000DF94 /* @ECU_Address@RPG_CoeffPForPRailCtlMapOut@ */ /end MEASUREMENT
/begin MEASUREMENT RPG_PIDCoeffP "Rail Pressure Controller P Coefficient" FLOAT32_IEEE EcuIntgdSwGend_CM_single 0 0 -100.0 100.0 ECU_ADDRESS 0x4000D930 /* @ECU_Address@RPG_PIDCoeffP@ */ /end MEASUREMENT
/begin MEASUREMENT RPG_CoeffDForPRailCtlMapOut "Rail Pressure Controller D Coefficient Map Out" FLOAT32_IEEE EcuIntgdSwGend_CM_single 0 0 -100000.0 100000.0 ECU_ADDRESS 0x4000E76C /* @ECU_Address@RPG_CoeffDForPRailCtlMapOut@ */ /end MEASUREMENT
/begin MEASUREMENT RPG_PIDCoeffD "Rail Pressure Controller D Coefficient" FLOAT32_IEEE EcuIntgdSwGend_CM_single 0 0 -100.0 100.0 ECU_ADDRESS 0x4000D914 /* @ECU_Address@RPG_PIDCoeffD@ */ /end MEASUREMENT
/begin MEASUREMENT RPG_CoeffFiltForPRailCtlMapOut "Rail Pressure Controller D Filter Coefficient Map Out" FLOAT32_IEEE EcuIntgdSwGend_CM_single 0 0 -100000.0 100000.0 ECU_ADDRESS 0x4000D8FC /* @ECU_Address@RPG_CoeffFiltForPRailCtlMapOut@ */ /end MEASUREMENT
/begin MEASUREMENT RPG_PIDCoeffFilt "Rail Pressure Controller D Filter Coefficient" FLOAT32_IEEE EcuIntgdSwGend_CM_single 0 0 -100.0 100.0 ECU_ADDRESS 0x4000D990 /* @ECU_Address@RPG_PIDCoeffFilt@ */ /end MEASUREMENT
/begin MEASUREMENT RPG_PercgVolCtrlVlvFFLeakgMap1 "Percentage Volumetric Control Valve FeedForward Leakage Map 1 Out" FLOAT32_IEEE EcuIntgdSwGend_CM_single__ 0 0 0.0 100.0 ECU_ADDRESS 0x4000DA54 /* @ECU_Address@RPG_PercgVolCtrlVlvFFLeakgMap1@ */ /end MEASUREMENT
/begin MEASUREMENT RPG_PercgVolCtrlVlvFFLeakgMap2 "Percentage Volumetric Control Valve FeedForward Leakage Map 2 Out" FLOAT32_IEEE EcuIntgdSwGend_CM_single__ 0 0 0.0 100.0 ECU_ADDRESS 0x4000DA58 /* @ECU_Address@RPG_PercgVolCtrlVlvFFLeakgMap2@ */ /end MEASUREMENT
/begin MEASUREMENT RPG_FFLeakgSetPoint1to2Intp "FeedForward Leakage Set Point Interpolation Between Map 2 and 3" FLOAT32_IEEE EcuIntgdSwGend_CM_single__ 0 0 0.0 5000.0 ECU_ADDRESS 0x4000E59C /* @ECU_Address@RPG_FFLeakgSetPoint1to2Intp@ */ /end MEASUREMENT
/begin MEASUREMENT RPG_PercgVolCtrlVlvFFLeakgMap3 "Percentage Volumetric Control Valve FeedForward Leakage Map 3 Out" FLOAT32_IEEE EcuIntgdSwGend_CM_single__ 0 0 0.0 100.0 ECU_ADDRESS 0x4000DE78 /* @ECU_Address@RPG_PercgVolCtrlVlvFFLeakgMap3@ */ /end MEASUREMENT
/begin MEASUREMENT RPG_FFLeakgSetPoint2to3Intp "FeedForward Leakage Set Point Interpolation Between Map 1 and 2" FLOAT32_IEEE EcuIntgdSwGend_CM_single__ 0 0 0.0 5000.0 ECU_ADDRESS 0x4000DD5C /* @ECU_Address@RPG_FFLeakgSetPoint2to3Intp@ */ /end MEASUREMENT
/begin MEASUREMENT RPG_FFLeakgSetPoint "FeedForward Leakage Set Point" FLOAT32_IEEE EcuIntgdSwGend_CM_single__ 0 0 0.0 5000.0 ECU_ADDRESS 0x4000E92C /* @ECU_Address@RPG_FFLeakgSetPoint@ */ /end MEASUREMENT
/begin MEASUREMENT RPG_PercgVCVReqPreSat "FMU Valve Percentage Request Before Saturation" FLOAT32_IEEE EcuIntgdSwGend_CM_single__ 0 0 0.0 100.0 ECU_ADDRESS 0x4000DDE8 /* @ECU_Address@RPG_PercgVCVReqPreSat@ */ /end MEASUREMENT
/begin MEASUREMENT RPG_PercgVCVReq "FMU Valve 1 Percentage Request" FLOAT32_IEEE EcuIntgdSwGend_CM_single__ 0 0 0.0 100.0 ECU_ADDRESS 0x4000E910 /* @ECU_Address@RPG_PercgVCVReq@ */ /end MEASUREMENT
/begin MEASUREMENT RPG_PRailRefForPCV "Reference Rail Pressure for Pressure Control Valve 1" FLOAT32_IEEE EcuIntgdSwGend_CM_single_bar 0 0 0.0 2500.0 ECU_ADDRESS 0x4000DFA0 /* @ECU_Address@RPG_PRailRefForPCV@ */ /end MEASUREMENT
/begin MEASUREMENT RPG_CoeffIForPRailCtlMapOut "Rail Pressure Controller I Coefficient Map Out" FLOAT32_IEEE EcuIntgdSwGend_CM_single 0 0 -100000.0 100000.0 ECU_ADDRESS 0x4000E78C /* @ECU_Address@RPG_CoeffIForPRailCtlMapOut@ */ /end MEASUREMENT
/begin MEASUREMENT RPG_PIDCoeffI "Rail Pressure Controller I Coefficient" FLOAT32_IEEE EcuIntgdSwGend_CM_single 0 0 -100.0 100.0 ECU_ADDRESS 0x4000DD30 /* @ECU_Address@RPG_PIDCoeffI@ */ /end MEASUREMENT
/begin MEASUREMENT PtoCtrl_NEngTargetSpdRemPto "Remote PTO Engine Target Speed " FLOAT32_IEEE EcuIntgdSwGend_CM_single_rpm 0 0 0.0 2000.0 ECU_ADDRESS 0x4000DE1C /* @ECU_Address@PtoCtrl_NEngTargetSpdRemPto@ */ /end MEASUREMENT
/begin MEASUREMENT PtoCtrl_StTargetSpdForPtoGovr "Target Speed State For Remote PTO" FLOAT32_IEEE EcuIntgdSwGend_CM_single 0 0 1.0 5.0 ECU_ADDRESS 0x4000DAAC /* @ECU_Address@PtoCtrl_StTargetSpdForPtoGovr@ */ /end MEASUREMENT
/begin MEASUREMENT PtoCtrl_ErrNEngRef "Engine Reference Error" FLOAT32_IEEE EcuIntgdSwGend_CM_single_rpm 0 0 -100000.0 100000.0 ECU_ADDRESS 0x4000E750 /* @ECU_Address@PtoCtrl_ErrNEngRef@ */ /end MEASUREMENT
/begin MEASUREMENT PtoCtrl_CoeffPMapOut "PID Controller Proportional Map Out For PTO Controller" FLOAT32_IEEE EcuIntgdSwGend_CM_single 0 0 -100000.0 100000.0 ECU_ADDRESS 0x4000DD7C /* @ECU_Address@PtoCtrl_CoeffPMapOut@ */ /end MEASUREMENT
/begin MEASUREMENT PtoCtrl_PIDCoeffP "PID Proportional Coefficient for PTO Controller" FLOAT32_IEEE EcuIntgdSwGend_CM_single 0 0 -10000.0 10000.0 ECU_ADDRESS 0x4000DDEC /* @ECU_Address@PtoCtrl_PIDCoeffP@ */ /end MEASUREMENT
/begin MEASUREMENT PtoCtrl_CoeffDMapOut "Derivative Coefficient Map Out Signal for PTO Controller" FLOAT32_IEEE EcuIntgdSwGend_CM_single 0 0 -100000.0 100000.0 ECU_ADDRESS 0x4000DB00 /* @ECU_Address@PtoCtrl_CoeffDMapOut@ */ /end MEASUREMENT
/begin MEASUREMENT PtoCtrl_PIDCoeffD "PID Derivative Coefficient for PTO Controller" FLOAT32_IEEE EcuIntgdSwGend_CM_single 0 0 -10000.0 10000.0 ECU_ADDRESS 0x4000DDC8 /* @ECU_Address@PtoCtrl_PIDCoeffD@ */ /end MEASUREMENT
/begin MEASUREMENT PtoCtrl_CoeffFiltMapOut "Filter Coefficient Map Out  for PTO Controller" FLOAT32_IEEE EcuIntgdSwGend_CM_single 0 0 -100000.0 100000.0 ECU_ADDRESS 0x4000D894 /* @ECU_Address@PtoCtrl_CoeffFiltMapOut@ */ /end MEASUREMENT
/begin MEASUREMENT PtoCtrl_PIDCoeffFilt "PID Filter Coefficient for PTO Controller" FLOAT32_IEEE EcuIntgdSwGend_CM_single 0 0 -10000.0 10000.0 ECU_ADDRESS 0x4000E044 /* @ECU_Address@PtoCtrl_PIDCoeffFilt@ */ /end MEASUREMENT
/begin MEASUREMENT PtoCtrl_PIDMax "PID Max Signal" FLOAT32_IEEE EcuIntgdSwGend_CM_single_N_m 0 0 -10000.0 10000.0 ECU_ADDRESS 0x4000E3EC /* @ECU_Address@PtoCtrl_PIDMax@ */ /end MEASUREMENT
/begin MEASUREMENT PtoCtrl_PIDMin "PID Min Signal" FLOAT32_IEEE EcuIntgdSwGend_CM_single_N_m 0 0 -10000.0 10000.0 ECU_ADDRESS 0x4000E8A8 /* @ECU_Address@PtoCtrl_PIDMin@ */ /end MEASUREMENT
/begin MEASUREMENT PtoCtrl_PtoCtrlFF "PTO Control PID Feed Forward Signal" FLOAT32_IEEE EcuIntgdSwGend_CM_single_N_m 0 0 -5000.0 5000.0 ECU_ADDRESS 0x4000DE90 /* @ECU_Address@PtoCtrl_PtoCtrlFF@ */ /end MEASUREMENT
/begin MEASUREMENT PtoCtrl_CoeffIMapOut "Integrator Coefficient Map Out for PTO Controller" FLOAT32_IEEE EcuIntgdSwGend_CM_single 0 0 -100000.0 100000.0 ECU_ADDRESS 0x4000E3DC /* @ECU_Address@PtoCtrl_CoeffIMapOut@ */ /end MEASUREMENT
/begin MEASUREMENT PtoCtrl_PIDCoeffI "PID Integrator Coefficient for PTO Controller" FLOAT32_IEEE EcuIntgdSwGend_CM_single 0 0 -10000.0 10000.0 ECU_ADDRESS 0x4000DDD4 /* @ECU_Address@PtoCtrl_PIDCoeffI@ */ /end MEASUREMENT
/begin MEASUREMENT PtoCtrl_NEngTargetSpd "Engine Target Speed for Cabin PTO" FLOAT32_IEEE EcuIntgdSwGend_CM_single_rpm 0 0 0.0 2000.0 ECU_ADDRESS 0x4000E090 /* @ECU_Address@PtoCtrl_NEngTargetSpd@ */ /end MEASUREMENT
/begin MEASUREMENT PHC_TiTCooltPreHeatrCorr "Coolant Temperature Grid Heater Timer Corrected " FLOAT32_IEEE EcuIntgdSwGend_CM_single_ms 0 0 0.0 500000.0 ECU_ADDRESS 0x4000D938 /* @ECU_Address@PHC_TiTCooltPreHeatrCorr@ */ /end MEASUREMENT
/begin MEASUREMENT PHC_TiMaxAftrStrtr "Timer Value for Grid Heater Activation After Starter Parameter" FLOAT32_IEEE EcuIntgdSwGend_CM_single_ms 0 0 0.0 500000.0 ECU_ADDRESS 0x4000E104 /* @ECU_Address@PHC_TiMaxAftrStrtr@ */ /end MEASUREMENT
/begin MEASUREMENT PHC_TiPreHeatg "PreHeating Time Calculation Before Start" FLOAT32_IEEE EcuIntgdSwGend_CM_single_ms 0 0 0.0 500000.0 ECU_ADDRESS 0x4000DEB0 /* @ECU_Address@PHC_TiPreHeatg@ */ /end MEASUREMENT
/begin MEASUREMENT PHC_TiMaxBfrStrtr "Timer Value for Grid Heater Activation Before Starter Parameter" FLOAT32_IEEE EcuIntgdSwGend_CM_single_ms 0 0 0.0 500000.0 ECU_ADDRESS 0x4000DF0C /* @ECU_Address@PHC_TiMaxBfrStrtr@ */ /end MEASUREMENT
/begin MEASUREMENT IC_MMaiFuQntyCorrd "Corrected Main Fuel Quantity Mass" FLOAT32_IEEE EcuIntgdSwGend_CM_single_mm_3_stk 0 0 0.0 5000.0 ECU_ADDRESS 0x4000DE44 /* @ECU_Address@IC_MMaiFuQntyCorrd@ */ /end MEASUREMENT
/begin MEASUREMENT IC_MMaiFuQntyCorrdCyl1 "Corrected Main Fuel Quantity Mass for Cylinder 1" FLOAT32_IEEE EcuIntgdSwGend_CM_single_mm_3_stk 0 0 0.0 1000.0 ECU_ADDRESS 0x4000DBD8 /* @ECU_Address@IC_MMaiFuQntyCorrdCyl1@ */ /end MEASUREMENT
/begin MEASUREMENT IC_MMaiFuQntyCorrdCyl2 "Corrected Main Fuel Quantity Mass for Cylinder 2" FLOAT32_IEEE EcuIntgdSwGend_CM_single_mm_3_stk 0 0 0.0 1000.0 ECU_ADDRESS 0x4000E7A4 /* @ECU_Address@IC_MMaiFuQntyCorrdCyl2@ */ /end MEASUREMENT
/begin MEASUREMENT IC_MMaiFuQntyCorrdCyl3 "Corrected Main Fuel Quantity Mass for Cylinder 3" FLOAT32_IEEE EcuIntgdSwGend_CM_single_mm_3_stk 0 0 0.0 1000.0 ECU_ADDRESS 0x4000E724 /* @ECU_Address@IC_MMaiFuQntyCorrdCyl3@ */ /end MEASUREMENT
/begin MEASUREMENT IC_MMaiFuQntyCorrdCyl4 "Corrected Main Fuel Quantity Mass for Cylinder 4" FLOAT32_IEEE EcuIntgdSwGend_CM_single_mm_3_stk 0 0 0.0 1000.0 ECU_ADDRESS 0x4000E7AC /* @ECU_Address@IC_MMaiFuQntyCorrdCyl4@ */ /end MEASUREMENT
/begin MEASUREMENT IC_MPltFuQntyCorrd "Corrected Pilot Fuel Quantity Mass" FLOAT32_IEEE EcuIntgdSwGend_CM_single_mm_3_stk 0 0 0.0 1000.0 ECU_ADDRESS 0x4000E0D8 /* @ECU_Address@IC_MPltFuQntyCorrd@ */ /end MEASUREMENT
/begin MEASUREMENT IC_MaxDurPltInjPre "Maximum Pre Pilot Injection Duration" FLOAT32_IEEE EcuIntgdSwGend_CM_single_us 0 0 0.0 10000.0 ECU_ADDRESS 0x4000E570 /* @ECU_Address@IC_MaxDurPltInjPre@ */ /end MEASUREMENT
/begin MEASUREMENT IC_DegPltInj "Pilot Injection Duration to Degree Signal" FLOAT32_IEEE EcuIntgdSwGend_CM_single_deg 0 0 -360.0 360.0 ECU_ADDRESS 0x4000DA90 /* @ECU_Address@IC_DegPltInj@ */ /end MEASUREMENT
/begin MEASUREMENT IC_SoiPltInjForPltAllwd "Start of Pilot Injection for Allowed Pilot Injection" FLOAT32_IEEE EcuIntgdSwGend_CM_single_deg 0 0 -360.0 360.0 ECU_ADDRESS 0x4000D8D0 /* @ECU_Address@IC_SoiPltInjForPltAllwd@ */ /end MEASUREMENT
/begin MEASUREMENT IC_InstFuCnsLtPerHour "Corrected Total Fuel Quantity Mass Total Cylinder" FLOAT32_IEEE EcuIntgdSwGend_CM_single_L_h 0 0 0.0 1.0E+8 ECU_ADDRESS 0x4000DF9C /* @ECU_Address@IC_InstFuCnsLtPerHour@ */ /end MEASUREMENT
/begin MEASUREMENT IC_CnvnInstFuCnsLtPerHourToSec "" FLOAT32_IEEE EcuIntgdSwGend_CM_single 0 0 0.0 100.0 ECU_ADDRESS 0x4000DE8C /* @ECU_Address@IC_CnvnInstFuCnsLtPerHourToSec@ */ /end MEASUREMENT
/begin MEASUREMENT IC_InstLtPerKm "" FLOAT32_IEEE EcuIntgdSwGend_CM_single_L_km 0 0 0.0 1000.0 ECU_ADDRESS 0x4000D854 /* @ECU_Address@IC_InstLtPerKm@ */ /end MEASUREMENT
/begin MEASUREMENT IC_InstFuCnsLtPerHundKm "" FLOAT32_IEEE EcuIntgdSwGend_CM_single_L_100km 0 0 0.0 10000.0 ECU_ADDRESS 0x4000DC2C /* @ECU_Address@IC_InstFuCnsLtPerHundKm@ */ /end MEASUREMENT
/begin MEASUREMENT IC_FuCns "Fuel Consumption" FLOAT32_IEEE EcuIntgdSwGend_CM_single_L_100km 0 0 0.0 1000.0 ECU_ADDRESS 0x4000D9F0 /* @ECU_Address@IC_FuCns@ */ /end MEASUREMENT
/begin MEASUREMENT IC_DstCalcn "Distance Calculation" FLOAT32_IEEE EcuIntgdSwGend_CM_single_m 0 0 0.0 100000.0 ECU_ADDRESS 0x4000DC54 /* @ECU_Address@IC_DstCalcn@ */ /end MEASUREMENT
/begin MEASUREMENT IC_CnvnDstMtoKm "" FLOAT32_IEEE EcuIntgdSwGend_CM_single_km 0 0 0.0 1.0E+6 ECU_ADDRESS 0x4000D978 /* @ECU_Address@IC_CnvnDstMtoKm@ */ /end MEASUREMENT
/begin MEASUREMENT IC_Trip "" FLOAT32_IEEE EcuIntgdSwGend_CM_single_km 0 0 0.0 1.0E+6 ECU_ADDRESS 0x4000E2E0 /* @ECU_Address@IC_Trip@ */ /end MEASUREMENT
/begin MEASUREMENT IC_KmPerLt "" FLOAT32_IEEE EcuIntgdSwGend_CM_single_km_L 0 0 0.0 10000.0 ECU_ADDRESS 0x4000E410 /* @ECU_Address@IC_KmPerLt@ */ /end MEASUREMENT
/begin MEASUREMENT IC_LtPerKm "Liter Per Kilometer" FLOAT32_IEEE EcuIntgdSwGend_CM_single_L_km 0 0 0.0 10000.0 ECU_ADDRESS 0x4000E3A4 /* @ECU_Address@IC_LtPerKm@ */ /end MEASUREMENT
/begin MEASUREMENT IC_FuCnsAve "Fuel Consumption Average" FLOAT32_IEEE EcuIntgdSwGend_CM_single_L_100km 0 0 0.0 10000.0 ECU_ADDRESS 0x4000E8E8 /* @ECU_Address@IC_FuCnsAve@ */ /end MEASUREMENT
/begin MEASUREMENT IC_FuInTank "Fuel in Tank" FLOAT32_IEEE EcuIntgdSwGend_CM_single_L 0 0 0.0 1000.0 ECU_ADDRESS 0x4000E69C /* @ECU_Address@IC_FuInTank@ */ /end MEASUREMENT
/begin MEASUREMENT IC_DstToEmpty "Distance to Empty" FLOAT32_IEEE EcuIntgdSwGend_CM_single_km 0 0 -1000.0 1000.0 ECU_ADDRESS 0x4000DB94 /* @ECU_Address@IC_DstToEmpty@ */ /end MEASUREMENT
/begin MEASUREMENT IC_DurMaiInjCyl6 "Main Injection Duration for Cylinder 8" FLOAT32_IEEE EcuIntgdSwGend_CM_single_us 0 0 0.0 10000.0 ECU_ADDRESS 0x4000E160 /* @ECU_Address@IC_DurMaiInjCyl6@ */ /end MEASUREMENT
/begin MEASUREMENT IC_DurMaiInjCyl5 "Main Injection Duration for Cylinder 8" FLOAT32_IEEE EcuIntgdSwGend_CM_single_us 0 0 0.0 10000.0 ECU_ADDRESS 0x4000E15C /* @ECU_Address@IC_DurMaiInjCyl5@ */ /end MEASUREMENT
/begin MEASUREMENT IC_DurMaiInjCyl1 "Main Injection Duration for Cylinder 8" FLOAT32_IEEE EcuIntgdSwGend_CM_single_us 0 0 0.0 10000.0 ECU_ADDRESS 0x4000E580 /* @ECU_Address@IC_DurMaiInjCyl1@ */ /end MEASUREMENT
/begin MEASUREMENT IC_DurMaiInjCyl2 "Main Injection Duration for Cylinder 8" FLOAT32_IEEE EcuIntgdSwGend_CM_single_us 0 0 0.0 10000.0 ECU_ADDRESS 0x4000E2A8 /* @ECU_Address@IC_DurMaiInjCyl2@ */ /end MEASUREMENT
/begin MEASUREMENT IC_DurMaiInjCyl3 "Main Injection Duration for Cylinder 8" FLOAT32_IEEE EcuIntgdSwGend_CM_single_us 0 0 0.0 10000.0 ECU_ADDRESS 0x4000DBB4 /* @ECU_Address@IC_DurMaiInjCyl3@ */ /end MEASUREMENT
/begin MEASUREMENT IC_DurMaiInjCyl4 "Main Injection Duration for Cylinder 8" FLOAT32_IEEE EcuIntgdSwGend_CM_single_us 0 0 0.0 10000.0 ECU_ADDRESS 0x4000E158 /* @ECU_Address@IC_DurMaiInjCyl4@ */ /end MEASUREMENT
/begin MEASUREMENT IC_CnvnKmtoM "" FLOAT32_IEEE EcuIntgdSwGend_CM_single_m 0 0 0.0 100000.0 ECU_ADDRESS 0x4000DB38 /* @ECU_Address@IC_CnvnKmtoM@ */ /end MEASUREMENT
/begin MEASUREMENT IC_CnvnKmHtoMSec "" FLOAT32_IEEE EcuIntgdSwGend_CM_single_m_sec 0 0 0.0 10000.0 ECU_ADDRESS 0x4000DFE4 /* @ECU_Address@IC_CnvnKmHtoMSec@ */ /end MEASUREMENT
/begin MEASUREMENT IC_MMaiFuQntyCorrdCyl6 "Corrected Main Fuel Quantity Mass for Cylinder 6" FLOAT32_IEEE EcuIntgdSwGend_CM_single_mm_3_stk 0 0 0.0 1000.0 ECU_ADDRESS 0x4000E7B4 /* @ECU_Address@IC_MMaiFuQntyCorrdCyl6@ */ /end MEASUREMENT
/begin MEASUREMENT IC_MMaiFuQntyCorrdCyl5 "Corrected Main Fuel Quantity Mass for Cylinder 5" FLOAT32_IEEE EcuIntgdSwGend_CM_single_mm_3_stk 0 0 0.0 1000.0 ECU_ADDRESS 0x4000E7B0 /* @ECU_Address@IC_MMaiFuQntyCorrdCyl5@ */ /end MEASUREMENT
/begin MEASUREMENT EngBrk_DrvrBrkLvrPosn "Driver Brake Lever Position" FLOAT32_IEEE EcuIntgdSwGend_CM_single__ 0 0 0.0 100.0 ECU_ADDRESS 0x4000DADC /* @ECU_Address@EngBrk_DrvrBrkLvrPosn@ */ /end MEASUREMENT
/begin MEASUREMENT EngBrk_DrvrDmdEngBrkTq "Driver Demand Engine Brake Torque" FLOAT32_IEEE EcuIntgdSwGend_CM_single_N_m 0 0 0.0 5000.0 ECU_ADDRESS 0x4000E93C /* @ECU_Address@EngBrk_DrvrDmdEngBrkTq@ */ /end MEASUREMENT
/begin MEASUREMENT EngBrk_RefEngBrkTq "Reference Engine Brake Torque" FLOAT32_IEEE EcuIntgdSwGend_CM_single_N_m 0 0 0.0 5000.0 ECU_ADDRESS 0x4000D940 /* @ECU_Address@EngBrk_RefEngBrkTq@ */ /end MEASUREMENT
/begin MEASUREMENT EngBrk_ActEngBrkTq "Actual Engine Brake Torque" FLOAT32_IEEE EcuIntgdSwGend_CM_single_N_m 0 0 0.0 5000.0 ECU_ADDRESS 0x4000DB34 /* @ECU_Address@EngBrk_ActEngBrkTq@ */ /end MEASUREMENT
/begin MEASUREMENT EngBrk_ActEngBrkPercTq "Actual Engine Brake Percent Torque" FLOAT32_IEEE EcuIntgdSwGend_CM_single__ 0 0 -125.0 125.0 ECU_ADDRESS 0x4000E374 /* @ECU_Address@EngBrk_ActEngBrkPercTq@ */ /end MEASUREMENT
/begin MEASUREMENT EngBrk_ActMaxAvlEngBrkPercTq "Actual Maximum Available Engine Brake Percent Torque" FLOAT32_IEEE EcuIntgdSwGend_CM_single__ 0 0 -125.0 125.0 ECU_ADDRESS 0x4000E0C4 /* @ECU_Address@EngBrk_ActMaxAvlEngBrkPercTq@ */ /end MEASUREMENT
/begin MEASUREMENT EOP_SoiPltInj1 "Output Processing Start of Pilot Injection 1" FLOAT32_IEEE EcuIntgdSwGend_CM_single_deg 0 0 -100.0 100.0 ECU_ADDRESS 0x4000DE08 /* @ECU_Address@EOP_SoiPltInj1@ */ /end MEASUREMENT
/begin MEASUREMENT EOP_SoiPltInj2 "Output Processing Start of Pilot Injection 2" FLOAT32_IEEE EcuIntgdSwGend_CM_single_deg 0 0 -100.0 100.0 ECU_ADDRESS 0x4000E890 /* @ECU_Address@EOP_SoiPltInj2@ */ /end MEASUREMENT
/begin MEASUREMENT EOP_SoiPltInj3 "Output Processing Start of Pilot Injection 3" FLOAT32_IEEE EcuIntgdSwGend_CM_single_deg 0 0 -100.0 100.0 ECU_ADDRESS 0x4000E894 /* @ECU_Address@EOP_SoiPltInj3@ */ /end MEASUREMENT
/begin MEASUREMENT EOP_SoiPltInj4 "Output Processing Start of Pilot Injection 4" FLOAT32_IEEE EcuIntgdSwGend_CM_single_deg 0 0 -100.0 100.0 ECU_ADDRESS 0x4000E898 /* @ECU_Address@EOP_SoiPltInj4@ */ /end MEASUREMENT
/begin MEASUREMENT EOP_SoiPltInj5 "Output Processing Start of Pilot Injection 5" FLOAT32_IEEE EcuIntgdSwGend_CM_single_deg 0 0 -100.0 100.0 ECU_ADDRESS 0x4000E89C /* @ECU_Address@EOP_SoiPltInj5@ */ /end MEASUREMENT
/begin MEASUREMENT EOP_SoiPltInj6 "Output Processing Start of Pilot Injection 6" FLOAT32_IEEE EcuIntgdSwGend_CM_single_deg 0 0 -100.0 100.0 ECU_ADDRESS 0x4000E8A0 /* @ECU_Address@EOP_SoiPltInj6@ */ /end MEASUREMENT
/begin MEASUREMENT EOP_SoiMaiInj1 "Output Processing Start of Main Injection 1" FLOAT32_IEEE EcuIntgdSwGend_CM_single_deg 0 0 -100.0 100.0 ECU_ADDRESS 0x4000E510 /* @ECU_Address@EOP_SoiMaiInj1@ */ /end MEASUREMENT
/begin MEASUREMENT EOP_SoiMaiInj2 "Output Processing Start of Main Injection 2" FLOAT32_IEEE EcuIntgdSwGend_CM_single_deg 0 0 -100.0 100.0 ECU_ADDRESS 0x4000E65C /* @ECU_Address@EOP_SoiMaiInj2@ */ /end MEASUREMENT
/begin MEASUREMENT EOP_SoiMaiInj3 "Output Processing Start of Main Injection 3" FLOAT32_IEEE EcuIntgdSwGend_CM_single_deg 0 0 -100.0 100.0 ECU_ADDRESS 0x4000E518 /* @ECU_Address@EOP_SoiMaiInj3@ */ /end MEASUREMENT
/begin MEASUREMENT EOP_SoiMaiInj4 "Output Processing Start of Main Injection 4" FLOAT32_IEEE EcuIntgdSwGend_CM_single_deg 0 0 -100.0 100.0 ECU_ADDRESS 0x4000E51C /* @ECU_Address@EOP_SoiMaiInj4@ */ /end MEASUREMENT
/begin MEASUREMENT EOP_SoiMaiInj5 "Output Processing Start of Main Injection 5" FLOAT32_IEEE EcuIntgdSwGend_CM_single_deg 0 0 -100.0 100.0 ECU_ADDRESS 0x4000E520 /* @ECU_Address@EOP_SoiMaiInj5@ */ /end MEASUREMENT
/begin MEASUREMENT EOP_SoiMaiInj6 "Output Processing Start of Main Injection 6" FLOAT32_IEEE EcuIntgdSwGend_CM_single_deg 0 0 -100.0 100.0 ECU_ADDRESS 0x4000E524 /* @ECU_Address@EOP_SoiMaiInj6@ */ /end MEASUREMENT
/begin MEASUREMENT EOP_DurPltInj1 "Output Processing Pre Pilot Injection Duration for Cylinder 1" FLOAT32_IEEE EcuIntgdSwGend_CM_single_us 0 0 0.0 10000.0 ECU_ADDRESS 0x4000D8C0 /* @ECU_Address@EOP_DurPltInj1@ */ /end MEASUREMENT
/begin MEASUREMENT EOP_DurPltInj2 "Output Processing Pre Pilot Injection Duration for Cylinder 2" FLOAT32_IEEE EcuIntgdSwGend_CM_single_us 0 0 0.0 10000.0 ECU_ADDRESS 0x4000E38C /* @ECU_Address@EOP_DurPltInj2@ */ /end MEASUREMENT
/begin MEASUREMENT EOP_DurPltInj3 "Output Processing Pre Pilot Injection Duration for Cylinder 3" FLOAT32_IEEE EcuIntgdSwGend_CM_single_us 0 0 0.0 10000.0 ECU_ADDRESS 0x4000E390 /* @ECU_Address@EOP_DurPltInj3@ */ /end MEASUREMENT
/begin MEASUREMENT EOP_DurPltInj4 "Output Processing Pre Pilot Injection Duration for Cylinder 4" FLOAT32_IEEE EcuIntgdSwGend_CM_single_us 0 0 0.0 10000.0 ECU_ADDRESS 0x4000E394 /* @ECU_Address@EOP_DurPltInj4@ */ /end MEASUREMENT
/begin MEASUREMENT EOP_DurPltInj5 "Output Processing Pre Pilot Injection Duration for Cylinder 5" FLOAT32_IEEE EcuIntgdSwGend_CM_single_us 0 0 0.0 10000.0 ECU_ADDRESS 0x4000E240 /* @ECU_Address@EOP_DurPltInj5@ */ /end MEASUREMENT
/begin MEASUREMENT EOP_DurPltInj6 "Output Processing Pre Pilot Injection Duration for Cylinder 6" FLOAT32_IEEE EcuIntgdSwGend_CM_single_us 0 0 0.0 10000.0 ECU_ADDRESS 0x4000DA78 /* @ECU_Address@EOP_DurPltInj6@ */ /end MEASUREMENT
/begin MEASUREMENT EOP_DurMaiInj1 "Output Processing Main Injection Duration for Cylinder 1" FLOAT32_IEEE EcuIntgdSwGend_CM_single_us 0 0 0.0 10000.0 ECU_ADDRESS 0x4000DB08 /* @ECU_Address@EOP_DurMaiInj1@ */ /end MEASUREMENT
/begin MEASUREMENT EOP_DurMaiInj2 "Output Processing Main Injection Duration for Cylinder 2" FLOAT32_IEEE EcuIntgdSwGend_CM_single_us 0 0 0.0 10000.0 ECU_ADDRESS 0x4000DA80 /* @ECU_Address@EOP_DurMaiInj2@ */ /end MEASUREMENT
/begin MEASUREMENT EOP_DurMaiInj3 "Output Processing Main Injection Duration for Cylinder 3" FLOAT32_IEEE EcuIntgdSwGend_CM_single_us 0 0 0.0 10000.0 ECU_ADDRESS 0x4000DA84 /* @ECU_Address@EOP_DurMaiInj3@ */ /end MEASUREMENT
/begin MEASUREMENT EOP_DurMaiInj4 "Output Processing Main Injection Duration for Cylinder 4" FLOAT32_IEEE EcuIntgdSwGend_CM_single_us 0 0 0.0 10000.0 ECU_ADDRESS 0x4000DB10 /* @ECU_Address@EOP_DurMaiInj4@ */ /end MEASUREMENT
/begin MEASUREMENT EOP_DurMaiInj5 "Output Processing Main Injection Duration for Cylinder 5" FLOAT32_IEEE EcuIntgdSwGend_CM_single_us 0 0 0.0 10000.0 ECU_ADDRESS 0x4000DB14 /* @ECU_Address@EOP_DurMaiInj5@ */ /end MEASUREMENT
/begin MEASUREMENT EOP_DurMaiInj6 "Output Processing Main Injection Duration for Cylinder 6" FLOAT32_IEEE EcuIntgdSwGend_CM_single_us 0 0 0.0 10000.0 ECU_ADDRESS 0x4000DB18 /* @ECU_Address@EOP_DurMaiInj6@ */ /end MEASUREMENT
/begin MEASUREMENT EOP_FuCns "Output Processing Fuel Consumption" FLOAT32_IEEE EcuIntgdSwGend_CM_single_l_100km 0 0 0.0 100.0 ECU_ADDRESS 0x4000E574 /* @ECU_Address@EOP_FuCns@ */ /end MEASUREMENT
/begin MEASUREMENT EOP_Trip "" FLOAT32_IEEE EcuIntgdSwGend_CM_single_km 0 0 0.0 1.0E+6 ECU_ADDRESS 0x4000E0AC /* @ECU_Address@EOP_Trip@ */ /end MEASUREMENT
/begin MEASUREMENT EOP_EngHr "Output Processing Engine Hour" FLOAT32_IEEE EcuIntgdSwGend_CM_single_h 0 0 0.0 1.0E+6 ECU_ADDRESS 0x4000DD9C /* @ECU_Address@EOP_EngHr@ */ /end MEASUREMENT
/begin MEASUREMENT EOP_DstTrvldInKm "Output Processing Distance Travel In Kilometer" FLOAT32_IEEE EcuIntgdSwGend_CM_single_km 0 0 0.0 1.0E+6 ECU_ADDRESS 0x4000E1E4 /* @ECU_Address@EOP_DstTrvldInKm@ */ /end MEASUREMENT
/begin MEASUREMENT EOP_EngDftTqLim "Engine Default Torque Limit For Memory" FLOAT32_IEEE EcuIntgdSwGend_CM_single_N_m 0 0 0.0 64255.0 ECU_ADDRESS 0x4000E000 /* @ECU_Address@EOP_EngDftTqLim@ */ /end MEASUREMENT
/begin MEASUREMENT EOP_VCVReq "Output Processing Volumetric Control Valve Request" FLOAT32_IEEE EcuIntgdSwGend_CM_single_A 0 0 0.0 10000.0 ECU_ADDRESS 0x4000E23C /* @ECU_Address@EOP_VCVReq@ */ /end MEASUREMENT
/begin MEASUREMENT EOP_VCVDynRateLimr "Output Processing Volumetric Control Valve Dynamic Rate Limiter" FLOAT32_IEEE EcuIntgdSwGend_CM_single 0 0 0.0 10000.0 ECU_ADDRESS 0x4000E018 /* @ECU_Address@EOP_VCVDynRateLimr@ */ /end MEASUREMENT
/begin MEASUREMENT EOP_IRefVCV "Output Processing Current Reference for Volumetric Control Valve" FLOAT32_IEEE EcuIntgdSwGend_CM_single_A 0 0 0.0 3000.0 ECU_ADDRESS 0x4000E71C /* @ECU_Address@EOP_IRefVCV@ */ /end MEASUREMENT
/begin MEASUREMENT EOP_IRefPCV "Output Processing Current Reference for Pressure Control Valve" FLOAT32_IEEE EcuIntgdSwGend_CM_single_A 0 0 0.0 10000.0 ECU_ADDRESS 0x4000E250 /* @ECU_Address@EOP_IRefPCV@ */ /end MEASUREMENT
/begin MEASUREMENT EOP_DutyVlvReq "Output Processing Duty Valve Request" FLOAT32_IEEE EcuIntgdSwGend_CM_single__ 0 0 0.0 100.0 ECU_ADDRESS 0x4000DF64 /* @ECU_Address@EOP_DutyVlvReq@ */ /end MEASUREMENT
/begin MEASUREMENT SpdLimr_SpdLimrModSt "" SLONG EcuIntgdSwGend_CM_SpeedLimiterMode 0 0 0 3 ECU_ADDRESS 0x4000DF44 /* @ECU_Address@SpdLimr_SpdLimrModSt@ */ /end MEASUREMENT
/begin MEASUREMENT PtoCtrl_CanPtoGovrSt "Power Take Off Governor State " SBYTE EcuIntgdSwGend_CM_int8 0 0 0.0 31.0 ECU_ADDRESS 0x4000DA99 /* @ECU_Address@PtoCtrl_CanPtoGovrSt@ */ /end MEASUREMENT
/begin MEASUREMENT SC_NEngRunDeacThd "Debouncer Activation for Deactivation Running Engine Speed Threshold Value" UBYTE EcuIntgdSwGend_CM_boolean 0 0 0.0 1.0 ECU_ADDRESS 0x4000E2C5 /* @ECU_Address@SC_NEngRunDeacThd@ */ /end MEASUREMENT
/begin MEASUREMENT SC_NEngStrtrInhThd "Debouncer Activation for Start Inhibition Engine Speed Threshold" UBYTE EcuIntgdSwGend_CM_boolean 0 0 0.0 1.0 ECU_ADDRESS 0x4000DA28 /* @ECU_Address@SC_NEngStrtrInhThd@ */ /end MEASUREMENT
/begin MEASUREMENT SC_bAcvStrtr "Starter is Active Flag" UBYTE EcuIntgdSwGend_CM_boolean 0 0 0.0 1.0 ECU_ADDRESS 0x4000E0E7 /* @ECU_Address@SC_bAcvStrtr@ */ /end MEASUREMENT
/begin MEASUREMENT SC_bAcvDisStrt "Starter is Disabled Flag" UBYTE EcuIntgdSwGend_CM_boolean 0 0 0.0 1.0 ECU_ADDRESS 0x4000DE67 /* @ECU_Address@SC_bAcvDisStrt@ */ /end MEASUREMENT
/begin MEASUREMENT SC_NEngAcvStrtLock "Debouncer Activation for Starter Locking Engine Speed Threshold" UBYTE EcuIntgdSwGend_CM_boolean 0 0 0.0 1.0 ECU_ADDRESS 0x4000E830 /* @ECU_Address@SC_NEngAcvStrtLock@ */ /end MEASUREMENT
/begin MEASUREMENT SC_bAcvStrtrLock "Starter Locking is Active Flag" UBYTE EcuIntgdSwGend_CM_boolean 0 0 0.0 1.0 ECU_ADDRESS 0x4000E6D9 /* @ECU_Address@SC_bAcvStrtrLock@ */ /end MEASUREMENT
/begin MEASUREMENT SC_bEnaAcvnStrtr "Enable Starter Activation" UBYTE EcuIntgdSwGend_CM_boolean 0 0 0.0 1.0 ECU_ADDRESS 0x4000DE64 /* @ECU_Address@SC_bEnaAcvnStrtr@ */ /end MEASUREMENT
/begin MEASUREMENT SC_bEnaAcvnStrtrTiEna "Engine Not Turn Finish Time" UBYTE EcuIntgdSwGend_CM_boolean 0 0 0.0 1.0 ECU_ADDRESS 0x4000DE96 /* @ECU_Address@SC_bEnaAcvnStrtrTiEna@ */ /end MEASUREMENT
/begin MEASUREMENT SC_bAcvEngAlrdyRunng "Engine is Already Running Flag" UBYTE EcuIntgdSwGend_CM_boolean 0 0 0.0 1.0 ECU_ADDRESS 0x4000DFC5 /* @ECU_Address@SC_bAcvEngAlrdyRunng@ */ /end MEASUREMENT
/begin MEASUREMENT SC_bInhEngStrt "Inhibition Engine Start" UBYTE EcuIntgdSwGend_CM_boolean 0 0 0.0 1.0 ECU_ADDRESS 0x4000E548 /* @ECU_Address@SC_bInhEngStrt@ */ /end MEASUREMENT
/begin MEASUREMENT SpdLimr_ErrSpdLimrOnOffBtn "Speed Limiter On-Off Button Error Signal" UBYTE EcuIntgdSwGend_CM_boolean 0 0 0.0 1.0 ECU_ADDRESS 0x4000D8F8 /* @ECU_Address@SpdLimr_ErrSpdLimrOnOffBtn@ */ /end MEASUREMENT
/begin MEASUREMENT SpdLimr_ErrSpdLimrInctBtn "Speed Limiter Increment Button Error Signal" UBYTE EcuIntgdSwGend_CM_boolean 0 0 0.0 1.0 ECU_ADDRESS 0x4000DBD4 /* @ECU_Address@SpdLimr_ErrSpdLimrInctBtn@ */ /end MEASUREMENT
/begin MEASUREMENT SpdLimr_ErrSpdLimrDecBtn "Speed Limiter Decrement Button Error Signal" UBYTE EcuIntgdSwGend_CM_boolean 0 0 0.0 1.0 ECU_ADDRESS 0x4000E494 /* @ECU_Address@SpdLimr_ErrSpdLimrDecBtn@ */ /end MEASUREMENT
/begin MEASUREMENT SpdLimr_ErrSpdLimrBtn "Speed Limiter Button Error " UBYTE EcuIntgdSwGend_CM_boolean 0 0 0.0 1.0 ECU_ADDRESS 0x4000E1A8 /* @ECU_Address@SpdLimr_ErrSpdLimrBtn@ */ /end MEASUREMENT
/begin MEASUREMENT SpdLimr_ActvSpdLimrInctBtn "Activation Speed Limiter Increment Button" UBYTE EcuIntgdSwGend_CM_boolean 0 0 0.0 1.0 ECU_ADDRESS 0x4000E403 /* @ECU_Address@SpdLimr_ActvSpdLimrInctBtn@ */ /end MEASUREMENT
/begin MEASUREMENT SpdLimr_ActvSpdLimrOnOffBtn "Activation Speed Limiter On-Off Button" UBYTE EcuIntgdSwGend_CM_boolean 0 0 0.0 1.0 ECU_ADDRESS 0x4000E634 /* @ECU_Address@SpdLimr_ActvSpdLimrOnOffBtn@ */ /end MEASUREMENT
/begin MEASUREMENT SpdLimr_ActvSpdLimrDecBtn "Activation Speed Limiter Decrement Button" UBYTE EcuIntgdSwGend_CM_boolean 0 0 0.0 1.0 ECU_ADDRESS 0x4000E280 /* @ECU_Address@SpdLimr_ActvSpdLimrDecBtn@ */ /end MEASUREMENT
/begin MEASUREMENT RPG_bNEngThdAcvnPRail "Debouncer Activation for Rail Pressure Correction Activation wrt Comparision with Engine Speed" UBYTE EcuIntgdSwGend_CM_boolean 0 0 0.0 1.0 ECU_ADDRESS 0x4000DDD0 /* @ECU_Address@RPG_bNEngThdAcvnPRail@ */ /end MEASUREMENT
/begin MEASUREMENT PtoCtrl_bErrCabPtoOnOff "Cabin PTO Switch Error" UBYTE EcuIntgdSwGend_CM_boolean 0 0 0.0 1.0 ECU_ADDRESS 0x4000DB89 /* @ECU_Address@PtoCtrl_bErrCabPtoOnOff@ */ /end MEASUREMENT
/begin MEASUREMENT PtoCtrl_TrsmCurrentGear "Transmission Gear Neutral" UBYTE EcuIntgdSwGend_CM_boolean 0 0 0.0 1.0 ECU_ADDRESS 0x4000E2B0 /* @ECU_Address@PtoCtrl_TrsmCurrentGear@ */ /end MEASUREMENT
/begin MEASUREMENT PtoCtrl_HndBrkPrkg "Hand Brake Parking Active Signal" UBYTE EcuIntgdSwGend_CM_boolean 0 0 0.0 1.0 ECU_ADDRESS 0x4000E40C /* @ECU_Address@PtoCtrl_HndBrkPrkg@ */ /end MEASUREMENT
/begin MEASUREMENT PtoCtrl_bAcvCabPtoOnOff "Cabin PTO On-Off Switch" UBYTE EcuIntgdSwGend_CM_boolean 0 0 0.0 1.0 ECU_ADDRESS 0x4000E365 /* @ECU_Address@PtoCtrl_bAcvCabPtoOnOff@ */ /end MEASUREMENT
/begin MEASUREMENT PtoCtrl_bErrCabPtoAccrSwt "Cabin PTO Accelerate Switch Error" UBYTE EcuIntgdSwGend_CM_boolean 0 0 0.0 1.0 ECU_ADDRESS 0x4000E4C0 /* @ECU_Address@PtoCtrl_bErrCabPtoAccrSwt@ */ /end MEASUREMENT
/begin MEASUREMENT PtoCtrl_bErrCabPtoCoastSwt "Cabin PTO Coast Switch Error" UBYTE EcuIntgdSwGend_CM_boolean 0 0 0.0 1.0 ECU_ADDRESS 0x4000DEC1 /* @ECU_Address@PtoCtrl_bErrCabPtoCoastSwt@ */ /end MEASUREMENT
/begin MEASUREMENT PtoCtrl_bAcvCabPto "Cabin PTO Activation" UBYTE EcuIntgdSwGend_CM_boolean 0 0 0.0 1.0 ECU_ADDRESS 0x4000E2F8 /* @ECU_Address@PtoCtrl_bAcvCabPto@ */ /end MEASUREMENT
/begin MEASUREMENT PtoCtrl_bAcvCabPtoCoastSwt "Cabin PTO Coast Switch" UBYTE EcuIntgdSwGend_CM_boolean 0 0 0.0 1.0 ECU_ADDRESS 0x4000E3F0 /* @ECU_Address@PtoCtrl_bAcvCabPtoCoastSwt@ */ /end MEASUREMENT
/begin MEASUREMENT PtoCtrl_bAcvCabPtoAccrSwt "Cabin PTO Accelerate Switch" UBYTE EcuIntgdSwGend_CM_boolean 0 0 0.0 1.0 ECU_ADDRESS 0x4000DA11 /* @ECU_Address@PtoCtrl_bAcvCabPtoAccrSwt@ */ /end MEASUREMENT
/begin MEASUREMENT PtoCtrl_bErrRemPtoSpdCtrlSwt "Remote PTO Speed Control Switch Error" UBYTE EcuIntgdSwGend_CM_boolean 0 0 0.0 1.0 ECU_ADDRESS 0x4000D904 /* @ECU_Address@PtoCtrl_bErrRemPtoSpdCtrlSwt@ */ /end MEASUREMENT
/begin MEASUREMENT PtoCtrl_bErrRemPtoAccrSwt "Remote PTO Accelerate Switch Error" UBYTE EcuIntgdSwGend_CM_boolean 0 0 0.0 1.0 ECU_ADDRESS 0x4000D9ED /* @ECU_Address@PtoCtrl_bErrRemPtoAccrSwt@ */ /end MEASUREMENT
/begin MEASUREMENT PtoCtrl_bAcvRemPtoSpdCtrlSwt "Remote PTO Speed Control Switch" UBYTE EcuIntgdSwGend_CM_boolean 0 0 0.0 1.0 ECU_ADDRESS 0x4000DE9E /* @ECU_Address@PtoCtrl_bAcvRemPtoSpdCtrlSwt@ */ /end MEASUREMENT
/begin MEASUREMENT PtoCtrl_TrsmCurrentGearForRemPto "Transmission Gear Neutral For Remote PTO" UBYTE EcuIntgdSwGend_CM_boolean 0 0 0.0 1.0 ECU_ADDRESS 0x4000E5C8 /* @ECU_Address@PtoCtrl_TrsmCurrentGearForRemPto@ */ /end MEASUREMENT
/begin MEASUREMENT PtoCtrl_HndBrkPrkgForRemPto "Hand Brake Parking Active For Remote PTO" UBYTE EcuIntgdSwGend_CM_boolean 0 0 0.0 1.0 ECU_ADDRESS 0x4000DD1A /* @ECU_Address@PtoCtrl_HndBrkPrkgForRemPto@ */ /end MEASUREMENT
/begin MEASUREMENT PtoCtrl_bAcvRemPto "Remote PTO Activation" UBYTE EcuIntgdSwGend_CM_boolean 0 0 0.0 1.0 ECU_ADDRESS 0x4000DFAC /* @ECU_Address@PtoCtrl_bAcvRemPto@ */ /end MEASUREMENT
/begin MEASUREMENT PtoCtrl_bAcvRemPtoAccrSwt "Remote PTO Accelerate Switch" UBYTE EcuIntgdSwGend_CM_boolean 0 0 0.0 1.0 ECU_ADDRESS 0x4000DFEC /* @ECU_Address@PtoCtrl_bAcvRemPtoAccrSwt@ */ /end MEASUREMENT
/begin MEASUREMENT PtoCtrl_bErrRemPtoCoastSwt "Remote PTO Coast Switch Error" UBYTE EcuIntgdSwGend_CM_boolean 0 0 0.0 1.0 ECU_ADDRESS 0x4000D96C /* @ECU_Address@PtoCtrl_bErrRemPtoCoastSwt@ */ /end MEASUREMENT
/begin MEASUREMENT PtoCtrl_bAcvRemPtoCoastSwt "Remote PTO Coast Switch" UBYTE EcuIntgdSwGend_CM_boolean 0 0 0.0 1.0 ECU_ADDRESS 0x4000DF4C /* @ECU_Address@PtoCtrl_bAcvRemPtoCoastSwt@ */ /end MEASUREMENT
/begin MEASUREMENT PHC_bAcvPreAcvnGridHeatr "Grid Heater is Active Flag Before Starter" UBYTE EcuIntgdSwGend_CM_boolean 0 0 0.0 1.0 ECU_ADDRESS 0x4000E049 /* @ECU_Address@PHC_bAcvPreAcvnGridHeatr@ */ /end MEASUREMENT
/begin MEASUREMENT PHC_bAcvPostAcvnGridHeatr "Grid Heater Activation with After Starter" UBYTE EcuIntgdSwGend_CM_boolean 0 0 0.0 1.0 ECU_ADDRESS 0x4000DC77 /* @ECU_Address@PHC_bAcvPostAcvnGridHeatr@ */ /end MEASUREMENT
/begin MEASUREMENT PHC_bAcvGridHeatr "Grid Heater is Active Flag " UBYTE EcuIntgdSwGend_CM_boolean 0 0 0.0 1.0 ECU_ADDRESS 0x4000DF8D /* @ECU_Address@PHC_bAcvGridHeatr@ */ /end MEASUREMENT
/begin MEASUREMENT PHC_bErrAcvGridHeatr "Grid Heater Error Detection" UBYTE EcuIntgdSwGend_CM_boolean 0 0 0.0 1.0 ECU_ADDRESS 0x4000E8B9 /* @ECU_Address@PHC_bErrAcvGridHeatr@ */ /end MEASUREMENT
/begin MEASUREMENT PHC_bAcvPostAcvnGridHeatrTiEna "Timer Elapsed Time Finish for Activation After Start" UBYTE EcuIntgdSwGend_CM_boolean 0 0 0.0 1.0 ECU_ADDRESS 0x4000E7A0 /* @ECU_Address@PHC_bAcvPostAcvnGridHeatrTiEna@ */ /end MEASUREMENT
/begin MEASUREMENT PHC_bTiDisaPreAcvnGridHeatr "Grid Heater Before Starter Deactivation Timer Enable" UBYTE EcuIntgdSwGend_CM_boolean 0 0 0.0 1.0 ECU_ADDRESS 0x4000E731 /* @ECU_Address@PHC_bTiDisaPreAcvnGridHeatr@ */ /end MEASUREMENT
/begin MEASUREMENT PHC_bAcvPreAcvnGridHeatrTiEna "Timer Elapsed Time Finish for Activation Before Start" UBYTE EcuIntgdSwGend_CM_boolean 0 0 0.0 1.0 ECU_ADDRESS 0x4000DB6D /* @ECU_Address@PHC_bAcvPreAcvnGridHeatrTiEna@ */ /end MEASUREMENT
/begin MEASUREMENT IC_bAcvPltAllwd "Pilot Injection Allowance Flag" UBYTE EcuIntgdSwGend_CM_boolean 0 0 0.0 1.0 ECU_ADDRESS 0x4000E54A /* @ECU_Address@IC_bAcvPltAllwd@ */ /end MEASUREMENT
/begin MEASUREMENT EngBrk_ActvEngBrkLvl1 "Engine Brake Button 1 Active" UBYTE EcuIntgdSwGend_CM_boolean 0 0 0.0 1.0 ECU_ADDRESS 0x4000E2E4 /* @ECU_Address@EngBrk_ActvEngBrkLvl1@ */ /end MEASUREMENT
/begin MEASUREMENT EngBrk_ActvEngBrkLvl2 "Engine Brake Button 2 Active" UBYTE EcuIntgdSwGend_CM_boolean 0 0 0.0 1.0 ECU_ADDRESS 0x4000E5E2 /* @ECU_Address@EngBrk_ActvEngBrkLvl2@ */ /end MEASUREMENT
/begin MEASUREMENT EngBrk_ActvBrkPedl "Brake Pedal Active" UBYTE EcuIntgdSwGend_CM_boolean 0 0 0.0 1.0 ECU_ADDRESS 0x4000DB60 /* @ECU_Address@EngBrk_ActvBrkPedl@ */ /end MEASUREMENT
/begin MEASUREMENT EngBrk_ActvCanABS "ABS Active from CAN" UBYTE EcuIntgdSwGend_CM_boolean 0 0 0.0 1.0 ECU_ADDRESS 0x4000DCD4 /* @ECU_Address@EngBrk_ActvCanABS@ */ /end MEASUREMENT
/begin MEASUREMENT EngBrk_TrsmCurrentGearNotNeut "Transmission Current Gear Evaluation" UBYTE EcuIntgdSwGend_CM_boolean 0 0 0.0 1.0 ECU_ADDRESS 0x4000E267 /* @ECU_Address@EngBrk_TrsmCurrentGearNotNeut@ */ /end MEASUREMENT
/begin MEASUREMENT EngBrk_ActvTrsmLockUpEngd "Transmission Lock Up Engaged Active" UBYTE EcuIntgdSwGend_CM_boolean 0 0 0.0 1.0 ECU_ADDRESS 0x4000E7F1 /* @ECU_Address@EngBrk_ActvTrsmLockUpEngd@ */ /end MEASUREMENT
/begin MEASUREMENT EngBrk_PtoNotActv "Power Take Off Not Active" UBYTE EcuIntgdSwGend_CM_boolean 0 0 0.0 1.0 ECU_ADDRESS 0x4000E040 /* @ECU_Address@EngBrk_PtoNotActv@ */ /end MEASUREMENT
/begin MEASUREMENT EngBrk_EnaEngBrk "Engine Brake Enable" UBYTE EcuIntgdSwGend_CM_boolean 0 0 0.0 1.0 ECU_ADDRESS 0x4000E6D8 /* @ECU_Address@EngBrk_EnaEngBrk@ */ /end MEASUREMENT
/begin MEASUREMENT EngBrk_ActvEngBrkSoln1 "Engine Brake Selenoid 1 Active" UBYTE EcuIntgdSwGend_CM_boolean 0 0 0.0 1.0 ECU_ADDRESS 0x4000E068 /* @ECU_Address@EngBrk_ActvEngBrkSoln1@ */ /end MEASUREMENT
/begin MEASUREMENT EngBrk_ActvEngBrkSoln2 "Engine Brake Selenoid 2 Active" UBYTE EcuIntgdSwGend_CM_boolean 0 0 0.0 1.0 ECU_ADDRESS 0x4000E069 /* @ECU_Address@EngBrk_ActvEngBrkSoln2@ */ /end MEASUREMENT
/begin MEASUREMENT EngBrk_ActvEngBrkCtrl "Engine Brake Control" UBYTE EcuIntgdSwGend_CM_boolean 0 0 0.0 1.0 ECU_ADDRESS 0x4000D94D /* @ECU_Address@EngBrk_ActvEngBrkCtrl@ */ /end MEASUREMENT
/begin MEASUREMENT EOP_bAcvGridHeatr "Output Processing Grid Heater Activation" UBYTE EcuIntgdSwGend_CM_boolean 0 0 0.0 1.0 ECU_ADDRESS 0x4000E822 /* @ECU_Address@EOP_bAcvGridHeatr@ */ /end MEASUREMENT
/begin MEASUREMENT EOP_RedStopLamp "Red Stop Lamp (RSL)" UBYTE EcuIntgdSwGend_CM_boolean 0 0 0.0 1.0 ECU_ADDRESS 0x4000E8E4 /* @ECU_Address@EOP_RedStopLamp@ */ /end MEASUREMENT
/begin MEASUREMENT EOP_AmberWarnLamp "Amber Warning Lamp (AWL)" UBYTE EcuIntgdSwGend_CM_boolean 0 0 0.0 1.0 ECU_ADDRESS 0x4000E0FD /* @ECU_Address@EOP_AmberWarnLamp@ */ /end MEASUREMENT
/begin MEASUREMENT EOP_ColdStrtLamp "Check System Lamp (CSL)" UBYTE EcuIntgdSwGend_CM_boolean 0 0 0.0 1.0 ECU_ADDRESS 0x4000E2DD /* @ECU_Address@EOP_ColdStrtLamp@ */ /end MEASUREMENT
/begin MEASUREMENT EOP_ActvEngBrkSoln1 "" UBYTE EcuIntgdSwGend_CM_boolean 0 0 0.0 1.0 ECU_ADDRESS 0x4000DB0C /* @ECU_Address@EOP_ActvEngBrkSoln1@ */ /end MEASUREMENT
/begin MEASUREMENT EOP_ActvEngBrkSoln2 "" UBYTE EcuIntgdSwGend_CM_boolean 0 0 0.0 1.0 ECU_ADDRESS 0x4000E266 /* @ECU_Address@EOP_ActvEngBrkSoln2@ */ /end MEASUREMENT
/begin MEASUREMENT EOP_bAcvStrtr "Output Processing Starter Activaiton" UBYTE EcuIntgdSwGend_CM_boolean 0 0 0.0 1.0 ECU_ADDRESS 0x4000E134 /* @ECU_Address@EOP_bAcvStrtr@ */ /end MEASUREMENT
/begin MEASUREMENT EMS_bTranStrtToStop "Start To Stop Mode Transition Flag Signal" UBYTE EcuIntgdSwGend_CM_boolean 0 0 0.0 1.0 ECU_ADDRESS 0x4000E0CE /* @ECU_Address@EMS_bTranStrtToStop@ */ /end MEASUREMENT
/begin MEASUREMENT EMS_bTranStopToPwrOn "Stop To Power On Mode Transition Flag Signal" UBYTE EcuIntgdSwGend_CM_boolean 0 0 0.0 1.0 ECU_ADDRESS 0x4000E1D1 /* @ECU_Address@EMS_bTranStopToPwrOn@ */ /end MEASUREMENT
/begin MEASUREMENT EMS_bTranTqToIdlespd "Torque To Idle Speed Mode Transition Flag Signal" UBYTE EcuIntgdSwGend_CM_boolean 0 0 0.0 1.0 ECU_ADDRESS 0x4000E86C /* @ECU_Address@EMS_bTranTqToIdlespd@ */ /end MEASUREMENT
/begin MEASUREMENT EMS_bTranTqToOvspd "Torque To Overspeed Mode Transition Flag Signal" UBYTE EcuIntgdSwGend_CM_boolean 0 0 0.0 1.0 ECU_ADDRESS 0x4000E73C /* @ECU_Address@EMS_bTranTqToOvspd@ */ /end MEASUREMENT
/begin MEASUREMENT EMS_bTranTqToStop "Torque To Stop Mode Transition Flag Signal" UBYTE EcuIntgdSwGend_CM_boolean 0 0 0.0 1.0 ECU_ADDRESS 0x4000E99D /* @ECU_Address@EMS_bTranTqToStop@ */ /end MEASUREMENT
/begin MEASUREMENT EMS_bTranTqToTSC1 "Torque To TSC1 Mode Transition" UBYTE EcuIntgdSwGend_CM_boolean 0 0 0.0 1.0 ECU_ADDRESS 0x4000DEFD /* @ECU_Address@EMS_bTranTqToTSC1@ */ /end MEASUREMENT
/begin MEASUREMENT EMS_bTranTSC1ToStop "TSC1 To Stop Mode Transition" UBYTE EcuIntgdSwGend_CM_boolean 0 0 0.0 1.0 ECU_ADDRESS 0x4000E14B /* @ECU_Address@EMS_bTranTSC1ToStop@ */ /end MEASUREMENT
/begin MEASUREMENT EMS_bTranTSC1ToTq "TSC1 To Torque Mode Transition" UBYTE EcuIntgdSwGend_CM_boolean 0 0 0.0 1.0 ECU_ADDRESS 0x4000E96C /* @ECU_Address@EMS_bTranTSC1ToTq@ */ /end MEASUREMENT
/begin MEASUREMENT EMS_bTranTSC1ToOvspd "TSC1 To Overspeed Mode Transition" UBYTE EcuIntgdSwGend_CM_boolean 0 0 0.0 1.0 ECU_ADDRESS 0x4000E212 /* @ECU_Address@EMS_bTranTSC1ToOvspd@ */ /end MEASUREMENT
/begin MEASUREMENT EMS_bTranTSC1ToCrsCtrl "TSC1 To Cruise Control Transition Flag" UBYTE EcuIntgdSwGend_CM_boolean 0 0 0.0 1.0 ECU_ADDRESS 0x4000E6CC /* @ECU_Address@EMS_bTranTSC1ToCrsCtrl@ */ /end MEASUREMENT
/begin MEASUREMENT EMS_bTranTqToCrsCtrl "Torque To Cruise Control Transition Flag" UBYTE EcuIntgdSwGend_CM_boolean 0 0 0.0 1.0 ECU_ADDRESS 0x4000DEFE /* @ECU_Address@EMS_bTranTqToCrsCtrl@ */ /end MEASUREMENT
/begin COMPU_METHOD EcuIntgdSwGend_CM_single_N_m "Q = V" RAT_FUNC "%8.6" "N*m" COEFFS 0 1 0 0 0 1 /end COMPU_METHOD
/begin COMPU_METHOD EcuIntgdSwGend_CM_single_rpm "Q = V" RAT_FUNC "%8.6" "rpm" COEFFS 0 1 0 0 0 1 /end COMPU_METHOD
/begin COMPU_METHOD EcuIntgdSwGend_CM_single_degC "Q = V" RAT_FUNC "%8.6" "degC" COEFFS 0 1 0 0 0 1 /end COMPU_METHOD
/begin COMPU_METHOD EcuIntgdSwGend_CM_single__ "Q = V" RAT_FUNC "%8.6" "%" COEFFS 0 1 0 0 0 1 /end COMPU_METHOD
/begin COMPU_METHOD EcuIntgdSwGend_CM_single_A "Q = V" RAT_FUNC "%8.6" "A" COEFFS 0 1 0 0 0 1 /end COMPU_METHOD
/begin COMPU_METHOD EcuIntgdSwGend_CM_single "Q = V" RAT_FUNC "%8.6" "" COEFFS 0 1 0 0 0 1 /end COMPU_METHOD
/begin COMPU_METHOD EcuIntgdSwGend_CM_single_L "Q = V" RAT_FUNC "%8.6" "L" COEFFS 0 1 0 0 0 1 /end COMPU_METHOD
/begin COMPU_METHOD EcuIntgdSwGend_CM_single_deg "Q = V" RAT_FUNC "%8.6" "deg" COEFFS 0 1 0 0 0 1 /end COMPU_METHOD
/begin COMPU_METHOD EcuIntgdSwGend_CM_single_ms "Q = V" RAT_FUNC "%8.6" "ms" COEFFS 0 1 0 0 0 1 /end COMPU_METHOD
/begin COMPU_METHOD EcuIntgdSwGend_CM_single_mbar "Q = V" RAT_FUNC "%8.6" "mbar" COEFFS 0 1 0 0 0 1 /end COMPU_METHOD
/begin COMPU_METHOD EcuIntgdSwGend_CM_single_bar "Q = V" RAT_FUNC "%8.6" "bar" COEFFS 0 1 0 0 0 1 /end COMPU_METHOD
/begin COMPU_METHOD EcuIntgdSwGend_CM_single_mm_3 "Q = V" RAT_FUNC "%8.6" "mm^3" COEFFS 0 1 0 0 0 1 /end COMPU_METHOD
/begin COMPU_METHOD EcuIntgdSwGend_CM_single_mm_3_stk "Q = V" RAT_FUNC "%8.6" "mm^3/stk" COEFFS 0 1 0 0 0 1 /end COMPU_METHOD
/begin COMPU_METHOD EcuIntgdSwGend_CM_single_V "Q = V" RAT_FUNC "%8.6" "V" COEFFS 0 1 0 0 0 1 /end COMPU_METHOD
/begin COMPU_METHOD EcuIntgdSwGend_CM_single_km_h "Q = V" RAT_FUNC "%8.6" "km/h" COEFFS 0 1 0 0 0 1 /end COMPU_METHOD
/begin COMPU_METHOD EcuIntgdSwGend_CM_single_us "Q = V" RAT_FUNC "%8.6" "us" COEFFS 0 1 0 0 0 1 /end COMPU_METHOD
/begin COMPU_METHOD EcuIntgdSwGend_CM_single_km "Q = V" RAT_FUNC "%8.6" "km" COEFFS 0 1 0 0 0 1 /end COMPU_METHOD
/begin COMPU_METHOD EcuIntgdSwGend_CM_single_h "Q = V" RAT_FUNC "%8.6" "h" COEFFS 0 1 0 0 0 1 /end COMPU_METHOD
/begin COMPU_METHOD EcuIntgdSwGend_CM_single_l_100km "Q = V" RAT_FUNC "%8.6" "l/100km" COEFFS 0 1 0 0 0 1 /end COMPU_METHOD
/begin COMPU_METHOD EcuIntgdSwGend_CM_single_L_h "Q = V" RAT_FUNC "%8.6" "L/h" COEFFS 0 1 0 0 0 1 /end COMPU_METHOD
/begin COMPU_METHOD EcuIntgdSwGend_CM_single_L_100km "Q = V" RAT_FUNC "%8.6" "L/100km" COEFFS 0 1 0 0 0 1 /end COMPU_METHOD
/begin COMPU_METHOD EcuIntgdSwGend_CM_boolean "Q = V" RAT_FUNC "%1.0" "" COEFFS 0 1 0 0 0 1 /end COMPU_METHOD
/begin COMPU_METHOD EcuIntgdSwGend_CM_int8 "Q = V" RAT_FUNC "%3.0" "" COEFFS 0 1 0 0 0 1 /end COMPU_METHOD
/begin COMPU_METHOD EcuIntgdSwGend_CM_single_L_km "Q = V" RAT_FUNC "%8.6" "L/km" COEFFS 0 1 0 0 0 1 /end COMPU_METHOD
/begin COMPU_METHOD EcuIntgdSwGend_CM_single_m "Q = V" RAT_FUNC "%8.6" "m" COEFFS 0 1 0 0 0 1 /end COMPU_METHOD
/begin COMPU_METHOD EcuIntgdSwGend_CM_single_km_L "Q = V" RAT_FUNC "%8.6" "km/L" COEFFS 0 1 0 0 0 1 /end COMPU_METHOD
/begin COMPU_METHOD EcuIntgdSwGend_CM_single_m_sec "Q = V" RAT_FUNC "%8.6" "m/sec" COEFFS 0 1 0 0 0 1 /end COMPU_METHOD
/begin COMPU_METHOD EcuIntgdSwGend_CM_SpeedLimiterMode "Enumerated data type: SpeedLimiterMode" TAB_VERB "%0.6" "" COMPU_TAB_REF VTAB_FOR_EcuIntgdSwGend_CM_SpeedLimiterMode /end COMPU_METHOD
/begin COMPU_VTAB VTAB_FOR_EcuIntgdSwGend_CM_SpeedLimiterMode "Enumerated data type: SpeedLimiterMode" TAB_VERB 4 0 "SpeedLimiterOff" 1 "SpeedLimiterIdle" 2 "SpeedLimiterOn" 3 "SpeedLimiterOnMaxSpeed" /end COMPU_VTAB
/begin GROUP S5_Start_to_Stop_Transition "EcuIntgdSwGend/ControlSoftware/EcuModSeln/Start to Stop Transition" /begin SUB_GROUP S299_Neg_Edge /end SUB_GROUP /begin REF_MEASUREMENT EMS_bTranStrtToStop /end REF_MEASUREMENT /end GROUP
/begin GROUP S5_Stop_to_Power_On_Transition "EcuIntgdSwGend/ControlSoftware/EcuModSeln/Stop to Power On Transition" /begin REF_CHARACTERISTIC EMS_DynoModOvs_P EMS_DynoModOvv_P /end REF_CHARACTERISTIC /begin REF_MEASUREMENT EMS_bTranStopToPwrOn /end REF_MEASUREMENT /end GROUP
/begin GROUP S5_TSC1_To_Torque_Transition "EcuIntgdSwGend/ControlSoftware/EcuModSeln/TSC1 To Torque Transition" /begin REF_CHARACTERISTIC EG_OvrdDis_C EG_VldInpSt_C /end REF_CHARACTERISTIC /begin REF_MEASUREMENT EMS_bTranTSC1ToTq /end REF_MEASUREMENT /end GROUP
/begin GROUP S5_TSC1_to_Cruise_Control_Transition "EcuIntgdSwGend/ControlSoftware/EcuModSeln/TSC1 to Cruise Control Transition" /begin REF_CHARACTERISTIC EG_CrsCtrlActvd_C /end REF_CHARACTERISTIC /begin REF_MEASUREMENT EMS_bTranTSC1ToCrsCtrl /end REF_MEASUREMENT /end GROUP
/begin GROUP S5_TSC1_to_Overspeed_Transition "EcuIntgdSwGend/ControlSoftware/EcuModSeln/TSC1 to Overspeed Transition" /begin REF_MEASUREMENT EMS_bTranTSC1ToOvspd /end REF_MEASUREMENT /end GROUP
/begin GROUP S5_TSC1_to_Stop_Transition "EcuIntgdSwGend/ControlSoftware/EcuModSeln/TSC1 to Stop Transition" /begin SUB_GROUP S304_Neg_Edge /end SUB_GROUP /begin REF_MEASUREMENT EMS_bTranTSC1ToStop /end REF_MEASUREMENT /end GROUP
/begin GROUP S5_Torque_to_Cruise_Control_Transition "EcuIntgdSwGend/ControlSoftware/EcuModSeln/Torque to Cruise Control Transition" /begin REF_CHARACTERISTIC EG_CrsCtrlActvd_C /end REF_CHARACTERISTIC /begin REF_MEASUREMENT EMS_bTranTqToCrsCtrl /end REF_MEASUREMENT /end GROUP
/begin GROUP S5_Torque_to_Idle_Speed_Transition "EcuIntgdSwGend/ControlSoftware/EcuModSeln/Torque to Idle Speed Transition" /begin REF_CHARACTERISTIC EMS_NEngTqtoIdleThd_P EMS_StAccrLvl0_C /end REF_CHARACTERISTIC /begin REF_MEASUREMENT EMS_bTranTqToIdlespd /end REF_MEASUREMENT /end GROUP
/begin GROUP S5_Torque_to_Overspeed_Transition "EcuIntgdSwGend/ControlSoftware/EcuModSeln/Torque to Overspeed Transition" /begin REF_MEASUREMENT EMS_bTranTqToOvspd /end REF_MEASUREMENT /end GROUP
/begin GROUP S5_Torque_to_Stop_Transition "EcuIntgdSwGend/ControlSoftware/EcuModSeln/Torque to Stop Transition" /begin SUB_GROUP S308_Neg_Edge /end SUB_GROUP /begin REF_MEASUREMENT EMS_bTranTqToStop /end REF_MEASUREMENT /end GROUP
/begin GROUP S5_Torque_to_TSC1_Transition "EcuIntgdSwGend/ControlSoftware/EcuModSeln/Torque to TSC1 Transition"
 /begin REF_CHARACTERISTIC EG_TSC1SpdCtrlMod_C EG_TSC1TqCtrlMod_C EG_TSC1TqSpdLimMod_C EG_VldInpSt_C /end REF_CHARACTERISTIC
 /begin REF_MEASUREMENT EMS_bTranTqToTSC1 /end REF_MEASUREMENT
/end GROUP
/begin GROUP S6_AuxiliaryOutputs "EcuIntgdSwGend/ControlSoftware/EcuOutpPrcsg/AuxiliaryOutputs" /begin REF_CHARACTERISTIC EOP_bAcvGridHeatrOvs_P EOP_bAcvGridHeatrOvv_P /end REF_CHARACTERISTIC /begin REF_MEASUREMENT EOP_bAcvGridHeatr /end REF_MEASUREMENT /end GROUP
/begin GROUP S6_CAN_Signals "EcuIntgdSwGend/ControlSoftware/EcuOutpPrcsg/CAN Signals"
 /begin SUB_GROUP 0 S318_SPN_100___Engine_Oil_Pressure S318_SPN_102___Engine_Intake_Manifold_1_Pressure S318_SPN_105___Engine_Intake_Manifold_1_Temperature S318_SPN_1081___Engine_Wait_to_Start_Lamp S318_SPN_108___Barometric_Pressure S318_SPN_1136___Engine_ECU_Temperature S318_SPN_1188___Engine_Turbocharger_Wastegate_Actuator_1_Position S318_SPN_1237___Engine_Shutdown_Override_Switch S318_SPN_1436___Engine_Actual_Ignition_Timing S318_SPN_157___Engine_Injector_Metering_Rail_1_Pressure S318_SPN_1636___Engine_Intake_Manifold_1_Air_Temperature__High_Resolution_ S318_SPN_1637___Engine_Coolant_Temperature__High_Resolution_ S318_SPN_166___Engine_Rated_Power S318_SPN_1675___Engine_Starter_Mode S318_SPN_168___Battery_Potential____Power_Input_1 S318_SPN_1715___Drivers_Demand_Retarder___Percent_Torque S318_SPN_1717___Actual_Maximum_Available_Retarder___Percent_Torque S318_SPN_171___Ambient_Air_Temperature S318_SPN_174___Engine_Fuel_Temperature_1 S318_SPN_175___Engine_Oil_Temperature_1 S318_SPN_183___Engine_Fuel_Rate S318_SPN_1846___Engine_Default_Torque_Limit S318_SPN_188___Engine_Speed_At_Idle__Point_1 S318_SPN_189___Engine_Rated_Speed S318_SPN_190___Engine_Speed S318_SPN_2432___Engine_Demand___Percent_Torque S318_SPN_247___Engine_Total_Hours_of_Operation S318_SPN_250___Engine_Total_Fuel_Used S318_SPN_2978___Estimated_Engine_Parasitic_Losses___Percent_Torque S318_SPN_2979___Vehicle_Acceleration_Rate_Limit_Status S318_SPN_3543___Engine_Operating_State S318_SPN_4154___Actual_Engine___Percent_Torque_High_Resolution S318_SPN_5078___Engine_Amber_Warning_Lamp_Command S318_SPN_5079___Engine_Red_Stop_Lamp_Command S318_SPN_5081___Engine_Brake_Active_Lamp_Command S318_SPN_513___Actual_Engine___Percent_Torque S318_SPN_514___Nominal_Friction___Percent_Torque S318_SPN_520___Actual_Retarder___Percent_Torque S318_SPN_527___Cruise_Control_States S318_SPN_528___Engine_Speed_At_Point_2 S318_SPN_529___Engine_Speed_At_Point_3 S318_SPN_530___Engine_Speed_At_Point_4 S318_SPN_531___Engine_Speed_At_Point_5 S318_SPN_532___Engine_Speed_At_High_Idle__Point_6 S318_SPN_533___Engine_Maximum_Momentary_Override_Speed__Point_7 S318_SPN_539___Engine_Percent_Torque_At_Idle__Point_1 S318_SPN_540___Engine_Percent_Torque_At_Point_2 S318_SPN_541___Engine_Percent_Torque_At_Point_3 S318_SPN_542___Engine_Percent_Torque_At_Point_4 S318_SPN_543___Engine_Percent_Torque_At_Point_5 S318_SPN_544___Engine_Reference_Torque S318_SPN_556___Reference_Retarder_Torque__Retarder_Configuration_ S318_SPN_558___Accelerator_Pedal_1_Low_Idle_Switch S318_SPN_595___Cruise_Control_Active S318_SPN_596___Cruise_Control_Enable_Switch S318_SPN_597___Brake_Switch S318_SPN_599___Cruise_Control_Set_Switch S318_SPN_600___Cruise_Control_Coast__Decelerate__Switch S318_SPN_601___Cruise_Control_Resume_Switch S318_SPN_602___Cruise_Control_Accelerate_Switch S318_SPN_623___Red_Stop_Lamp S318_SPN_624___Amber_Warning_Lamp S318_SPN_70___Parking_Brake_Switch S318_SPN_84___Wheel_Based_Vehicle_Speed S318_SPN_86___Cruise_Control_Set_Speed S318_SPN_899___Engine_Torque_Mode S318_SPN_91___Accelerator_Pedal_Position_1 S318_SPN_92___Engine_Percent_Load_At_Current_Speed S318_SPN_94___Engine_Fuel_Delivery_Pressure S318_SPN_976___PTO_Governor_State S318_SPN_97___Water_In_Fuel_Indicator S318_SPN_98___Engine_Oil_Level /end SUB_GROUP
/end GROUP
/begin GROUP S6_Digital_Output "EcuIntgdSwGend/ControlSoftware/EcuOutpPrcsg/Digital Output"
 /begin REF_CHARACTERISTIC EOP_ActvEngBrkSoln1Ovs_P EOP_ActvEngBrkSoln1Ovv_P EOP_ActvEngBrkSoln2Ovs_P EOP_ActvEngBrkSoln2Ovv_P EOP_AmberWarnLampOvs_P EOP_AmberWarnLampOvv_P EOP_ColdStrtLampOvs_P EOP_ColdStrtLampOvv_P EOP_RedStopLampOvs_P EOP_RedStopLampOvv_P /end REF_CHARACTERISTIC
 /begin REF_MEASUREMENT EOP_ActvEngBrkSoln1 EOP_ActvEngBrkSoln2 EOP_AmberWarnLamp EOP_ColdStrtLamp EOP_RedStopLamp /end REF_MEASUREMENT
/end GROUP
/begin GROUP S6_InjectionOutputs "EcuIntgdSwGend/ControlSoftware/EcuOutpPrcsg/InjectionOutputs"
 /begin REF_CHARACTERISTIC EOP_DurMaiInj1Ovs_P EOP_DurMaiInj1Ovv_P EOP_DurMaiInj2Ovs_P EOP_DurMaiInj2Ovv_P EOP_DurMaiInj3Ovs_P EOP_DurMaiInj3Ovv_P EOP_DurMaiInj4Ovs_P EOP_DurMaiInj4Ovv_P EOP_DurMaiInj5Ovs_P EOP_DurMaiInj5Ovv_P EOP_DurMaiInj6Ovs_P EOP_DurMaiInj6Ovv_P EOP_DurPltInj1Ovs_P EOP_DurPltInj1Ovv_P EOP_DurPltInj2Ovs_P EOP_DurPltInj2Ovv_P EOP_DurPltInj3Ovs_P EOP_DurPltInj3Ovv_P EOP_DurPltInj4Ovs_P EOP_DurPltInj4Ovv_P EOP_DurPltInj5Ovs_P EOP_DurPltInj5Ovv_P EOP_DurPltInj6Ovs_P EOP_DurPltInj6Ovv_P EOP_SoiMaiInj1Ovs_P EOP_SoiMaiInj1Ovv_P EOP_SoiMaiInj2Ovs_P EOP_SoiMaiInj2Ovv_P EOP_SoiMaiInj3Ovs_P EOP_SoiMaiInj3Ovv_P EOP_SoiMaiInj4Ovs_P EOP_SoiMaiInj4Ovv_P EOP_SoiMaiInj5Ovs_P EOP_SoiMaiInj5Ovv_P EOP_SoiMaiInj6Ovs_P EOP_SoiMaiInj6Ovv_P EOP_SoiPltInj1Ovs_P EOP_SoiPltInj1Ovv_P EOP_SoiPltInj2Ovs_P EOP_SoiPltInj2Ovv_P EOP_SoiPltInj3Ovs_P EOP_SoiPltInj3Ovv_P EOP_SoiPltInj4Ovs_P EOP_SoiPltInj4Ovv_P EOP_SoiPltInj5Ovs_P EOP_SoiPltInj5Ovv_P EOP_SoiPltInj6Ovs_P EOP_SoiPltInj6Ovv_P /end REF_CHARACTERISTIC
 /begin REF_MEASUREMENT EOP_DurMaiInj1 EOP_DurMaiInj2 EOP_DurMaiInj3 EOP_DurMaiInj4 EOP_DurMaiInj5 EOP_DurMaiInj6 EOP_DurPltInj1 EOP_DurPltInj2 EOP_DurPltInj3 EOP_DurPltInj4 EOP_DurPltInj5 EOP_DurPltInj6 EOP_SoiMaiInj1 EOP_SoiMaiInj2 EOP_SoiMaiInj3 EOP_SoiMaiInj4 EOP_SoiMaiInj5 EOP_SoiMaiInj6 EOP_SoiPltInj1 EOP_SoiPltInj2 EOP_SoiPltInj3 EOP_SoiPltInj4 EOP_SoiPltInj5 EOP_SoiPltInj6 /end REF_MEASUREMENT
/end GROUP
/begin GROUP S6_NvM_Signals_to_BSW "EcuIntgdSwGend/ControlSoftware/EcuOutpPrcsg/NvM Signals to BSW"
 /begin REF_CHARACTERISTIC EOP_DstTrvldInKmOvs_P EOP_DstTrvldInKmOvv_P EOP_EngDftTqLimOvs_P EOP_EngDftTqLimOvv_P EOP_EngHrOvs_P EOP_EngHrOvv_P EOP_FuCnsOvs_P EOP_FuCnsOvv_P EOP_TripOvs_P EOP_TripOvv_P /end REF_CHARACTERISTIC
 /begin REF_MEASUREMENT EOP_DstTrvldInKm EOP_EngDftTqLim EOP_EngHr EOP_FuCns EOP_Trip /end REF_MEASUREMENT
/end GROUP
/begin GROUP S6_Starter_Digital_Output "EcuIntgdSwGend/ControlSoftware/EcuOutpPrcsg/Starter Digital Output" /begin REF_CHARACTERISTIC EOP_bAcvStrtrOvs_P EOP_bAcvStrtrOvv_P /end REF_CHARACTERISTIC /begin REF_MEASUREMENT EOP_bAcvStrtr /end REF_MEASUREMENT /end GROUP
/begin GROUP S6_ValveOutputs "EcuIntgdSwGend/ControlSoftware/EcuOutpPrcsg/ValveOutputs"
 /begin REF_CHARACTERISTIC EG_NmrSng0_C EOP_DutyVlvReqOvs_P EOP_DutyVlvReqOvv_P EOP_DynRateVCVActvnSwt_P EOP_DynRateVCVLoLim_P EOP_DynRateVCVUpLim_P EOP_IRefPCVOvs_P EOP_IRefPCVOvv_P EOP_IRefPCV_M EOP_IRefVCV_M EOP_IVCVReqOvs_P EOP_IVCVReqOvv_P /end REF_CHARACTERISTIC
 /begin REF_MEASUREMENT EOP_DutyVlvReq EOP_IRefPCV EOP_IRefVCV EOP_VCVDynRateLimr EOP_VCVReq /end REF_MEASUREMENT
/end GROUP
/begin GROUP S7_Can_Message_and_Hardware_Check "EcuIntgdSwGend/ControlSoftware/EngBrk/Can Message and Hardware Check"
 /begin REF_CHARACTERISTIC EG_EngBrkLvl100Perc_C EG_EngBrkLvl1_C EG_EngBrkLvl2_C EG_EngBrkLvl50Perc_C EG_VldInpSt_C EngBrk_ActvEngBrkFromCan_P EngBrk_EngBrkLvl1_C EngBrk_EngBrkLvl2_C /end REF_CHARACTERISTIC
 /begin REF_MEASUREMENT EngBrk_ActvEngBrkLvl1 EngBrk_ActvEngBrkLvl2 /end REF_MEASUREMENT
/end GROUP
/begin GROUP S7_Enable_Conditionals "EcuIntgdSwGend/ControlSoftware/EngBrk/Enable Conditionals" /begin SUB_GROUP S425_Hysteresis_Switch /end SUB_GROUP
 /begin REF_CHARACTERISTIC EngBrk_NEngActvThd_P EngBrk_NEngDeacThd_P EngBrk_NEngEnaSwt_C EngBrk_PAirBoostMaxThd_P EngBrk_PercgAccrThd_P EngBrk_VehVMinThd_P /end REF_CHARACTERISTIC
 /begin REF_MEASUREMENT EngBrk_EnaEngBrk /end REF_MEASUREMENT
/end GROUP
/begin GROUP S7_Engine_Brake_Active "EcuIntgdSwGend/ControlSoftware/EngBrk/Engine Brake Active" /begin REF_CHARACTERISTIC EngBrk_EngBrkLvl1NotActv_C EngBrk_EngBrkLvl2NotActv_C /end REF_CHARACTERISTIC
 /begin REF_MEASUREMENT EngBrk_ActvEngBrkCtrl EngBrk_ActvEngBrkSoln1 EngBrk_ActvEngBrkSoln2 /end REF_MEASUREMENT
/end GROUP
/begin GROUP S7_Engine_Brake_CAN_Signals "EcuIntgdSwGend/ControlSoftware/EngBrk/Engine Brake CAN Signals"
 /begin SUB_GROUP S427_If_Action_Subsystem S427_If_Action_Subsystem1 S427_If_Action_Subsystem2 S427_saturation1 /end SUB_GROUP
 /begin REF_CHARACTERISTIC EG_NmrSng100_C EngBrk_ActEngBrkTq_M EngBrk_EngBrkPercTqLoLim_P EngBrk_EngBrkPercTqUpLim_P EngBrk_EngBrkSoln1Actvd_C EngBrk_EngBrkSoln2Actvd_C EngBrk_EngBrkTqMax_M EngBrk_EngBrkTqMin_P EngBrk_RefEngBrkTq_P /end REF_CHARACTERISTIC
 /begin REF_MEASUREMENT EngBrk_ActEngBrkPercTq EngBrk_ActEngBrkTq EngBrk_ActMaxAvlEngBrkPercTq EngBrk_DrvrBrkLvrPosn EngBrk_DrvrDmdEngBrkTq EngBrk_RefEngBrkTq /end REF_MEASUREMENT
/end GROUP
/begin GROUP S7_For_Calibration "EcuIntgdSwGend/ControlSoftware/EngBrk/For Calibration"
 /begin REF_CHARACTERISTIC EG_VldInpSt_C EngBrk_ActvTrsmLockUpEngd_C EngBrk_BrkPedlActv_C EngBrk_BrkPedlEvln_P EngBrk_BrkPedlNotActv_C EngBrk_CanABSActv_C EngBrk_CanABSAcvEvln_P EngBrk_CanABSNotActv_C EngBrk_IdxGearNeut_C EngBrk_IdxGearNotNeut_C EngBrk_PtoNotActv_C EngBrk_TrsmCurrentGearEvln_P EngBrk_TrsmLockUpEngdEvln_P EngBrk_TrsmLockUpEngd_C /end REF_CHARACTERISTIC
 /begin REF_MEASUREMENT EngBrk_ActvBrkPedl EngBrk_ActvCanABS EngBrk_ActvTrsmLockUpEngd EngBrk_PtoNotActv EngBrk_TrsmCurrentGearNotNeut /end REF_MEASUREMENT
/end GROUP
/begin GROUP S8_Calibration_Purpose "EcuIntgdSwGend/ControlSoftware/InjCtl/Calibration Purpose"
 /begin REF_CHARACTERISTIC IC_MMaiFuQntyCorrdOvs_P IC_MMaiFuQntyCorrdOvv_P IC_MMaiLimdHi_P IC_MMaiLimdLo_P IC_MPltFuQntyCorrdOvs_P IC_MPltFuQntyCorrdOvv_P IC_MPltLimdHi_P IC_MPltLimdLo_P /end REF_CHARACTERISTIC
 /begin REF_MEASUREMENT IC_MMaiFuQntyCorrd IC_MPltFuQntyCorrd /end REF_MEASUREMENT
/end GROUP
/begin GROUP S8_Cylinder_1 "EcuIntgdSwGend/ControlSoftware/InjCtl/Cylinder 1" /begin REF_MEASUREMENT IC_MMaiFuQntyCorrdCyl1 /end REF_MEASUREMENT /end GROUP
/begin GROUP S8_Cylinder_2 "EcuIntgdSwGend/ControlSoftware/InjCtl/Cylinder 2" /begin REF_MEASUREMENT IC_MMaiFuQntyCorrdCyl2 /end REF_MEASUREMENT /end GROUP
/begin GROUP S8_Cylinder_3 "EcuIntgdSwGend/ControlSoftware/InjCtl/Cylinder 3" /begin REF_MEASUREMENT IC_MMaiFuQntyCorrdCyl3 /end REF_MEASUREMENT /end GROUP
/begin GROUP S8_Cylinder_4 "EcuIntgdSwGend/ControlSoftware/InjCtl/Cylinder 4" /begin REF_MEASUREMENT IC_MMaiFuQntyCorrdCyl4 /end REF_MEASUREMENT /end GROUP
/begin GROUP S8_Cylinder_5 "EcuIntgdSwGend/ControlSoftware/InjCtl/Cylinder 5" /begin REF_MEASUREMENT IC_MMaiFuQntyCorrdCyl5 /end REF_MEASUREMENT /end GROUP
/begin GROUP S8_Cylinder_6 "EcuIntgdSwGend/ControlSoftware/InjCtl/Cylinder 6" /begin REF_MEASUREMENT IC_MMaiFuQntyCorrdCyl6 /end REF_MEASUREMENT /end GROUP
/begin GROUP S8_Cylinder_Balancing "EcuIntgdSwGend/ControlSoftware/InjCtl/Cylinder Balancing"
 /begin SUB_GROUP S442_Cylinder_Balancing_For_Cylinder_1 S442_Cylinder_Balancing_For_Cylinder_2 S442_Cylinder_Balancing_For_Cylinder_3 S442_Cylinder_Balancing_For_Cylinder_4 S442_Cylinder_Balancing_For_Cylinder_5 S442_Cylinder_Balancing_For_Cylinder_6 S442_Cylinder_Balancing_PID_Controllers_ /end SUB_GROUP
 /begin REF_CHARACTERISTIC EG_NmrSng1_C /end REF_CHARACTERISTIC
/end GROUP
/begin GROUP S8_Fuel_Consumption_Calculation "EcuIntgdSwGend/ControlSoftware/InjCtl/Fuel Consumption Calculation"
 /begin SUB_GROUP S443_LowPassFilter S443_LowPassFilter1 S443_LowPassFilter2 S443_avoidzerodivision_single3 S443_avoidzerodivision_single4 S443_avoidzerodivision_single5 /end SUB_GROUP
 /begin REF_CHARACTERISTIC EG_NmrSng0_C EG_NmrSng1_C EG_TsSw_C IC_CnvnHtoSec_P IC_CnvnInstFuCnsLtPerHourToSec_P IC_CnvnKmtoM_C IC_CnvnMTotFuQntyCorrdToInstFuCnsLtPerHour_P IC_CnvnMtoKm_C IC_DstToEmptyOvs_P IC_DstToEmptyOvv_P IC_FuCnsAveOvs_P IC_FuCnsAveOvv_P IC_FuCnsOvs_P IC_FuCnsOvv_P IC_FuInTank_M IC_HundKm_C IC_IntglRst_P IC_PercgAccrForFuCns_P IC_TcDstToEmptyFil_P IC_TcFuCnsAveFil_P IC_TcFuCnsFil_P IC_VehVThdForFuCns_P /end REF_CHARACTERISTIC
 /begin REF_MEASUREMENT IC_CnvnDstMtoKm IC_CnvnInstFuCnsLtPerHourToSec IC_CnvnKmHtoMSec IC_CnvnKmtoM IC_DstCalcn IC_DstToEmpty IC_FuCns IC_FuCnsAve IC_FuInTank IC_InstFuCnsLtPerHour IC_InstFuCnsLtPerHundKm IC_InstLtPerKm IC_KmPerLt IC_LtPerKm IC_Trip /end REF_MEASUREMENT
/end GROUP
/begin GROUP S8_Main_Injector_Characteristic_Maps "EcuIntgdSwGend/ControlSoftware/InjCtl/Main Injector Characteristic Maps"
 /begin SUB_GROUP S445_Injector_1_Characteristic S445_Injector_1_Characteristic_Calibration_ S445_Injector_2_Characteristic S445_Injector_2_Characteristic_Calibration_ S445_Injector_3_Characteristic S445_Injector_3_Characteristic_Calibration_ S445_Injector_4_Characteristic S445_Injector_4_Characteristic_Calibration_ S445_Injector_5_Characteristic S445_Injector_5_Characteristic_Calibration_ S445_Injector_6_Characteristic S445_Injector_6_Characteristic_Calibration /end SUB_GROUP
 /begin REF_CHARACTERISTIC IC_DurMaiCyl1BalOvs_P IC_DurMaiCyl1BalOvv_P IC_DurMaiCyl2BalOvs_P IC_DurMaiCyl2BalOvv_P IC_DurMaiCyl3BalOvs_P IC_DurMaiCyl3BalOvv_P IC_DurMaiCyl4BalOvs_P IC_DurMaiCyl4BalOvv_P IC_DurMaiCyl5BalOvs_P IC_DurMaiCyl5BalOvv_P IC_DurMaiCyl6BalOvs_P IC_DurMaiCyl6BalOvv_P IC_DurMaiLimdHi_P IC_DurMaiLimdLo_P IC_NoInjCodeForInj1_P IC_NoInjCodeForInj2_P IC_NoInjCodeForInj3_P IC_NoInjCodeForInj4_P IC_NoInjCodeForInj5_P IC_NoInjCodeForInj6_P /end REF_CHARACTERISTIC
 /begin REF_MEASUREMENT IC_DurMaiInjCyl1 IC_DurMaiInjCyl2 IC_DurMaiInjCyl3 IC_DurMaiInjCyl4 IC_DurMaiInjCyl5 IC_DurMaiInjCyl6 /end REF_MEASUREMENT
/end GROUP
/begin GROUP S8_Pilot_Injector_Characteristic_Maps "EcuIntgdSwGend/ControlSoftware/InjCtl/Pilot Injector Characteristic Maps"
 /begin SUB_GROUP S446_Duration_Injection_1_Pre S446_Duration_Injection_2_Pre S446_Duration_Injection_3_Pre S446_Duration_Injection_4_Pre S446_Duration_Injection_5_Pre S446_Duration_Injection_6_Pre S446__Injector_1_Characteristic S446__Injector_1_Characteristic_Calibration S446__Injector_2_Characteristic S446__Injector_2_Characteristic_Calibration S446__Injector_3_Characteristic S446__Injector_3_Characteristic_Calibration S446__Injector_4_Characteristic S446__Injector_4_Characteristic_Calibration S446__Injector_5_Characteristic S446__Injector_5_Characteristic_Calibration S446__Injector_6_Characteristic S446__Injector_6_Characteristic_Calibration /end SUB_GROUP
 /begin REF_CHARACTERISTIC EG_NmrSng0_C IC_DurPltInj1PreOvs_P IC_DurPltInj1PreOvv_P IC_DurPltInj2PreOvs_P IC_DurPltInj2PreOvv_P IC_DurPltInj3PreOvs_P IC_DurPltInj3PreOvv_P IC_DurPltInj4PreOvs_P IC_DurPltInj4PreOvv_P IC_DurPltInj5PreOvs_P IC_DurPltInj5PreOvv_P IC_DurPltInj6PreOvs_P IC_DurPltInj6PreOvv_P IC_DurPltLimdHi_P IC_DurPltLimdLo_P IC_NoInjCodeForInj1_P IC_NoInjCodeForInj2_P IC_NoInjCodeForInj3_P IC_NoInjCodeForInj4_P IC_NoInjCodeForInj5_P IC_NoInjCodeForInj6_P /end REF_CHARACTERISTIC
 /begin REF_MEASUREMENT IC_MaxDurPltInjPre /end REF_MEASUREMENT
/end GROUP
/begin GROUP S8_Pre_Injection_Shadowing "EcuIntgdSwGend/ControlSoftware/InjCtl/Pre Injection Shadowing"
 /begin REF_CHARACTERISTIC EG_CnvRpm2SecPerDeg_C EG_CnvnFromMicrosToSec_C IC_OfsPlt2MaiInj_M IC_bAcvPltAllwdOvs_P IC_bAcvPltAllwdOvv_P /end REF_CHARACTERISTIC
 /begin REF_MEASUREMENT IC_DegPltInj IC_SoiPltInjForPltAllwd IC_bAcvPltAllwd /end REF_MEASUREMENT
/end GROUP
/begin GROUP S8_Start_of_Injection_Angle_for_Pilot_and_Main_Injection "EcuIntgdSwGend/ControlSoftware/InjCtl/Start of Injection Angle for Pilot and Main Injection"
 /begin SUB_GROUP S448_Main_SOI_Reference_Calculation S448_Pilot_SOI_Reference_Calculation /end SUB_GROUP
/end GROUP
/begin GROUP S9_Grid_Heater_Activation "EcuIntgdSwGend/ControlSoftware/PrhtgCtl/Grid Heater Activation" /begin SUB_GROUP S578_SetRstLtch /end SUB_GROUP
 /begin REF_CHARACTERISTIC PHC_NmrSng0_C PHC_bAcvGridHeatrOvs_P PHC_bAcvGridHeatrOvv_P /end REF_CHARACTERISTIC
 /begin REF_MEASUREMENT PHC_bAcvGridHeatr /end REF_MEASUREMENT
/end GROUP
/begin GROUP S9_Grid_Heater_Activation_After_Starter "EcuIntgdSwGend/ControlSoftware/PrhtgCtl/Grid Heater Activation After Starter"
 /begin SUB_GROUP S579_CompRstTmr S579_Neg_Edge S579_Pos_Edge S579_SetRstLtch /end SUB_GROUP
 /begin REF_CHARACTERISTIC EG_NmrSng0_C EG_TsSw_C PHC_NEngPostAcvnGridHeatr_P PHC_StUsrForTiPreHeatg_P PHC_TiAcvnGridHeatr_M PHC_TiAftrAcvnGridHeatrForSnsrErr_P PHC_bAcvPostGridHeatrOvs_P PHC_bAcvPostGridHeatrOvv_P /end REF_CHARACTERISTIC
 /begin REF_MEASUREMENT PHC_TiMaxAftrStrtr PHC_TiTCooltPreHeatrCorr PHC_bAcvPostAcvnGridHeatr PHC_bAcvPostAcvnGridHeatrTiEna /end REF_MEASUREMENT
/end GROUP
/begin GROUP S9_Grid_Heater_Activation_Before_Starter "EcuIntgdSwGend/ControlSoftware/PrhtgCtl/Grid Heater Activation Before Starter"
 /begin SUB_GROUP S580_CompRstTmr S580_Neg_Edge1 S580_Neg_Edge2 S580_Pos_Edge S580_SetRstLtch /end SUB_GROUP
 /begin REF_CHARACTERISTIC EG_NmrSng0_C EG_TsSw_C PHC_StUsrForTiPreHeatg_P PHC_TiPreAcvnGridHeatrForSnsrErr_P PHC_TiPreHeatg_M PHC_bAcvPreAcvnGridHeatrOvs_P PHC_bAcvPreAcvnGridHeatrOvv_P /end REF_CHARACTERISTIC
 /begin REF_MEASUREMENT PHC_TiMaxBfrStrtr PHC_TiPreHeatg PHC_bAcvPreAcvnGridHeatr PHC_bAcvPreAcvnGridHeatrTiEna PHC_bTiDisaPreAcvnGridHeatr /end REF_MEASUREMENT
/end GROUP
/begin GROUP S9_Grid_Heater_Fault "EcuIntgdSwGend/ControlSoftware/PrhtgCtl/Grid Heater Fault"
 /begin SUB_GROUP S581_Debouncer S581_Debouncer1 S581_SetRstLtch1 S581_SetRstLtch2 /end SUB_GROUP
 /begin REF_CHARACTERISTIC EG_NmrSng0_C EG_TsSw_C PHC_GridHeatrRlyFbOffStsThd_P PHC_GridHeatrRlyFbOnStsThd_P PHC_TiGridHeatErrOfStsDeb_P PHC_TiGridHeatErrOnStsDeb_P PHC_bErrAcvGridHeatrOvs_P PHC_bErrAcvGridHeatrOvv_P /end REF_CHARACTERISTIC
 /begin REF_MEASUREMENT PHC_bErrAcvGridHeatr /end REF_MEASUREMENT
/end GROUP
/begin GROUP S10_Cabin_PTO "EcuIntgdSwGend/ControlSoftware/PtoCtrl/Cabin PTO"
 /begin REF_CHARACTERISTIC EG_TsSw_C EG_bFlgFalse_C EG_bFlgTrue_C PtoCtrl_HndBrkPrkgActv_C PtoCtrl_IdxGearNeut_C PtoCtrl_LongPsdTiThd_P PtoCtrl_LowrNEngThdForCabPto_P PtoCtrl_LowrVehVForCabPto_P PtoCtrl_NEngForCabPto_P PtoCtrl_NEngLongPsd_P PtoCtrl_NEngMaxSpd_P PtoCtrl_NEngShoPsd_P PtoCtrl_ShoPsdTiThd_P PtoCtrl_UpprNEngThdForCabPto_P PtoCtrl_UpprVehVForCabPto_P PtoCtrl_bAcvCabPtoOvs_P PtoCtrl_bAcvCabPtoOvv_P PtoCtrl_bAcvHndBrkPrkg_P PtoCtrl_bAcvTrsmCurrentGear_P /end REF_CHARACTERISTIC
 /begin REF_MEASUREMENT PtoCtrl_HndBrkPrkg PtoCtrl_NEngTargetSpd PtoCtrl_TrsmCurrentGear PtoCtrl_bAcvCabPto /end REF_MEASUREMENT
/end GROUP
/begin GROUP S10_Can_Message_and_Hardware_Check "EcuIntgdSwGend/ControlSoftware/PtoCtrl/Can Message and Hardware Check"
 /begin REF_CHARACTERISTIC EG_VldInpSt_C PtoCtrl_ActvCanEngPtoGovrAccrSwt_C PtoCtrl_ActvCanEngPtoGovrCoastSwt_C PtoCtrl_ActvCanEngPtoGovrEnaSwt_C PtoCtrl_ActvCanEngRemPtoGovrProgdSpdCtrlSwt_C PtoCtrl_bAcvCabPtoCanOrDigInpOvs_P /end REF_CHARACTERISTIC
 /begin REF_MEASUREMENT PtoCtrl_bAcvCabPtoAccrSwt PtoCtrl_bAcvCabPtoCoastSwt PtoCtrl_bAcvCabPtoOnOff PtoCtrl_bAcvRemPtoAccrSwt PtoCtrl_bAcvRemPtoCoastSwt PtoCtrl_bAcvRemPtoSpdCtrlSwt PtoCtrl_bErrCabPtoAccrSwt PtoCtrl_bErrCabPtoCoastSwt PtoCtrl_bErrCabPtoOnOff PtoCtrl_bErrRemPtoAccrSwt PtoCtrl_bErrRemPtoCoastSwt PtoCtrl_bErrRemPtoSpdCtrlSwt /end REF_MEASUREMENT
/end GROUP
/begin GROUP S10_PTO_Governor_State "EcuIntgdSwGend/ControlSoftware/PtoCtrl/PTO Governor State" /begin REF_CHARACTERISTIC PtoCtrl_NotAvlAcv_P /end REF_CHARACTERISTIC /begin REF_MEASUREMENT PtoCtrl_CanPtoGovrSt /end REF_MEASUREMENT /end GROUP
/begin GROUP S10_PTO_PID "EcuIntgdSwGend/ControlSoftware/PtoCtrl/PTO PID" /begin SUB_GROUP S599_PID_Controller /end SUB_GROUP
 /begin REF_CHARACTERISTIC PtoCtrl_CoeffDForPto_M PtoCtrl_CoeffFiltForPto_M PtoCtrl_CoeffIForPto_M PtoCtrl_CoeffPForPto_M PtoCtrl_FacSclPIDCoeff_P PtoCtrl_PIDCoeffDOvs_P PtoCtrl_PIDCoeffDOvv_P PtoCtrl_PIDCoeffFiltOvs_P PtoCtrl_PIDCoeffFiltOvv_P PtoCtrl_PIDCoeffIOvs_P PtoCtrl_PIDCoeffIOvv_P PtoCtrl_PIDCoeffPOvs_P PtoCtrl_PIDCoeffPOvv_P PtoCtrl_PIDMaxForCabPto_P PtoCtrl_PIDMaxForRemPto_P PtoCtrl_PIDMinForCabPto_P PtoCtrl_PIDMinForRemPto_P PtoCtrl_PtoCtrlFF_M /end REF_CHARACTERISTIC
 /begin REF_MEASUREMENT PtoCtrl_CoeffDMapOut PtoCtrl_CoeffFiltMapOut PtoCtrl_CoeffIMapOut PtoCtrl_CoeffPMapOut PtoCtrl_ErrNEngRef PtoCtrl_PIDCoeffD PtoCtrl_PIDCoeffFilt PtoCtrl_PIDCoeffI PtoCtrl_PIDCoeffP PtoCtrl_PIDMax PtoCtrl_PIDMin PtoCtrl_PtoCtrlFF /end REF_MEASUREMENT
/end GROUP
/begin GROUP S10_Remote_PTO "EcuIntgdSwGend/ControlSoftware/PtoCtrl/Remote PTO" /begin SUB_GROUP S601_Pos_Edge3 /end SUB_GROUP
 /begin REF_CHARACTERISTIC EG_bFlgFalse_C EG_bFlgTrue_C PtoCtrl_HndBrkPrkgActv_C PtoCtrl_IdxGearNeut_C PtoCtrl_LowrNEngThdForRemPto_P PtoCtrl_LowrVehVForRemPto_P PtoCtrl_NEngSetSpd1_P PtoCtrl_NEngSetSpd2_P PtoCtrl_NEngSetSpd3_P PtoCtrl_NEngSetSpd4_P PtoCtrl_NEngSetSpd5_P PtoCtrl_UpprNEngThdForRemPto_P PtoCtrl_UpprVehVForRemPto_P PtoCtrl_bAcvHndBrkPrkgForRemPto_P PtoCtrl_bAcvRemPtoOvs_P PtoCtrl_bAcvRemPtoOvv_P PtoCtrl_bAcvTrsmCurrentGearForRemPto_P /end REF_CHARACTERISTIC
 /begin REF_MEASUREMENT PtoCtrl_HndBrkPrkgForRemPto PtoCtrl_NEngTargetSpdRemPto PtoCtrl_StTargetSpdForPtoGovr PtoCtrl_TrsmCurrentGearForRemPto PtoCtrl_bAcvRemPto /end REF_MEASUREMENT
/end GROUP
/begin GROUP S11_Pressure_Control_Valve "EcuIntgdSwGend/ControlSoftware/RailPGovr/Pressure Control Valve"
 /begin REF_CHARACTERISTIC RPG_OfsPRailRefForPCV_P RPG_PRailRefForPCVOvs_P RPG_PRailRefForPCVOvv_P RPG_PRailRefForPCVPwrOnCtlMod_P RPG_PRailRefForPCVStpCtlMod_P /end REF_CHARACTERISTIC
 /begin REF_MEASUREMENT RPG_PRailRefForPCV /end REF_MEASUREMENT
/end GROUP
/begin GROUP S11_Rail_Pressure_Control_FeedForward_Map_ "EcuIntgdSwGend/ControlSoftware/RailPGovr/Rail Pressure Control FeedForward Map "
 /begin SUB_GROUP S613_avoidzerodivision_single S613_avoidzerodivision_single1 /end SUB_GROUP
 /begin REF_CHARACTERISTIC RPG_FFLeakgSetPointOvs_P RPG_FFLeakgSetPointOvv_P RPG_PercgVolCtrlVlvFFLeakg1_M RPG_PercgVolCtrlVlvFFLeakg2_M RPG_PercgVolCtrlVlvFFLeakg3_M RPG_TCooltFFLeakgMap1Thd_P RPG_TCooltFFLeakgMap2Thd_P RPG_TCooltFFLeakgMap3Thd_P /end REF_CHARACTERISTIC
 /begin REF_MEASUREMENT RPG_FFLeakgSetPoint RPG_FFLeakgSetPoint1to2Intp RPG_FFLeakgSetPoint2to3Intp RPG_PercgVolCtrlVlvFFLeakgMap1 RPG_PercgVolCtrlVlvFFLeakgMap2 RPG_PercgVolCtrlVlvFFLeakgMap3 /end REF_MEASUREMENT
/end GROUP
/begin GROUP S11_Rail_Pressure_PID_Controller "EcuIntgdSwGend/ControlSoftware/RailPGovr/Rail Pressure PID Controller" /begin SUB_GROUP S614_VCV_Opening_Percentage_PID_Controller /end SUB_GROUP
 /begin REF_CHARACTERISTIC RPG_CoeffDForPRailCtl_M RPG_CoeffFiltForPRailCtl_M RPG_CoeffIForPRailCtl_M RPG_CoeffPForPRailCtl_M RPG_FacSclPIDCoeff_P RPG_PIDCoeffDOvs_P RPG_PIDCoeffDOvv_P RPG_PIDCoeffFiltOvs_P RPG_PIDCoeffFiltOvv_P RPG_PIDCoeffIOvs_P RPG_PIDCoeffIOvv_P RPG_PIDCoeffPOvs_P RPG_PIDCoeffPOvv_P RPG_PIDMax_P RPG_PIDMin_P /end REF_CHARACTERISTIC
 /begin REF_MEASUREMENT RPG_CoeffDForPRailCtlMapOut RPG_CoeffFiltForPRailCtlMapOut RPG_CoeffIForPRailCtlMapOut RPG_CoeffPForPRailCtlMapOut RPG_ErrPRail RPG_PIDCoeffD RPG_PIDCoeffFilt RPG_PIDCoeffI RPG_PIDCoeffP /end REF_MEASUREMENT
/end GROUP
/begin GROUP S11_Rail_Pressure_Reference_Calculation "EcuIntgdSwGend/ControlSoftware/RailPGovr/Rail Pressure Reference Calculation"
 /begin SUB_GROUP S615_Debouncer S615_N_Map_Interpolation_for_Rail_Pressure_Reference /end SUB_GROUP
 /begin REF_CHARACTERISTIC EG_NmrSng0_C EG_TsSw_C RPG_NEngThdAcvnPRailCorr_P RPG_PAmbAirCorrForPRail_M RPG_PRailCorrPAmbAir_M RPG_PRailLimdHi_P RPG_PRailLimdLo_P RPG_PRailRefNotCorrdOvs_P RPG_TCorrForPRail_M RPG_TiDebAcvnPRailCorr_P RPG_bAcvTCorrForPRail_P /end REF_CHARACTERISTIC
 /begin REF_MEASUREMENT RPG_PRailCorrPAmbAir RPG_PRailRefNotCorrd RPG_PRailSetpointCorr RPG_TCorrForPRail RPG_bNEngThdAcvnPRail /end REF_MEASUREMENT
/end GROUP
/begin GROUP S11_VCV_Valve_Control "EcuIntgdSwGend/ControlSoftware/RailPGovr/VCV Valve Control"
 /begin REF_CHARACTERISTIC RPG_PercgLowrLim_P RPG_PercgUpprLim_P RPG_PercgVCVPwrOnCtlMod_P RPG_PercgVCVReqOvs_P RPG_PercgVCVReqOvv_P RPG_PercgVCVStpCtlMod_P /end REF_CHARACTERISTIC
 /begin REF_MEASUREMENT RPG_PercgVCVReq RPG_PercgVCVReqPreSat /end REF_MEASUREMENT
/end GROUP
/begin GROUP S12_Can_Message_and_Hardware_Check "EcuIntgdSwGend/ControlSoftware/SpdLimr/Can Message and Hardware Check"
 /begin REF_CHARACTERISTIC EG_VldInpSt_C SpdLimr_ActvCanOrDigInEva_P SpdLimr_ActvCanSpdLimrEnaSwt_C SpdLimr_ActvCanSpdLimrResuSwt_C SpdLimr_ActvCanSpdLimrSetSwt_C /end REF_CHARACTERISTIC
 /begin REF_MEASUREMENT SpdLimr_ActvSpdLimrDecBtn SpdLimr_ActvSpdLimrInctBtn SpdLimr_ActvSpdLimrOnOffBtn SpdLimr_ErrSpdLimrDecBtn SpdLimr_ErrSpdLimrInctBtn SpdLimr_ErrSpdLimrOnOffBtn /end REF_MEASUREMENT
/end GROUP
/begin GROUP S12_Engine_Brake_Activation_Via_Speed_Limiter "EcuIntgdSwGend/ControlSoftware/SpdLimr/Engine Brake Activation Via Speed Limiter"
 /begin SUB_GROUP S630_Engine_Brake_Level_1_Activation_Condition S630_Engine_Brake_Level_2_Activation_Condition /end SUB_GROUP
 /begin REF_CHARACTERISTIC SpdLimr_EngBrkLvl0_C SpdLimr_EngBrkLvl1Cfg_C SpdLimr_EngBrkLvl1_C SpdLimr_EngBrkLvl2Cfg_C SpdLimr_EngBrkLvl2_C /end REF_CHARACTERISTIC
 /begin REF_MEASUREMENT SpdLimr_EngBrkLvl /end REF_MEASUREMENT
/end GROUP
/begin GROUP S12_Speed_Limiter "EcuIntgdSwGend/ControlSoftware/SpdLimr/Speed Limiter"
 /begin REF_CHARACTERISTIC EG_TsSw_C SpdLimr_LongPsdTiThd_P SpdLimr_MaxTarSpd_P SpdLimr_MaxVehSpdHys_P SpdLimr_MaxVehSpd_P SpdLimr_MinTarSpd_P SpdLimr_ShoPsdTiThd_P SpdLimr_VehVLongPsd_P SpdLimr_VehVShoPsd_P /end REF_CHARACTERISTIC
 /begin REF_MEASUREMENT SpdLimr_ActvSpdLimr SpdLimr_ErrSpdLimrBtn SpdLimr_SpdLimrModSt SpdLimr_TarSpd SpdLimr_TarSpdPre /end REF_MEASUREMENT
/end GROUP
/begin GROUP S12_Speed_Limiter_PID "EcuIntgdSwGend/ControlSoftware/SpdLimr/Speed Limiter PID" /begin SUB_GROUP S632_SpeedLimiterPIDController /end SUB_GROUP
 /begin REF_CHARACTERISTIC SpdLimr_SpdLimrOnMaxSpd_C SpdLimr_SpdLimrOn_C SpdLimr_SpdLimrTq_P /end REF_CHARACTERISTIC
 /begin REF_MEASUREMENT SpdLimr_ErrVehVRef SpdLimr_SpdLimrTq /end REF_MEASUREMENT
/end GROUP
/begin GROUP S13_Enabling___Disabling_Starter "EcuIntgdSwGend/ControlSoftware/StrtrCtl/Enabling & Disabling Starter"
 /begin SUB_GROUP S645_Debouncer S645_Debouncer1 S645_Debouncer2 S645_SetRstLtch /end SUB_GROUP
 /begin REF_CHARACTERISTIC EG_NmrSng0_C EG_TsSw_C SC_NEngRunDeacThd_P SC_NEngStrtrInhThd_P SC_TiDebEngAlrdyRunngThd_P SC_TiDebNEngRunAcvn_P SC_TiDebNEngRunDeac_P /end REF_CHARACTERISTIC
 /begin REF_MEASUREMENT SC_NEngRunDeacThd SC_NEngStrtrInhThd SC_bAcvEngAlrdyRunng SC_bEnaAcvnStrtr /end REF_MEASUREMENT
/end GROUP
/begin GROUP S13_Maximum_Allowable_Cranking_Time_Calculation "EcuIntgdSwGend/ControlSoftware/StrtrCtl/Maximum Allowable Cranking Time Calculation" /begin SUB_GROUP S646_CompRstTmr S646_Neg_Edge /end SUB_GROUP
 /begin REF_CHARACTERISTIC SC_StUsrForAllwblCrnkg_P SC_TiMaxAllwblCrnkgOvs_P SC_TiMaxAllwblCrnkgOvv_P SC_TiMaxAllwblCrnkg_M SC_bAcvStrtrOvs_P SC_bAcvStrtrOvv_P /end REF_CHARACTERISTIC
 /begin REF_MEASUREMENT SC_TiMaxAllwblCrnkg SC_bAcvStrtr SC_bEnaAcvnStrtrTiEna /end REF_MEASUREMENT
/end GROUP
/begin GROUP S13_Start_Error_Detect_Algorithms_ "EcuIntgdSwGend/ControlSoftware/StrtrCtl/Start Error Detect Algorithms " /begin SUB_GROUP S647_Engine_Not_Turn S647_Engine_Over_Heating_Protection /end SUB_GROUP /begin REF_CHARACTERISTIC SC_bAcvDisStrtOvs_P SC_bAcvDisStrtOvv_P /end REF_CHARACTERISTIC /begin REF_MEASUREMENT SC_bAcvDisStrt /end REF_MEASUREMENT /end GROUP
/begin GROUP S13_StartInhibitor "EcuIntgdSwGend/ControlSoftware/StrtrCtl/StartInhibitor"
 /begin SUB_GROUP S648_Electrical_Failure_Dependent_Sensor_Inhibitor S648_Sensor_Inhibitor /end SUB_GROUP
 /begin REF_CHARACTERISTIC EG_bFlgFalse_C SC_bInhEngStrtOvs_P SC_bInhEngStrtOvv_P /end REF_CHARACTERISTIC
 /begin REF_MEASUREMENT SC_bInhEngStrt /end REF_MEASUREMENT
/end GROUP
/begin GROUP S13_Starter_Locking "EcuIntgdSwGend/ControlSoftware/StrtrCtl/Starter Locking" /begin SUB_GROUP S649_Debouncer S649_Neg_Edge S649_SetRstLtch /end SUB_GROUP
 /begin REF_CHARACTERISTIC EG_NmrSng0_C EG_TsSw_C SC_NEngAcvStrtLock_P SC_TiDebNEngAcvStrtLock_P SC_bAcvStrtrLockOvs_P SC_bAcvStrtrLockOvv_P /end REF_CHARACTERISTIC
 /begin REF_MEASUREMENT SC_NEngAcvStrtLock SC_bAcvStrtrLock /end REF_MEASUREMENT
/end GROUP
/begin GROUP S14_Desired_Torque_Calculation_CAN_Signals "EcuIntgdSwGend/ControlSoftware/TqCnvn/Desired Torque Calculation CAN Signals" /begin REF_CHARACTERISTIC EG_NmrSng100_C TrC_FuQntyToTq_M /end REF_CHARACTERISTIC
 /begin REF_MEASUREMENT TrC_ActEngPercTq TrC_ActEngTq TrC_EngDmdPercTq TrC_EngDmdTq /end REF_MEASUREMENT
/end GROUP
/begin GROUP S14_Main_Quantity_Correction "EcuIntgdSwGend/ControlSoftware/TqCnvn/Main Quantity Correction"
 /begin REF_CHARACTERISTIC TrC_MaiFuPAmbAirCorr_M TrC_MaiFuTAirBoostCorr_M TrC_MaiFuTAmbAirCorr_M TrC_MaiFuTCooltCorr_M TrC_MaiFuTOilCorr_M TrC_MaiFuUClmp30Corr_M /end REF_CHARACTERISTIC
 /begin REF_MEASUREMENT TrC_MMaiFuQntyCorrPAmbAir TrC_MMaiFuQntyCorrTAirBoost TrC_MMaiFuQntyCorrTAmbAir TrC_MMaiFuQntyCorrTCoolt TrC_MMaiFuQntyCorrTOil TrC_MMaiFuQntyCorrUClmp30 TrC_MMaiFuQntyCorrd /end REF_MEASUREMENT
/end GROUP
/begin GROUP S679_Main_Quantity_Correction "EcuIntgdSwGend/ControlSoftware/TqCnvn/Torque Conversion For SPN  2432 - Engine Demand Torque/Main Quantity Correction"
 /begin REF_CHARACTERISTIC TrC_MaiFuPAmbAirCorr_M TrC_MaiFuTAirBoostCorr_M TrC_MaiFuTAmbAirCorr_M TrC_MaiFuTCooltCorr_M TrC_MaiFuTOilCorr_M TrC_MaiFuUClmp30Corr_M /end REF_CHARACTERISTIC
/end GROUP
/end MODULE
/end PROJECT
